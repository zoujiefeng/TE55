AUTOSAR XML (schema 4-2-2)
# Copyright (C) Infineon Technologies (2020)
# All rights reserved.
package /AUTOSAR_Can_17_McmCan/BswModuleDescriptions
  bsw module description Can: category=BSW_MODULE, module-id=80  # CAN Driver
    provided-entrys:
      Can_Init
      Can_SetControllerMode
      Can_DisableControllerInterrupts
      Can_EnableControllerInterrupts
      Can_Write
      Can_MainFunction_Write
      Can_MainFunction_Mode
      Can_MainFunction_Read
      Can_MainFunction_BusOff
      Can_MainFunction_Wakeup
      Can_IsrTransmitHandler
      Can_IsrReceiveHandler
      Can_IsrRxFIFOHandler
      Can_IsrBusOffHandler
    bsw module dependency DetDependency: target-module-id=15, required-entrys=Det_ReportError
    bsw module dependency CanIfDependency: target-module-id=60, required-entrys=[CanIf_RxIndication, CanIf_ControllerBusOff, CanIf_TxConfirmation, CanIf_CurrentIcomConfiguration]
    bsw module dependency McalLibDependency: target-module-id=255, required-entrys=[Mcal_GetCpuIndex, Mcal_WritePeripEndInitProtReg, Mcal_GetBitAtomic, Mcal_SetBitAtomic]
    bsw internal behavior CanBehavior
      exclusive area CanIntCtrl
      exclusive area IcomMsgCntrVal
      exclusive area CanWrMO
      4 x bsw called entity:
        Can_Init: reentrancy-level=NON-REENTRANT, implemented-entry=Can_Init
        Can_DisableControllerInterrupts: can-enter-exclusive-area=CanIntCtrl, reentrancy-level=MULTICORE-REENTRANT, runs-inside-exclusive-area=CanIntCtrl, implemented-entry=Can_DisableControllerInterrupts
        Can_EnableControllerInterrupts: can-enter-exclusive-area=CanIntCtrl, reentrancy-level=MULTICORE-REENTRANT, runs-inside-exclusive-area=CanIntCtrl, implemented-entry=Can_EnableControllerInterrupts
        Can_Write: can-enter-exclusive-area=CanWrMO, reentrancy-level=MULTICORE-REENTRANT, runs-inside-exclusive-area=CanWrMO, implemented-entry=Can_Write
      bsw schedulable entity Can_MainFunction_Write: minimum-start-interval=0.005, reentrancy-level=NON-REENTRANT, implemented-entry=Can_MainFunction_Write
      4 x bsw interrupt entity, all with reentrancy-level=MULTICORE-REENTRANT:
        Can_IsrTransmitHandler: implemented-entry=Can_IsrTransmitHandler
        Can_IsrReceiveHandler: can-enter-exclusive-area=IcomMsgCntrVal, implemented-entry=Can_IsrReceiveHandler
        Can_IsrRxFIFOHandler: can-enter-exclusive-area=IcomMsgCntrVal, implemented-entry=Can_IsrRxFIFOHandler
        Can_IsrBusOffHandler: implemented-entry=Can_IsrBusOffHandler
      4 x bsw schedulable entity, all with minimum-start-interval=0.005, reentrancy-level=NON-REENTRANT:
        Can_MainFunction_Read: can-enter-exclusive-area=IcomMsgCntrVal, implemented-entry=Can_MainFunction_Read
        Can_MainFunction_BusOff: implemented-entry=Can_MainFunction_BusOff
        Can_MainFunction_Wakeup: can-enter-exclusive-area=IcomMsgCntrVal, implemented-entry=Can_MainFunction_Wakeup
        Can_MainFunction_Mode: implemented-entry=Can_MainFunction_Mode
      bsw called entity Can_SetControllerMode: can-enter-exclusive-area=[CanIntCtrl, IcomMsgCntrVal], reentrancy-level=NON-REENTRANT, implemented-entry=Can_SetControllerMode
      5 x bsw timing event:
        TimingEvent_Can_17_McmCan_MainFunction_Mode: starts-on-event=Can_MainFunction_Mode, period=0.001
        TimingEvent_Can_17_McmCan_MainFunction_BusOff: starts-on-event=Can_MainFunction_BusOff, period=0.001
        TimingEvent_Can_17_McmCan_MainFunction_Wakeup: starts-on-event=Can_MainFunction_Wakeup, period=0.005
        TimingEvent_Can_17_McmCan_MainFunction_Read: starts-on-event=Can_MainFunction_Read, period=0.001
        TimingEvent_Can_17_McmCan_MainFunction_Write: starts-on-event=Can_MainFunction_Write, period=0.001
package /AUTOSAR_Can_17_McmCan/BswModuleEntrys
  14 x bsw module entry, all with is-synchronous=true, sw-service-impl-policy=STANDARD:
    Can_Init: service-id=0, is-reentrant=false, call-type=REGULAR, execution-context=TASK
      sw service arg Config: category=DATA_REFERENCE, sw-pointer-target-props={target-category=TYPE_REFERENCE, implementation-data-type=Can_17_McmCan_ConfigType}
    Can_SetControllerMode: service-id=3, is-reentrant=false, call-type=REGULAR, execution-context=TASK
      return type Return: implementation-data-type=Can_ReturnType
      sw service arg Controller: implementation-data-type=uint8
      sw service arg Transition: implementation-data-type=Can_StateTransitionType
    Can_DisableControllerInterrupts: service-id=4, is-reentrant=true, call-type=REGULAR, execution-context=TASK
      sw service arg Controller: implementation-data-type=uint8
    Can_EnableControllerInterrupts: service-id=5, is-reentrant=true, call-type=REGULAR, execution-context=TASK
      sw service arg Controller: implementation-data-type=uint8
    Can_Write: service-id=6, is-reentrant=true, call-type=REGULAR, execution-context=TASK
      return type Return: implementation-data-type=Can_ReturnType
      sw service arg Hth: implementation-data-type=Can_HwHandleType
      sw service arg PduInfo: category=DATA_REFERENCE, sw-pointer-target-props={target-category=TYPE_REFERENCE, implementation-data-type=Can_PduType}
    Can_MainFunction_Wakeup: service-id=10, is-reentrant=false, call-type=SCHEDULED, execution-context=TASK
    Can_MainFunction_BusOff: service-id=9, is-reentrant=false, call-type=SCHEDULED, execution-context=TASK
    Can_MainFunction_Mode: service-id=12, is-reentrant=false, call-type=SCHEDULED, execution-context=TASK
    Can_MainFunction_Read: service-id=8, is-reentrant=false, call-type=SCHEDULED, execution-context=TASK
    Can_MainFunction_Write: service-id=1, is-reentrant=false, call-type=SCHEDULED, execution-context=TASK
    Can_IsrTransmitHandler: role=Can_IsrTransmitHandler, is-reentrant=true, call-type=INTERRUPT, execution-context=INTERRUPT-CAT-1
      sw service arg HwKernelId: implementation-data-type=uint8
      sw service arg NodeIdIndex: implementation-data-type=uint8
    Can_IsrReceiveHandler: role=Can_IsrReceiveHandler, is-reentrant=true, call-type=INTERRUPT, execution-context=INTERRUPT-CAT-1
      sw service arg HwKernelId: implementation-data-type=uint8
      sw service arg NodeIdIndex: implementation-data-type=uint8
    Can_IsrRxFIFOHandler: role=Can_IsrRxFIFOHandler, is-reentrant=true, call-type=INTERRUPT, execution-context=INTERRUPT-CAT-1
      sw service arg HwKernelId: implementation-data-type=uint8
      sw service arg NodeIdIndex: implementation-data-type=uint8
    Can_IsrBusOffHandler: role=Can_IsrBusOffHandler, is-reentrant=true, call-type=INTERRUPT, execution-context=INTERRUPT-CAT-1
      sw service arg HwKernelId: implementation-data-type=uint8
      sw service arg NodeIdIndex: implementation-data-type=uint8
package /AUTOSAR_Can_17_McmCan/Implementations
  bsw implementation Can: programming-language=C, sw-version=10.40.2, vendor-id=17, ar-release-version=4.2.2, behavior=CanBehavior, vendor-api-infix=McmCan, vendor-specific-module-def=Can
    code-descriptors:
      code Files
        artifact-descriptors:
          short-label=ssc::inc::Can_17_McmCan.h, category=SWHDR
          short-label=ssc::src::Can_17_McmCan.c, category=SWSRC
    generated-artifacts:
      6 x dependency on artifact:
        Can_Cfg_h: artifact-descriptor={short-label=generate::inc:Can_17_McmCan_Cfg.h, category=SWTEMPLATE}, usages=COMPILE
        Can_PBcfg_h: artifact-descriptor={short-label=generate::template::inc::Can_17_McmCan_PBcfg.h, category=SWTEMPLATE}, usages=EXECUTE
        Can_PBCfg_c: artifact-descriptor={short-label=generate::src::Can_17_McmCan_PBcfg.c, category=SWTEMPLATE}, usages=EXECUTE
        Can_Externals_h: artifact-descriptor={short-label=generate::template::inc::Can_17_McmCan_Externals.h, category=SWTEMPLATE}, usages=EXECUTE
        Can_xdm: artifact-descriptor={short-label=config::Can_17_McmCan.xdm, category=SWTOOL}, usages=CODEGENERATION
        Can_bmd: artifact-descriptor={short-label=autosar::TC38x::TC387x::Can_17_McmCan.bmd, category=SWTOOL}, usages=CODEGENERATION
    resource consumption ResourceConsumption
      7 x memory section, all with alignment=UNSPECIFIED:
        VAR_CLEARED_QM_CORE0_UNSPECIFIED: sw-addrmethod=VAR_CLEARED
        VAR_CLEARED_QM_GLOBAL_UNSPECIFIED: sw-addrmethod=VAR_CLEARED
        CONST_QM_GLOBAL_UNSPECIFIED: sw-addrmethod=CONST
        CONST_QM_CORE0_UNSPECIFIED: sw-addrmethod=CONST
        CONFIG_DATA_QM_GLOBAL_UNSPECIFIED: sw-addrmethod=CONFIG_DATA
        CONFIG_DATA_QM_CORE0_UNSPECIFIED: sw-addrmethod=CONFIG_DATA
        CODE_QM_GLOBAL: sw-addrmethod=CODE
      section name prefix CAN_17_MCMCAN
package /AUTOSAR_Can_17_McmCan/ImplementationDataTypes
  25 x impl type, all with type-emitter=BSW:
    Can_17_McmCan_LPduRxCalloutFnPtrType: category=FUNCTION_REFERENCE, sw-pointer-target-props=Can_LpduCallout
    Can_17_McmCan_IcomSignalOperType: compu {0=CAN_17_MCMCAN_ICOM_OPER_AND, 1=CAN_17_MCMCAN_ICOM_OPER_EQUAL, 2=CAN_17_MCMCAN_ICOM_OPER_GREATER, 3=CAN_17_MCMCAN_ICOM_OPER_SMALLER, 4=CAN_17_MCMCAN_ICOM_OPER_XOR}, implementation-data-type=uint32, additional-native-type-qualifier=enum
    Can_17_McmCan_TxBufferType: compu {0=CAN_17_MCMCAN_TX_DED_BUFFER, 1=CAN_17_MCMCAN_TX_QUEUE}, implementation-data-type=uint32, additional-native-type-qualifier=enum
    Can_17_McmCan_ConfigType: category=STRUCTURE
      11 x element:
        CanCoreConfigPtr: category=DATA_REFERENCE, array-size=4, array-size-semantics=FIXED-SIZE, sw-pointer-target-props={target-category=TYPE_REFERENCE, implementation-data-type=Can_17_McmCan_CoreConfigType}
        CanLPduRxCalloutFuncPtr: implementation-data-type=Can_17_McmCan_LPduRxCalloutFnPtrType
        CanNoOfKernel: implementation-data-type=uint8
        CanNoOfHrh: implementation-data-type=uint8
        CanMCMModuleConfigPtr: implementation-data-type=Can_17_McmCan_MCMModuleConfigType
        Can_PhyControllerIndexPtr: implementation-data-type=Can_17_McmCan_PhyControllerIndexType
        Can_LogicalControllerIndexPtr: implementation-data-type=Can_17_McmCan_LogicalControllerIndexType
        CanHthIndexPtr: implementation-data-type=Can_17_McmCan_HthIndexType
        CanIcomConfigPtr: implementation-data-type=Can_17_McmCan_IcomConfigType
        CanIcomMsgConfigPtr: implementation-data-type=Can_17_McmCan_IcomRxMsgConfigType
        CanIcomRxSignalConfigPtr: implementation-data-type=Can_17_McmCan_IcomRxMsgSignalConfigType
    Can_17_McmCan_ControllerBaudrateConfigType: category=STRUCTURE
      4 x element, all with category=TYPE_REFERENCE:
        CanBaudrateCfg: implementation-data-type=uint16
        CanControllerBaudrate: implementation-data-type=uint32
        CanFDIndex: implementation-data-type=uint16
        CanFdConfigEnabled: implementation-data-type=boolean
    Can_17_McmCan_ControllerConfigType: category=STRUCTURE
      10 x element, all with category=TYPE_REFERENCE:
        CanNPCRValue: implementation-data-type=uint32
        CanNodeAddress: implementation-data-type=uint32
        CanControllerMOMap: array-size=6, array-size-semantics=FIXED-SIZE, implementation-data-type=uint16
        CanControllerLogicalId: implementation-data-type=uint8
        CanBaudrateCfgIndx: implementation-data-type=uint16
        CanNoOfBaudrateCfg: implementation-data-type=uint16
        CanKernelHwId: implementation-data-type=uint8
        CanControllerHwId: implementation-data-type=uint8
        CanDefaultBaudrateCfgIndx: implementation-data-type=uint16
        CanFDSupport: implementation-data-type=boolean
    Can_17_McmCan_ControllerFDBaudrateConfigType: category=STRUCTURE
      element CanControllerFDBaudrate: implementation-data-type=uint32
      element CanTrcvDelyComp: implementation-data-type=uint32
      element CanTxBRSEnable: implementation-data-type=boolean
    Can_17_McmCan_ControllerMsgRAMConfigType: category=STRUCTURE
      9 x element, all with category=TYPE_REFERENCE:
        CanControllerMsgRAMMap: array-size=7, array-size-semantics=FIXED-SIZE, implementation-data-type=uint32
        CanRxFIFO0Size: implementation-data-type=uint8
        CanTxDedBuffCount: implementation-data-type=uint8
        CanTxEvntFIFOSize: implementation-data-type=uint8
        CanTxQueueSize: implementation-data-type=uint8
        CanTxQueueStatus: implementation-data-type=boolean
        CanRxFIFO0Threshold: implementation-data-type=uint8
        CanRxFIFO1Size: implementation-data-type=uint8
        CanRxFIFO1Threshold: implementation-data-type=uint8
    Can_17_McmCan_CoreConfigType: category=STRUCTURE
      16 x element:
        CanNoOfController: implementation-data-type=uint8
        CanControllerMsgRAMMapConfigPtr: category=DATA_REFERENCE, sw-pointer-target-props={target-category=TYPE_REFERENCE, implementation-data-type=Can_17_McmCan_ControllerMsgRAMConfigType}
        ControllerIndexingPtr: implementation-data-type=uint8
        CanControllerConfigPtr: implementation-data-type=Can_17_McmCan_ControllerConfigType
        CanEventHandlingConfigPtr: implementation-data-type=Can_17_McmCan_EventHandlingType
        CanBaudrateConfigPtr: implementation-data-type=Can_17_McmCan_ControllerBaudrateConfigType
        Can_HthPeriodIndexPtr: implementation-data-type=uint8
        CanFDConfigParamPtr: implementation-data-type=Can_17_McmCan_ControllerFDBaudrateConfigType
        CanHthMaskObjectConfigPtr: implementation-data-type=Can_17_McmCan_HthMaskObjectConfigType
        CanPeriodHthMaskConfigPtr: implementation-data-type=Can_17_McmCan_PeriodHthMaskConfigType
        Can_HrhPeriodIndexPtr: implementation-data-type=uint8
        CanHrhMaskObjectConfigPtr: implementation-data-type=Can_17_McmCan_HrhMaskObjectConfigType
        CanPeriodHrhMaskConfigPtr: implementation-data-type=Can_17_McmCan_PeriodHrhMaskConfigType
        CanTxHwObjectConfigPtr: implementation-data-type=Can_17_McmCan_TxHwObjectConfigType
        CanSIDFilterConfigPtr: implementation-data-type=Can_17_McmCan_SIDFilterConfigType
        CanXIDFilterConfigPtr: implementation-data-type=Can_17_McmCan_XIDFilterConfigType
    Can_17_McmCan_EventHandlingType: category=STRUCTURE
      element CanEventType: implementation-data-type=uint8
    Can_17_McmCan_HrhMaskObjectConfigType: category=STRUCTURE
      5 x element, all with category=TYPE_REFERENCE:
        CanPerRxbufferMaskvalue_0: implementation-data-type=uint32
        CanPerRxbufferMaskvalue_1: implementation-data-type=uint32
        CanPerHwObjId: implementation-data-type=Can_HwHandleType
        HwControllerId: implementation-data-type=uint8
        CanPerBufferType: implementation-data-type=Can_17_McmCan_RxBufferType
    Can_17_McmCan_HthIndexType: category=STRUCTURE
      element CanHthCoreAssigned: implementation-data-type=uint8
      element CanHthLogicalContIndex: implementation-data-type=uint8
      element CanHthHthCoreSpecIndex: implementation-data-type=uint16
    Can_17_McmCan_HthMaskObjectConfigType: category=STRUCTURE
      element CanTxBufferMaskvalue: implementation-data-type=uint32
      element CanPerHthHwObjId: implementation-data-type=Can_HwHandleType
      element HwControllerId: implementation-data-type=uint8
    Can_17_McmCan_IcomConfigType: category=STRUCTURE
      element CanIcomFirstMsgIndx: implementation-data-type=uint16
      element CanIcomNoOfMsgIndx: implementation-data-type=uint16
      element CanIcomWakeOnBusOff: implementation-data-type=boolean
    Can_17_McmCan_IcomRxMsgConfigType: category=STRUCTURE
      7 x element, all with category=TYPE_REFERENCE:
        CanIcomMsgId: implementation-data-type=Can_IdType
        CanIcomMaskRef: implementation-data-type=Can_IdType
        CanIcomCntrVal: implementation-data-type=uint16
        CanIcomDLC: implementation-data-type=uint8
        CanIcomFirstSignalIndx: implementation-data-type=uint8
        CanIcomNoOfSignalIndx: implementation-data-type=uint8
        CanIcomLengthErr: implementation-data-type=boolean
    Can_17_McmCan_IcomRxMsgSignalConfigType: category=STRUCTURE
      element CanIcomSignalMask: array-size=8, array-size-semantics=FIXED-SIZE, implementation-data-type=uint8
      element CanIcomSignalValue: array-size=8, array-size-semantics=FIXED-SIZE, implementation-data-type=uint8
      element CanIcomSignalOper: implementation-data-type=Can_17_McmCan_IcomSignalOperType
    Can_17_McmCan_LogicalControllerIndexType: category=STRUCTURE
      4 x element, all with category=TYPE_REFERENCE, implementation-data-type=uint8:
        CanLCoreAssigned
        CanLContCoreSpecIndex
        CanLContPhyIndex
        CanLKerPhyIndex
    Can_17_McmCan_MCMModuleConfigType: category=STRUCTURE
      element CanBaseAddress: implementation-data-type=uint32
      element CanNodeUsed: array-size=4, array-size-semantics=FIXED-SIZE, implementation-data-type=boolean
    Can_17_McmCan_PeriodHrhMaskConfigType: category=STRUCTURE
      element CanPerHrhStartIndx: implementation-data-type=uint8
      element CanPerHrhEndIndx: implementation-data-type=uint8
    Can_17_McmCan_PeriodHthMaskConfigType: category=STRUCTURE
      element CanPerHthStartIndx: implementation-data-type=uint8
      element CanPerHthEndIndx: implementation-data-type=uint8
    Can_17_McmCan_PhyControllerIndexType: category=STRUCTURE
      element CanPLogicalControllerIndex: implementation-data-type=uint8
      element CanPContCoreSpecIndex: implementation-data-type=uint8
      element CanPCoreAssigned: implementation-data-type=uint8
    Can_17_McmCan_RxBufferType: compu {0=CAN_17_MCMCAN_RX_DED_BUFFER, 1=CAN_17_MCMCAN_RX_FIFO0, 2=CAN_17_MCMCAN_RX_FIFO1}, implementation-data-type=uint32, additional-native-type-qualifier=enum
    Can_17_McmCan_SIDFilterConfigType: category=STRUCTURE
      5 x element, all with category=TYPE_REFERENCE:
        CanSIDFilterElementS0: implementation-data-type=uint32
        CanHwObjId: implementation-data-type=Can_HwHandleType
        HwControllerId: implementation-data-type=uint8
        CanSIDBufferType: implementation-data-type=Can_17_McmCan_RxBufferType
        CanSIDPretendedSupport: implementation-data-type=boolean
    Can_17_McmCan_TxHwObjectConfigType: category=STRUCTURE
      7 x element, all with category=TYPE_REFERENCE:
        CanHwObjId: implementation-data-type=Can_HwHandleType
        CanBuffIndx: implementation-data-type=uint8
        HwControllerId: implementation-data-type=uint8
        CanFdPaddValue: implementation-data-type=uint8
        CanHwObjIdType: implementation-data-type=uint8
        CanTxBufferType: implementation-data-type=Can_17_McmCan_TxBufferType
        CanTriggerTransmitStatus: implementation-data-type=boolean
    Can_17_McmCan_XIDFilterConfigType: category=STRUCTURE
      6 x element, all with category=TYPE_REFERENCE:
        CanXIDFilterElementF0: implementation-data-type=uint32
        CanXIDFilterElementF1: implementation-data-type=uint32
        CanHwObjId: implementation-data-type=Can_HwHandleType
        HwControllerId: implementation-data-type=uint8
        CanXIDBufferType: implementation-data-type=Can_17_McmCan_RxBufferType
        CanXIDPretendedSupport: implementation-data-type=boolean
