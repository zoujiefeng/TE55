AUTOSAR XML (schema 4-2-2)
# Copyright (C) Infineon Technologies (2020)
# All rights reserved.
package /AUTOSAR_Icu_17_TimerIp/BswModuleDescriptions
  bsw module description Icu: category=BSW_MODULE, module-id=122  # ICU Driver
    provided-entrys:
      Icu_Init
      Icu_SetActivationCondition
      Icu_DisableEdgeDetection
      Icu_EnableEdgeDetection
      Icu_DisableNotification
      Icu_EnableNotification
      Icu_StartSignalMeasurement
      Icu_StopSignalMeasurement
      Icu_GetDutyCycleValues
      Icu_Timer_Isr
      Icu_EnableMultiEdgeDetection
    bsw module dependency McuDependency: target-module-id=101
      required-entrys:
        Mcu_17_Gpt12_TimerClockInit
        Mcu_17_Gtm_TimChannelDeInit
        Mcu_17_Ccu6_TimerDeInit
        Mcu_17_Gpt12_TimerDeInit
        Mcu_17_Ccu6_TimerStop
        Mcu_17_Gtm_ConnectPortPinToTim
        Mcu_17_Gtm_TimChannelInit
        Mcu_17_Ccu6_TimerInit
        Mcu_17_Ccu6_TimerShadowTransfer
        Mcu_17_Ccu6_TimerStart
        Mcu_17_Gpt12_TimerInit
    bsw module dependency McalLibDependency: target-module-id=255, required-entrys=[Mcal_WriteSafetyEndInitProtRegMask, Mcal_GetCpuIndex, Mcal_GetBitAtomic, Mcal_SetBitAtomic]
    bsw internal behavior IcuBehavior
      exclusive area GtmGetDutyCycle
      exclusive area SetActivationCondition
      10 x bsw called entity:
        Icu_Init: reentrancy-level=NON-REENTRANT, implemented-entry=Icu_Init
        Icu_SetActivationCondition: can-enter-exclusive-area=SetActivationCondition, reentrancy-level=MULTICORE-REENTRANT, implemented-entry=Icu_SetActivationCondition
        Icu_DisableEdgeDetection: reentrancy-level=MULTICORE-REENTRANT, implemented-entry=Icu_DisableEdgeDetection
        Icu_EnableEdgeDetection: reentrancy-level=MULTICORE-REENTRANT, implemented-entry=Icu_EnableEdgeDetection
        Icu_DisableNotification: reentrancy-level=MULTICORE-REENTRANT, implemented-entry=Icu_DisableNotification
        Icu_EnableNotification: reentrancy-level=MULTICORE-REENTRANT, implemented-entry=Icu_EnableNotification
        Icu_StartSignalMeasurement: reentrancy-level=MULTICORE-REENTRANT, implemented-entry=Icu_StartSignalMeasurement
        Icu_StopSignalMeasurement: reentrancy-level=MULTICORE-REENTRANT, implemented-entry=Icu_StopSignalMeasurement
        Icu_GetDutyCycleValues: can-enter-exclusive-area=GtmGetDutyCycle, reentrancy-level=MULTICORE-REENTRANT, implemented-entry=Icu_GetDutyCycleValues
        Icu_EnableMultiEdgeDetection: reentrancy-level=MULTICORE-REENTRANT, implemented-entry=Icu_EnableMultiEdgeDetection
      bsw interrupt entity Icu_Timer_Isr: reentrancy-level=MULTICORE-REENTRANT, implemented-entry=Icu_Timer_Isr
package /AUTOSAR_Icu_17_TimerIp/BswModuleEntrys
  11 x bsw module entry, all with sw-service-impl-policy=STANDARD:
    Icu_Init: service-id=0, is-reentrant=false, is-synchronous=true, call-type=REGULAR, execution-context=TASK
      sw service arg ConfigPtr: category=DATA_REFERENCE, sw-pointer-target-props={target-category=TYPE_REFERENCE, implementation-data-type=Icu_17_TimerIp_ConfigType}
    Icu_SetActivationCondition: service-id=5, is-reentrant=true, is-synchronous=true, call-type=REGULAR, execution-context=TASK
      sw service arg Channel: implementation-data-type=Icu_17_TimerIp_ChannelType
      sw service arg Activation: implementation-data-type=Icu_17_TimerIp_ActivationType
    Icu_DisableEdgeDetection: service-id=23, is-reentrant=true, is-synchronous=true, call-type=REGULAR, execution-context=TASK
      sw service arg Channel: implementation-data-type=Icu_17_TimerIp_ChannelType
    Icu_EnableEdgeDetection: service-id=22, is-reentrant=true, is-synchronous=true, call-type=REGULAR, execution-context=TASK
      sw service arg Channel: implementation-data-type=Icu_17_TimerIp_ChannelType
    Icu_DisableNotification: service-id=6, is-reentrant=true, is-synchronous=true, call-type=REGULAR, execution-context=TASK
      sw service arg Channel: implementation-data-type=Icu_17_TimerIp_ChannelType
    Icu_EnableNotification: service-id=7, is-reentrant=true, is-synchronous=true, call-type=REGULAR, execution-context=TASK
      sw service arg Channel: implementation-data-type=Icu_17_TimerIp_ChannelType
    Icu_StartSignalMeasurement: service-id=19, is-reentrant=true, is-synchronous=false, call-type=REGULAR, execution-context=TASK
      sw service arg Channel: implementation-data-type=Icu_17_TimerIp_ChannelType
    Icu_StopSignalMeasurement: service-id=20, is-reentrant=true, is-synchronous=true, call-type=REGULAR, execution-context=TASK
      sw service arg Channel: implementation-data-type=Icu_17_TimerIp_ChannelType
    Icu_GetDutyCycleValues: service-id=17, is-reentrant=true, is-synchronous=true, call-type=REGULAR, execution-context=TASK
      sw service arg Channel: implementation-data-type=Icu_17_TimerIp_ChannelType
      sw service arg DutyCycleValues: category=DATA_REFERENCE, sw-pointer-target-props={target-category=TYPE_REFERENCE, implementation-data-type=Icu_17_TimerIp_DutyCycleType}
    Icu_Timer_Isr: service-id=32, is-reentrant=true, is-synchronous=true, call-type=CALLBACK, execution-context=INTERRUPT-CAT-1
      sw service arg Channel: implementation-data-type=uint8
    Icu_EnableMultiEdgeDetection: service-id=25, is-reentrant=true, is-synchronous=true, call-type=REGULAR, execution-context=TASK
      sw service arg Channel: implementation-data-type=Icu_17_TimerIp_ChannelType
      sw service arg EdgeCount: implementation-data-type=uint32
package /AUTOSAR_Icu_17_TimerIp/Implementations
  bsw implementation Icu: programming-language=C, sw-version=10.40.1, vendor-id=17, ar-release-version=4.2.2, behavior=IcuBehavior, vendor-api-infix=TimerIp, vendor-specific-module-def=Icu
    code-descriptors:
      code Files
        artifact-descriptors:
          short-label=ssc::src::Icu_17_TimerIp.c, category=SWSRC
          short-label=ssc::inc::Icu_17_TimerIp.h, category=SWHDR
          short-label=ssc::inc::Icu_17_TimerIp_Local.h, category=SWHDR
          short-label=ssc::inc::Icu_17_TimerIp_Cbk.h, category=SWHDR
    generated-artifacts:
      5 x dependency on artifact:
        Icu_PBcfg_c: artifact-descriptor={short-label=generate::template::src::Icu_17_TimerIp_PBcfg.c, category=SWTEMPLATE}, usages=EXECUTE
        Icu_PBcfg_h: artifact-descriptor={short-label=generate::template::inc::Icu_17_TimerIp_PBcfg.h, category=SWTEMPLATE}, usages=EXECUTE
        Icu_Cfg_h: artifact-descriptor={short-label=generate::template::inc::Icu_17_TimerIp_Cfg.h, category=SWTEMPLATE}, usages=COMPILE
        Icu_xdm: artifact-descriptor={short-label=config::Icu_17_TimerIp.xdm, category=SWTOOL}, usages=CODEGENERATION
        Icu_bmd: artifact-descriptor={short-label=autosar::TC38x::TC387x::Icu_17_TimerIp.bmd, category=SWTOOL}, usages=CODEGENERATION
    resource consumption ResourceConsumption
      7 x memory section:
        VAR_CLEARED_ASIL_B_CORE0_32: alignment=32, sw-addrmethod=VAR_CLEARED
        CONFIG_DATA_ASIL_B_CORE0_UNSPECIFIED: alignment=UNSPECIFIED, sw-addrmethod=CONFIG_DATA
        VAR_INIT_ASIL_B_CORE0_32: alignment=32, sw-addrmethod=VAR_INIT
        CONST_ASIL_B_GLOBAL_32: alignment=32, sw-addrmethod=CONST
        VAR_CLEARED_ASIL_B_GLOBAL_32: alignment=32, sw-addrmethod=VAR_CLEARED
        CONFIG_DATA_ASIL_B_GLOBAL_UNSPECIFIED: alignment=UNSPECIFIED, sw-addrmethod=CONFIG_DATA
        CODE_ASIL_B_GLOBAL: alignment=UNSPECIFIED, sw-addrmethod=CODE
      section name prefix ICU_17_TIMERIP
package /AUTOSAR_Icu_17_TimerIp/ImplementationDataTypes
  8 x impl type, all with type-emitter=BSW:
    Icu_17_TimerIp_NotifiPtrType: category=FUNCTION_REFERENCE, sw-pointer-target-props=IoHwAb_IcuNotification
    Icu_17_TimerIp_ChannelType: implementation-data-type=uint8
    Icu_17_TimerIp_ActivationType: compu {0=ICU_17_TIMERIP_RISING_EDGE, 1=ICU_17_TIMERIP_FALLING_EDGE, 2=ICU_17_TIMERIP_BOTH_EDGES, 3=ICU_17_TIMERIP_NO_EDGE}, implementation-data-type=sint32, additional-native-type-qualifier=enum
    Icu_17_TimerIp_ValueType: implementation-data-type=uint32
    Icu_17_TimerIp_DutyCycleType: category=STRUCTURE
      element ActiveTime: implementation-data-type=Icu_17_TimerIp_ValueType
      element PeriodTime: implementation-data-type=Icu_17_TimerIp_ValueType
    Icu_17_TimerIp_ConfigType: category=STRUCTURE
      element EruChannelMap: array-size=8, array-size-semantics=FIXED-SIZE, implementation-data-type=uint16
      element CoreConfig: category=DATA_REFERENCE, array-size=6, array-size-semantics=FIXED-SIZE, sw-pointer-target-props={target-category=TYPE_REFERENCE, implementation-data-type=Icu_17_TimerIp_CoreConfigType}
      element ChannelMapping: array-size=19, array-size-semantics=FIXED-SIZE, implementation-data-type=uint16
    Icu_17_TimerIp_ChannelConfigType: category=STRUCTURE
      21 x element, all with category=TYPE_REFERENCE:
        NotificationPointer: implementation-data-type=Icu_17_TimerIp_NotifiPtrType
        MeasurementMode: sw-bit-representation=number-of-bits=3, implementation-data-type=unsigned_int
        DefaultStartEdge: sw-bit-representation=number-of-bits=2, implementation-data-type=unsigned_int
        MeasurementProperty: sw-bit-representation=number-of-bits=2, implementation-data-type=unsigned_int
        WakeupCapability: sw-bit-representation=number-of-bits=2, implementation-data-type=unsigned_int
        AssignedHwUnitNumber: sw-bit-representation=number-of-bits=16, implementation-data-type=unsigned_int
        AssignedHwUnit: sw-bit-representation=number-of-bits=2, implementation-data-type=unsigned_int
        PinSelection: sw-bit-representation=number-of-bits=4, implementation-data-type=unsigned_int
        Reserved: sw-bit-representation=number-of-bits=1, implementation-data-type=unsigned_int
        TimChFilterTimeForRisingEdge: implementation-data-type=uint32
        TimChFilterTimeForFallingEdge: implementation-data-type=uint32
        InterruptMode: implementation-data-type=uint8
        TimChannelClockSelect: implementation-data-type=uint8
        TimChannelGpr0InputSelect: implementation-data-type=uint8
        TimChannelFilterEnable: implementation-data-type=uint8
        TimChFilterCounterFreqSelect: implementation-data-type=uint8
        TimChFilterModeForRisingEdge: implementation-data-type=uint8
        ModeMappingIndex: implementation-data-type=uint8
        TimChFilterModeForFallingEdge: implementation-data-type=uint8
        OverflowISRThreshold: implementation-data-type=uint32
        TimChannelInputSelect: implementation-data-type=uint8
    Icu_17_TimerIp_CoreConfigType: category=STRUCTURE
      element MaxChannelCore: implementation-data-type=Icu_17_TimerIp_ChannelType
      element ChannelConfigPtr: category=DATA_REFERENCE, sw-pointer-target-props={target-category=TYPE_REFERENCE, implementation-data-type=Icu_17_TimerIp_ChannelConfigType}
      element MaxDataChannelCore: implementation-data-type=Icu_17_TimerIp_ChannelType
