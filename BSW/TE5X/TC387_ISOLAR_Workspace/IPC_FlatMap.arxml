AUTOSAR XML (schema 00047)
package /IPC_FlatView
  flat map IPC_FlatMap
    41 x flat instance descriptor:
      AppMode: sw-refresh-timing={cse-code=1000, cse-code-factor=1}, upstream-reference=RootSwCompositionPrototype_0.CPT_BswM.RP_BswMArbitration_BswMSwcModeRequest.AppMode, ecu-extract-reference=CPT_IPC_FlatView.CPT_BswM.RP_BswMArbitration_BswMSwcModeRequest.AppMode
      CPT_ASW_BASE: upstream-reference=RootSwCompositionPrototype_0.CPT_ASW_BASE, ecu-extract-reference=CPT_IPC_FlatView.CPT_ASW_BASE
      CPT_ASW_COM: upstream-reference=RootSwCompositionPrototype_0.CPT_ASW_COM, ecu-extract-reference=CPT_IPC_FlatView.CPT_ASW_COM
      CPT_ASW_CORE{0..2}: upstream-reference=RootSwCompositionPrototype_0.CPT_ASW_CORE{0..2}, ecu-extract-reference=CPT_IPC_FlatView.CPT_ASW_CORE{0..2}
      CPT_ASW_DCM: upstream-reference=RootSwCompositionPrototype_0.CPT_ASW_DCM, ecu-extract-reference=CPT_IPC_FlatView.CPT_ASW_DCM
      CPT_ASW_DEM: upstream-reference=RootSwCompositionPrototype_0.CPT_ASW_DEM, ecu-extract-reference=CPT_IPC_FlatView.CPT_ASW_DEM
      CPT_ASW_NM: upstream-reference=RootSwCompositionPrototype_0.CPT_ASW_NM, ecu-extract-reference=CPT_IPC_FlatView.CPT_ASW_NM
      CPT_ASW_NVM: upstream-reference=RootSwCompositionPrototype_0.CPT_ASW_NVM, ecu-extract-reference=CPT_IPC_FlatView.CPT_ASW_NVM
      CPT_ASW_WDG: upstream-reference=RootSwCompositionPrototype_0.CPT_ASW_WDG, ecu-extract-reference=CPT_IPC_FlatView.CPT_ASW_WDG
      CPT_ASW_XCP: upstream-reference=RootSwCompositionPrototype_0.CPT_ASW_XCP, ecu-extract-reference=CPT_IPC_FlatView.CPT_ASW_XCP
      CPT_BswM: upstream-reference=RootSwCompositionPrototype_0.CPT_BswM, ecu-extract-reference=CPT_IPC_FlatView.CPT_BswM
      CPT_CDD_CORE{0..2}: upstream-reference=RootSwCompositionPrototype_0.CPT_CDD_CORE{0..2}, ecu-extract-reference=CPT_IPC_FlatView.CPT_CDD_CORE{0..2}
      CPT_ComM: upstream-reference=RootSwCompositionPrototype_0.CPT_ComM, ecu-extract-reference=CPT_IPC_FlatView.CPT_ComM
      CPT_Dcm: upstream-reference=RootSwCompositionPrototype_0.CPT_Dcm, ecu-extract-reference=CPT_IPC_FlatView.CPT_Dcm
      CPT_Dem: upstream-reference=RootSwCompositionPrototype_0.CPT_Dem, ecu-extract-reference=CPT_IPC_FlatView.CPT_Dem
      CPT_Det: upstream-reference=RootSwCompositionPrototype_0.CPT_Det, ecu-extract-reference=CPT_IPC_FlatView.CPT_Det
      CPT_EcuM: upstream-reference=RootSwCompositionPrototype_0.CPT_EcuM, ecu-extract-reference=CPT_IPC_FlatView.CPT_EcuM
      CPT_NvM: upstream-reference=RootSwCompositionPrototype_0.CPT_NvM, ecu-extract-reference=CPT_IPC_FlatView.CPT_NvM
      CPT_RSID: upstream-reference=RootSwCompositionPrototype_0.CPT_RSID, ecu-extract-reference=CPT_IPC_FlatView.CPT_RSID
      CPT_WdgM: upstream-reference=RootSwCompositionPrototype_0.CPT_WdgM, ecu-extract-reference=CPT_IPC_FlatView.CPT_WdgM
      CPT_rba_DiagLib: upstream-reference=RootSwCompositionPrototype_0.CPT_rba_DiagLib, ecu-extract-reference=CPT_IPC_FlatView.CPT_rba_DiagLib
      Data_ptr: sw-refresh-timing={cse-code=5, cse-code-factor=1}, upstream-reference=RootSwCompositionPrototype_0.CPT_ASW_CORE0.PPort_TransmitData2Core1.Data_ptr, ecu-extract-reference=CPT_IPC_FlatView.CPT_ASW_CORE0.PPort_TransmitData2Core1.Data_ptr
      Data_ptr_0: sw-refresh-timing={cse-code=4, cse-code-factor=1}, upstream-reference=RootSwCompositionPrototype_0.CPT_ASW_CORE1.PPort_TransmitData2Core0.Data_ptr, ecu-extract-reference=CPT_IPC_FlatView.CPT_ASW_CORE1.PPort_TransmitData2Core0.Data_ptr
      Explicit_IRV_1: sw-refresh-timing={cse-code=4, cse-code-factor=1}, upstream-reference=RootSwCompositionPrototype_0.CPT_ASW_CORE0.Explicit_IRV_1, ecu-extract-reference=CPT_IPC_FlatView.CPT_ASW_CORE0.Explicit_IRV_1
      MDGP_DcmCommunicationControl_Can_Network_Channel_Can_Network: role=CURRENT_MODE, upstream-reference=RootSwCompositionPrototype_0.CPT_Dcm.Pp_DcmCommunicationControl_Can_Network_CanNodeNum_01.MDGP_DcmCommunicationControl_Can_Network_CanNodeNum_01, ecu-extract-reference=CPT_IPC_FlatView.CPT_Dcm.Pp_DcmCommunicationControl_Can_Network_CanNodeNum_01.MDGP_DcmCommunicationControl_Can_Network_CanNodeNum_01
      MDGP_DcmControlDTCSetting: role=CURRENT_MODE, upstream-reference=RootSwCompositionPrototype_0.CPT_Dcm.Pp_DcmControlDTCSetting.MDGP_DcmControlDTCSetting, ecu-extract-reference=CPT_IPC_FlatView.CPT_Dcm.Pp_DcmControlDTCSetting.MDGP_DcmControlDTCSetting
      MDGP_DcmDiagnosticSessionControl: role=CURRENT_MODE, upstream-reference=RootSwCompositionPrototype_0.CPT_Dcm.Pp_DcmDiagnosticSessionControl.MDGP_DcmDiagnosticSessionControl, ecu-extract-reference=CPT_IPC_FlatView.CPT_Dcm.Pp_DcmDiagnosticSessionControl.MDGP_DcmDiagnosticSessionControl
      MDGP_DcmEcuReset: role=CURRENT_MODE, upstream-reference=RootSwCompositionPrototype_0.CPT_Dcm.Pp_DcmEcuReset.MDGP_DcmEcuReset, ecu-extract-reference=CPT_IPC_FlatView.CPT_Dcm.Pp_DcmEcuReset.MDGP_DcmEcuReset
      currentMode: role=CURRENT_MODE, upstream-reference=RootSwCompositionPrototype_0.CPT_ComM.UM_ComMUser_Can_Network_CanNodeNum_01.currentMode, ecu-extract-reference=CPT_IPC_FlatView.CPT_ComM.UM_ComMUser_Can_Network_CanNodeNum_01.currentMode
      currentMode_0: role=CURRENT_MODE, upstream-reference=RootSwCompositionPrototype_0.CPT_ComM.UM_ComMUser_Can_Network_CanNodeNum_00.currentMode, ecu-extract-reference=CPT_IPC_FlatView.CPT_ComM.UM_ComMUser_Can_Network_CanNodeNum_00.currentMode
      currentMode_1: role=CURRENT_MODE, upstream-reference=RootSwCompositionPrototype_0.CPT_WdgM.globalMode.currentMode, ecu-extract-reference=CPT_IPC_FlatView.CPT_WdgM.globalMode.currentMode
      currentMode_2: role=CURRENT_MODE, upstream-reference=RootSwCompositionPrototype_0.CPT_WdgM.mode_WdgMSupervisedEntity_Alive_Supervision_Entity1.currentMode, ecu-extract-reference=CPT_IPC_FlatView.CPT_WdgM.mode_WdgMSupervisedEntity_Alive_Supervision_Entity1.currentMode
      uint8: sw-refresh-timing={cse-code=1000, cse-code-factor=1}, upstream-reference=RootSwCompositionPrototype_0.CPT_BswM.RP_BswMArbitration_BswM_MRP_SWC_Network.uint8, ecu-extract-reference=CPT_IPC_FlatView.CPT_BswM.RP_BswMArbitration_BswM_MRP_SWC_Network.uint8
      CPT_SWC_DEM: upstream-reference=RootSwCompositionPrototype_0.CPT_SWC_DEM, ecu-extract-reference=CPT_IPC_FlatView.CPT_SWC_DEM
      currentMode_3: role=CURRENT_MODE, upstream-reference=RootSwCompositionPrototype_0.CPT_WdgM.mode_WdgMSupervisedEntity_Logic_Supervision_Entity1.currentMode, ecu-extract-reference=CPT_IPC_FlatView.CPT_WdgM.mode_WdgMSupervisedEntity_Logic_Supervision_Entity1.currentMode
      CPT_CDD_CORE3: upstream-reference=RootSwCompositionPrototype_0.CPT_CDD_CORE3, ecu-extract-reference=CPT_IPC_FlatView.CPT_CDD_CORE3
      CPT_ASW_CORE3: upstream-reference=RootSwCompositionPrototype_0.CPT_ASW_CORE3, ecu-extract-reference=CPT_IPC_FlatView.CPT_ASW_CORE3
