AUTOSAR XML (schema 00047)
package /System_EcuExtract
  system EXTR_IPC: category=ECU_EXTRACT, ecu-extract-version=1.0.0, system-version=1.0.0
    system mapping SYSMPG_IPC
      sw-mappings:
        swc to ecu mapping SwcToEcuMapping_0: ecu-instance=IPC
          component:
            CPT_IPC_FlatView.CPT_ASW_BASE
            CPT_IPC_FlatView.CPT_ASW_COM
            CPT_IPC_FlatView.CPT_ASW_CORE{0..2}
            CPT_IPC_FlatView.CPT_ASW_DCM
            CPT_IPC_FlatView.CPT_ASW_DEM
            CPT_IPC_FlatView.CPT_ASW_NM
            CPT_IPC_FlatView.CPT_ASW_NVM
            CPT_IPC_FlatView.CPT_ASW_WDG
            CPT_IPC_FlatView.CPT_ASW_XCP
            CPT_IPC_FlatView.CPT_BswM
            CPT_IPC_FlatView.CPT_CDD_CORE{0..2}
            CPT_IPC_FlatView.CPT_ComM
            CPT_IPC_FlatView.CPT_Dcm
            CPT_IPC_FlatView.CPT_Dem
            CPT_IPC_FlatView.CPT_Det
            CPT_IPC_FlatView.CPT_EcuM
            CPT_IPC_FlatView.CPT_NvM
            CPT_IPC_FlatView.CPT_RSID
            CPT_IPC_FlatView.CPT_WdgM
            CPT_IPC_FlatView.CPT_rba_DiagLib
            CPT_IPC_FlatView.CPT_SWC_DEM
            CPT_IPC_FlatView.CPT_ASW_CORE3
            CPT_IPC_FlatView.CPT_CDD_CORE3
    root-software-compositions:
      root sw composition prototype CPT_IPC_FlatView: flat-map=IPC_FlatMap, software-composition=IPC_FlatView
