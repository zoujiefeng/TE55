AUTOSAR XML (schema 4-2-2)
standard types defined: Std_ReturnType, uint8
package /AUTOSAR_Rte/BswModuleDescriptions
  bsw module description Rte: outgoing-callbacks=[Rte_StartHook_Return, Rte_StartHook_Start, Rte_StopHook_Return, Rte_StopHook_Start, Rte_Task_Activate]
    provided-entrys:
      Rte_ActivateRE
      Rte_Call_ASW_CORE0_RPort_CPUUtilizationCore0_CPU_Utilization
      Rte_Call_ASW_CORE0_RPort_ClientCallCore0_Core_ClientServer
      Rte_Call_ASW_CORE0_RPort_GetMaxUserStackUtilization_GetMaxUserStackUtilization
      Rte_Call_ASW_CORE1_RPort_CPUUtilizationCore1_CPU_Utilization
      Rte_Call_ASW_CORE1_RPort_GetMaxUserStackUtilization_GetMaxUserStackUtilization
      Rte_Call_ASW_CORE2_RPort_CPUUtilizationCore2_CPU_Utilization
      Rte_Call_ASW_CORE2_RPort_GetMaxUserStackUtilization_GetMaxUserStackUtilization
      Rte_Call_ASW_CORE3_RPort_CPUUtilizationCore3_CPU_Utilization
      Rte_Call_ASW_CORE3_RPort_GetMaxUserStackUtilization_GetMaxUserStackUtilization
      Rte_Call_ASW_DEM_IndStatus_MIL_GetIndicatorStatus
      Rte_Call_ASW_DEM_OpCycle_DemOperationCycle_Ignition_GetOperationCycleState
      Rte_Call_ASW_DEM_OpCycle_DemOperationCycle_Ignition_SetOperationCycleState
      Rte_Call_ASW_DEM_RPort_OpCycle_DemOperationCycle_Power_GetCycleQualified
      Rte_Call_ASW_DEM_RPort_OpCycle_DemOperationCycle_Power_GetOperationCycleState
      Rte_Call_ASW_DEM_RPort_OpCycle_DemOperationCycle_Power_SetCycleQualified
      Rte_Call_ASW_DEM_RPort_OpCycle_DemOperationCycle_Power_SetOperationCycleState
      Rte_Call_ASW_NM_RP_ComM_UserRequest_CAN0_GetCurrentComMode
      Rte_Call_ASW_NM_RP_ComM_UserRequest_CAN0_GetMaxComMode
      Rte_Call_ASW_NM_RP_ComM_UserRequest_CAN0_GetRequestedComMode
      Rte_Call_ASW_NM_RP_ComM_UserRequest_CAN0_RequestComMode
      Rte_Call_ASW_NM_RPort_EcuModeLimitation_LimitECUToNoComMode
      Rte_Call_ASW_NM_RPort_EcuModeLimitation_ReadInhibitCounter
      Rte_Call_ASW_NM_RPort_EcuModeLimitation_ResetInhibitCounter
      Rte_Call_ASW_NM_RPort_EcuModeLimitation_SetECUGroupClassification
      Rte_Call_ASW_NVM_RPort_ASW_NVM_BlockNative_1024_1_EraseBlock
      Rte_Call_ASW_NVM_RPort_ASW_NVM_BlockNative_1024_1_GetDataIndex
      Rte_Call_ASW_NVM_RPort_ASW_NVM_BlockNative_1024_1_GetErrorStatus
      Rte_Call_ASW_NVM_RPort_ASW_NVM_BlockNative_1024_1_InvalidateNvBlock
      Rte_Call_ASW_NVM_RPort_ASW_NVM_BlockNative_1024_1_ReadBlock
      Rte_Call_ASW_NVM_RPort_ASW_NVM_BlockNative_1024_1_RestoreBlockDefaults
      Rte_Call_ASW_NVM_RPort_ASW_NVM_BlockNative_1024_1_SetDataIndex
      Rte_Call_ASW_NVM_RPort_ASW_NVM_BlockNative_1024_1_SetRamBlockStatus
      Rte_Call_ASW_NVM_RPort_ASW_NVM_BlockNative_1024_1_WriteBlock
      Rte_Call_ASW_WDG_RPort_Alive_Supervision_Entity1_CheckpointReached
      Rte_Call_Dcm_DataServices_DcmDspPidData_04_ReadData
      Rte_Call_Dcm_DataServices_DcmDspPidData_05_ReadData
      Rte_Call_Dcm_DataServices_DcmDspPidData_0C_ReadData
      Rte_Call_Dcm_DataServices_DcmDspPidData_0D_ReadData
      Rte_Call_Dcm_DataServices_DcmDspPidData_21_ReadData
      Rte_Call_Dcm_DataServices_DcmDspPidData_30_ReadData
      Rte_Call_Dcm_DataServices_DcmDspPidData_31_ReadData
      Rte_Call_Dcm_DataServices_DcmDspPidData_41_ReadData
      Rte_Call_Dcm_DataServices_DcmDspPidData_42_ReadData
      Rte_Call_Dcm_DataServices_DcmDspPidData_49_ReadData
      Rte_Call_Dcm_InfotypeServices_DcmDspVehInfoData_04_GetInfotypeValueData
      Rte_Call_Dcm_InfotypeServices_DcmDspVehInfoData_0A_GetInfotypeValueData
      Rte_Call_Dcm_InfotypeServices_VIT_06_0_GetInfotypeValueData
      Rte_Call_Dcm_RoutineServices_DcmDspRoutine_0203_RequestResults
      Rte_Call_Dcm_RoutineServices_DcmDspRoutine_0203_Start
      Rte_Call_Dem_DataServices_CS_ExtendedDataRecord_Aged_counter_ReadData
      Rte_Call_Dem_DataServices_CS_ExtendedDataRecord_Fault_pending_counter_ReadData
      Rte_Call_Dem_DataServices_PID_02_ReadData
      Rte_Call_Dem_DataServices_PID_04_ReadData
      Rte_Call_Dem_DataServices_PID_05_ReadData
      Rte_Call_Dem_DataServices_PID_0C_ReadData
      Rte_Call_Dem_DataServices_PID_0D_ReadData
      Rte_Call_Dem_DataServices_PID_42_ReadData
      Rte_Call_Dem_DataServices_PID_49_ReadData
      Rte_DecrementWaitingCount
      Rte_GetCurrentTaskIndex
      Rte_IrvRead_ASW_CORE0_RE_CORE0_SWC_100ms_Explicit_IRV_1
      Rte_IrvWrite_ASW_CORE0_RE_CORE0_SWC_10ms_Explicit_IRV_1
      Rte_MSACbk_SW_13
      Rte_MainFunction
      Rte_ReadQueue
      Rte_Read_ASW_CORE0_RPort_ReceiveDatafromCore1_Data_ptr
      Rte_Read_ASW_CORE1_RPort_ReceiverDataFromCore0_Data_ptr
      Rte_Read_BswM_RP_BswMArbitration_BswMSwcModeRequest_AppMode
      Rte_Read_BswM_RP_BswMArbitration_BswM_MRP_SWC_Network_uint8
      Rte_SetEvent
      Rte_Start
      Rte_Stop
      Rte_SwitchAck_WdgM_globalMode_currentMode
      Rte_SwitchAck_WdgM_mode_WdgMSupervisedEntity_Alive_Supervision_CPU{1..3}_currentMode
      Rte_SwitchAck_WdgM_mode_WdgMSupervisedEntity_Alive_Supervision_Entity1_currentMode
      Rte_SwitchAck_WdgM_mode_WdgMSupervisedEntity_Logic_Supervision_Entity1_currentMode
      Rte_Switch_ComM_UM_ComMUser_Can_Network_CanNodeNum_{00..03}_currentMode
      Rte_Switch_Dcm_Pp_DcmCommunicationControl_Can_Network_CanNodeNum_01_MDGP_DcmCommunicationControl_Can_Network_CanNodeNum_01
      Rte_Switch_Dcm_Pp_DcmControlDTCSetting_MDGP_DcmControlDTCSetting
      Rte_Switch_Dcm_Pp_DcmDiagnosticSessionControl_MDGP_DcmDiagnosticSessionControl
      Rte_Switch_Dcm_Pp_DcmEcuReset_MDGP_DcmEcuReset
      Rte_Switch_WdgM_globalMode_currentMode
      Rte_Switch_WdgM_mode_WdgMSupervisedEntity_Alive_Supervision_CPU{1..3}_currentMode
      Rte_Switch_WdgM_mode_WdgMSupervisedEntity_Alive_Supervision_Entity1_currentMode
      Rte_Switch_WdgM_mode_WdgMSupervisedEntity_Logic_Supervision_Entity1_currentMode
      Rte_WaitWithTimeout
      Rte_WriteQueue
      Rte_Write_ASW_BASE_PPort_SwcModeRequest_AppMode
      Rte_Write_ASW_CORE0_PPort_SwcModeRequest_AppMode
      Rte_Write_ASW_CORE0_PPort_TransmitData2Core1_Data_ptr
      Rte_Write_ASW_CORE1_PPort_TransmitData2Core0_Data_ptr
      Rte_Write_ASW_NM_PP_BswMArbitration_BswM_MRP_Network_uint8
      Rte_Write_ASW_NM_PP_BswMArbitration_BswM_MRP_NmState_uint8
      Rte_memcpy
      SchM_Deinit
      SchM_IModeInit
      SchM_Init
      SchM_Mode_BswM_MDGR_BswM_MRP_BswM_MDG
      SchM_Mode_BswM_MDGR_BswM_MRP_DCM_ModeNotification_EcuReset
      SchM_Mode_Dcm_R_DcmCommunicationControl_Can_Network_CanNodeNum_01
      SchM_Mode_WdgM_Current_WdgMSupervisionCycle
      SchM_Switch_BswM_MDGP_AUTOSAR_BswM_ModeDeclarationGroups_MDG_ECUM_STATE
      SchM_Switch_Dcm_DcmCommunicationControl_Can_Network_CanNodeNum_01
      SchM_Switch_Dcm_DcmEcuReset
      SchM_Switch_WdgM_WdgMSupervisionCycle
    bsw module dependency AUTOSAR_Os: target-module-id=1
      required-entrys:
        ActivateTask
        GetResource
        IocRead_Rte_Rx_000000
        IocRead_Rte_Rx_000001
        IocWrite_Rte_Rx_000000
        IocWrite_Rte_Rx_000001
        ReleaseResource
        ResumeOSInterrupts
        Rte_ResumeOSInterrupts
        Rte_SuspendOSInterrupts
        SuspendOSInterrupts
        TerminateTask
    bsw internal behavior RteInternalBehavior
      constant-memorys:
        55 x parameter data prototype:
          Rte_Inst_ASW_BASE: type=Rte_CDS_ASW_BASE
          Rte_Inst_ASW_COM: type=Rte_CDS_ASW_COM
          Rte_Inst_ASW_CORE{0..3}: type=Rte_CDS_ASW_CORE{0..3}
          Rte_Inst_ASW_DCM: type=Rte_CDS_ASW_DCM
          Rte_Inst_ASW_DEM: type=Rte_CDS_ASW_DEM
          Rte_Inst_ASW_NM: type=Rte_CDS_ASW_NM
          Rte_Inst_ASW_NVM: type=Rte_CDS_ASW_NVM
          Rte_Inst_ASW_WDG: type=Rte_CDS_ASW_WDG
          Rte_Inst_ASW_XCP: type=Rte_CDS_ASW_XCP
          Rte_Inst_BswM: type=Rte_CDS_BswM
          Rte_Inst_CDD_CORE{0..3}: type=Rte_CDS_CDD_CORE{0..3}
          Rte_Inst_ComM: type=Rte_CDS_ComM
          Rte_Inst_Dcm: type=Rte_CDS_Dcm
          Rte_Inst_Dem: type=Rte_CDS_Dem
          Rte_Inst_Det: type=Rte_CDS_Det
          Rte_Inst_EcuM: type=Rte_CDS_EcuM
          Rte_Inst_NvM: type=Rte_CDS_NvM
          Rte_Inst_RSID: type=Rte_CDS_RSID
          Rte_Inst_SWC_DEM: type=Rte_CDS_SWC_DEM
          Rte_Inst_WdgM: type=Rte_CDS_WdgM
          Rte_Inst_rba_DiagLib: type=Rte_CDS_rba_DiagLib
          Rte_Self_CPT_ASW_BASE: type=Rte_SelfType_ASW_BASE
          Rte_Self_CPT_ASW_COM: type=Rte_SelfType_ASW_COM
          Rte_Self_CPT_ASW_CORE{0..3}: type=Rte_SelfType_ASW_CORE{0..3}
          Rte_Self_CPT_ASW_DCM: type=Rte_SelfType_ASW_DCM
          Rte_Self_CPT_ASW_DEM: type=Rte_SelfType_ASW_DEM
          Rte_Self_CPT_ASW_NM: type=Rte_SelfType_ASW_NM
          Rte_Self_CPT_ASW_NVM: type=Rte_SelfType_ASW_NVM
          Rte_Self_CPT_ASW_WDG: type=Rte_SelfType_ASW_WDG
          Rte_Self_CPT_ASW_XCP: type=Rte_SelfType_ASW_XCP
          Rte_Self_CPT_BswM: type=Rte_SelfType_BswM
          Rte_Self_CPT_CDD_CORE{0..3}: type=Rte_SelfType_CDD_CORE{0..3}
          Rte_Self_CPT_ComM: type=Rte_SelfType_ComM
          Rte_Self_CPT_Dcm: type=Rte_SelfType_Dcm
          Rte_Self_CPT_Dem: type=Rte_SelfType_Dem
          Rte_Self_CPT_Det: type=Rte_SelfType_Det
          Rte_Self_CPT_EcuM: type=Rte_SelfType_EcuM
          Rte_Self_CPT_NvM: type=Rte_SelfType_NvM
          Rte_Self_CPT_RSID: type=Rte_SelfType_RSID
          Rte_Self_CPT_SWC_DEM: type=Rte_SelfType_SWC_DEM
          Rte_Self_CPT_WdgM: type=Rte_SelfType_WdgM
          Rte_Self_CPT_rba_DiagLib: type=Rte_SelfType_rba_DiagLib
          Rte_Tasks: type=Rte_TaskInfo
      static-memorys:
        35 x data:
          Rte_ActCount_CPT_BswM_DRE_BswM_Cfg_DfrdSwcReqst_BswMSwcModeRequest: type=Rte_REActCounterType
          Rte_ActCount_CPT_BswM_DRE_BswM_Cfg_DfrdSwcReqst_BswM_MRP_SWC_Network: type=Rte_REActCounterType
          Rte_CPim_ASW_NVM_ASW_NVM_BlockNative_1024_1: type=Rte_PimType_ASW_NVM_ASW_NVM_BlockNative_1024_Type
          Rte_CPim_ASW_NVM_ASW_NVM_BlockNative_1024_2: type=Rte_PimType_ASW_NVM_ASW_NVM_BlockRedundant_1024_Type
          Rte_FbVar_CPT_WdgM_globalMode_currentMode: type=Std_ReturnType
          Rte_Irv_ASW_CORE0_Explicit_IRV_1: type=Array100ByteDataElement
          Rte_ModeCurrent_0: type=uint8
          Rte_ModeCurrent_1: type=uint8
          Rte_ModeCurrent_{10..18}: type=uint8
          Rte_ModeCurrent_{2..9}: type=uint8
          Rte_ModeSchMNext_0: type=uint8
          Rte_ModeSchMNext_5: type=uint8
          Rte_RECount_Core0_OsTask_ASW_100ms_divby2_0: type=uint8
          Rte_RECount_Core0_OsTask_ASW_10ms_divby5_0: type=uint8
          Rte_RECount_Core0_OsTask_ASW_1ms_divby2_0: type=uint8
          Rte_RECount_Core0_OsTask_ASW_1ms_divby5_0: type=uint8
          Rte_RECount_Core2_OsTask_ASW_100ms_divby2_0: type=uint8
          Rte_RECount_Core2_OsTask_ASW_1ms_divby2_0: type=uint8
          Rte_Rx_000002: type=uint8
          Rte_Rx_000003: type=uint8
      113 x bsw called entity, all with sw-addr-method=CODE:
        Rte_ActivateRE: implemented-entry=Rte_ActivateRE
        Rte_Call_ASW_CORE0_RPort_CPUUtilizationCore0_CPU_Utilization: implemented-entry=Rte_Call_ASW_CORE0_RPort_CPUUtilizationCore0_CPU_Utilization
        Rte_Call_ASW_CORE0_RPort_ClientCallCore0_Core_ClientServer: implemented-entry=Rte_Call_ASW_CORE0_RPort_ClientCallCore0_Core_ClientServer
        Rte_Call_ASW_CORE0_RPort_GetMaxUserStackUtilization_GetMaxUserStackUtilization: implemented-entry=Rte_Call_ASW_CORE0_RPort_GetMaxUserStackUtilization_GetMaxUserStackUtilization
        Rte_Call_ASW_CORE1_RPort_CPUUtilizationCore1_CPU_Utilization: implemented-entry=Rte_Call_ASW_CORE1_RPort_CPUUtilizationCore1_CPU_Utilization
        Rte_Call_ASW_CORE1_RPort_GetMaxUserStackUtilization_GetMaxUserStackUtilization: implemented-entry=Rte_Call_ASW_CORE1_RPort_GetMaxUserStackUtilization_GetMaxUserStackUtilization
        Rte_Call_ASW_CORE2_RPort_CPUUtilizationCore2_CPU_Utilization: implemented-entry=Rte_Call_ASW_CORE2_RPort_CPUUtilizationCore2_CPU_Utilization
        Rte_Call_ASW_CORE2_RPort_GetMaxUserStackUtilization_GetMaxUserStackUtilization: implemented-entry=Rte_Call_ASW_CORE2_RPort_GetMaxUserStackUtilization_GetMaxUserStackUtilization
        Rte_Call_ASW_CORE3_RPort_CPUUtilizationCore3_CPU_Utilization: implemented-entry=Rte_Call_ASW_CORE3_RPort_CPUUtilizationCore3_CPU_Utilization
        Rte_Call_ASW_CORE3_RPort_GetMaxUserStackUtilization_GetMaxUserStackUtilization: implemented-entry=Rte_Call_ASW_CORE3_RPort_GetMaxUserStackUtilization_GetMaxUserStackUtilization
        Rte_Call_ASW_DEM_IndStatus_MIL_GetIndicatorStatus: implemented-entry=Rte_Call_ASW_DEM_IndStatus_MIL_GetIndicatorStatus
        Rte_Call_ASW_DEM_OpCycle_DemOperationCycle_Ignition_GetOperationCycleState: implemented-entry=Rte_Call_ASW_DEM_OpCycle_DemOperationCycle_Ignition_GetOperationCycleState
        Rte_Call_ASW_DEM_OpCycle_DemOperationCycle_Ignition_SetOperationCycleState: implemented-entry=Rte_Call_ASW_DEM_OpCycle_DemOperationCycle_Ignition_SetOperationCycleState
        Rte_Call_ASW_DEM_RPort_OpCycle_DemOperationCycle_Power_GetCycleQualified: implemented-entry=Rte_Call_ASW_DEM_RPort_OpCycle_DemOperationCycle_Power_GetCycleQualified
        Rte_Call_ASW_DEM_RPort_OpCycle_DemOperationCycle_Power_GetOperationCycleState: implemented-entry=Rte_Call_ASW_DEM_RPort_OpCycle_DemOperationCycle_Power_GetOperationCycleState
        Rte_Call_ASW_DEM_RPort_OpCycle_DemOperationCycle_Power_SetCycleQualified: implemented-entry=Rte_Call_ASW_DEM_RPort_OpCycle_DemOperationCycle_Power_SetCycleQualified
        Rte_Call_ASW_DEM_RPort_OpCycle_DemOperationCycle_Power_SetOperationCycleState: implemented-entry=Rte_Call_ASW_DEM_RPort_OpCycle_DemOperationCycle_Power_SetOperationCycleState
        Rte_Call_ASW_NM_RP_ComM_UserRequest_CAN0_GetCurrentComMode: implemented-entry=Rte_Call_ASW_NM_RP_ComM_UserRequest_CAN0_GetCurrentComMode
        Rte_Call_ASW_NM_RP_ComM_UserRequest_CAN0_GetMaxComMode: implemented-entry=Rte_Call_ASW_NM_RP_ComM_UserRequest_CAN0_GetMaxComMode
        Rte_Call_ASW_NM_RP_ComM_UserRequest_CAN0_GetRequestedComMode: implemented-entry=Rte_Call_ASW_NM_RP_ComM_UserRequest_CAN0_GetRequestedComMode
        Rte_Call_ASW_NM_RP_ComM_UserRequest_CAN0_RequestComMode: implemented-entry=Rte_Call_ASW_NM_RP_ComM_UserRequest_CAN0_RequestComMode
        Rte_Call_ASW_NM_RPort_EcuModeLimitation_LimitECUToNoComMode: implemented-entry=Rte_Call_ASW_NM_RPort_EcuModeLimitation_LimitECUToNoComMode
        Rte_Call_ASW_NM_RPort_EcuModeLimitation_ReadInhibitCounter: implemented-entry=Rte_Call_ASW_NM_RPort_EcuModeLimitation_ReadInhibitCounter
        Rte_Call_ASW_NM_RPort_EcuModeLimitation_ResetInhibitCounter: implemented-entry=Rte_Call_ASW_NM_RPort_EcuModeLimitation_ResetInhibitCounter
        Rte_Call_ASW_NM_RPort_EcuModeLimitation_SetECUGroupClassification: implemented-entry=Rte_Call_ASW_NM_RPort_EcuModeLimitation_SetECUGroupClassification
        Rte_Call_ASW_NVM_RPort_ASW_NVM_BlockNative_1024_1_EraseBlock: implemented-entry=Rte_Call_ASW_NVM_RPort_ASW_NVM_BlockNative_1024_1_EraseBlock
        Rte_Call_ASW_NVM_RPort_ASW_NVM_BlockNative_1024_1_GetDataIndex: implemented-entry=Rte_Call_ASW_NVM_RPort_ASW_NVM_BlockNative_1024_1_GetDataIndex
        Rte_Call_ASW_NVM_RPort_ASW_NVM_BlockNative_1024_1_GetErrorStatus: implemented-entry=Rte_Call_ASW_NVM_RPort_ASW_NVM_BlockNative_1024_1_GetErrorStatus
        Rte_Call_ASW_NVM_RPort_ASW_NVM_BlockNative_1024_1_InvalidateNvBlock: implemented-entry=Rte_Call_ASW_NVM_RPort_ASW_NVM_BlockNative_1024_1_InvalidateNvBlock
        Rte_Call_ASW_NVM_RPort_ASW_NVM_BlockNative_1024_1_ReadBlock: implemented-entry=Rte_Call_ASW_NVM_RPort_ASW_NVM_BlockNative_1024_1_ReadBlock
        Rte_Call_ASW_NVM_RPort_ASW_NVM_BlockNative_1024_1_RestoreBlockDefaults: implemented-entry=Rte_Call_ASW_NVM_RPort_ASW_NVM_BlockNative_1024_1_RestoreBlockDefaults
        Rte_Call_ASW_NVM_RPort_ASW_NVM_BlockNative_1024_1_SetDataIndex: implemented-entry=Rte_Call_ASW_NVM_RPort_ASW_NVM_BlockNative_1024_1_SetDataIndex
        Rte_Call_ASW_NVM_RPort_ASW_NVM_BlockNative_1024_1_SetRamBlockStatus: implemented-entry=Rte_Call_ASW_NVM_RPort_ASW_NVM_BlockNative_1024_1_SetRamBlockStatus
        Rte_Call_ASW_NVM_RPort_ASW_NVM_BlockNative_1024_1_WriteBlock: implemented-entry=Rte_Call_ASW_NVM_RPort_ASW_NVM_BlockNative_1024_1_WriteBlock
        Rte_Call_ASW_WDG_RPort_Alive_Supervision_Entity1_CheckpointReached: implemented-entry=Rte_Call_ASW_WDG_RPort_Alive_Supervision_Entity1_CheckpointReached
        Rte_Call_Dcm_DataServices_DcmDspPidData_04_ReadData: implemented-entry=Rte_Call_Dcm_DataServices_DcmDspPidData_04_ReadData
        Rte_Call_Dcm_DataServices_DcmDspPidData_05_ReadData: implemented-entry=Rte_Call_Dcm_DataServices_DcmDspPidData_05_ReadData
        Rte_Call_Dcm_DataServices_DcmDspPidData_0C_ReadData: implemented-entry=Rte_Call_Dcm_DataServices_DcmDspPidData_0C_ReadData
        Rte_Call_Dcm_DataServices_DcmDspPidData_0D_ReadData: implemented-entry=Rte_Call_Dcm_DataServices_DcmDspPidData_0D_ReadData
        Rte_Call_Dcm_DataServices_DcmDspPidData_21_ReadData: implemented-entry=Rte_Call_Dcm_DataServices_DcmDspPidData_21_ReadData
        Rte_Call_Dcm_DataServices_DcmDspPidData_30_ReadData: implemented-entry=Rte_Call_Dcm_DataServices_DcmDspPidData_30_ReadData
        Rte_Call_Dcm_DataServices_DcmDspPidData_31_ReadData: implemented-entry=Rte_Call_Dcm_DataServices_DcmDspPidData_31_ReadData
        Rte_Call_Dcm_DataServices_DcmDspPidData_41_ReadData: implemented-entry=Rte_Call_Dcm_DataServices_DcmDspPidData_41_ReadData
        Rte_Call_Dcm_DataServices_DcmDspPidData_42_ReadData: implemented-entry=Rte_Call_Dcm_DataServices_DcmDspPidData_42_ReadData
        Rte_Call_Dcm_DataServices_DcmDspPidData_49_ReadData: implemented-entry=Rte_Call_Dcm_DataServices_DcmDspPidData_49_ReadData
        Rte_Call_Dcm_InfotypeServices_DcmDspVehInfoData_04_GetInfotypeValueData: implemented-entry=Rte_Call_Dcm_InfotypeServices_DcmDspVehInfoData_04_GetInfotypeValueData
        Rte_Call_Dcm_InfotypeServices_DcmDspVehInfoData_0A_GetInfotypeValueData: implemented-entry=Rte_Call_Dcm_InfotypeServices_DcmDspVehInfoData_0A_GetInfotypeValueData
        Rte_Call_Dcm_InfotypeServices_VIT_06_0_GetInfotypeValueData: implemented-entry=Rte_Call_Dcm_InfotypeServices_VIT_06_0_GetInfotypeValueData
        Rte_Call_Dcm_RoutineServices_DcmDspRoutine_0203_RequestResults: implemented-entry=Rte_Call_Dcm_RoutineServices_DcmDspRoutine_0203_RequestResults
        Rte_Call_Dcm_RoutineServices_DcmDspRoutine_0203_Start: implemented-entry=Rte_Call_Dcm_RoutineServices_DcmDspRoutine_0203_Start
        Rte_Call_Dem_DataServices_CS_ExtendedDataRecord_Aged_counter_ReadData: implemented-entry=Rte_Call_Dem_DataServices_CS_ExtendedDataRecord_Aged_counter_ReadData
        Rte_Call_Dem_DataServices_CS_ExtendedDataRecord_Fault_pending_counter_ReadData: implemented-entry=Rte_Call_Dem_DataServices_CS_ExtendedDataRecord_Fault_pending_counter_ReadData
        Rte_Call_Dem_DataServices_PID_02_ReadData: implemented-entry=Rte_Call_Dem_DataServices_PID_02_ReadData
        Rte_Call_Dem_DataServices_PID_04_ReadData: implemented-entry=Rte_Call_Dem_DataServices_PID_04_ReadData
        Rte_Call_Dem_DataServices_PID_05_ReadData: implemented-entry=Rte_Call_Dem_DataServices_PID_05_ReadData
        Rte_Call_Dem_DataServices_PID_0C_ReadData: implemented-entry=Rte_Call_Dem_DataServices_PID_0C_ReadData
        Rte_Call_Dem_DataServices_PID_0D_ReadData: implemented-entry=Rte_Call_Dem_DataServices_PID_0D_ReadData
        Rte_Call_Dem_DataServices_PID_42_ReadData: implemented-entry=Rte_Call_Dem_DataServices_PID_42_ReadData
        Rte_Call_Dem_DataServices_PID_49_ReadData: implemented-entry=Rte_Call_Dem_DataServices_PID_49_ReadData
        Rte_DecrementWaitingCount: implemented-entry=Rte_DecrementWaitingCount
        Rte_GetCurrentTaskIndex: implemented-entry=Rte_GetCurrentTaskIndex
        Rte_IrvRead_ASW_CORE0_RE_CORE0_SWC_100ms_Explicit_IRV_1: implemented-entry=Rte_IrvRead_ASW_CORE0_RE_CORE0_SWC_100ms_Explicit_IRV_1
        Rte_IrvWrite_ASW_CORE0_RE_CORE0_SWC_10ms_Explicit_IRV_1: implemented-entry=Rte_IrvWrite_ASW_CORE0_RE_CORE0_SWC_10ms_Explicit_IRV_1
        Rte_MSACbk_SW_13: implemented-entry=Rte_MSACbk_SW_13
        Rte_MainFunction: implemented-entry=Rte_MainFunction
        Rte_ReadQueue: implemented-entry=Rte_ReadQueue
        Rte_Read_ASW_CORE0_RPort_ReceiveDatafromCore1_Data_ptr: implemented-entry=Rte_Read_ASW_CORE0_RPort_ReceiveDatafromCore1_Data_ptr
        Rte_Read_ASW_CORE1_RPort_ReceiverDataFromCore0_Data_ptr: implemented-entry=Rte_Read_ASW_CORE1_RPort_ReceiverDataFromCore0_Data_ptr
        Rte_Read_BswM_RP_BswMArbitration_BswMSwcModeRequest_AppMode: implemented-entry=Rte_Read_BswM_RP_BswMArbitration_BswMSwcModeRequest_AppMode
        Rte_Read_BswM_RP_BswMArbitration_BswM_MRP_SWC_Network_uint8: implemented-entry=Rte_Read_BswM_RP_BswMArbitration_BswM_MRP_SWC_Network_uint8
        Rte_SetEvent: implemented-entry=Rte_SetEvent
        Rte_Start: implemented-entry=Rte_Start
        Rte_Stop: implemented-entry=Rte_Stop
        Rte_SwitchAck_WdgM_globalMode_currentMode: implemented-entry=Rte_SwitchAck_WdgM_globalMode_currentMode
        Rte_SwitchAck_WdgM_mode_WdgMSupervisedEntity_Alive_Supervision_CPU{1..3}_currentMode: implemented-entry=Rte_SwitchAck_WdgM_mode_WdgMSupervisedEntity_Alive_Supervision_CPU{1..3}_currentMode
        Rte_SwitchAck_WdgM_mode_WdgMSupervisedEntity_Alive_Supervision_Entity1_currentMode: implemented-entry=Rte_SwitchAck_WdgM_mode_WdgMSupervisedEntity_Alive_Supervision_Entity1_currentMode
        Rte_SwitchAck_WdgM_mode_WdgMSupervisedEntity_Logic_Supervision_Entity1_currentMode: implemented-entry=Rte_SwitchAck_WdgM_mode_WdgMSupervisedEntity_Logic_Supervision_Entity1_currentMode
        Rte_Switch_ComM_UM_ComMUser_Can_Network_CanNodeNum_{00..03}_currentMode: implemented-entry=Rte_Switch_ComM_UM_ComMUser_Can_Network_CanNodeNum_{00..03}_currentMode
        Rte_Switch_Dcm_Pp_DcmCommunicationControl_Can_Network_CanNodeNum_01_MDGP_DcmCommunicationControl_Can_Network_CanNodeNum_01: implemented-entry=Rte_Switch_Dcm_Pp_DcmCommunicationControl_Can_Network_CanNodeNum_01_MDGP_DcmCommunicationControl_Can_Network_CanNodeNum_01
        Rte_Switch_Dcm_Pp_DcmControlDTCSetting_MDGP_DcmControlDTCSetting: implemented-entry=Rte_Switch_Dcm_Pp_DcmControlDTCSetting_MDGP_DcmControlDTCSetting
        Rte_Switch_Dcm_Pp_DcmDiagnosticSessionControl_MDGP_DcmDiagnosticSessionControl: implemented-entry=Rte_Switch_Dcm_Pp_DcmDiagnosticSessionControl_MDGP_DcmDiagnosticSessionControl
        Rte_Switch_Dcm_Pp_DcmEcuReset_MDGP_DcmEcuReset: implemented-entry=Rte_Switch_Dcm_Pp_DcmEcuReset_MDGP_DcmEcuReset
        Rte_Switch_WdgM_globalMode_currentMode: implemented-entry=Rte_Switch_WdgM_globalMode_currentMode
        Rte_Switch_WdgM_mode_WdgMSupervisedEntity_Alive_Supervision_CPU{1..3}_currentMode: implemented-entry=Rte_Switch_WdgM_mode_WdgMSupervisedEntity_Alive_Supervision_CPU{1..3}_currentMode
        Rte_Switch_WdgM_mode_WdgMSupervisedEntity_Alive_Supervision_Entity1_currentMode: implemented-entry=Rte_Switch_WdgM_mode_WdgMSupervisedEntity_Alive_Supervision_Entity1_currentMode
        Rte_Switch_WdgM_mode_WdgMSupervisedEntity_Logic_Supervision_Entity1_currentMode: implemented-entry=Rte_Switch_WdgM_mode_WdgMSupervisedEntity_Logic_Supervision_Entity1_currentMode
        Rte_WaitWithTimeout: implemented-entry=Rte_WaitWithTimeout
        Rte_WriteQueue: implemented-entry=Rte_WriteQueue
        Rte_Write_ASW_BASE_PPort_SwcModeRequest_AppMode: implemented-entry=Rte_Write_ASW_BASE_PPort_SwcModeRequest_AppMode
        Rte_Write_ASW_CORE0_PPort_SwcModeRequest_AppMode: implemented-entry=Rte_Write_ASW_CORE0_PPort_SwcModeRequest_AppMode
        Rte_Write_ASW_CORE0_PPort_TransmitData2Core1_Data_ptr: implemented-entry=Rte_Write_ASW_CORE0_PPort_TransmitData2Core1_Data_ptr
        Rte_Write_ASW_CORE1_PPort_TransmitData2Core0_Data_ptr: implemented-entry=Rte_Write_ASW_CORE1_PPort_TransmitData2Core0_Data_ptr
        Rte_Write_ASW_NM_PP_BswMArbitration_BswM_MRP_Network_uint8: implemented-entry=Rte_Write_ASW_NM_PP_BswMArbitration_BswM_MRP_Network_uint8
        Rte_Write_ASW_NM_PP_BswMArbitration_BswM_MRP_NmState_uint8: implemented-entry=Rte_Write_ASW_NM_PP_BswMArbitration_BswM_MRP_NmState_uint8
        Rte_memcpy: implemented-entry=Rte_memcpy
        SchM_Deinit: implemented-entry=SchM_Deinit
        SchM_IModeInit: implemented-entry=SchM_IModeInit
        SchM_Init: implemented-entry=SchM_Init
        SchM_Mode_BswM_MDGR_BswM_MRP_BswM_MDG: implemented-entry=SchM_Mode_BswM_MDGR_BswM_MRP_BswM_MDG
        SchM_Mode_BswM_MDGR_BswM_MRP_DCM_ModeNotification_EcuReset: implemented-entry=SchM_Mode_BswM_MDGR_BswM_MRP_DCM_ModeNotification_EcuReset
        SchM_Mode_Dcm_R_DcmCommunicationControl_Can_Network_CanNodeNum_01: implemented-entry=SchM_Mode_Dcm_R_DcmCommunicationControl_Can_Network_CanNodeNum_01
        SchM_Mode_WdgM_Current_WdgMSupervisionCycle: implemented-entry=SchM_Mode_WdgM_Current_WdgMSupervisionCycle
        SchM_Switch_BswM_MDGP_AUTOSAR_BswM_ModeDeclarationGroups_MDG_ECUM_STATE: implemented-entry=SchM_Switch_BswM_MDGP_AUTOSAR_BswM_ModeDeclarationGroups_MDG_ECUM_STATE
        SchM_Switch_Dcm_DcmCommunicationControl_Can_Network_CanNodeNum_01: implemented-entry=SchM_Switch_Dcm_DcmCommunicationControl_Can_Network_CanNodeNum_01
        SchM_Switch_Dcm_DcmEcuReset: implemented-entry=SchM_Switch_Dcm_DcmEcuReset
        SchM_Switch_WdgM_WdgMSupervisionCycle: implemented-entry=SchM_Switch_WdgM_WdgMSupervisionCycle
package /AUTOSAR_Rte/BswModuleEntrys
  118 x bsw module entry:
    Rte_ActivateRE: call-type=REGULAR
    Rte_Call_ASW_CORE0_RPort_CPUUtilizationCore0_CPU_Utilization: call-type=REGULAR
    Rte_Call_ASW_CORE0_RPort_ClientCallCore0_Core_ClientServer: call-type=REGULAR
    Rte_Call_ASW_CORE0_RPort_GetMaxUserStackUtilization_GetMaxUserStackUtilization: call-type=REGULAR
    Rte_Call_ASW_CORE1_RPort_CPUUtilizationCore1_CPU_Utilization: call-type=REGULAR
    Rte_Call_ASW_CORE1_RPort_GetMaxUserStackUtilization_GetMaxUserStackUtilization: call-type=REGULAR
    Rte_Call_ASW_CORE2_RPort_CPUUtilizationCore2_CPU_Utilization: call-type=REGULAR
    Rte_Call_ASW_CORE2_RPort_GetMaxUserStackUtilization_GetMaxUserStackUtilization: call-type=REGULAR
    Rte_Call_ASW_CORE3_RPort_CPUUtilizationCore3_CPU_Utilization: call-type=REGULAR
    Rte_Call_ASW_CORE3_RPort_GetMaxUserStackUtilization_GetMaxUserStackUtilization: call-type=REGULAR
    Rte_Call_ASW_DEM_IndStatus_MIL_GetIndicatorStatus: call-type=REGULAR
    Rte_Call_ASW_DEM_OpCycle_DemOperationCycle_Ignition_GetOperationCycleState: call-type=REGULAR
    Rte_Call_ASW_DEM_OpCycle_DemOperationCycle_Ignition_SetOperationCycleState: call-type=REGULAR
    Rte_Call_ASW_DEM_RPort_OpCycle_DemOperationCycle_Power_GetCycleQualified: call-type=REGULAR
    Rte_Call_ASW_DEM_RPort_OpCycle_DemOperationCycle_Power_GetOperationCycleState: call-type=REGULAR
    Rte_Call_ASW_DEM_RPort_OpCycle_DemOperationCycle_Power_SetCycleQualified: call-type=REGULAR
    Rte_Call_ASW_DEM_RPort_OpCycle_DemOperationCycle_Power_SetOperationCycleState: call-type=REGULAR
    Rte_Call_ASW_NM_RP_ComM_UserRequest_CAN0_GetCurrentComMode: call-type=REGULAR
    Rte_Call_ASW_NM_RP_ComM_UserRequest_CAN0_GetMaxComMode: call-type=REGULAR
    Rte_Call_ASW_NM_RP_ComM_UserRequest_CAN0_GetRequestedComMode: call-type=REGULAR
    Rte_Call_ASW_NM_RP_ComM_UserRequest_CAN0_RequestComMode: call-type=REGULAR
    Rte_Call_ASW_NM_RPort_EcuModeLimitation_LimitECUToNoComMode: call-type=REGULAR
    Rte_Call_ASW_NM_RPort_EcuModeLimitation_ReadInhibitCounter: call-type=REGULAR
    Rte_Call_ASW_NM_RPort_EcuModeLimitation_ResetInhibitCounter: call-type=REGULAR
    Rte_Call_ASW_NM_RPort_EcuModeLimitation_SetECUGroupClassification: call-type=REGULAR
    Rte_Call_ASW_NVM_RPort_ASW_NVM_BlockNative_1024_1_EraseBlock: call-type=REGULAR
    Rte_Call_ASW_NVM_RPort_ASW_NVM_BlockNative_1024_1_GetDataIndex: call-type=REGULAR
    Rte_Call_ASW_NVM_RPort_ASW_NVM_BlockNative_1024_1_GetErrorStatus: call-type=REGULAR
    Rte_Call_ASW_NVM_RPort_ASW_NVM_BlockNative_1024_1_InvalidateNvBlock: call-type=REGULAR
    Rte_Call_ASW_NVM_RPort_ASW_NVM_BlockNative_1024_1_ReadBlock: call-type=REGULAR
    Rte_Call_ASW_NVM_RPort_ASW_NVM_BlockNative_1024_1_RestoreBlockDefaults: call-type=REGULAR
    Rte_Call_ASW_NVM_RPort_ASW_NVM_BlockNative_1024_1_SetDataIndex: call-type=REGULAR
    Rte_Call_ASW_NVM_RPort_ASW_NVM_BlockNative_1024_1_SetRamBlockStatus: call-type=REGULAR
    Rte_Call_ASW_NVM_RPort_ASW_NVM_BlockNative_1024_1_WriteBlock: call-type=REGULAR
    Rte_Call_ASW_WDG_RPort_Alive_Supervision_Entity1_CheckpointReached: call-type=REGULAR
    Rte_Call_Dcm_DataServices_DcmDspPidData_04_ReadData: call-type=REGULAR
    Rte_Call_Dcm_DataServices_DcmDspPidData_05_ReadData: call-type=REGULAR
    Rte_Call_Dcm_DataServices_DcmDspPidData_0C_ReadData: call-type=REGULAR
    Rte_Call_Dcm_DataServices_DcmDspPidData_0D_ReadData: call-type=REGULAR
    Rte_Call_Dcm_DataServices_DcmDspPidData_21_ReadData: call-type=REGULAR
    Rte_Call_Dcm_DataServices_DcmDspPidData_30_ReadData: call-type=REGULAR
    Rte_Call_Dcm_DataServices_DcmDspPidData_31_ReadData: call-type=REGULAR
    Rte_Call_Dcm_DataServices_DcmDspPidData_41_ReadData: call-type=REGULAR
    Rte_Call_Dcm_DataServices_DcmDspPidData_42_ReadData: call-type=REGULAR
    Rte_Call_Dcm_DataServices_DcmDspPidData_49_ReadData: call-type=REGULAR
    Rte_Call_Dcm_InfotypeServices_DcmDspVehInfoData_04_GetInfotypeValueData: call-type=REGULAR
    Rte_Call_Dcm_InfotypeServices_DcmDspVehInfoData_0A_GetInfotypeValueData: call-type=REGULAR
    Rte_Call_Dcm_InfotypeServices_VIT_06_0_GetInfotypeValueData: call-type=REGULAR
    Rte_Call_Dcm_RoutineServices_DcmDspRoutine_0203_RequestResults: call-type=REGULAR
    Rte_Call_Dcm_RoutineServices_DcmDspRoutine_0203_Start: call-type=REGULAR
    Rte_Call_Dem_DataServices_CS_ExtendedDataRecord_Aged_counter_ReadData: call-type=REGULAR
    Rte_Call_Dem_DataServices_CS_ExtendedDataRecord_Fault_pending_counter_ReadData: call-type=REGULAR
    Rte_Call_Dem_DataServices_PID_02_ReadData: call-type=REGULAR
    Rte_Call_Dem_DataServices_PID_04_ReadData: call-type=REGULAR
    Rte_Call_Dem_DataServices_PID_05_ReadData: call-type=REGULAR
    Rte_Call_Dem_DataServices_PID_0C_ReadData: call-type=REGULAR
    Rte_Call_Dem_DataServices_PID_0D_ReadData: call-type=REGULAR
    Rte_Call_Dem_DataServices_PID_42_ReadData: call-type=REGULAR
    Rte_Call_Dem_DataServices_PID_49_ReadData: call-type=REGULAR
    Rte_DecrementWaitingCount: call-type=REGULAR
    Rte_GetCurrentTaskIndex: call-type=REGULAR
    Rte_IrvRead_ASW_CORE0_RE_CORE0_SWC_100ms_Explicit_IRV_1: call-type=REGULAR
    Rte_IrvWrite_ASW_CORE0_RE_CORE0_SWC_10ms_Explicit_IRV_1: call-type=REGULAR
    Rte_MSACbk_SW_13: call-type=REGULAR
    Rte_MainFunction: call-type=REGULAR
    Rte_ReadQueue: call-type=REGULAR
    Rte_Read_ASW_CORE0_RPort_ReceiveDatafromCore1_Data_ptr: call-type=REGULAR
    Rte_Read_ASW_CORE1_RPort_ReceiverDataFromCore0_Data_ptr: call-type=REGULAR
    Rte_Read_BswM_RP_BswMArbitration_BswMSwcModeRequest_AppMode: call-type=REGULAR
    Rte_Read_BswM_RP_BswMArbitration_BswM_MRP_SWC_Network_uint8: call-type=REGULAR
    Rte_SetEvent: call-type=REGULAR
    Rte_Start: call-type=REGULAR
    Rte_StartHook_Return: call-type=CALLBACK
    Rte_StartHook_Start: call-type=CALLBACK
    Rte_Stop: call-type=REGULAR
    Rte_StopHook_Return: call-type=CALLBACK
    Rte_StopHook_Start: call-type=CALLBACK
    Rte_SwitchAck_WdgM_globalMode_currentMode: call-type=REGULAR
    Rte_SwitchAck_WdgM_mode_WdgMSupervisedEntity_Alive_Supervision_CPU{1..3}_currentMode: call-type=REGULAR
    Rte_SwitchAck_WdgM_mode_WdgMSupervisedEntity_Alive_Supervision_Entity1_currentMode: call-type=REGULAR
    Rte_SwitchAck_WdgM_mode_WdgMSupervisedEntity_Logic_Supervision_Entity1_currentMode: call-type=REGULAR
    Rte_Switch_ComM_UM_ComMUser_Can_Network_CanNodeNum_{00..03}_currentMode: call-type=REGULAR
    Rte_Switch_Dcm_Pp_DcmCommunicationControl_Can_Network_CanNodeNum_01_MDGP_DcmCommunicationControl_Can_Network_CanNodeNum_01: call-type=REGULAR
    Rte_Switch_Dcm_Pp_DcmControlDTCSetting_MDGP_DcmControlDTCSetting: call-type=REGULAR
    Rte_Switch_Dcm_Pp_DcmDiagnosticSessionControl_MDGP_DcmDiagnosticSessionControl: call-type=REGULAR
    Rte_Switch_Dcm_Pp_DcmEcuReset_MDGP_DcmEcuReset: call-type=REGULAR
    Rte_Switch_WdgM_globalMode_currentMode: call-type=REGULAR
    Rte_Switch_WdgM_mode_WdgMSupervisedEntity_Alive_Supervision_CPU{1..3}_currentMode: call-type=REGULAR
    Rte_Switch_WdgM_mode_WdgMSupervisedEntity_Alive_Supervision_Entity1_currentMode: call-type=REGULAR
    Rte_Switch_WdgM_mode_WdgMSupervisedEntity_Logic_Supervision_Entity1_currentMode: call-type=REGULAR
    Rte_Task_Activate: call-type=CALLBACK
    Rte_WaitWithTimeout: call-type=REGULAR
    Rte_WriteQueue: call-type=REGULAR
    Rte_Write_ASW_BASE_PPort_SwcModeRequest_AppMode: call-type=REGULAR
    Rte_Write_ASW_CORE0_PPort_SwcModeRequest_AppMode: call-type=REGULAR
    Rte_Write_ASW_CORE0_PPort_TransmitData2Core1_Data_ptr: call-type=REGULAR
    Rte_Write_ASW_CORE1_PPort_TransmitData2Core0_Data_ptr: call-type=REGULAR
    Rte_Write_ASW_NM_PP_BswMArbitration_BswM_MRP_Network_uint8: call-type=REGULAR
    Rte_Write_ASW_NM_PP_BswMArbitration_BswM_MRP_NmState_uint8: call-type=REGULAR
    Rte_memcpy: call-type=REGULAR
    SchM_Deinit: call-type=REGULAR
    SchM_IModeInit: call-type=REGULAR
    SchM_Init: call-type=REGULAR
    SchM_Mode_BswM_MDGR_BswM_MRP_BswM_MDG: call-type=REGULAR
    SchM_Mode_BswM_MDGR_BswM_MRP_DCM_ModeNotification_EcuReset: call-type=REGULAR
    SchM_Mode_Dcm_R_DcmCommunicationControl_Can_Network_CanNodeNum_01: call-type=REGULAR
    SchM_Mode_WdgM_Current_WdgMSupervisionCycle: call-type=REGULAR
    SchM_Switch_BswM_MDGP_AUTOSAR_BswM_ModeDeclarationGroups_MDG_ECUM_STATE: call-type=REGULAR
    SchM_Switch_Dcm_DcmCommunicationControl_Can_Network_CanNodeNum_01: call-type=REGULAR
    SchM_Switch_Dcm_DcmEcuReset: call-type=REGULAR
    SchM_Switch_WdgM_WdgMSupervisionCycle: call-type=REGULAR
package /AUTOSAR_Rte/BswImplementations
  bsw implementation Rte: programming-language=C, sw-version=0.0.0, used-code-generator=ETAS RTEGen, vendor-id=11, ar-release-version=4.0.0, behavior=RteInternalBehavior
    generated-artifacts:
      140 x dependency on artifact:
        Com_h: artifact-descriptor={short-label=Com_h, category=SWHDR, domain=AUTOSAR}
        Core0_BSW_OsTask_SwcRequest_c: artifact-descriptor={short-label=Core0_BSW_OsTask_SwcRequest_c, category=SWSRC, domain=AUTOSAR}
        Core0_BSW_OsTask_SwcRequest_h: artifact-descriptor={short-label=Core0_BSW_OsTask_SwcRequest_h, category=SWHDR, domain=AUTOSAR}
        Core0_OsTask_ASW_100ms_c: artifact-descriptor={short-label=Core0_OsTask_ASW_100ms_c, category=SWSRC, domain=AUTOSAR}
        Core0_OsTask_ASW_100ms_h: artifact-descriptor={short-label=Core0_OsTask_ASW_100ms_h, category=SWHDR, domain=AUTOSAR}
        Core0_OsTask_ASW_10ms_c: artifact-descriptor={short-label=Core0_OsTask_ASW_10ms_c, category=SWSRC, domain=AUTOSAR}
        Core0_OsTask_ASW_10ms_h: artifact-descriptor={short-label=Core0_OsTask_ASW_10ms_h, category=SWHDR, domain=AUTOSAR}
        Core0_OsTask_ASW_1ms_c: artifact-descriptor={short-label=Core0_OsTask_ASW_1ms_c, category=SWSRC, domain=AUTOSAR}
        Core0_OsTask_ASW_1ms_h: artifact-descriptor={short-label=Core0_OsTask_ASW_1ms_h, category=SWHDR, domain=AUTOSAR}
        Core0_OsTask_BSW_100ms_c: artifact-descriptor={short-label=Core0_OsTask_BSW_100ms_c, category=SWSRC, domain=AUTOSAR}
        Core0_OsTask_BSW_100ms_h: artifact-descriptor={short-label=Core0_OsTask_BSW_100ms_h, category=SWHDR, domain=AUTOSAR}
        Core0_OsTask_BSW_10ms_c: artifact-descriptor={short-label=Core0_OsTask_BSW_10ms_c, category=SWSRC, domain=AUTOSAR}
        Core0_OsTask_BSW_10ms_h: artifact-descriptor={short-label=Core0_OsTask_BSW_10ms_h, category=SWHDR, domain=AUTOSAR}
        Core0_OsTask_BSW_1ms_c: artifact-descriptor={short-label=Core0_OsTask_BSW_1ms_c, category=SWSRC, domain=AUTOSAR}
        Core0_OsTask_BSW_1ms_h: artifact-descriptor={short-label=Core0_OsTask_BSW_1ms_h, category=SWHDR, domain=AUTOSAR}
        Core0_OsTask_BSW_50ms_c: artifact-descriptor={short-label=Core0_OsTask_BSW_50ms_c, category=SWSRC, domain=AUTOSAR}
        Core0_OsTask_BSW_50ms_h: artifact-descriptor={short-label=Core0_OsTask_BSW_50ms_h, category=SWHDR, domain=AUTOSAR}
        Core1_OsTask_ASW_100ms_c: artifact-descriptor={short-label=Core1_OsTask_ASW_100ms_c, category=SWSRC, domain=AUTOSAR}
        Core1_OsTask_ASW_100ms_h: artifact-descriptor={short-label=Core1_OsTask_ASW_100ms_h, category=SWHDR, domain=AUTOSAR}
        Core1_OsTask_ASW_10ms_c: artifact-descriptor={short-label=Core1_OsTask_ASW_10ms_c, category=SWSRC, domain=AUTOSAR}
        Core1_OsTask_ASW_10ms_h: artifact-descriptor={short-label=Core1_OsTask_ASW_10ms_h, category=SWHDR, domain=AUTOSAR}
        Core1_OsTask_ASW_1ms_c: artifact-descriptor={short-label=Core1_OsTask_ASW_1ms_c, category=SWSRC, domain=AUTOSAR}
        Core1_OsTask_ASW_1ms_h: artifact-descriptor={short-label=Core1_OsTask_ASW_1ms_h, category=SWHDR, domain=AUTOSAR}
        Core1_OsTask_BSW_10ms_c: artifact-descriptor={short-label=Core1_OsTask_BSW_10ms_c, category=SWSRC, domain=AUTOSAR}
        Core1_OsTask_BSW_10ms_h: artifact-descriptor={short-label=Core1_OsTask_BSW_10ms_h, category=SWHDR, domain=AUTOSAR}
        Core2_OsTask_ASW_100ms_c: artifact-descriptor={short-label=Core2_OsTask_ASW_100ms_c, category=SWSRC, domain=AUTOSAR}
        Core2_OsTask_ASW_100ms_h: artifact-descriptor={short-label=Core2_OsTask_ASW_100ms_h, category=SWHDR, domain=AUTOSAR}
        Core2_OsTask_ASW_10ms_c: artifact-descriptor={short-label=Core2_OsTask_ASW_10ms_c, category=SWSRC, domain=AUTOSAR}
        Core2_OsTask_ASW_10ms_h: artifact-descriptor={short-label=Core2_OsTask_ASW_10ms_h, category=SWHDR, domain=AUTOSAR}
        Core2_OsTask_ASW_1ms_c: artifact-descriptor={short-label=Core2_OsTask_ASW_1ms_c, category=SWSRC, domain=AUTOSAR}
        Core2_OsTask_ASW_1ms_h: artifact-descriptor={short-label=Core2_OsTask_ASW_1ms_h, category=SWHDR, domain=AUTOSAR}
        Core2_OsTask_ASW_5ms_c: artifact-descriptor={short-label=Core2_OsTask_ASW_5ms_c, category=SWSRC, domain=AUTOSAR}
        Core2_OsTask_ASW_5ms_h: artifact-descriptor={short-label=Core2_OsTask_ASW_5ms_h, category=SWHDR, domain=AUTOSAR}
        Core2_OsTask_BSW_10ms_c: artifact-descriptor={short-label=Core2_OsTask_BSW_10ms_c, category=SWSRC, domain=AUTOSAR}
        Core2_OsTask_BSW_10ms_h: artifact-descriptor={short-label=Core2_OsTask_BSW_10ms_h, category=SWHDR, domain=AUTOSAR}
        Core3_OsTask_ASW_1ms_c: artifact-descriptor={short-label=Core3_OsTask_ASW_1ms_c, category=SWSRC, domain=AUTOSAR}
        Core3_OsTask_ASW_1ms_h: artifact-descriptor={short-label=Core3_OsTask_ASW_1ms_h, category=SWHDR, domain=AUTOSAR}
        Core3_OsTask_ASW_5ms_c: artifact-descriptor={short-label=Core3_OsTask_ASW_5ms_c, category=SWSRC, domain=AUTOSAR}
        Core3_OsTask_ASW_5ms_h: artifact-descriptor={short-label=Core3_OsTask_ASW_5ms_h, category=SWHDR, domain=AUTOSAR}
        Core3_OsTask_BSW_10ms_c: artifact-descriptor={short-label=Core3_OsTask_BSW_10ms_c, category=SWSRC, domain=AUTOSAR}
        Core3_OsTask_BSW_10ms_h: artifact-descriptor={short-label=Core3_OsTask_BSW_10ms_h, category=SWHDR, domain=AUTOSAR}
        Ioc_h: artifact-descriptor={short-label=Ioc_h, category=SWHDR, domain=AUTOSAR}
        NvM_h: artifact-descriptor={short-label=NvM_h, category=SWHDR, domain=AUTOSAR}
        Os_h: artifact-descriptor={short-label=Os_h, category=SWHDR, domain=AUTOSAR}
        Rte_c: artifact-descriptor={short-label=Rte_c, category=SWSRC, domain=AUTOSAR}
        Rte_h: artifact-descriptor={short-label=Rte_h, category=SWHDR, domain=AUTOSAR}
        Rte_ASW_BASE_h: artifact-descriptor={short-label=Rte_ASW_BASE_h, category=SWHDR, domain=AUTOSAR}
        Rte_ASW_BASE_Type_h: artifact-descriptor={short-label=Rte_ASW_BASE_Type_h, category=SWHDR, domain=AUTOSAR}
        Rte_ASW_COM_h: artifact-descriptor={short-label=Rte_ASW_COM_h, category=SWHDR, domain=AUTOSAR}
        Rte_ASW_COM_Type_h: artifact-descriptor={short-label=Rte_ASW_COM_Type_h, category=SWHDR, domain=AUTOSAR}
        Rte_ASW_CORE0_h: artifact-descriptor={short-label=Rte_ASW_CORE0_h, category=SWHDR, domain=AUTOSAR}
        Rte_ASW_CORE0_Type_h: artifact-descriptor={short-label=Rte_ASW_CORE0_Type_h, category=SWHDR, domain=AUTOSAR}
        Rte_ASW_CORE1_h: artifact-descriptor={short-label=Rte_ASW_CORE1_h, category=SWHDR, domain=AUTOSAR}
        Rte_ASW_CORE1_Type_h: artifact-descriptor={short-label=Rte_ASW_CORE1_Type_h, category=SWHDR, domain=AUTOSAR}
        Rte_ASW_CORE2_h: artifact-descriptor={short-label=Rte_ASW_CORE2_h, category=SWHDR, domain=AUTOSAR}
        Rte_ASW_CORE2_Type_h: artifact-descriptor={short-label=Rte_ASW_CORE2_Type_h, category=SWHDR, domain=AUTOSAR}
        Rte_ASW_CORE3_h: artifact-descriptor={short-label=Rte_ASW_CORE3_h, category=SWHDR, domain=AUTOSAR}
        Rte_ASW_CORE3_Type_h: artifact-descriptor={short-label=Rte_ASW_CORE3_Type_h, category=SWHDR, domain=AUTOSAR}
        Rte_ASW_DCM_h: artifact-descriptor={short-label=Rte_ASW_DCM_h, category=SWHDR, domain=AUTOSAR}
        Rte_ASW_DCM_Type_h: artifact-descriptor={short-label=Rte_ASW_DCM_Type_h, category=SWHDR, domain=AUTOSAR}
        Rte_ASW_DEM_h: artifact-descriptor={short-label=Rte_ASW_DEM_h, category=SWHDR, domain=AUTOSAR}
        Rte_ASW_DEM_Type_h: artifact-descriptor={short-label=Rte_ASW_DEM_Type_h, category=SWHDR, domain=AUTOSAR}
        Rte_ASW_NM_h: artifact-descriptor={short-label=Rte_ASW_NM_h, category=SWHDR, domain=AUTOSAR}
        Rte_ASW_NM_Type_h: artifact-descriptor={short-label=Rte_ASW_NM_Type_h, category=SWHDR, domain=AUTOSAR}
        Rte_ASW_NVM_h: artifact-descriptor={short-label=Rte_ASW_NVM_h, category=SWHDR, domain=AUTOSAR}
        Rte_ASW_NVM_Type_h: artifact-descriptor={short-label=Rte_ASW_NVM_Type_h, category=SWHDR, domain=AUTOSAR}
        Rte_ASW_WDG_h: artifact-descriptor={short-label=Rte_ASW_WDG_h, category=SWHDR, domain=AUTOSAR}
        Rte_ASW_WDG_Type_h: artifact-descriptor={short-label=Rte_ASW_WDG_Type_h, category=SWHDR, domain=AUTOSAR}
        Rte_ASW_XCP_h: artifact-descriptor={short-label=Rte_ASW_XCP_h, category=SWHDR, domain=AUTOSAR}
        Rte_ASW_XCP_Type_h: artifact-descriptor={short-label=Rte_ASW_XCP_Type_h, category=SWHDR, domain=AUTOSAR}
        Rte_BswM_h: artifact-descriptor={short-label=Rte_BswM_h, category=SWHDR, domain=AUTOSAR}
        Rte_BswM_Type_h: artifact-descriptor={short-label=Rte_BswM_Type_h, category=SWHDR, domain=AUTOSAR}
        Rte_CDD_CORE0_h: artifact-descriptor={short-label=Rte_CDD_CORE0_h, category=SWHDR, domain=AUTOSAR}
        Rte_CDD_CORE0_Type_h: artifact-descriptor={short-label=Rte_CDD_CORE0_Type_h, category=SWHDR, domain=AUTOSAR}
        Rte_CDD_CORE1_h: artifact-descriptor={short-label=Rte_CDD_CORE1_h, category=SWHDR, domain=AUTOSAR}
        Rte_CDD_CORE1_Type_h: artifact-descriptor={short-label=Rte_CDD_CORE1_Type_h, category=SWHDR, domain=AUTOSAR}
        Rte_CDD_CORE2_h: artifact-descriptor={short-label=Rte_CDD_CORE2_h, category=SWHDR, domain=AUTOSAR}
        Rte_CDD_CORE2_Type_h: artifact-descriptor={short-label=Rte_CDD_CORE2_Type_h, category=SWHDR, domain=AUTOSAR}
        Rte_CDD_CORE3_h: artifact-descriptor={short-label=Rte_CDD_CORE3_h, category=SWHDR, domain=AUTOSAR}
        Rte_CDD_CORE3_Type_h: artifact-descriptor={short-label=Rte_CDD_CORE3_Type_h, category=SWHDR, domain=AUTOSAR}
        Rte_Cbk_h: artifact-descriptor={short-label=Rte_Cbk_h, category=SWHDR, domain=AUTOSAR}
        Rte_Cfg_h: artifact-descriptor={short-label=Rte_Cfg_h, category=SWHDR, domain=AUTOSAR}
        Rte_ComM_h: artifact-descriptor={short-label=Rte_ComM_h, category=SWHDR, domain=AUTOSAR}
        Rte_ComM_Type_h: artifact-descriptor={short-label=Rte_ComM_Type_h, category=SWHDR, domain=AUTOSAR}
        Rte_Const_h: artifact-descriptor={short-label=Rte_Const_h, category=SWHDR, domain=AUTOSAR}
        Rte_DataHandleType_h: artifact-descriptor={short-label=Rte_DataHandleType_h, category=SWHDR, domain=AUTOSAR}
        Rte_Dcm_h: artifact-descriptor={short-label=Rte_Dcm_h, category=SWHDR, domain=AUTOSAR}
        Rte_Dcm_Type_h: artifact-descriptor={short-label=Rte_Dcm_Type_h, category=SWHDR, domain=AUTOSAR}
        Rte_Dem_h: artifact-descriptor={short-label=Rte_Dem_h, category=SWHDR, domain=AUTOSAR}
        Rte_Dem_Type_h: artifact-descriptor={short-label=Rte_Dem_Type_h, category=SWHDR, domain=AUTOSAR}
        Rte_Det_h: artifact-descriptor={short-label=Rte_Det_h, category=SWHDR, domain=AUTOSAR}
        Rte_Det_Type_h: artifact-descriptor={short-label=Rte_Det_Type_h, category=SWHDR, domain=AUTOSAR}
        Rte_EcuM_h: artifact-descriptor={short-label=Rte_EcuM_h, category=SWHDR, domain=AUTOSAR}
        Rte_EcuM_Type_h: artifact-descriptor={short-label=Rte_EcuM_Type_h, category=SWHDR, domain=AUTOSAR}
        Rte_Hook_h: artifact-descriptor={short-label=Rte_Hook_h, category=SWHDR, domain=AUTOSAR}
        Rte_Intl_h: artifact-descriptor={short-label=Rte_Intl_h, category=SWHDR, domain=AUTOSAR}
        Rte_Lib_c: artifact-descriptor={short-label=Rte_Lib_c, category=SWSRC, domain=AUTOSAR}
        Rte_Main_h: artifact-descriptor={short-label=Rte_Main_h, category=SWHDR, domain=AUTOSAR}
        Rte_NvM_h: artifact-descriptor={short-label=Rte_NvM_h, category=SWHDR, domain=AUTOSAR}
        Rte_NvM_Type_h: artifact-descriptor={short-label=Rte_NvM_Type_h, category=SWHDR, domain=AUTOSAR}
        Rte_RSID_h: artifact-descriptor={short-label=Rte_RSID_h, category=SWHDR, domain=AUTOSAR}
        Rte_RSID_Type_h: artifact-descriptor={short-label=Rte_RSID_Type_h, category=SWHDR, domain=AUTOSAR}
        Rte_SWC_DEM_h: artifact-descriptor={short-label=Rte_SWC_DEM_h, category=SWHDR, domain=AUTOSAR}
        Rte_SWC_DEM_Type_h: artifact-descriptor={short-label=Rte_SWC_DEM_Type_h, category=SWHDR, domain=AUTOSAR}
        Rte_Type_h: artifact-descriptor={short-label=Rte_Type_h, category=SWHDR, domain=AUTOSAR}
        Rte_WdgM_h: artifact-descriptor={short-label=Rte_WdgM_h, category=SWHDR, domain=AUTOSAR}
        Rte_WdgM_Type_h: artifact-descriptor={short-label=Rte_WdgM_Type_h, category=SWHDR, domain=AUTOSAR}
        Rte_rba_DiagLib_h: artifact-descriptor={short-label=Rte_rba_DiagLib_h, category=SWHDR, domain=AUTOSAR}
        Rte_rba_DiagLib_Type_h: artifact-descriptor={short-label=Rte_rba_DiagLib_Type_h, category=SWHDR, domain=AUTOSAR}
        SchM_BswM_h: artifact-descriptor={short-label=SchM_BswM_h, category=SWHDR, domain=AUTOSAR}
        SchM_BswM_Type_h: artifact-descriptor={short-label=SchM_BswM_Type_h, category=SWHDR, domain=AUTOSAR}
        SchM_Can_h: artifact-descriptor={short-label=SchM_Can_h, category=SWHDR, domain=AUTOSAR}
        SchM_CanNm_h: artifact-descriptor={short-label=SchM_CanNm_h, category=SWHDR, domain=AUTOSAR}
        SchM_CanNm_Type_h: artifact-descriptor={short-label=SchM_CanNm_Type_h, category=SWHDR, domain=AUTOSAR}
        SchM_CanSM_h: artifact-descriptor={short-label=SchM_CanSM_h, category=SWHDR, domain=AUTOSAR}
        SchM_CanSM_Type_h: artifact-descriptor={short-label=SchM_CanSM_Type_h, category=SWHDR, domain=AUTOSAR}
        SchM_CanTp_h: artifact-descriptor={short-label=SchM_CanTp_h, category=SWHDR, domain=AUTOSAR}
        SchM_CanTp_Type_h: artifact-descriptor={short-label=SchM_CanTp_Type_h, category=SWHDR, domain=AUTOSAR}
        SchM_CanTrcv_h: artifact-descriptor={short-label=SchM_CanTrcv_h, category=SWHDR, domain=AUTOSAR}
        SchM_CanTrcv_Type_h: artifact-descriptor={short-label=SchM_CanTrcv_Type_h, category=SWHDR, domain=AUTOSAR}
        SchM_Can_Type_h: artifact-descriptor={short-label=SchM_Can_Type_h, category=SWHDR, domain=AUTOSAR}
        SchM_Com_h: artifact-descriptor={short-label=SchM_Com_h, category=SWHDR, domain=AUTOSAR}
        SchM_ComM_h: artifact-descriptor={short-label=SchM_ComM_h, category=SWHDR, domain=AUTOSAR}
        SchM_ComM_Type_h: artifact-descriptor={short-label=SchM_ComM_Type_h, category=SWHDR, domain=AUTOSAR}
        SchM_Com_Type_h: artifact-descriptor={short-label=SchM_Com_Type_h, category=SWHDR, domain=AUTOSAR}
        SchM_Dcm_h: artifact-descriptor={short-label=SchM_Dcm_h, category=SWHDR, domain=AUTOSAR}
        SchM_Dcm_Type_h: artifact-descriptor={short-label=SchM_Dcm_Type_h, category=SWHDR, domain=AUTOSAR}
        SchM_Dem_h: artifact-descriptor={short-label=SchM_Dem_h, category=SWHDR, domain=AUTOSAR}
        SchM_Dem_Type_h: artifact-descriptor={short-label=SchM_Dem_Type_h, category=SWHDR, domain=AUTOSAR}
        SchM_EcuM_h: artifact-descriptor={short-label=SchM_EcuM_h, category=SWHDR, domain=AUTOSAR}
        SchM_EcuM_Type_h: artifact-descriptor={short-label=SchM_EcuM_Type_h, category=SWHDR, domain=AUTOSAR}
        SchM_NvM_h: artifact-descriptor={short-label=SchM_NvM_h, category=SWHDR, domain=AUTOSAR}
        SchM_NvM_Type_h: artifact-descriptor={short-label=SchM_NvM_Type_h, category=SWHDR, domain=AUTOSAR}
        SchM_PduR_h: artifact-descriptor={short-label=SchM_PduR_h, category=SWHDR, domain=AUTOSAR}
        SchM_PduR_Type_h: artifact-descriptor={short-label=SchM_PduR_Type_h, category=SWHDR, domain=AUTOSAR}
        SchM_WdgM_h: artifact-descriptor={short-label=SchM_WdgM_h, category=SWHDR, domain=AUTOSAR}
        SchM_WdgM_Type_h: artifact-descriptor={short-label=SchM_WdgM_Type_h, category=SWHDR, domain=AUTOSAR}
        SchM_Xcp_h: artifact-descriptor={short-label=SchM_Xcp_h, category=SWHDR, domain=AUTOSAR}
        SchM_Xcp_Type_h: artifact-descriptor={short-label=SchM_Xcp_Type_h, category=SWHDR, domain=AUTOSAR}
        iocNeeds_h: artifact-descriptor={short-label=iocNeeds_h, category=SWHDR, domain=AUTOSAR}
    resource consumption ResConsumption
      64 x memory section:
        RTE_ASW_BASE_CODE: executable-entity=Rte_Write_ASW_BASE_PPort_SwcModeRequest_AppMode, prefix=RTE_ASW_BASE, sw-addrmethod=CODE, symbol=CODE
        RTE_ASW_CORE0_CODE:
          executable-entity=[Rte_Call_ASW_CORE0_RPort_CPUUtilizationCore0_CPU_Utilization, Rte_Call_ASW_CORE0_RPort_ClientCallCore0_Core_ClientServer, Rte_Call_ASW_CORE0_RPort_GetMaxUserStackUtilization_GetMaxUserStackUtilization, Rte_IrvRead_ASW_CORE0_RE_CORE0_SWC_100ms_Explicit_IRV_1, Rte_IrvWrite_ASW_CORE0_RE_CORE0_SWC_10ms_Explicit_IRV_1, Rte_Read_ASW_CORE0_RPort_ReceiveDatafromCore1_Data_ptr, Rte_Write_ASW_CORE0_PPort_SwcModeRequest_AppMode, Rte_Write_ASW_CORE0_PPort_TransmitData2Core1_Data_ptr]
          prefix=RTE_ASW_CORE0
          sw-addrmethod=CODE
          symbol=CODE
        RTE_ASW_CORE1_CODE: executable-entity=[Rte_Call_ASW_CORE1_RPort_CPUUtilizationCore1_CPU_Utilization, Rte_Call_ASW_CORE1_RPort_GetMaxUserStackUtilization_GetMaxUserStackUtilization, Rte_Read_ASW_CORE1_RPort_ReceiverDataFromCore0_Data_ptr, Rte_Write_ASW_CORE1_PPort_TransmitData2Core0_Data_ptr], prefix=RTE_ASW_CORE1, sw-addrmethod=CODE, symbol=CODE
        RTE_ASW_CORE2_CODE: executable-entity=[Rte_Call_ASW_CORE2_RPort_CPUUtilizationCore2_CPU_Utilization, Rte_Call_ASW_CORE2_RPort_GetMaxUserStackUtilization_GetMaxUserStackUtilization], prefix=RTE_ASW_CORE2, sw-addrmethod=CODE, symbol=CODE
        RTE_ASW_CORE3_CODE: executable-entity=[Rte_Call_ASW_CORE3_RPort_CPUUtilizationCore3_CPU_Utilization, Rte_Call_ASW_CORE3_RPort_GetMaxUserStackUtilization_GetMaxUserStackUtilization], prefix=RTE_ASW_CORE3, sw-addrmethod=CODE, symbol=CODE
        RTE_ASW_DEM_CODE:
          executable-entity=[Rte_Call_ASW_DEM_IndStatus_MIL_GetIndicatorStatus, Rte_Call_ASW_DEM_OpCycle_DemOperationCycle_Ignition_GetOperationCycleState, Rte_Call_ASW_DEM_OpCycle_DemOperationCycle_Ignition_SetOperationCycleState, Rte_Call_ASW_DEM_RPort_OpCycle_DemOperationCycle_Power_GetCycleQualified, Rte_Call_ASW_DEM_RPort_OpCycle_DemOperationCycle_Power_GetOperationCycleState, Rte_Call_ASW_DEM_RPort_OpCycle_DemOperationCycle_Power_SetCycleQualified, Rte_Call_ASW_DEM_RPort_OpCycle_DemOperationCycle_Power_SetOperationCycleState]
          prefix=RTE_ASW_DEM
          sw-addrmethod=CODE
          symbol=CODE
        RTE_ASW_NM_CODE:
          executable-entity=[Rte_Call_ASW_NM_RP_ComM_UserRequest_CAN0_GetCurrentComMode, Rte_Call_ASW_NM_RP_ComM_UserRequest_CAN0_GetMaxComMode, Rte_Call_ASW_NM_RP_ComM_UserRequest_CAN0_GetRequestedComMode, Rte_Call_ASW_NM_RP_ComM_UserRequest_CAN0_RequestComMode, Rte_Call_ASW_NM_RPort_EcuModeLimitation_LimitECUToNoComMode, Rte_Call_ASW_NM_RPort_EcuModeLimitation_ReadInhibitCounter, Rte_Call_ASW_NM_RPort_EcuModeLimitation_ResetInhibitCounter, Rte_Call_ASW_NM_RPort_EcuModeLimitation_SetECUGroupClassification, Rte_Write_ASW_NM_PP_BswMArbitration_BswM_MRP_Network_uint8, Rte_Write_ASW_NM_PP_BswMArbitration_BswM_MRP_NmState_uint8]
          prefix=RTE_ASW_NM
          sw-addrmethod=CODE
          symbol=CODE
        RTE_ASW_NVM_CODE:
          executable-entity=[Rte_Call_ASW_NVM_RPort_ASW_NVM_BlockNative_1024_1_EraseBlock, Rte_Call_ASW_NVM_RPort_ASW_NVM_BlockNative_1024_1_GetDataIndex, Rte_Call_ASW_NVM_RPort_ASW_NVM_BlockNative_1024_1_GetErrorStatus, Rte_Call_ASW_NVM_RPort_ASW_NVM_BlockNative_1024_1_InvalidateNvBlock, Rte_Call_ASW_NVM_RPort_ASW_NVM_BlockNative_1024_1_ReadBlock, Rte_Call_ASW_NVM_RPort_ASW_NVM_BlockNative_1024_1_RestoreBlockDefaults, Rte_Call_ASW_NVM_RPort_ASW_NVM_BlockNative_1024_1_SetDataIndex, Rte_Call_ASW_NVM_RPort_ASW_NVM_BlockNative_1024_1_SetRamBlockStatus, Rte_Call_ASW_NVM_RPort_ASW_NVM_BlockNative_1024_1_WriteBlock]
          prefix=RTE_ASW_NVM
          sw-addrmethod=CODE
          symbol=CODE
        RTE_ASW_WDG_CODE: executable-entity=Rte_Call_ASW_WDG_RPort_Alive_Supervision_Entity1_CheckpointReached, prefix=RTE_ASW_WDG, sw-addrmethod=CODE, symbol=CODE
        RTE_BSWM_CODE: executable-entity=[Rte_Read_BswM_RP_BswMArbitration_BswMSwcModeRequest_AppMode, Rte_Read_BswM_RP_BswMArbitration_BswM_MRP_SWC_Network_uint8, SchM_Mode_BswM_MDGR_BswM_MRP_BswM_MDG, SchM_Mode_BswM_MDGR_BswM_MRP_DCM_ModeNotification_EcuReset, SchM_Switch_BswM_MDGP_AUTOSAR_BswM_ModeDeclarationGroups_MDG_ECUM_STATE], prefix=RTE_BSWM, sw-addrmethod=CODE, symbol=CODE
        RTE_COMM_CODE: executable-entity=[Rte_Switch_ComM_UM_ComMUser_Can_Network_CanNodeNum_00_currentMode, Rte_Switch_ComM_UM_ComMUser_Can_Network_CanNodeNum_01_currentMode, Rte_Switch_ComM_UM_ComMUser_Can_Network_CanNodeNum_02_currentMode, Rte_Switch_ComM_UM_ComMUser_Can_Network_CanNodeNum_03_currentMode], prefix=RTE_COMM, sw-addrmethod=CODE, symbol=CODE
        RTE_CORE0_BSW_OSTASK_SWCREQUEST_CODE: prefix=RTE_CORE0_BSW_OSTASK_SWCREQUEST, sw-addrmethod=CODE, symbol=CODE
        RTE_CORE0_OSTASK_ASW_100MS_CODE: prefix=RTE_CORE0_OSTASK_ASW_100MS, sw-addrmethod=CODE, symbol=CODE
        RTE_CORE0_OSTASK_ASW_10MS_CODE: prefix=RTE_CORE0_OSTASK_ASW_10MS, sw-addrmethod=CODE, symbol=CODE
        RTE_CORE0_OSTASK_ASW_1MS_CODE: prefix=RTE_CORE0_OSTASK_ASW_1MS, sw-addrmethod=CODE, symbol=CODE
        RTE_CORE0_OSTASK_BSW_100MS_CODE: prefix=RTE_CORE0_OSTASK_BSW_100MS, sw-addrmethod=CODE, symbol=CODE
        RTE_CORE0_OSTASK_BSW_10MS_CODE: prefix=RTE_CORE0_OSTASK_BSW_10MS, sw-addrmethod=CODE, symbol=CODE
        RTE_CORE0_OSTASK_BSW_1MS_CODE: prefix=RTE_CORE0_OSTASK_BSW_1MS, sw-addrmethod=CODE, symbol=CODE
        RTE_CORE0_OSTASK_BSW_50MS_CODE: prefix=RTE_CORE0_OSTASK_BSW_50MS, sw-addrmethod=CODE, symbol=CODE
        RTE_CORE1_OSTASK_ASW_100MS_CODE: prefix=RTE_CORE1_OSTASK_ASW_100MS, sw-addrmethod=CODE, symbol=CODE
        RTE_CORE1_OSTASK_ASW_10MS_CODE: prefix=RTE_CORE1_OSTASK_ASW_10MS, sw-addrmethod=CODE, symbol=CODE
        RTE_CORE1_OSTASK_ASW_1MS_CODE: prefix=RTE_CORE1_OSTASK_ASW_1MS, sw-addrmethod=CODE, symbol=CODE
        RTE_CORE1_OSTASK_BSW_10MS_CODE: prefix=RTE_CORE1_OSTASK_BSW_10MS, sw-addrmethod=CODE, symbol=CODE
        RTE_CORE2_OSTASK_ASW_100MS_CODE: prefix=RTE_CORE2_OSTASK_ASW_100MS, sw-addrmethod=CODE, symbol=CODE
        RTE_CORE2_OSTASK_ASW_10MS_CODE: prefix=RTE_CORE2_OSTASK_ASW_10MS, sw-addrmethod=CODE, symbol=CODE
        RTE_CORE2_OSTASK_ASW_1MS_CODE: prefix=RTE_CORE2_OSTASK_ASW_1MS, sw-addrmethod=CODE, symbol=CODE
        RTE_CORE2_OSTASK_ASW_5MS_CODE: prefix=RTE_CORE2_OSTASK_ASW_5MS, sw-addrmethod=CODE, symbol=CODE
        RTE_CORE2_OSTASK_BSW_10MS_CODE: prefix=RTE_CORE2_OSTASK_BSW_10MS, sw-addrmethod=CODE, symbol=CODE
        RTE_CORE3_OSTASK_ASW_1MS_CODE: prefix=RTE_CORE3_OSTASK_ASW_1MS, sw-addrmethod=CODE, symbol=CODE
        RTE_CORE3_OSTASK_ASW_5MS_CODE: prefix=RTE_CORE3_OSTASK_ASW_5MS, sw-addrmethod=CODE, symbol=CODE
        RTE_CORE3_OSTASK_BSW_10MS_CODE: prefix=RTE_CORE3_OSTASK_BSW_10MS, sw-addrmethod=CODE, symbol=CODE
        RTE_DCM_CODE:
          executable-entity=[Rte_Call_Dcm_DataServices_DcmDspPidData_04_ReadData, Rte_Call_Dcm_DataServices_DcmDspPidData_05_ReadData, Rte_Call_Dcm_DataServices_DcmDspPidData_0C_ReadData, Rte_Call_Dcm_DataServices_DcmDspPidData_0D_ReadData, Rte_Call_Dcm_DataServices_DcmDspPidData_21_ReadData, Rte_Call_Dcm_DataServices_DcmDspPidData_30_ReadData, Rte_Call_Dcm_DataServices_DcmDspPidData_31_ReadData, Rte_Call_Dcm_DataServices_DcmDspPidData_41_ReadData, Rte_Call_Dcm_DataServices_DcmDspPidData_42_ReadData, Rte_Call_Dcm_DataServices_DcmDspPidData_49_ReadData, Rte_Call_Dcm_InfotypeServices_DcmDspVehInfoData_04_GetInfotypeValueData, Rte_Call_Dcm_InfotypeServices_DcmDspVehInfoData_0A_GetInfotypeValueData, Rte_Call_Dcm_InfotypeServices_VIT_06_0_GetInfotypeValueData, Rte_Call_Dcm_RoutineServices_DcmDspRoutine_0203_RequestResults, Rte_Call_Dcm_RoutineServices_DcmDspRoutine_0203_Start, Rte_Switch_Dcm_Pp_DcmCommunicationControl_Can_Network_CanNodeNum_01_MDGP_DcmCommunicationControl_Can_Network_CanNodeNum_01, Rte_Switch_Dcm_Pp_DcmControlDTCSetting_MDGP_DcmControlDTCSetting, Rte_Switch_Dcm_Pp_DcmDiagnosticSessionControl_MDGP_DcmDiagnosticSessionControl, Rte_Switch_Dcm_Pp_DcmEcuReset_MDGP_DcmEcuReset, SchM_Mode_Dcm_R_DcmCommunicationControl_Can_Network_CanNodeNum_01, SchM_Switch_Dcm_DcmCommunicationControl_Can_Network_CanNodeNum_01, SchM_Switch_Dcm_DcmEcuReset]
          prefix=RTE_DCM
          sw-addrmethod=CODE
          symbol=CODE
        RTE_DEM_CODE:
          executable-entity=[Rte_Call_Dem_DataServices_CS_ExtendedDataRecord_Aged_counter_ReadData, Rte_Call_Dem_DataServices_CS_ExtendedDataRecord_Fault_pending_counter_ReadData, Rte_Call_Dem_DataServices_PID_02_ReadData, Rte_Call_Dem_DataServices_PID_04_ReadData, Rte_Call_Dem_DataServices_PID_05_ReadData, Rte_Call_Dem_DataServices_PID_0C_ReadData, Rte_Call_Dem_DataServices_PID_0D_ReadData, Rte_Call_Dem_DataServices_PID_42_ReadData, Rte_Call_Dem_DataServices_PID_49_ReadData]
          prefix=RTE_DEM
          sw-addrmethod=CODE
          symbol=CODE
        RTE_EXT_CODE: executable-entity=[Rte_ActivateRE, Rte_MSACbk_SW_13, Rte_SetEvent, Rte_WriteQueue], prefix=RTE_EXT, sw-addrmethod=CODE, symbol=CODE
        RTE_LIB_CODE: executable-entity=[Rte_GetCurrentTaskIndex, Rte_memcpy], prefix=RTE_LIB, sw-addrmethod=CODE, symbol=CODE
        RTE_MAIN_CODE: executable-entity=[Rte_MainFunction, Rte_Start, Rte_Stop, SchM_Deinit, SchM_Init], prefix=RTE_MAIN, sw-addrmethod=CODE, symbol=CODE
        RTE_SYS_CODE: executable-entity=[Rte_DecrementWaitingCount, Rte_ReadQueue, Rte_WaitWithTimeout, SchM_IModeInit], prefix=RTE_SYS, sw-addrmethod=CODE, symbol=CODE
        RTE_WDGM_CODE:
          executable-entity=[Rte_SwitchAck_WdgM_globalMode_currentMode, Rte_SwitchAck_WdgM_mode_WdgMSupervisedEntity_Alive_Supervision_CPU1_currentMode, Rte_SwitchAck_WdgM_mode_WdgMSupervisedEntity_Alive_Supervision_CPU2_currentMode, Rte_SwitchAck_WdgM_mode_WdgMSupervisedEntity_Alive_Supervision_CPU3_currentMode, Rte_SwitchAck_WdgM_mode_WdgMSupervisedEntity_Alive_Supervision_Entity1_currentMode, Rte_SwitchAck_WdgM_mode_WdgMSupervisedEntity_Logic_Supervision_Entity1_currentMode, Rte_Switch_WdgM_globalMode_currentMode, Rte_Switch_WdgM_mode_WdgMSupervisedEntity_Alive_Supervision_CPU1_currentMode, Rte_Switch_WdgM_mode_WdgMSupervisedEntity_Alive_Supervision_CPU2_currentMode, Rte_Switch_WdgM_mode_WdgMSupervisedEntity_Alive_Supervision_CPU3_currentMode, Rte_Switch_WdgM_mode_WdgMSupervisedEntity_Alive_Supervision_Entity1_currentMode, Rte_Switch_WdgM_mode_WdgMSupervisedEntity_Logic_Supervision_Entity1_currentMode, SchM_Mode_WdgM_Current_WdgMSupervisionCycle, SchM_Switch_WdgM_WdgMSupervisionCycle]
          prefix=RTE_WDGM
          sw-addrmethod=CODE
          symbol=CODE
        CONST_UNSPECIFIED: alignment=UNSPECIFIED, sw-addrmethod=CONST
        EcucPartition_Core0_CONST_UNSPECIFIED: alignment=UNSPECIFIED, sw-addrmethod=EcucPartition_Core0_CONST
        EcucPartition_Core0_VAR_CLEARED_8: alignment=8, sw-addrmethod=EcucPartition_Core0_VAR_CLEARED
        EcucPartition_Core0_VAR_CLEARED_UNSPECIFIED: alignment=UNSPECIFIED, sw-addrmethod=EcucPartition_Core0_VAR_CLEARED
        EcucPartition_Core{1..3}_CONST_UNSPECIFIED: alignment=UNSPECIFIED, sw-addrmethod=EcucPartition_Core{1..3}_CONST
        VAR_CLEARED_16: alignment=16, sw-addrmethod=VAR_CLEARED
        RTE_OSAPPLICATION_CORE{0..3}_VAR_CLEARED_16: alignment=16, prefix=RTE_OSAPPLICATION_CORE{0..3}, sw-addrmethod=VAR_CLEARED, symbol=VAR_CLEARED_16
        RTE_SYS_VAR_CLEARED_32: alignment=32, prefix=RTE_SYS, sw-addrmethod=VAR_CLEARED, symbol=VAR_CLEARED_32
        VAR_CLEARED_8: alignment=8, sw-addrmethod=VAR_CLEARED
        RTE_AF_CPT_BSWM_DRE_BSWM_CFG_DFRDSWCREQST_BSWMSWCMODEREQUEST_VAR_CLEARED_8: alignment=8, prefix=RTE_AF_CPT_BSWM_DRE_BSWM_CFG_DFRDSWCREQST_BSWMSWCMODEREQUEST, sw-addrmethod=VAR_CLEARED, symbol=VAR_CLEARED_8
        RTE_AF_CPT_BSWM_DRE_BSWM_CFG_DFRDSWCREQST_BSWM_MRP_SWC_NETWORK_VAR_CLEARED_8: alignment=8, prefix=RTE_AF_CPT_BSWM_DRE_BSWM_CFG_DFRDSWCREQST_BSWM_MRP_SWC_NETWORK, sw-addrmethod=VAR_CLEARED, symbol=VAR_CLEARED_8
        RTE_CORE0_OSTASK_ASW_100MS_VAR_CLEARED_8: alignment=8, prefix=RTE_CORE0_OSTASK_ASW_100MS, sw-addrmethod=VAR_CLEARED, symbol=VAR_CLEARED_8
        RTE_CORE0_OSTASK_ASW_10MS_VAR_CLEARED_8: alignment=8, prefix=RTE_CORE0_OSTASK_ASW_10MS, sw-addrmethod=VAR_CLEARED, symbol=VAR_CLEARED_8
        RTE_CORE0_OSTASK_ASW_1MS_VAR_CLEARED_8: alignment=8, prefix=RTE_CORE0_OSTASK_ASW_1MS, sw-addrmethod=VAR_CLEARED, symbol=VAR_CLEARED_8
        RTE_CORE2_OSTASK_ASW_100MS_VAR_CLEARED_8: alignment=8, prefix=RTE_CORE2_OSTASK_ASW_100MS, sw-addrmethod=VAR_CLEARED, symbol=VAR_CLEARED_8
        RTE_CORE2_OSTASK_ASW_1MS_VAR_CLEARED_8: alignment=8, prefix=RTE_CORE2_OSTASK_ASW_1MS, sw-addrmethod=VAR_CLEARED, symbol=VAR_CLEARED_8
        RTE_ECUCPARTITION_CORE0_VAR_CLEARED_8: alignment=8, prefix=RTE_ECUCPARTITION_CORE0, sw-addrmethod=VAR_CLEARED, symbol=VAR_CLEARED_8
        VAR_CLEARED_BOOLEAN: alignment=BOOLEAN, sw-addrmethod=VAR_CLEARED
        VAR_INIT_8: alignment=8, sw-addrmethod=VAR_INIT
        RTE_ECUCPARTITION_CORE0_VAR_INIT_8: alignment=8, prefix=RTE_ECUCPARTITION_CORE0, sw-addrmethod=VAR_INIT, symbol=VAR_INIT_8
        VAR_INIT_UNSPECIFIED: alignment=UNSPECIFIED, sw-addrmethod=VAR_INIT
      45 x section name prefix:
        RTE_AF_CPT_BSWM_DRE_BSWM_CFG_DFRDSWCREQST_BSWMSWCMODEREQUEST
        RTE_AF_CPT_BSWM_DRE_BSWM_CFG_DFRDSWCREQST_BSWM_MRP_SWC_NETWORK
        RTE_ASW_BASE
        RTE_ASW_CORE{0..3}
        RTE_ASW_DEM
        RTE_ASW_NM
        RTE_ASW_NVM
        RTE_ASW_WDG
        RTE_BSWM
        RTE_COMM
        RTE_CORE0_BSW_OSTASK_SWCREQUEST
        RTE_CORE0_OSTASK_ASW_100MS
        RTE_CORE0_OSTASK_ASW_10MS
        RTE_CORE0_OSTASK_ASW_1MS
        RTE_CORE0_OSTASK_BSW_100MS
        RTE_CORE0_OSTASK_BSW_10MS
        RTE_CORE0_OSTASK_BSW_1MS
        RTE_CORE0_OSTASK_BSW_50MS
        RTE_CORE1_OSTASK_ASW_100MS
        RTE_CORE1_OSTASK_ASW_10MS
        RTE_CORE1_OSTASK_ASW_1MS
        RTE_CORE1_OSTASK_BSW_10MS
        RTE_CORE2_OSTASK_ASW_100MS
        RTE_CORE2_OSTASK_ASW_10MS
        RTE_CORE2_OSTASK_ASW_1MS
        RTE_CORE2_OSTASK_ASW_5MS
        RTE_CORE2_OSTASK_BSW_10MS
        RTE_CORE3_OSTASK_ASW_1MS
        RTE_CORE3_OSTASK_ASW_5MS
        RTE_CORE3_OSTASK_BSW_10MS
        RTE_DCM
        RTE_DEM
        RTE_ECUCPARTITION_CORE0
        RTE_EXT
        RTE_LIB
        RTE_MAIN
        RTE_OSAPPLICATION_CORE{0..3}
        RTE_SYS
        RTE_WDGM
package /AUTOSAR_Rte/ImplementationDataTypes
  63 x impl type:
    Rte_REActCounterType: category=VALUE  # This is an external type, i.e. it is declared in the Rte Library and not in the XML. RTEGen does not have any information about this type apart from its name.
    Rte_PimType_ASW_NVM_ASW_NVM_BlockNative_1024_Type: category=TYPE_REFERENCE
    Rte_PimType_ASW_NVM_ASW_NVM_BlockRedundant_1024_Type: category=TYPE_REFERENCE
    Rte_CDS_ASW_BASE: category=STRUCTURE
      element Rte_Dummy: implementation-data-type=uint8
    Rte_CDS_ASW_COM: category=STRUCTURE
      element Rte_Dummy: implementation-data-type=uint8
    Rte_CDS_ASW_CORE0: category=STRUCTURE
      element Rte_Dummy: implementation-data-type=uint8
    Rte_CDS_ASW_CORE1: category=STRUCTURE
      element Rte_Dummy: implementation-data-type=uint8
    Rte_CDS_ASW_CORE2: category=STRUCTURE
      element Rte_Dummy: implementation-data-type=uint8
    Rte_CDS_ASW_CORE3: category=STRUCTURE
      element Rte_Dummy: implementation-data-type=uint8
    Rte_CDS_ASW_DCM: category=STRUCTURE
      element Rte_Dummy: implementation-data-type=uint8
    Rte_CDS_ASW_DEM: category=STRUCTURE
      element Rte_Dummy: implementation-data-type=uint8
    Rte_CDS_ASW_NM: category=STRUCTURE
      element Rte_Dummy: implementation-data-type=uint8
    Rte_CDS_ASW_NVM: category=STRUCTURE
      element Pim_ASW_NVM_BlockNative_1024_1: implementation-data-type=Rte_PimType_ASW_NVM_ASW_NVM_BlockNative_1024_Type
      element Pim_ASW_NVM_BlockNative_1024_2: implementation-data-type=Rte_PimType_ASW_NVM_ASW_NVM_BlockRedundant_1024_Type
    Rte_CDS_ASW_WDG: category=STRUCTURE
      element Rte_Dummy: implementation-data-type=uint8
    Rte_CDS_ASW_XCP: category=STRUCTURE
      element Rte_Dummy: implementation-data-type=uint8
    Rte_CDS_BswM: category=STRUCTURE
      element Rte_Dummy: implementation-data-type=uint8
    Rte_CDS_CDD_CORE0: category=STRUCTURE
      element Rte_Dummy: implementation-data-type=uint8
    Rte_CDS_CDD_CORE1: category=STRUCTURE
      element Rte_Dummy: implementation-data-type=uint8
    Rte_CDS_CDD_CORE2: category=STRUCTURE
      element Rte_Dummy: implementation-data-type=uint8
    Rte_CDS_CDD_CORE3: category=STRUCTURE
      element Rte_Dummy: implementation-data-type=uint8
    Rte_CDS_ComM: category=STRUCTURE
      element Rte_Dummy: implementation-data-type=uint8
    Rte_CDS_Dcm: category=STRUCTURE
      element Rte_Dummy: implementation-data-type=uint8
    Rte_CDS_Dem: category=STRUCTURE
      element Rte_Dummy: implementation-data-type=uint8
    Rte_CDS_Det: category=STRUCTURE
      element Rte_Dummy: implementation-data-type=uint8
    Rte_CDS_EcuM: category=STRUCTURE
      element Rte_Dummy: implementation-data-type=uint8
    Rte_CDS_NvM: category=STRUCTURE
      element Rte_Dummy: implementation-data-type=uint8
    Rte_CDS_RSID: category=STRUCTURE
      element Rte_Dummy: implementation-data-type=uint8
    Rte_CDS_SWC_DEM: category=STRUCTURE
      element Rte_Dummy: implementation-data-type=uint8
    Rte_SwitchAckFP_WdgM_WdgM_LocalMode_currentMode: category=FUNCTION_REFERENCE
    Rte_SwitchFP_WdgM_WdgM_LocalMode_currentMode: category=FUNCTION_REFERENCE
    Rte_PDS_WdgM_WdgM_LocalMode_P: category=STRUCTURE
      element SwitchAck_currentMode: implementation-data-type=Rte_SwitchAckFP_WdgM_WdgM_LocalMode_currentMode
      element Switch_currentMode: implementation-data-type=Rte_SwitchFP_WdgM_WdgM_LocalMode_currentMode
    Rte_PDS_WdgM_WdgM_LocalMode_PA: category=ARRAY
      element Rte_PDS_WdgM_WdgM_LocalMode_PAElement: array-size=5, array-size-semantics=FIXED-SIZE, implementation-data-type=Rte_PDS_WdgM_WdgM_LocalMode_P
    Rte_CDS_WdgM: category=STRUCTURE
      element mode_WdgMSupervisedEntity_Alive_Supervision_CPU1: implementation-data-type=Rte_PDS_WdgM_WdgM_LocalMode_PA
    Rte_CDS_rba_DiagLib: category=STRUCTURE
      element Rte_Dummy: implementation-data-type=uint8
    Array100ByteDataElement: category=ARRAY
      element Array100ByteDataElementElement: array-size=100, array-size-semantics=FIXED-SIZE, implementation-data-type=uint8
    Rte_SelfType_ASW_BASE: implementation-data-type=Rte_CDS_ASW_BASE
    Rte_SelfType_ASW_COM: implementation-data-type=Rte_CDS_ASW_COM
    Rte_SelfType_ASW_CORE{0..3}: implementation-data-type=Rte_CDS_ASW_CORE{0..3}
    Rte_SelfType_ASW_DCM: implementation-data-type=Rte_CDS_ASW_DCM
    Rte_SelfType_ASW_DEM: implementation-data-type=Rte_CDS_ASW_DEM
    Rte_SelfType_ASW_NM: implementation-data-type=Rte_CDS_ASW_NM
    Rte_SelfType_ASW_NVM: implementation-data-type=Rte_CDS_ASW_NVM
    Rte_SelfType_ASW_WDG: implementation-data-type=Rte_CDS_ASW_WDG
    Rte_SelfType_ASW_XCP: implementation-data-type=Rte_CDS_ASW_XCP
    Rte_SelfType_BswM: implementation-data-type=Rte_CDS_BswM
    Rte_SelfType_CDD_CORE{0..3}: implementation-data-type=Rte_CDS_CDD_CORE{0..3}
    Rte_SelfType_ComM: implementation-data-type=Rte_CDS_ComM
    Rte_SelfType_Dcm: implementation-data-type=Rte_CDS_Dcm
    Rte_SelfType_Dem: implementation-data-type=Rte_CDS_Dem
    Rte_SelfType_Det: implementation-data-type=Rte_CDS_Det
    Rte_SelfType_EcuM: implementation-data-type=Rte_CDS_EcuM
    Rte_SelfType_NvM: implementation-data-type=Rte_CDS_NvM
    Rte_SelfType_RSID: implementation-data-type=Rte_CDS_RSID
    Rte_SelfType_SWC_DEM: implementation-data-type=Rte_CDS_SWC_DEM
    Rte_SelfType_WdgM: implementation-data-type=Rte_CDS_WdgM
    Rte_SelfType_rba_DiagLib: implementation-data-type=Rte_CDS_rba_DiagLib
    Rte_TaskInfo: category=VALUE  # This is an external type, i.e. it is declared in the Rte Library and not in the XML. RTEGen does not have any information about this type apart from its name.
package /AUTOSAR_Rte/SwAddrMethods
  11 x sw addr method:
    CODE: memory-allocation-keyword-policy=ADDR-METHOD-SHORT-NAME, section-type=CODE
    CODE_FAST: memory-allocation-keyword-policy=ADDR-METHOD-SHORT-NAME, section-type=CODE
    CODE_SLOW: memory-allocation-keyword-policy=ADDR-METHOD-SHORT-NAME, section-type=CODE
    CONST: memory-allocation-keyword-policy=ADDR-METHOD-SHORT-NAME-AND-ALIGNMENT, section-type=CONST
    EcucPartition_Core0_CONST: memory-allocation-keyword-policy=ADDR-METHOD-SHORT-NAME-AND-ALIGNMENT, section-type=CONST
    EcucPartition_Core0_VAR_CLEARED: memory-allocation-keyword-policy=ADDR-METHOD-SHORT-NAME-AND-ALIGNMENT, section-initialization-policy=CLEARED, section-type=VAR
    EcucPartition_Core{1..3}_CONST: memory-allocation-keyword-policy=ADDR-METHOD-SHORT-NAME-AND-ALIGNMENT, section-type=CONST
    VAR_CLEARED: memory-allocation-keyword-policy=ADDR-METHOD-SHORT-NAME-AND-ALIGNMENT, section-initialization-policy=CLEARED, section-type=VAR
    VAR_INIT: memory-allocation-keyword-policy=ADDR-METHOD-SHORT-NAME-AND-ALIGNMENT, section-initialization-policy=INIT, section-type=VAR
package /AUTOSAR_Rte/SwBaseTypes
  base type AUTOSAR_Platform_BaseTypes_uint8: category=FIXED_LENGTH, base-type-size=8, base-type-encoding=NONE, mem-alignment=8  # unsigned integer 8bit | This standard AUTOSAR type shall be of 8 bit unsigned.
  base type AUTOSAR_PlatformTypes_SwBaseTypes_uint8: category=FIXED_LENGTH, base-type-size=8, base-type-encoding=NONE, mem-alignment=8  # unsigned integer 8bit | This standard AUTOSAR type shall be of 8 bit unsigned.
