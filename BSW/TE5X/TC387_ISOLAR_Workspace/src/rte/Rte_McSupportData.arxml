AUTOSAR XML (schema 4-2-2)
package /AUTOSAR_Rte/BswImplementations
  bsw implementation Rte: mc-support=mc-sw-emulation-method-support=category=NONE
package /AUTOSAR_Rte/Units
  29 x unit:
    AUTOSAR_CanIf_Units_NoUnit: display-name=noUnit, factor-si-to-unit=1.0, offset-si-to-unit=0.0, physical-dimension=AUTOSAR_CanIf_PhysicalDimensions_NoUnit  # No Unit
    AUTOSAR_CanNm_Units_NoUnit: display-name=noUnit, factor-si-to-unit=1.0, offset-si-to-unit=0.0, physical-dimension=AUTOSAR_CanNm_PhysicalDimensions_NoUnit  # No Unit
    AUTOSAR_CanSM_Units_NoUnit: display-name=noUnit, factor-si-to-unit=1.0, offset-si-to-unit=0.0, physical-dimension=AUTOSAR_CanSM_PhysicalDimensions_NoUnit  # No Unit
    AUTOSAR_CanTrcv_Units_NoUnit: display-name=noUnit, factor-si-to-unit=1.0, offset-si-to-unit=0.0, physical-dimension=AUTOSAR_CanTrcv_PhysicalDimensions_NoUnit  # No Unit
    AUTOSAR_ComM_Units_NoUnit: display-name=noUnit, factor-si-to-unit=1.0, offset-si-to-unit=0.0, physical-dimension=AUTOSAR_ComM_PhysicalDimensions_NoUnit  # No Unit
    AUTOSAR_Com_Units_NoUnit: display-name=noUnit, factor-si-to-unit=1.0, offset-si-to-unit=0.0, physical-dimension=AUTOSAR_Com_PhysicalDimensions_NoUnit  # No Unit
    AUTOSAR_Nm_Units_NoUnit: display-name=noUnit, factor-si-to-unit=1.0, offset-si-to-unit=0.0, physical-dimension=AUTOSAR_Nm_PhysicalDimensions_NoUnit  # No Unit
    AUTOSAR_NvM_Units_NoUnit: display-name=noUnit, factor-si-to-unit=1.0, offset-si-to-unit=0.0, physical-dimension=AUTOSAR_NvM_PhysicalDimensions_NoUnit  # No Unit
    AUTOSAR_PduR_Units_NoUnit: display-name=noUnit, factor-si-to-unit=1.0, offset-si-to-unit=0.0, physical-dimension=AUTOSAR_PduR_PhysicalDimensions_NoUnit  # No Unit
    AUTOSAR_Xcp_Units_NoUnit: display-name=noUnit, factor-si-to-unit=1.0, offset-si-to-unit=0.0, physical-dimension=AUTOSAR_Xcp_PhysicalDimensions_NoUnit  # No Unit
    RB_RBA_rba_MemLib_Units_Mem_NoUnit: display-name=Mem_NoUnit, factor-si-to-unit=1.0, offset-si-to-unit=0.0, physical-dimension=RB_RBA_rba_MemLib_PhysicalDimensions_Mem_NoPhysDim  # Mem No Unit / 1:1 / Identical
    DBC_SysDesc_CanNetwork_Pkg_Units_I
    DBC_SysDesc_CanNetwork_Pkg_Units_NOUNIT
    DBC_SysDesc_CanNetwork_Pkg_Units_Nm
    DBC_SysDesc_CanNetwork_Pkg_Units_rpm
    DBC_SysDesc_CanNetwork_Pkg_Units_kW
    DBC_SysDesc_CanNetwork_Pkg_Units_W
    DBC_SysDesc_CanNetwork_Pkg_Units_Ampere
    DBC_SysDesc_CanNetwork_Pkg_Units_pct
    DBC_SysDesc_CanNetwork_Pkg_Units_Min
    DBC_SysDesc_CanNetwork_Pkg_Units_km_h
    DBC_SysDesc_CanNetwork_Pkg_Units_km
    DBC_SysDesc_CanNetwork_Pkg_Units_V
    DBC_SysDesc_CanNetwork_Pkg_Units_ohm
    DBC_SysDesc_CanNetwork_Pkg_Units_degreeC
    DBC_SysDesc_CanNetwork_Pkg_Units_degree
    DBC_SysDesc_CanNetwork_Pkg_Units_Hz
    DataTypes_Units_NoUnit: factor-si-to-unit=1.0, offset-si-to-unit=0.0
    RB_RBA_Common_CentralElements_Units_NoUnit: display-name=noUnit, factor-si-to-unit=1.0, offset-si-to-unit=0.0, physical-dimension=RB_RBA_Common_CentralElements_PhysicalDimensions_NoUnit  # No Unit
package /AUTOSAR_Rte/PhysicalDimensions
  12 x physical dimension, all with length-exp=0:
    AUTOSAR_CanIf_PhysicalDimensions_NoUnit
    AUTOSAR_CanNm_PhysicalDimensions_NoUnit
    AUTOSAR_CanSM_PhysicalDimensions_NoUnit
    AUTOSAR_CanTrcv_PhysicalDimensions_NoUnit
    AUTOSAR_ComM_PhysicalDimensions_NoUnit
    AUTOSAR_Com_PhysicalDimensions_NoUnit
    AUTOSAR_Nm_PhysicalDimensions_NoUnit
    AUTOSAR_NvM_PhysicalDimensions_NoUnit
    AUTOSAR_PduR_PhysicalDimensions_NoUnit
    AUTOSAR_Xcp_PhysicalDimensions_NoUnit
    RB_RBA_rba_MemLib_PhysicalDimensions_Mem_NoPhysDim
    RB_RBA_Common_CentralElements_PhysicalDimensions_NoUnit
