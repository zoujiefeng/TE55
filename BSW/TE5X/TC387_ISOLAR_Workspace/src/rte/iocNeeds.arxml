AUTOSAR XML (schema 4-2-2)
standard types defined: uint8
package /OS
  module config Os
    IocOs (OsIoc)
      Rte_Rx_000000 (OsIocCommunication): OsIocDataTypeRef=Array100ByteDataElement
        iocSemantic00000 (OsIocCommunicationSemantics)
          iocLastIsBest00000 (OsIocLastIsBestCommunication)
        c00000rx (OsIocReceiverProperties): OsIocReceivingOsApplicationRef=OsApplication_Core1
        c00000tx (OsIocSenderProperties): OsIocSendingOsApplicationRef=OsApplication_Core0
      Rte_Rx_000001 (OsIocCommunication): OsIocDataTypeRef=Array100ByteDataElement
        iocSemantic00001 (OsIocCommunicationSemantics)
          iocLastIsBest00001 (OsIocLastIsBestCommunication)
        c00001rx (OsIocReceiverProperties): OsIocReceivingOsApplicationRef=OsApplication_Core0
        c00001tx (OsIocSenderProperties): OsIocSendingOsApplicationRef=OsApplication_Core1
  base type AUTOSAR_Platform_BaseTypes_uint8: category=FIXED_LENGTH, base-type-size=8, base-type-encoding=NONE, mem-alignment=8  # unsigned integer 8bit | This standard AUTOSAR type shall be of 8 bit unsigned.
  impl type Array100ByteDataElement: category=ARRAY
    element Array100ByteDataElementElement: array-size=100, array-size-semantics=FIXED-SIZE, implementation-data-type=uint8
