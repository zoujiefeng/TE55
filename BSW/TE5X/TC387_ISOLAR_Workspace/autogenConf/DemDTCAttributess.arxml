AUTOSAR XML (schema 00047)
package /ETAS_Project/EcucModuleConfigurationValuess
  module config Dem
    DemConfigSet
      500 x DemDTCAttributes, all with DemAgingCycleCounterThreshold=40, DemImmediateNvStorage=false, DemMaxNumberFreezeFrameRecords=1, DemDTCSignificance=DEM_EVENT_SIGNIFICANCE_FAULT, DemAgingCycleRef=DEM_OPCYC_WARMUP, DemMemoryDestinationRef=DemPrimaryMemory, DemExtendedDataClassRef=DemExtendedDataClass_0, DemFreezeFrameRecNumClassRef=DemFreezeFrameRecNumClass:
        DemDTCAttributes_ECU1_DTC00: DemAgingAllowed=true, DemDTCPriority=3, DemFreezeFrameClassRef=DemFreezeFrameClass_Ecu1
        DemDTCAttributes_ECU1_DTC{01..16}: DemDTCPriority=3, DemAgingAllowed=1, DemFreezeFrameClassRef=DemFreezeFrameClass_Ecu1
        DemDTCAttributes_ECU1_DTC17: DemAgingAllowed=true, DemDTCPriority=3, DemFreezeFrameClassRef=DemFreezeFrameClass_Ecu1
        DemDTCAttributes_ECU1_DTC18: DemAgingAllowed=true, DemDTCPriority=4, DemFreezeFrameClassRef=DemFreezeFrameClass_Ecu1
        DemDTCAttributes_ECU1_DTC19: DemAgingAllowed=true, DemDTCPriority=3, DemFreezeFrameClassRef=DemFreezeFrameClass_Ecu1
        DemDTCAttributes_ECU1_DTC20: DemAgingAllowed=true, DemDTCPriority=4, DemFreezeFrameClassRef=DemFreezeFrameClass_Ecu1
        DemDTCAttributes_ECU1_DTC21: DemDTCPriority=4, DemAgingAllowed=1, DemFreezeFrameClassRef=DemFreezeFrameClass_Ecu1
        DemDTCAttributes_ECU1_DTC22: DemAgingAllowed=true, DemDTCPriority=4, DemFreezeFrameClassRef=DemFreezeFrameClass_Ecu1
        DemDTCAttributes_ECU1_DTC23: DemDTCPriority=4, DemAgingAllowed=1, DemFreezeFrameClassRef=DemFreezeFrameClass_Ecu1
        DemDTCAttributes_ECU1_DTC24: DemDTCPriority=3, DemAgingAllowed=1, DemFreezeFrameClassRef=DemFreezeFrameClass_Ecu1
        DemDTCAttributes_ECU1_DTC25: DemAgingAllowed=true, DemDTCPriority=3, DemFreezeFrameClassRef=DemFreezeFrameClass_Ecu1
        DemDTCAttributes_ECU1_DTC{26..41}: DemDTCPriority=3, DemAgingAllowed=1, DemFreezeFrameClassRef=DemFreezeFrameClass_Ecu1
        DemDTCAttributes_ECU1_DTC42: DemAgingAllowed=true, DemDTCPriority=3, DemFreezeFrameClassRef=DemFreezeFrameClass_Ecu1
        DemDTCAttributes_ECU1_DTC43: DemAgingAllowed=true, DemDTCPriority=4, DemFreezeFrameClassRef=DemFreezeFrameClass_Ecu1
        DemDTCAttributes_ECU1_DTC44: DemAgingAllowed=true, DemDTCPriority=3, DemFreezeFrameClassRef=DemFreezeFrameClass_Ecu1
        DemDTCAttributes_ECU1_DTC45: DemAgingAllowed=true, DemDTCPriority=4, DemFreezeFrameClassRef=DemFreezeFrameClass_Ecu1
        DemDTCAttributes_ECU1_DTC46: DemDTCPriority=4, DemAgingAllowed=1, DemFreezeFrameClassRef=DemFreezeFrameClass_Ecu1
        DemDTCAttributes_ECU1_DTC47: DemAgingAllowed=true, DemDTCPriority=4, DemFreezeFrameClassRef=DemFreezeFrameClass_Ecu1
        DemDTCAttributes_ECU1_DTC48: DemDTCPriority=4, DemAgingAllowed=1, DemFreezeFrameClassRef=DemFreezeFrameClass_Ecu1
        DemDTCAttributes_ECU1_DTC{49..73}: DemDTCPriority=3, DemAgingAllowed=1, DemFreezeFrameClassRef=DemFreezeFrameClass_Ecu1
        DemDTCAttributes_ECU1_DTC74: DemDTCPriority=4, DemAgingAllowed=1, DemFreezeFrameClassRef=DemFreezeFrameClass_Ecu1
        DemDTCAttributes_ECU1_DTC{75..98}: DemDTCPriority=3, DemAgingAllowed=1, DemFreezeFrameClassRef=DemFreezeFrameClass_Ecu1
        DemDTCAttributes_ECU1_DTC99: DemDTCPriority=4, DemAgingAllowed=1, DemFreezeFrameClassRef=DemFreezeFrameClass_Ecu1
        DemDTCAttributes_ECU2_DTC00: DemDTCPriority=3, DemAgingAllowed=1, DemFreezeFrameClassRef=DemFreezeFrameClass_Ecu2
        DemDTCAttributes_ECU2_DTC01: DemDTCPriority=4, DemAgingAllowed=1, DemFreezeFrameClassRef=DemFreezeFrameClass_Ecu2
        DemDTCAttributes_ECU2_DTC{02..12}: DemDTCPriority=3, DemAgingAllowed=1, DemFreezeFrameClassRef=DemFreezeFrameClass_Ecu2
        DemDTCAttributes_ECU2_DTC13: DemDTCPriority=4, DemAgingAllowed=1, DemFreezeFrameClassRef=DemFreezeFrameClass_Ecu2
        DemDTCAttributes_ECU2_DTC{14..30}: DemDTCPriority=3, DemAgingAllowed=1, DemFreezeFrameClassRef=DemFreezeFrameClass_Ecu2
        DemDTCAttributes_ECU2_DTC31: DemDTCPriority=4, DemAgingAllowed=1, DemFreezeFrameClassRef=DemFreezeFrameClass_Ecu2
        DemDTCAttributes_ECU2_DTC{32..37}: DemDTCPriority=3, DemAgingAllowed=1, DemFreezeFrameClassRef=DemFreezeFrameClass_Ecu2
        DemDTCAttributes_ECU2_DTC38: DemDTCPriority=4, DemAgingAllowed=1, DemFreezeFrameClassRef=DemFreezeFrameClass_Ecu2
        DemDTCAttributes_ECU2_DTC{39..47}: DemDTCPriority=3, DemAgingAllowed=1, DemFreezeFrameClassRef=DemFreezeFrameClass_Ecu2
        DemDTCAttributes_ECU2_DTC48: DemDTCPriority=4, DemAgingAllowed=1, DemFreezeFrameClassRef=DemFreezeFrameClass_Ecu2
        DemDTCAttributes_ECU2_DTC{49..51}: DemDTCPriority=3, DemAgingAllowed=1, DemFreezeFrameClassRef=DemFreezeFrameClass_Ecu2
        DemDTCAttributes_ECU2_DTC52: DemAgingAllowed=true, DemDTCPriority=3, DemFreezeFrameClassRef=DemFreezeFrameClass_Ecu2
        DemDTCAttributes_ECU2_DTC{53..56}: DemDTCPriority=3, DemAgingAllowed=1, DemFreezeFrameClassRef=DemFreezeFrameClass_Ecu2
        DemDTCAttributes_ECU2_DTC57: DemDTCPriority=4, DemAgingAllowed=1, DemFreezeFrameClassRef=DemFreezeFrameClass_Ecu2
        DemDTCAttributes_ECU2_DTC{58..63}: DemDTCPriority=3, DemAgingAllowed=1, DemFreezeFrameClassRef=DemFreezeFrameClass_Ecu2
        DemDTCAttributes_ECU2_DTC64: DemAgingAllowed=true, DemDTCPriority=3, DemFreezeFrameClassRef=DemFreezeFrameClass_Ecu2
        DemDTCAttributes_ECU2_DTC{65..68}: DemDTCPriority=3, DemAgingAllowed=1, DemFreezeFrameClassRef=DemFreezeFrameClass_Ecu2
        DemDTCAttributes_ECU2_DTC69: DemDTCPriority=4, DemAgingAllowed=1, DemFreezeFrameClassRef=DemFreezeFrameClass_Ecu2
        DemDTCAttributes_ECU2_DTC{70..75}: DemDTCPriority=3, DemAgingAllowed=1, DemFreezeFrameClassRef=DemFreezeFrameClass_Ecu2
        DemDTCAttributes_ECU2_DTC76: DemAgingAllowed=true, DemDTCPriority=3, DemFreezeFrameClassRef=DemFreezeFrameClass_Ecu2
        DemDTCAttributes_ECU2_DTC{77..80}: DemDTCPriority=3, DemAgingAllowed=1, DemFreezeFrameClassRef=DemFreezeFrameClass_Ecu2
        DemDTCAttributes_ECU2_DTC81: DemDTCPriority=4, DemAgingAllowed=1, DemFreezeFrameClassRef=DemFreezeFrameClass_Ecu2
        DemDTCAttributes_ECU2_DTC{82..87}: DemDTCPriority=3, DemAgingAllowed=1, DemFreezeFrameClassRef=DemFreezeFrameClass_Ecu2
        DemDTCAttributes_ECU2_DTC88: DemAgingAllowed=true, DemDTCPriority=3, DemFreezeFrameClassRef=DemFreezeFrameClass_Ecu2
        DemDTCAttributes_ECU2_DTC{89..92}: DemDTCPriority=3, DemAgingAllowed=1, DemFreezeFrameClassRef=DemFreezeFrameClass_Ecu2
        DemDTCAttributes_ECU2_DTC93: DemDTCPriority=4, DemAgingAllowed=1, DemFreezeFrameClassRef=DemFreezeFrameClass_Ecu2
        DemDTCAttributes_ECU2_DTC{94..99}: DemDTCPriority=3, DemAgingAllowed=1, DemFreezeFrameClassRef=DemFreezeFrameClass_Ecu2
        DemDTCAttributes_ECU3_DTC{00..02}: DemDTCPriority=3, DemAgingAllowed=1, DemFreezeFrameClassRef=DemFreezeFrameClass_Ecu3
        DemDTCAttributes_ECU3_DTC{03..10}: DemAgingAllowed=true, DemDTCPriority=3, DemFreezeFrameClassRef=DemFreezeFrameClass_Ecu3
        DemDTCAttributes_ECU3_DTC11: DemDTCPriority=3, DemAgingAllowed=1, DemFreezeFrameClassRef=DemFreezeFrameClass_Ecu3
        DemDTCAttributes_ECU3_DTC{12..17}: DemAgingAllowed=true, DemDTCPriority=3, DemFreezeFrameClassRef=DemFreezeFrameClass_Ecu3
        DemDTCAttributes_ECU3_DTC{18..22}: DemDTCPriority=3, DemAgingAllowed=1, DemFreezeFrameClassRef=DemFreezeFrameClass_Ecu3
        DemDTCAttributes_ECU3_DTC{23..30}: DemAgingAllowed=true, DemDTCPriority=3, DemFreezeFrameClassRef=DemFreezeFrameClass_Ecu3
        DemDTCAttributes_ECU3_DTC31: DemDTCPriority=3, DemAgingAllowed=1, DemFreezeFrameClassRef=DemFreezeFrameClass_Ecu3
        DemDTCAttributes_ECU3_DTC{32..37}: DemAgingAllowed=true, DemDTCPriority=3, DemFreezeFrameClassRef=DemFreezeFrameClass_Ecu3
        DemDTCAttributes_ECU3_DTC{38..42}: DemDTCPriority=3, DemAgingAllowed=1, DemFreezeFrameClassRef=DemFreezeFrameClass_Ecu3
        DemDTCAttributes_ECU3_DTC{43..49}: DemAgingAllowed=true, DemDTCPriority=3, DemFreezeFrameClassRef=DemFreezeFrameClass_Ecu3
        DemDTCAttributes_ECU3_DTC{50..65}: DemDTCPriority=3, DemAgingAllowed=1, DemFreezeFrameClassRef=DemFreezeFrameClass_Ecu3
        DemDTCAttributes_ECU3_DTC66: DemAgingAllowed=true, DemDTCPriority=3, DemFreezeFrameClassRef=DemFreezeFrameClass_Ecu3
        DemDTCAttributes_ECU3_DTC67: DemAgingAllowed=true, DemDTCPriority=4, DemFreezeFrameClassRef=DemFreezeFrameClass_Ecu3
        DemDTCAttributes_ECU3_DTC68: DemAgingAllowed=true, DemDTCPriority=3, DemFreezeFrameClassRef=DemFreezeFrameClass_Ecu3
        DemDTCAttributes_ECU3_DTC69: DemAgingAllowed=true, DemDTCPriority=4, DemFreezeFrameClassRef=DemFreezeFrameClass_Ecu3
        DemDTCAttributes_ECU3_DTC70: DemDTCPriority=4, DemAgingAllowed=1, DemFreezeFrameClassRef=DemFreezeFrameClass_Ecu3
        DemDTCAttributes_ECU3_DTC71: DemAgingAllowed=true, DemDTCPriority=4, DemFreezeFrameClassRef=DemFreezeFrameClass_Ecu3
        DemDTCAttributes_ECU3_DTC72: DemDTCPriority=4, DemAgingAllowed=1, DemFreezeFrameClassRef=DemFreezeFrameClass_Ecu3
        DemDTCAttributes_ECU3_DTC73: DemDTCPriority=3, DemAgingAllowed=1, DemFreezeFrameClassRef=DemFreezeFrameClass_Ecu3
        DemDTCAttributes_ECU3_DTC74: DemAgingAllowed=true, DemDTCPriority=3, DemFreezeFrameClassRef=DemFreezeFrameClass_Ecu3
        DemDTCAttributes_ECU3_DTC{75..90}: DemDTCPriority=3, DemAgingAllowed=1, DemFreezeFrameClassRef=DemFreezeFrameClass_Ecu3
        DemDTCAttributes_ECU3_DTC91: DemAgingAllowed=true, DemDTCPriority=3, DemFreezeFrameClassRef=DemFreezeFrameClass_Ecu3
        DemDTCAttributes_ECU3_DTC92: DemAgingAllowed=true, DemDTCPriority=4, DemFreezeFrameClassRef=DemFreezeFrameClass_Ecu3
        DemDTCAttributes_ECU3_DTC93: DemAgingAllowed=true, DemDTCPriority=3, DemFreezeFrameClassRef=DemFreezeFrameClass_Ecu3
        DemDTCAttributes_ECU3_DTC94: DemAgingAllowed=true, DemDTCPriority=4, DemFreezeFrameClassRef=DemFreezeFrameClass_Ecu3
        DemDTCAttributes_ECU3_DTC95: DemDTCPriority=4, DemAgingAllowed=1, DemFreezeFrameClassRef=DemFreezeFrameClass_Ecu3
        DemDTCAttributes_ECU3_DTC96: DemAgingAllowed=true, DemDTCPriority=4, DemFreezeFrameClassRef=DemFreezeFrameClass_Ecu3
        DemDTCAttributes_ECU3_DTC97: DemDTCPriority=4, DemAgingAllowed=1, DemFreezeFrameClassRef=DemFreezeFrameClass_Ecu3
        DemDTCAttributes_ECU3_DTC98: DemDTCPriority=3, DemAgingAllowed=1, DemFreezeFrameClassRef=DemFreezeFrameClass_Ecu3
        DemDTCAttributes_ECU3_DTC99: DemAgingAllowed=true, DemDTCPriority=3, DemFreezeFrameClassRef=DemFreezeFrameClass_Ecu3
        DemDTCAttributes_ECU4_DTC{00..23}: DemDTCPriority=3, DemAgingAllowed=1, DemFreezeFrameClassRef=DemFreezeFrameClass_Ecu4
        DemDTCAttributes_ECU4_DTC24: DemDTCPriority=4, DemAgingAllowed=1, DemFreezeFrameClassRef=DemFreezeFrameClass_Ecu4
        DemDTCAttributes_ECU4_DTC{25..48}: DemDTCPriority=3, DemAgingAllowed=1, DemFreezeFrameClassRef=DemFreezeFrameClass_Ecu4
        DemDTCAttributes_ECU4_DTC49: DemDTCPriority=4, DemAgingAllowed=1, DemFreezeFrameClassRef=DemFreezeFrameClass_Ecu4
        DemDTCAttributes_ECU4_DTC50: DemDTCPriority=3, DemAgingAllowed=1, DemFreezeFrameClassRef=DemFreezeFrameClass_Ecu4
        DemDTCAttributes_ECU4_DTC51: DemDTCPriority=4, DemAgingAllowed=1, DemFreezeFrameClassRef=DemFreezeFrameClass_Ecu4
        DemDTCAttributes_ECU4_DTC{52..62}: DemDTCPriority=3, DemAgingAllowed=1, DemFreezeFrameClassRef=DemFreezeFrameClass_Ecu4
        DemDTCAttributes_ECU4_DTC63: DemDTCPriority=4, DemAgingAllowed=1, DemFreezeFrameClassRef=DemFreezeFrameClass_Ecu4
        DemDTCAttributes_ECU4_DTC{64..80}: DemDTCPriority=3, DemAgingAllowed=1, DemFreezeFrameClassRef=DemFreezeFrameClass_Ecu4
        DemDTCAttributes_ECU4_DTC81: DemDTCPriority=4, DemAgingAllowed=1, DemFreezeFrameClassRef=DemFreezeFrameClass_Ecu4
        DemDTCAttributes_ECU4_DTC{82..87}: DemDTCPriority=3, DemAgingAllowed=1, DemFreezeFrameClassRef=DemFreezeFrameClass_Ecu4
        DemDTCAttributes_ECU4_DTC88: DemDTCPriority=4, DemAgingAllowed=1, DemFreezeFrameClassRef=DemFreezeFrameClass_Ecu4
        DemDTCAttributes_ECU4_DTC{89..97}: DemDTCPriority=3, DemAgingAllowed=1, DemFreezeFrameClassRef=DemFreezeFrameClass_Ecu4
        DemDTCAttributes_ECU4_DTC98: DemDTCPriority=4, DemAgingAllowed=1, DemFreezeFrameClassRef=DemFreezeFrameClass_Ecu4
        DemDTCAttributes_ECU4_DTC99: DemDTCPriority=3, DemAgingAllowed=1, DemFreezeFrameClassRef=DemFreezeFrameClass_Ecu4
        DemDTCAttributes_ECU5_DTC00: DemDTCPriority=3, DemAgingAllowed=1, DemFreezeFrameClassRef=DemFreezeFrameClass_Ecu5
        DemDTCAttributes_ECU5_DTC01: DemDTCPriority=3, DemAgingAllowed=1, DemFreezeFrameClassRef=DemFreezeFrameClass_Ecu5
        DemDTCAttributes_ECU5_DTC02: DemAgingAllowed=true, DemDTCPriority=3, DemFreezeFrameClassRef=DemFreezeFrameClass_Ecu5
        DemDTCAttributes_ECU5_DTC{03..06}: DemDTCPriority=3, DemAgingAllowed=1, DemFreezeFrameClassRef=DemFreezeFrameClass_Ecu5
        DemDTCAttributes_ECU5_DTC07: DemDTCPriority=4, DemAgingAllowed=1, DemFreezeFrameClassRef=DemFreezeFrameClass_Ecu5
        DemDTCAttributes_ECU5_DTC{08..13}: DemDTCPriority=3, DemAgingAllowed=1, DemFreezeFrameClassRef=DemFreezeFrameClass_Ecu5
        DemDTCAttributes_ECU5_DTC14: DemAgingAllowed=true, DemDTCPriority=3, DemFreezeFrameClassRef=DemFreezeFrameClass_Ecu5
        DemDTCAttributes_ECU5_DTC{15..18}: DemDTCPriority=3, DemAgingAllowed=1, DemFreezeFrameClassRef=DemFreezeFrameClass_Ecu5
        DemDTCAttributes_ECU5_DTC19: DemDTCPriority=4, DemAgingAllowed=1, DemFreezeFrameClassRef=DemFreezeFrameClass_Ecu5
        DemDTCAttributes_ECU5_DTC{20..25}: DemDTCPriority=3, DemAgingAllowed=1, DemFreezeFrameClassRef=DemFreezeFrameClass_Ecu5
        DemDTCAttributes_ECU5_DTC26: DemAgingAllowed=true, DemDTCPriority=3, DemFreezeFrameClassRef=DemFreezeFrameClass_Ecu5
        DemDTCAttributes_ECU5_DTC{27..30}: DemDTCPriority=3, DemAgingAllowed=1, DemFreezeFrameClassRef=DemFreezeFrameClass_Ecu5
        DemDTCAttributes_ECU5_DTC31: DemDTCPriority=4, DemAgingAllowed=1, DemFreezeFrameClassRef=DemFreezeFrameClass_Ecu5
        DemDTCAttributes_ECU5_DTC{32..37}: DemDTCPriority=3, DemAgingAllowed=1, DemFreezeFrameClassRef=DemFreezeFrameClass_Ecu5
        DemDTCAttributes_ECU5_DTC38: DemAgingAllowed=true, DemDTCPriority=3, DemFreezeFrameClassRef=DemFreezeFrameClass_Ecu5
        DemDTCAttributes_ECU5_DTC{39..42}: DemDTCPriority=3, DemAgingAllowed=1, DemFreezeFrameClassRef=DemFreezeFrameClass_Ecu5
        DemDTCAttributes_ECU5_DTC43: DemDTCPriority=4, DemAgingAllowed=1, DemFreezeFrameClassRef=DemFreezeFrameClass_Ecu5
        DemDTCAttributes_ECU5_DTC{44..52}: DemDTCPriority=3, DemAgingAllowed=1, DemFreezeFrameClassRef=DemFreezeFrameClass_Ecu5
        DemDTCAttributes_ECU5_DTC{53..60}: DemAgingAllowed=true, DemDTCPriority=3, DemFreezeFrameClassRef=DemFreezeFrameClass_Ecu5
        DemDTCAttributes_ECU5_DTC61: DemDTCPriority=3, DemAgingAllowed=1, DemFreezeFrameClassRef=DemFreezeFrameClass_Ecu5
        DemDTCAttributes_ECU5_DTC{62..67}: DemAgingAllowed=true, DemDTCPriority=3, DemFreezeFrameClassRef=DemFreezeFrameClass_Ecu5
        DemDTCAttributes_ECU5_DTC{68..72}: DemDTCPriority=3, DemAgingAllowed=1, DemFreezeFrameClassRef=DemFreezeFrameClass_Ecu5
        DemDTCAttributes_ECU5_DTC{73..80}: DemAgingAllowed=true, DemDTCPriority=3, DemFreezeFrameClassRef=DemFreezeFrameClass_Ecu5
        DemDTCAttributes_ECU5_DTC81: DemDTCPriority=3, DemAgingAllowed=1, DemFreezeFrameClassRef=DemFreezeFrameClass_Ecu5
        DemDTCAttributes_ECU5_DTC{82..87}: DemAgingAllowed=true, DemDTCPriority=3, DemFreezeFrameClassRef=DemFreezeFrameClass_Ecu5
        DemDTCAttributes_ECU5_DTC{88..92}: DemDTCPriority=3, DemAgingAllowed=1, DemFreezeFrameClassRef=DemFreezeFrameClass_Ecu5
        DemDTCAttributes_ECU5_DTC{93..99}: DemAgingAllowed=true, DemDTCPriority=3, DemFreezeFrameClassRef=DemFreezeFrameClass_Ecu5
