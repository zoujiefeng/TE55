AUTOSAR XML (schema 00047)
package /ETAS_Project/EcucModuleConfigurationValuess
  module config E2E_0: definition=E2E
    E2ERbGeneral_0 (E2ERbGeneral):
      E2ERbCallout = true
      E2ERbCheckParameterType = E2E_INTEGRATED
      E2ERbCheckStatusTypeCompatibilityMode = 1
      E2ERbDataIDBitOrderProfile5 = ORDER_UNCHANGED
      E2ERbDataIDBitOrderProfile6 = ORDER_FLIPPED
      E2ERbDevTest = 0
      E2ERbHeaderBitOrderProfile11 = ORDER_FLIPPED
      E2ERbHeaderBitOrderProfile22 = ORDER_FLIPPED
      E2ERbHeaderBitOrderProfile4 = ORDER_FLIPPED
      E2ERbHeaderBitOrderProfile44 = ORDER_FLIPPED
      E2ERbHeaderBitOrderProfile5 = ORDER_UNCHANGED
      E2ERbHeaderBitOrderProfile6 = ORDER_FLIPPED
      E2ERbHeaderBitOrderProfile7 = ORDER_FLIPPED
      E2ERbProfile1 = 1
      E2ERbProfile11 = 1
      E2ERbProfile2 = 1
      E2ERbProfile22 = 1
      E2ERbProfile4 = 1
      E2ERbProfile44 = 1
      E2ERbProfile5 = 1
      E2ERbProfile6 = 1
      E2ERbProfile7 = false
      E2ERbStateMachine = 1
      E2ERbVersionInfoApi = false
