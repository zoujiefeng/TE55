AUTOSAR XML (schema 00047)
package /ETAS_Project/EcucModuleConfigurationValuess
  module config Dem
    DemGeneral
      145 x DemDidClass:
        Did_Class_D000: DemDidIdentifier=53248, DemDidDataElementClassRef=DemDataElementClass_D000
        Did_Class_D001: DemDidIdentifier=53249, DemDidDataElementClassRef=DemDataElementClass_D001
        Did_Class_D002: DemDidIdentifier=53250, DemDidDataElementClassRef=DemDataElementClass_D002
        Did_Class_D003: DemDidIdentifier=53251, DemDidDataElementClassRef=DemDataElementClass_D003
        Did_Class_D004: DemDidIdentifier=53252, DemDidDataElementClassRef=DemDataElementClass_D004
        Did_Class_D005: DemDidIdentifier=53253, DemDidDataElementClassRef=DemDataElementClass_D005
        Did_Class_D007: DemDidIdentifier=53255, DemDidDataElementClassRef=DemDataElementClass_D007
        Did_Class_D008: DemDidIdentifier=53256, DemDidDataElementClassRef=DemDataElementClass_D008
        Did_Class_D009: DemDidIdentifier=53257, DemDidDataElementClassRef=DemDataElementClass_D009
        Did_Class_D010: DemDidIdentifier=53264, DemDidDataElementClassRef=DemDataElementClass_D010
        Did_Class_D011: DemDidIdentifier=53265, DemDidDataElementClassRef=DemDataElementClass_D011
        Did_Class_D012: DemDidIdentifier=53266, DemDidDataElementClassRef=DemDataElementClass_D012
        Did_Class_D013: DemDidIdentifier=53267, DemDidDataElementClassRef=DemDataElementClass_D013
        Did_Class_D014: DemDidIdentifier=53268, DemDidDataElementClassRef=DemDataElementClass_D014
        Did_Class_D015: DemDidIdentifier=53269, DemDidDataElementClassRef=DemDataElementClass_D015
        Did_Class_D016: DemDidIdentifier=53270, DemDidDataElementClassRef=DemDataElementClass_D016
        Did_Class_D017: DemDidIdentifier=53271, DemDidDataElementClassRef=DemDataElementClass_D017
        Did_Class_D018: DemDidIdentifier=53272, DemDidDataElementClassRef=DemDataElementClass_D018
        Did_Class_D019: DemDidIdentifier=53273, DemDidDataElementClassRef=DemDataElementClass_D019
        Did_Class_D020: DemDidIdentifier=53280, DemDidDataElementClassRef=DemDataElementClass_D020
        Did_Class_D021: DemDidIdentifier=53281, DemDidDataElementClassRef=DemDataElementClass_D021
        Did_Class_D022: DemDidIdentifier=53282, DemDidDataElementClassRef=DemDataElementClass_D022
        Did_Class_D023: DemDidIdentifier=53283, DemDidDataElementClassRef=DemDataElementClass_D023
        Did_Class_D024: DemDidIdentifier=53284, DemDidDataElementClassRef=DemDataElementClass_D024
        Did_Class_D025: DemDidIdentifier=53285, DemDidDataElementClassRef=DemDataElementClass_D025
        Did_Class_D026: DemDidIdentifier=53286, DemDidDataElementClassRef=DemDataElementClass_D026
        Did_Class_D027: DemDidIdentifier=53287, DemDidDataElementClassRef=DemDataElementClass_D027
        Did_Class_D028: DemDidIdentifier=53288, DemDidDataElementClassRef=DemDataElementClass_D028
        Did_Class_D029: DemDidIdentifier=53289, DemDidDataElementClassRef=DemDataElementClass_D029
        Did_Class_D030: DemDidIdentifier=53296, DemDidDataElementClassRef=DemDataElementClass_D030
        Did_Class_D031: DemDidIdentifier=53297, DemDidDataElementClassRef=DemDataElementClass_D031
        Did_Class_D032: DemDidIdentifier=53298, DemDidDataElementClassRef=DemDataElementClass_D032
        Did_Class_D033: DemDidIdentifier=53299, DemDidDataElementClassRef=DemDataElementClass_D033
        Did_Class_D034: DemDidIdentifier=53300, DemDidDataElementClassRef=DemDataElementClass_D034
        Did_Class_D035: DemDidIdentifier=53301, DemDidDataElementClassRef=DemDataElementClass_D035
        Did_Class_D036: DemDidIdentifier=53302, DemDidDataElementClassRef=DemDataElementClass_D036
        Did_Class_D037: DemDidIdentifier=53303, DemDidDataElementClassRef=DemDataElementClass_D037
        Did_Class_D038: DemDidIdentifier=53304, DemDidDataElementClassRef=DemDataElementClass_D038
        Did_Class_D039: DemDidIdentifier=53305, DemDidDataElementClassRef=DemDataElementClass_D039
        Did_Class_D040: DemDidIdentifier=53312, DemDidDataElementClassRef=DemDataElementClass_D040
        Did_Class_D041: DemDidIdentifier=53313, DemDidDataElementClassRef=DemDataElementClass_D041
        Did_Class_D042: DemDidIdentifier=53314, DemDidDataElementClassRef=DemDataElementClass_D042
        Did_Class_D043: DemDidIdentifier=53315, DemDidDataElementClassRef=DemDataElementClass_D043
        Did_Class_D044: DemDidIdentifier=53316, DemDidDataElementClassRef=DemDataElementClass_D044
        Did_Class_D045: DemDidIdentifier=53317, DemDidDataElementClassRef=DemDataElementClass_D045
        Did_Class_D046: DemDidIdentifier=53318, DemDidDataElementClassRef=DemDataElementClass_D046
        Did_Class_D047: DemDidIdentifier=53319, DemDidDataElementClassRef=DemDataElementClass_D047
        Did_Class_D048: DemDidIdentifier=53320, DemDidDataElementClassRef=DemDataElementClass_D048
        Did_Class_D049: DemDidIdentifier=53321, DemDidDataElementClassRef=DemDataElementClass_D049
        Did_Class_1D06: DemDidIdentifier=7430, DemDidDataElementClassRef=DemDataElementClass_1D06
        Did_Class_1D07: DemDidIdentifier=7431, DemDidDataElementClassRef=DemDataElementClass_1D07
        Did_Class_1D08: DemDidIdentifier=7432, DemDidDataElementClassRef=DemDataElementClass_1D08
        Did_Class_1D09: DemDidIdentifier=7433, DemDidDataElementClassRef=DemDataElementClass_1D09
        Did_Class_1D0A: DemDidIdentifier=7434, DemDidDataElementClassRef=DemDataElementClass_1D0A
        Did_Class_1D0B: DemDidIdentifier=7435, DemDidDataElementClassRef=DemDataElementClass_1D0B
        Did_Class_1D0C: DemDidIdentifier=7436, DemDidDataElementClassRef=DemDataElementClass_1D0C
        Did_Class_1D0D: DemDidIdentifier=7437, DemDidDataElementClassRef=DemDataElementClass_1D0D
        Did_Class_1D0E: DemDidIdentifier=7438, DemDidDataElementClassRef=DemDataElementClass_1D0E
        Did_Class_1D0F: DemDidIdentifier=7439, DemDidDataElementClassRef=DemDataElementClass_1D0F
        Did_Class_1D13: DemDidIdentifier=7443, DemDidDataElementClassRef=DemDataElementClass_1D13
        Did_Class_1D14: DemDidIdentifier=7444, DemDidDataElementClassRef=DemDataElementClass_1D14
        Did_Class_1D15: DemDidIdentifier=7445, DemDidDataElementClassRef=DemDataElementClass_1D15
        Did_Class_1D16: DemDidIdentifier=7446, DemDidDataElementClassRef=DemDataElementClass_1D16
        Did_Class_1D17: DemDidIdentifier=7447, DemDidDataElementClassRef=DemDataElementClass_1D17
        Did_Class_1D18: DemDidIdentifier=7448, DemDidDataElementClassRef=DemDataElementClass_1D18
        Did_Class_1D19: DemDidIdentifier=7449, DemDidDataElementClassRef=DemDataElementClass_1D19
        Did_Class_1D1A: DemDidIdentifier=7450, DemDidDataElementClassRef=DemDataElementClass_1D1A
        Did_Class_1D1B: DemDidIdentifier=7451, DemDidDataElementClassRef=DemDataElementClass_1D1B
        Did_Class_1D1C: DemDidIdentifier=7452, DemDidDataElementClassRef=DemDataElementClass_1D1C
        Did_Class_1D1D: DemDidIdentifier=7453, DemDidDataElementClassRef=DemDataElementClass_1D1D
        Did_Class_1D1E: DemDidIdentifier=7454, DemDidDataElementClassRef=DemDataElementClass_1D1E
        Did_Class_1D1F: DemDidIdentifier=7455, DemDidDataElementClassRef=DemDataElementClass_1D1F
        Did_Class_1D20: DemDidIdentifier=7456, DemDidDataElementClassRef=DemDataElementClass_1D20
        Did_Class_1D21: DemDidIdentifier=7457, DemDidDataElementClassRef=DemDataElementClass_1D21
        Did_Class_1D22: DemDidIdentifier=7458, DemDidDataElementClassRef=DemDataElementClass_1D22
        Did_Class_1D23: DemDidIdentifier=7459, DemDidDataElementClassRef=DemDataElementClass_1D23
        Did_Class_1D24: DemDidIdentifier=7460, DemDidDataElementClassRef=DemDataElementClass_1D24
        Did_Class_1D25: DemDidIdentifier=7461, DemDidDataElementClassRef=DemDataElementClass_1D25
        Did_Class_1D26: DemDidIdentifier=7462, DemDidDataElementClassRef=DemDataElementClass_1D26
        Did_Class_1D27: DemDidIdentifier=7463, DemDidDataElementClassRef=DemDataElementClass_1D27
        Did_Class_1D28: DemDidIdentifier=7464, DemDidDataElementClassRef=DemDataElementClass_1D28
        Did_Class_1D29: DemDidIdentifier=7465, DemDidDataElementClassRef=DemDataElementClass_1D29
        Did_Class_2D02: DemDidIdentifier=11522, DemDidDataElementClassRef=DemDataElementClass_2D02
        Did_Class_2D03: DemDidIdentifier=11523, DemDidDataElementClassRef=DemDataElementClass_2D03
        Did_Class_2D04: DemDidIdentifier=11524, DemDidDataElementClassRef=DemDataElementClass_2D04
        Did_Class_2D05: DemDidIdentifier=11525, DemDidDataElementClassRef=DemDataElementClass_2D05
        Did_Class_2D06: DemDidIdentifier=11526, DemDidDataElementClassRef=DemDataElementClass_2D06
        Did_Class_2D07: DemDidIdentifier=11527, DemDidDataElementClassRef=DemDataElementClass_2D07
        Did_Class_2D08: DemDidIdentifier=11528, DemDidDataElementClassRef=DemDataElementClass_2D08
        Did_Class_2D0E: DemDidIdentifier=11534, DemDidDataElementClassRef=DemDataElementClass_2D0E
        Did_Class_2D13: DemDidIdentifier=11539, DemDidDataElementClassRef=DemDataElementClass_2D13
        Did_Class_2D14: DemDidIdentifier=11540, DemDidDataElementClassRef=DemDataElementClass_2D14
        Did_Class_2D15: DemDidIdentifier=11541, DemDidDataElementClassRef=DemDataElementClass_2D15
        Did_Class_2D1C: DemDidIdentifier=11548, DemDidDataElementClassRef=DemDataElementClass_2D1C
        Did_Class_2D1D: DemDidIdentifier=11549, DemDidDataElementClassRef=DemDataElementClass_2D1D
        Did_Class_2D1E: DemDidIdentifier=11550, DemDidDataElementClassRef=DemDataElementClass_2D1E
        Did_Class_2D1F: DemDidIdentifier=11551, DemDidDataElementClassRef=DemDataElementClass_2D1F
        Did_Class_2D20: DemDidIdentifier=11552, DemDidDataElementClassRef=DemDataElementClass_2D20
        Did_Class_2D21: DemDidIdentifier=11553, DemDidDataElementClassRef=DemDataElementClass_2D21
        Did_Class_2D22: DemDidIdentifier=11554, DemDidDataElementClassRef=DemDataElementClass_2D22
        Did_Class_2D25: DemDidIdentifier=11557, DemDidDataElementClassRef=DemDataElementClass_2D25
        Did_Class_2D26: DemDidIdentifier=11558, DemDidDataElementClassRef=DemDataElementClass_2D26
        Did_Class_3D02: DemDidIdentifier=15618, DemDidDataElementClassRef=DemDataElementClass_3D02
        Did_Class_3D03: DemDidIdentifier=15619, DemDidDataElementClassRef=DemDataElementClass_3D03
        Did_Class_3D04: DemDidIdentifier=15620, DemDidDataElementClassRef=DemDataElementClass_3D04
        Did_Class_3D05: DemDidIdentifier=15621, DemDidDataElementClassRef=DemDataElementClass_3D05
        Did_Class_3D06: DemDidIdentifier=15622, DemDidDataElementClassRef=DemDataElementClass_3D06
        Did_Class_3D07: DemDidIdentifier=15623, DemDidDataElementClassRef=DemDataElementClass_3D07
        Did_Class_3D08: DemDidIdentifier=15624, DemDidDataElementClassRef=DemDataElementClass_3D08
        Did_Class_3D0E: DemDidIdentifier=15630, DemDidDataElementClassRef=DemDataElementClass_3D0E
        Did_Class_3D13: DemDidIdentifier=15635, DemDidDataElementClassRef=DemDataElementClass_3D13
        Did_Class_3D14: DemDidIdentifier=15636, DemDidDataElementClassRef=DemDataElementClass_3D14
        Did_Class_3D15: DemDidIdentifier=15637, DemDidDataElementClassRef=DemDataElementClass_3D15
        Did_Class_3D1C: DemDidIdentifier=15644, DemDidDataElementClassRef=DemDataElementClass_3D1C
        Did_Class_3D1D: DemDidIdentifier=15645, DemDidDataElementClassRef=DemDataElementClass_3D1D
        Did_Class_3D1E: DemDidIdentifier=15646, DemDidDataElementClassRef=DemDataElementClass_3D1E
        Did_Class_3D1F: DemDidIdentifier=15647, DemDidDataElementClassRef=DemDataElementClass_3D1F
        Did_Class_3D20: DemDidIdentifier=15648, DemDidDataElementClassRef=DemDataElementClass_3D20
        Did_Class_3D21: DemDidIdentifier=15649, DemDidDataElementClassRef=DemDataElementClass_3D21
        Did_Class_3D22: DemDidIdentifier=15650, DemDidDataElementClassRef=DemDataElementClass_3D22
        Did_Class_3D25: DemDidIdentifier=15653, DemDidDataElementClassRef=DemDataElementClass_3D25
        Did_Class_3D26: DemDidIdentifier=15654, DemDidDataElementClassRef=DemDataElementClass_3D26
        Did_Class_4D27: DemDidIdentifier=19751, DemDidDataElementClassRef=DemDataElementClass_4D27
        Did_Class_4D28: DemDidIdentifier=19752, DemDidDataElementClassRef=DemDataElementClass_4D28
        Did_Class_4D29: DemDidIdentifier=19753, DemDidDataElementClassRef=DemDataElementClass_4D29
        Did_Class_4D2A: DemDidIdentifier=19754, DemDidDataElementClassRef=DemDataElementClass_4D2A
        Did_Class_4D2B: DemDidIdentifier=19755, DemDidDataElementClassRef=DemDataElementClass_4D2B
        Did_Class_4D2C: DemDidIdentifier=19756, DemDidDataElementClassRef=DemDataElementClass_4D2C
        Did_Class_4D2D: DemDidIdentifier=19757, DemDidDataElementClassRef=DemDataElementClass_4D2D
        Did_Class_4D2E: DemDidIdentifier=19758, DemDidDataElementClassRef=DemDataElementClass_4D2E
        Did_Class_4D2F: DemDidIdentifier=19759, DemDidDataElementClassRef=DemDataElementClass_4D2F
        Did_Class_4D30: DemDidIdentifier=19760, DemDidDataElementClassRef=DemDataElementClass_4D30
        Did_Class_4D31: DemDidIdentifier=19761, DemDidDataElementClassRef=DemDataElementClass_4D31
        Did_Class_4D32: DemDidIdentifier=19762, DemDidDataElementClassRef=DemDataElementClass_4D32
        Did_Class_4D33: DemDidIdentifier=19763, DemDidDataElementClassRef=DemDataElementClass_4D33
        Did_Class_4D34: DemDidIdentifier=19764, DemDidDataElementClassRef=DemDataElementClass_4D34
        Did_Class_4D35: DemDidIdentifier=19765, DemDidDataElementClassRef=DemDataElementClass_4D35
        Did_Class_4D36: DemDidIdentifier=19766, DemDidDataElementClassRef=DemDataElementClass_4D36
        Did_Class_4D37: DemDidIdentifier=19767, DemDidDataElementClassRef=DemDataElementClass_4D37
        Did_Class_4D38: DemDidIdentifier=19768, DemDidDataElementClassRef=DemDataElementClass_4D38
        Did_Class_4D39: DemDidIdentifier=19769, DemDidDataElementClassRef=DemDataElementClass_4D39
        Did_Class_4D3A: DemDidIdentifier=19770, DemDidDataElementClassRef=DemDataElementClass_4D3A
        Did_Class_4D3B: DemDidIdentifier=19771, DemDidDataElementClassRef=DemDataElementClass_4D3B
        Did_Class_4D3C: DemDidIdentifier=19772, DemDidDataElementClassRef=DemDataElementClass_4D3C
        Did_Class_4D3D: DemDidIdentifier=19773, DemDidDataElementClassRef=DemDataElementClass_4D3D
