AUTOSAR XML (schema 00047)
package /ETAS_Project/EcucModuleConfigurationValuess
  module config Dcm
    DcmConfigSet
      DcmDsp
        307 x DcmDspData, all with DcmDspDataEndianness=BIG_ENDIAN, DcmDspDataUsePort=USE_DATA_ASYNCH_FNC:
          DcmDspData_ReadBootCompileTime_0400: DcmRbDspDataUseAsynchronousServerCallPoint=0, DcmDspDataConditionCheckReadFncUsed=false, DcmDspDataSize=48, DcmDspDataType=UINT8_N, DcmDspDataReadFnc=DcmDspData_BootTime_ReadFunc
          DcmDspData_ReadActiveBank_0401: DcmRbDspDataUseAsynchronousServerCallPoint=0, DcmDspDataReadFnc=DcmDspData_ActiveBank_ReadFunc, DcmDspDataSize=8, DcmDspDataType=UINT8_N
          DcmDspData_ReadBootReqCanId_0402: DcmRbDspDataUseAsynchronousServerCallPoint=0, DcmDspDataReadFnc=DcmDspData_BootReqCanId_ReadFunc, DcmDspDataConditionCheckReadFncUsed=false, DcmDspDataSize=32, DcmDspDataType=UINT8_N
          DcmDspData_ReadBootRspCanId_0403: DcmDspDataConditionCheckReadFncUsed=false, DcmDspDataReadFnc=DcmDspData_BootRspCanId_ReadFunc, DcmDspDataSize=32, DcmDspDataType=UINT8_N
          DcmDspData_ReadAppReqCanId_0404: DcmDspDataConditionCheckReadFncUsed=false, DcmDspDataReadFnc=DcmDspData_AppReqCanId_ReadFunc, DcmDspDataSize=32, DcmDspDataType=UINT8_N
          DcmDspData_ReadAppRspCanId_0405: DcmDspDataConditionCheckReadFncUsed=false, DcmDspDataReadFnc=DcmDspData_AppRspCanId_ReadFunc, DcmDspDataSize=32, DcmDspDataType=UINT8_N
          DcmDspData_ReadIntBswLibDate_0410: DcmDspDataConditionCheckReadFncUsed=false, DcmDspDataSize=48, DcmDspDataType=UINT8_N, DcmDspDataReadFnc=DataServices_R_IntBswLibDate_0410_ReadData
          DcmDspData_ReadIntOfflineDate_0411: DcmDspDataConditionCheckReadFncUsed=false, DcmDspDataSize=32, DcmDspDataType=UINT8_N, DcmDspDataReadFnc=DataServices_R_IntOfflineDate_0411_ReadData
          DcmDspData_ReadIntProductionLineId_0412: DcmDspDataConditionCheckReadFncUsed=false, DcmDspDataSize=32, DcmDspDataType=UINT8_N, DcmDspDataReadFnc=DataServices_R_IntProductionLineId_0412_ReadData
          DcmDspData_ReadIntProjectId_0413: DcmDspDataConditionCheckReadFncUsed=false, DcmDspDataSize=64, DcmDspDataType=UINT8_N, DcmDspDataReadFnc=DataServices_R_IntProjectId_0413_ReadData
          DcmDspData_ReadIntBswSvnRev_0414: DcmDspDataConditionCheckReadFncUsed=false, DcmDspDataSize=16, DcmDspDataType=UINT8_N, DcmDspDataReadFnc=DataServices_R_IntBswSvnRev_0414_ReadData
          DcmDspData_ReadIntBootSvnRev_0415: DcmDspDataConditionCheckReadFncUsed=false, DcmDspDataSize=16, DcmDspDataType=UINT8_N, DcmDspDataReadFnc=DataServices_R_IntBootSvnRev_0415_ReadData
          DcmDspData_ReadIntFpgaSvnRev_0416: DcmDspDataConditionCheckReadFncUsed=false, DcmDspDataSize=16, DcmDspDataType=UINT16, DcmDspDataReadFnc=DataServices_R_IntFpgaSvnRev_0416_ReadData
          DcmDspData_ReadIntCpldSvnRev_0417: DcmDspDataConditionCheckReadFncUsed=false, DcmDspDataSize=16, DcmDspDataType=UINT8_N, DcmDspDataReadFnc=DataServices_R_IntCpldSvnRev_0417_ReadData
          DcmDspData_ReadIntHwSvnRev_0418: DcmDspDataConditionCheckReadFncUsed=false, DcmDspDataSize=16, DcmDspDataType=UINT8_N, DcmDspDataReadFnc=DataServices_R_IntHwSvnRev_0418_ReadData
          DcmDspData_ReadIntAddlInfo_0419: DcmDspDataConditionCheckReadFncUsed=false, DcmDspDataSize=64, DcmDspDataType=UINT8_N, DcmDspDataReadFnc=DataServices_R_IntAddlInfo_0419_ReadData
          DcmDspData_R_ResetLog_0420: DcmDspDataConditionCheckReadFncUsed=false, DcmDspDataSize=1600, DcmDspDataType=UINT8_N, DcmDspDataReadFnc=DataServices_R_ResetLog_0420_ReadData
          DcmDspData_R_D000: DcmDspDataConditionCheckReadFncUsed=false, DcmDspDataSize=8, DcmDspDataType=UINT8_N, DcmDspDataReadFnc=DataServices_R_D000_ReadData
          DcmDspData_R_D001: DcmDspDataConditionCheckReadFncUsed=false, DcmDspDataSize=16, DcmDspDataType=UINT8_N, DcmDspDataReadFnc=DataServices_R_D001_ReadData
          DcmDspData_R_D002: DcmDspDataConditionCheckReadFncUsed=false, DcmDspDataSize=16, DcmDspDataType=UINT8_N, DcmDspDataReadFnc=DataServices_R_D002_ReadData
          DcmDspData_R_D003: DcmDspDataConditionCheckReadFncUsed=false, DcmDspDataSize=8, DcmDspDataType=UINT8_N, DcmDspDataReadFnc=DataServices_R_D003_ReadData
          DcmDspData_R_D004: DcmDspDataConditionCheckReadFncUsed=false, DcmDspDataSize=16, DcmDspDataType=UINT8_N, DcmDspDataReadFnc=DataServices_R_D004_ReadData
          DcmDspData_R_D005: DcmDspDataConditionCheckReadFncUsed=false, DcmDspDataSize=8, DcmDspDataType=UINT8_N, DcmDspDataReadFnc=DataServices_R_D005_ReadData
          DcmDspData_R_D007: DcmDspDataConditionCheckReadFncUsed=false, DcmDspDataSize=16, DcmDspDataType=UINT8_N, DcmDspDataReadFnc=DataServices_R_D007_ReadData
          DcmDspData_R_D008: DcmDspDataConditionCheckReadFncUsed=false, DcmDspDataSize=16, DcmDspDataType=UINT8_N, DcmDspDataReadFnc=DataServices_R_D008_ReadData
          DcmDspData_R_D{009..033}: DcmDspDataConditionCheckReadFncUsed=false, DcmDspDataSize=8, DcmDspDataType=UINT8_N, DcmDspDataReadFnc=DataServices_R_D{009..033}_ReadData
          DcmDspData_R_D034: DcmDspDataConditionCheckReadFncUsed=false, DcmDspDataSize=16, DcmDspDataType=UINT8_N, DcmDspDataReadFnc=DataServices_R_D034_ReadData
          DcmDspData_R_D035: DcmDspDataConditionCheckReadFncUsed=false, DcmDspDataSize=16, DcmDspDataType=UINT8_N, DcmDspDataReadFnc=DataServices_R_D035_ReadData
          DcmDspData_R_D{036..039}: DcmDspDataConditionCheckReadFncUsed=false, DcmDspDataSize=8, DcmDspDataType=UINT8_N, DcmDspDataReadFnc=DataServices_R_D{036..039}_ReadData
          DcmDspData_R_D040: DcmDspDataConditionCheckReadFncUsed=false, DcmDspDataSize=16, DcmDspDataType=UINT8_N, DcmDspDataReadFnc=DataServices_R_D040_ReadData
          DcmDspData_R_D{041..046}: DcmDspDataConditionCheckReadFncUsed=false, DcmDspDataSize=8, DcmDspDataType=UINT8_N, DcmDspDataReadFnc=DataServices_R_D{041..046}_ReadData
          DcmDspData_R_D{047..049}: DcmDspDataConditionCheckReadFncUsed=false, DcmDspDataSize=16, DcmDspDataType=UINT8_N, DcmDspDataReadFnc=DataServices_R_D{047..049}_ReadData
          DcmDspData_R_0D2B: DcmDspDataConditionCheckReadFncUsed=false, DcmDspDataSize=8, DcmDspDataType=UINT8_N, DcmDspDataReadFnc=DataServices_R_0D2B_ReadData
          DcmDspData_RW_0E00: DcmDspDataConditionCheckReadFncUsed=false, DcmDspDataSize=16, DcmDspDataType=UINT8_N, DcmDspDataReadFnc=DataServices_RW_0E00_ReadData, DcmDspDataWriteFnc=DataServices_RW_0E00_WriteData
          DcmDspData_R_0E01: DcmDspDataConditionCheckReadFncUsed=false, DcmDspDataSize=8, DcmDspDataType=UINT8_N, DcmDspDataReadFnc=DataServices_R_0E01_ReadData
          DcmDspData_R_0E02: DcmDspDataConditionCheckReadFncUsed=false, DcmDspDataSize=8, DcmDspDataType=UINT8_N, DcmDspDataReadFnc=DataServices_R_0E02_ReadData
          DcmDspData_R_0E03: DcmDspDataConditionCheckReadFncUsed=false, DcmDspDataSize=128, DcmDspDataType=UINT8_N, DcmDspDataReadFnc=DataServices_R_0E03_ReadData
          DcmDspData_R_0E04: DcmDspDataConditionCheckReadFncUsed=false, DcmDspDataSize=8, DcmDspDataType=UINT8_N, DcmDspDataReadFnc=DataServices_R_0E04_ReadData
          DcmDspData_R_0E05: DcmDspDataConditionCheckReadFncUsed=false, DcmDspDataSize=16, DcmDspDataType=UINT8_N, DcmDspDataReadFnc=DataServices_R_0E05_ReadData
          DcmDspData_R_0E06: DcmDspDataConditionCheckReadFncUsed=false, DcmDspDataSize=8, DcmDspDataType=UINT8_N, DcmDspDataReadFnc=DataServices_R_0E06_ReadData
          DcmDspData_R_0E{07..09}: DcmDspDataConditionCheckReadFncUsed=false, DcmDspDataSize=16, DcmDspDataType=UINT8_N, DcmDspDataReadFnc=DataServices_R_0E{07..09}_ReadData
          DcmDspData_R_0E0A: DcmDspDataConditionCheckReadFncUsed=false, DcmDspDataSize=16, DcmDspDataType=UINT8_N, DcmDspDataReadFnc=DataServices_R_0E0A_ReadData
          DcmDspData_R_0E0B: DcmDspDataConditionCheckReadFncUsed=false, DcmDspDataSize=32, DcmDspDataType=UINT8_N, DcmDspDataReadFnc=DataServices_R_0E0B_ReadData
          DcmDspData_R_0E0C: DcmDspDataConditionCheckReadFncUsed=false, DcmDspDataSize=32, DcmDspDataType=UINT8_N, DcmDspDataReadFnc=DataServices_R_0E0C_ReadData
          DcmDspData_R_0E0D: DcmDspDataConditionCheckReadFncUsed=false, DcmDspDataSize=32, DcmDspDataType=UINT8_N, DcmDspDataReadFnc=DataServices_R_0E0D_ReadData
          DcmDspData_R_0E0E: DcmDspDataConditionCheckReadFncUsed=false, DcmDspDataSize=32, DcmDspDataType=UINT8_N, DcmDspDataReadFnc=DataServices_R_0E0E_ReadData
          DcmDspData_R_0E0F: DcmDspDataConditionCheckReadFncUsed=false, DcmDspDataSize=32, DcmDspDataType=UINT8_N, DcmDspDataReadFnc=DataServices_R_0E0F_ReadData
          DcmDspData_R_1D00: DcmDspDataConditionCheckReadFncUsed=false, DcmDspDataSize=8, DcmDspDataType=UINT8_N, DcmDspDataReadFnc=DataServices_R_1D00_ReadData
          DcmDspData_R_1D01: DcmDspDataConditionCheckReadFncUsed=false, DcmDspDataSize=8, DcmDspDataType=UINT8_N, DcmDspDataReadFnc=DataServices_R_1D01_ReadData
          DcmDspData_R_1D{02..04}: DcmDspDataConditionCheckReadFncUsed=false, DcmDspDataSize=16, DcmDspDataType=UINT8_N, DcmDspDataReadFnc=DataServices_R_1D{02..04}_ReadData
          DcmDspData_R_1D05: DcmDspDataConditionCheckReadFncUsed=false, DcmDspDataSize=8, DcmDspDataType=UINT8_N, DcmDspDataReadFnc=DataServices_R_1D05_ReadData
          DcmDspData_R_1D06: DcmDspDataConditionCheckReadFncUsed=false, DcmDspDataSize=16, DcmDspDataType=UINT8_N, DcmDspDataReadFnc=DataServices_R_1D06_ReadData
          DcmDspData_R_1D07: DcmDspDataConditionCheckReadFncUsed=false, DcmDspDataSize=8, DcmDspDataType=UINT8_N, DcmDspDataReadFnc=DataServices_R_1D07_ReadData
          DcmDspData_R_1D08: DcmDspDataConditionCheckReadFncUsed=false, DcmDspDataSize=16, DcmDspDataType=UINT8_N, DcmDspDataReadFnc=DataServices_R_1D08_ReadData
          DcmDspData_R_1D09: DcmDspDataConditionCheckReadFncUsed=false, DcmDspDataSize=8, DcmDspDataType=UINT8_N, DcmDspDataReadFnc=DataServices_R_1D09_ReadData
          DcmDspData_R_1D0A: DcmDspDataConditionCheckReadFncUsed=false, DcmDspDataSize=8, DcmDspDataType=UINT8_N, DcmDspDataReadFnc=DataServices_R_1D0A_ReadData
          DcmDspData_R_1D0B: DcmDspDataConditionCheckReadFncUsed=false, DcmDspDataSize=8, DcmDspDataType=UINT8_N, DcmDspDataReadFnc=DataServices_R_1D0B_ReadData
          DcmDspData_R_1D0C: DcmDspDataConditionCheckReadFncUsed=false, DcmDspDataSize=48, DcmDspDataType=UINT8_N, DcmDspDataReadFnc=DataServices_R_1D0C_ReadData
          DcmDspData_R_1D0D: DcmDspDataConditionCheckReadFncUsed=false, DcmDspDataSize=16, DcmDspDataType=UINT8_N, DcmDspDataReadFnc=DataServices_R_1D0D_ReadData
          DcmDspData_R_1D0E: DcmDspDataConditionCheckReadFncUsed=false, DcmDspDataSize=16, DcmDspDataType=UINT8_N, DcmDspDataReadFnc=DataServices_R_1D0E_ReadData
          DcmDspData_R_1D0F: DcmDspDataConditionCheckReadFncUsed=false, DcmDspDataSize=16, DcmDspDataType=UINT8_N, DcmDspDataReadFnc=DataServices_R_1D0F_ReadData
          DcmDspData_R_1D10: DcmDspDataConditionCheckReadFncUsed=false, DcmDspDataSize=8, DcmDspDataType=UINT8_N, DcmDspDataReadFnc=DataServices_R_1D10_ReadData
          DcmDspData_R_1D{11..19}: DcmDspDataConditionCheckReadFncUsed=false, DcmDspDataSize=16, DcmDspDataType=UINT8_N, DcmDspDataReadFnc=DataServices_R_1D{11..19}_ReadData
          DcmDspData_R_1D1A: DcmDspDataConditionCheckReadFncUsed=false, DcmDspDataSize=16, DcmDspDataType=UINT8_N, DcmDspDataReadFnc=DataServices_R_1D1A_ReadData
          DcmDspData_R_1D1B: DcmDspDataConditionCheckReadFncUsed=false, DcmDspDataSize=16, DcmDspDataType=UINT8_N, DcmDspDataReadFnc=DataServices_R_1D1B_ReadData
          DcmDspData_R_1D1C: DcmDspDataConditionCheckReadFncUsed=false, DcmDspDataSize=16, DcmDspDataType=UINT8_N, DcmDspDataReadFnc=DataServices_R_1D1C_ReadData
          DcmDspData_R_1D1D: DcmDspDataConditionCheckReadFncUsed=false, DcmDspDataSize=16, DcmDspDataType=UINT8_N, DcmDspDataReadFnc=DataServices_R_1D1D_ReadData
          DcmDspData_R_1D1E: DcmDspDataConditionCheckReadFncUsed=false, DcmDspDataSize=16, DcmDspDataType=UINT8_N, DcmDspDataReadFnc=DataServices_R_1D1E_ReadData
          DcmDspData_R_1D1F: DcmDspDataConditionCheckReadFncUsed=false, DcmDspDataSize=16, DcmDspDataType=UINT8_N, DcmDspDataReadFnc=DataServices_R_1D1F_ReadData
          DcmDspData_R_1D{20..29}: DcmDspDataConditionCheckReadFncUsed=false, DcmDspDataSize=16, DcmDspDataType=UINT8_N, DcmDspDataReadFnc=DataServices_R_1D{20..29}_ReadData
          DcmDspData_R_1D2A: DcmDspDataConditionCheckReadFncUsed=false, DcmDspDataSize=80, DcmDspDataType=UINT8_N, DcmDspDataReadFnc=DataServices_R_1D2A_ReadData
          DcmDspData_R_1D2B: DcmDspDataConditionCheckReadFncUsed=false, DcmDspDataSize=8, DcmDspDataType=UINT8_N, DcmDspDataReadFnc=DataServices_R_1D2B_ReadData
          DcmDspData_RW_1E00: DcmDspDataConditionCheckReadFncUsed=false, DcmDspDataSize=16, DcmDspDataType=UINT8_N, DcmDspDataReadFnc=DataServices_RW_1E00_ReadData, DcmDspDataWriteFnc=DataServices_RW_1E00_WriteData
          DcmDspData_R_1E01: DcmDspDataConditionCheckReadFncUsed=false, DcmDspDataSize=8, DcmDspDataType=UINT8_N, DcmDspDataReadFnc=DataServices_R_1E01_ReadData
          DcmDspData_R_1E02: DcmDspDataConditionCheckReadFncUsed=false, DcmDspDataSize=8, DcmDspDataType=UINT8_N, DcmDspDataReadFnc=DataServices_R_1E02_ReadData
          DcmDspData_R_1E03: DcmDspDataConditionCheckReadFncUsed=false, DcmDspDataSize=128, DcmDspDataType=UINT8_N, DcmDspDataReadFnc=DataServices_R_1E03_ReadData
          DcmDspData_R_1E04: DcmDspDataConditionCheckReadFncUsed=false, DcmDspDataSize=8, DcmDspDataType=UINT8_N, DcmDspDataReadFnc=DataServices_R_1E04_ReadData
          DcmDspData_R_1E05: DcmDspDataConditionCheckReadFncUsed=false, DcmDspDataSize=16, DcmDspDataType=UINT8_N, DcmDspDataReadFnc=DataServices_R_1E05_ReadData
          DcmDspData_R_1E06: DcmDspDataConditionCheckReadFncUsed=false, DcmDspDataSize=8, DcmDspDataType=UINT8_N, DcmDspDataReadFnc=DataServices_R_1E06_ReadData
          DcmDspData_R_1E{07..09}: DcmDspDataConditionCheckReadFncUsed=false, DcmDspDataSize=16, DcmDspDataType=UINT8_N, DcmDspDataReadFnc=DataServices_R_1E{07..09}_ReadData
          DcmDspData_R_1E0A: DcmDspDataConditionCheckReadFncUsed=false, DcmDspDataSize=16, DcmDspDataType=UINT8_N, DcmDspDataReadFnc=DataServices_R_1E0A_ReadData
          DcmDspData_R_1E0B: DcmDspDataConditionCheckReadFncUsed=false, DcmDspDataSize=32, DcmDspDataType=UINT8_N, DcmDspDataReadFnc=DataServices_R_1E0B_ReadData
          DcmDspData_R_1E0C: DcmDspDataConditionCheckReadFncUsed=false, DcmDspDataSize=32, DcmDspDataType=UINT8_N, DcmDspDataReadFnc=DataServices_R_1E0C_ReadData
          DcmDspData_R_1E0D: DcmDspDataConditionCheckReadFncUsed=false, DcmDspDataSize=32, DcmDspDataType=UINT8_N, DcmDspDataReadFnc=DataServices_R_1E0D_ReadData
          DcmDspData_R_1E0E: DcmDspDataConditionCheckReadFncUsed=false, DcmDspDataSize=32, DcmDspDataType=UINT8_N, DcmDspDataReadFnc=DataServices_R_1E0E_ReadData
          DcmDspData_R_1E0F: DcmDspDataConditionCheckReadFncUsed=false, DcmDspDataSize=32, DcmDspDataType=UINT8_N, DcmDspDataReadFnc=DataServices_R_1E0F_ReadData
          DcmDspData_R_2D{02..04}: DcmDspDataConditionCheckReadFncUsed=false, DcmDspDataSize=16, DcmDspDataType=UINT8_N, DcmDspDataReadFnc=DataServices_R_2D{02..04}_ReadData
          DcmDspData_R_2D05: DcmDspDataConditionCheckReadFncUsed=false, DcmDspDataSize=8, DcmDspDataType=UINT8_N, DcmDspDataReadFnc=DataServices_R_2D05_ReadData
          DcmDspData_R_2D06: DcmDspDataConditionCheckReadFncUsed=false, DcmDspDataSize=16, DcmDspDataType=UINT8_N, DcmDspDataReadFnc=DataServices_R_2D06_ReadData
          DcmDspData_R_2D07: DcmDspDataConditionCheckReadFncUsed=false, DcmDspDataSize=8, DcmDspDataType=UINT8_N, DcmDspDataReadFnc=DataServices_R_2D07_ReadData
          DcmDspData_R_2D08: DcmDspDataConditionCheckReadFncUsed=false, DcmDspDataSize=16, DcmDspDataType=UINT8_N, DcmDspDataReadFnc=DataServices_R_2D08_ReadData
          DcmDspData_R_2D09: DcmDspDataConditionCheckReadFncUsed=false, DcmDspDataSize=8, DcmDspDataType=UINT8_N, DcmDspDataReadFnc=DataServices_R_2D09_ReadData
          DcmDspData_R_2D0A: DcmDspDataConditionCheckReadFncUsed=false, DcmDspDataSize=8, DcmDspDataType=UINT8_N, DcmDspDataReadFnc=DataServices_R_2D0A_ReadData
          DcmDspData_R_2D0C: DcmDspDataConditionCheckReadFncUsed=false, DcmDspDataSize=48, DcmDspDataType=UINT8_N, DcmDspDataReadFnc=DataServices_R_2D0C_ReadData
          DcmDspData_R_2D0D: DcmDspDataConditionCheckReadFncUsed=false, DcmDspDataSize=16, DcmDspDataType=UINT8_N, DcmDspDataReadFnc=DataServices_R_2D0D_ReadData
          DcmDspData_R_2D0E: DcmDspDataConditionCheckReadFncUsed=false, DcmDspDataSize=16, DcmDspDataType=UINT8_N, DcmDspDataReadFnc=DataServices_R_2D0E_ReadData
          DcmDspData_R_2D{11..15}: DcmDspDataConditionCheckReadFncUsed=false, DcmDspDataSize=16, DcmDspDataType=UINT8_N, DcmDspDataReadFnc=DataServices_R_2D{11..15}_ReadData
          DcmDspData_R_2D1C: DcmDspDataConditionCheckReadFncUsed=false, DcmDspDataSize=16, DcmDspDataType=UINT8_N, DcmDspDataReadFnc=DataServices_R_2D1C_ReadData
          DcmDspData_R_2D1D: DcmDspDataConditionCheckReadFncUsed=false, DcmDspDataSize=16, DcmDspDataType=UINT8_N, DcmDspDataReadFnc=DataServices_R_2D1D_ReadData
          DcmDspData_R_2D1E: DcmDspDataConditionCheckReadFncUsed=false, DcmDspDataSize=16, DcmDspDataType=UINT8_N, DcmDspDataReadFnc=DataServices_R_2D1E_ReadData
          DcmDspData_R_2D1F: DcmDspDataConditionCheckReadFncUsed=false, DcmDspDataSize=16, DcmDspDataType=UINT8_N, DcmDspDataReadFnc=DataServices_R_2D1F_ReadData
          DcmDspData_R_2D{20..28}: DcmDspDataConditionCheckReadFncUsed=false, DcmDspDataSize=16, DcmDspDataType=UINT8_N, DcmDspDataReadFnc=DataServices_R_2D{20..28}_ReadData
          DcmDspData_R_2E02: DcmDspDataConditionCheckReadFncUsed=false, DcmDspDataSize=8, DcmDspDataType=UINT8_N, DcmDspDataReadFnc=DataServices_R_2E02_ReadData
          DcmDspData_R_2E03: DcmDspDataConditionCheckReadFncUsed=false, DcmDspDataSize=128, DcmDspDataType=UINT8_N, DcmDspDataReadFnc=DataServices_R_2E03_ReadData
          DcmDspData_R_2E04: DcmDspDataConditionCheckReadFncUsed=false, DcmDspDataSize=8, DcmDspDataType=UINT8_N, DcmDspDataReadFnc=DataServices_R_2E04_ReadData
          DcmDspData_R_2E05: DcmDspDataConditionCheckReadFncUsed=false, DcmDspDataSize=16, DcmDspDataType=UINT8_N, DcmDspDataReadFnc=DataServices_R_2E05_ReadData
          DcmDspData_R_2E06: DcmDspDataConditionCheckReadFncUsed=false, DcmDspDataSize=8, DcmDspDataType=UINT8_N, DcmDspDataReadFnc=DataServices_R_2E06_ReadData
          DcmDspData_R_2E{07..09}: DcmDspDataConditionCheckReadFncUsed=false, DcmDspDataSize=16, DcmDspDataType=UINT8_N, DcmDspDataReadFnc=DataServices_R_2E{07..09}_ReadData
          DcmDspData_R_2E0A: DcmDspDataConditionCheckReadFncUsed=false, DcmDspDataSize=16, DcmDspDataType=UINT8_N, DcmDspDataReadFnc=DataServices_R_2E0A_ReadData
          DcmDspData_R_2E0B: DcmDspDataConditionCheckReadFncUsed=false, DcmDspDataSize=32, DcmDspDataType=UINT8_N, DcmDspDataReadFnc=DataServices_R_2E0B_ReadData
          DcmDspData_R_2E0C: DcmDspDataConditionCheckReadFncUsed=false, DcmDspDataSize=32, DcmDspDataType=UINT8_N, DcmDspDataReadFnc=DataServices_R_2E0C_ReadData
          DcmDspData_R_2E0D: DcmDspDataConditionCheckReadFncUsed=false, DcmDspDataSize=32, DcmDspDataType=UINT8_N, DcmDspDataReadFnc=DataServices_R_2E0D_ReadData
          DcmDspData_R_2E0E: DcmDspDataConditionCheckReadFncUsed=false, DcmDspDataSize=32, DcmDspDataType=UINT8_N, DcmDspDataReadFnc=DataServices_R_2E0E_ReadData
          DcmDspData_R_2E0F: DcmDspDataConditionCheckReadFncUsed=false, DcmDspDataSize=32, DcmDspDataType=UINT8_N, DcmDspDataReadFnc=DataServices_R_2E0F_ReadData
          DcmDspData_R_3D{02..04}: DcmDspDataConditionCheckReadFncUsed=false, DcmDspDataSize=16, DcmDspDataType=UINT8_N, DcmDspDataReadFnc=DataServices_R_3D{02..04}_ReadData
          DcmDspData_R_3D05: DcmDspDataConditionCheckReadFncUsed=false, DcmDspDataSize=8, DcmDspDataType=UINT8_N, DcmDspDataReadFnc=DataServices_R_3D05_ReadData
          DcmDspData_R_3D06: DcmDspDataConditionCheckReadFncUsed=false, DcmDspDataSize=16, DcmDspDataType=UINT8_N, DcmDspDataReadFnc=DataServices_R_3D06_ReadData
          DcmDspData_R_3D07: DcmDspDataConditionCheckReadFncUsed=false, DcmDspDataSize=8, DcmDspDataType=UINT8_N, DcmDspDataReadFnc=DataServices_R_3D07_ReadData
          DcmDspData_R_3D08: DcmDspDataConditionCheckReadFncUsed=false, DcmDspDataSize=16, DcmDspDataType=UINT8_N, DcmDspDataReadFnc=DataServices_R_3D08_ReadData
          DcmDspData_R_3D09: DcmDspDataConditionCheckReadFncUsed=false, DcmDspDataSize=8, DcmDspDataType=UINT8_N, DcmDspDataReadFnc=DataServices_R_3D09_ReadData
          DcmDspData_R_3D0A: DcmDspDataConditionCheckReadFncUsed=false, DcmDspDataSize=8, DcmDspDataType=UINT8_N, DcmDspDataReadFnc=DataServices_R_3D0A_ReadData
          DcmDspData_R_3D0C: DcmDspDataConditionCheckReadFncUsed=false, DcmDspDataSize=48, DcmDspDataType=UINT8_N, DcmDspDataReadFnc=DataServices_R_3D0C_ReadData
          DcmDspData_R_3D0D: DcmDspDataConditionCheckReadFncUsed=false, DcmDspDataSize=16, DcmDspDataType=UINT8_N, DcmDspDataReadFnc=DataServices_R_3D0D_ReadData
          DcmDspData_R_3D0E: DcmDspDataConditionCheckReadFncUsed=false, DcmDspDataSize=16, DcmDspDataType=UINT8_N, DcmDspDataReadFnc=DataServices_R_3D0E_ReadData
          DcmDspData_R_3D{11..15}: DcmDspDataConditionCheckReadFncUsed=false, DcmDspDataSize=16, DcmDspDataType=UINT8_N, DcmDspDataReadFnc=DataServices_R_3D{11..15}_ReadData
          DcmDspData_R_3D1C: DcmDspDataConditionCheckReadFncUsed=false, DcmDspDataSize=16, DcmDspDataType=UINT8_N, DcmDspDataReadFnc=DataServices_R_3D1C_ReadData
          DcmDspData_R_3D1D: DcmDspDataConditionCheckReadFncUsed=false, DcmDspDataSize=16, DcmDspDataType=UINT8_N, DcmDspDataReadFnc=DataServices_R_3D1D_ReadData
          DcmDspData_R_3D1E: DcmDspDataConditionCheckReadFncUsed=false, DcmDspDataSize=16, DcmDspDataType=UINT8_N, DcmDspDataReadFnc=DataServices_R_3D1E_ReadData
          DcmDspData_R_3D1F: DcmDspDataConditionCheckReadFncUsed=false, DcmDspDataSize=16, DcmDspDataType=UINT8_N, DcmDspDataReadFnc=DataServices_R_3D1F_ReadData
          DcmDspData_R_3D{20..28}: DcmDspDataConditionCheckReadFncUsed=false, DcmDspDataSize=16, DcmDspDataType=UINT8_N, DcmDspDataReadFnc=DataServices_R_3D{20..28}_ReadData
          DcmDspData_R_3E02: DcmDspDataConditionCheckReadFncUsed=false, DcmDspDataSize=8, DcmDspDataType=UINT8_N, DcmDspDataReadFnc=DataServices_R_3E02_ReadData
          DcmDspData_R_3E03: DcmDspDataConditionCheckReadFncUsed=false, DcmDspDataSize=128, DcmDspDataType=UINT8_N, DcmDspDataReadFnc=DataServices_R_3E03_ReadData
          DcmDspData_R_3E04: DcmDspDataConditionCheckReadFncUsed=false, DcmDspDataSize=8, DcmDspDataType=UINT8_N, DcmDspDataReadFnc=DataServices_R_3E04_ReadData
          DcmDspData_R_3E05: DcmDspDataConditionCheckReadFncUsed=false, DcmDspDataSize=16, DcmDspDataType=UINT8_N, DcmDspDataReadFnc=DataServices_R_3E05_ReadData
          DcmDspData_R_3E06: DcmDspDataConditionCheckReadFncUsed=false, DcmDspDataSize=8, DcmDspDataType=UINT8_N, DcmDspDataReadFnc=DataServices_R_3E06_ReadData
          DcmDspData_R_3E{07..09}: DcmDspDataConditionCheckReadFncUsed=false, DcmDspDataSize=16, DcmDspDataType=UINT8_N, DcmDspDataReadFnc=DataServices_R_3E{07..09}_ReadData
          DcmDspData_R_3E0A: DcmDspDataConditionCheckReadFncUsed=false, DcmDspDataSize=16, DcmDspDataType=UINT8_N, DcmDspDataReadFnc=DataServices_R_3E0A_ReadData
          DcmDspData_R_3E0B: DcmDspDataConditionCheckReadFncUsed=false, DcmDspDataSize=32, DcmDspDataType=UINT8_N, DcmDspDataReadFnc=DataServices_R_3E0B_ReadData
          DcmDspData_R_3E0C: DcmDspDataConditionCheckReadFncUsed=false, DcmDspDataSize=32, DcmDspDataType=UINT8_N, DcmDspDataReadFnc=DataServices_R_3E0C_ReadData
          DcmDspData_R_3E0D: DcmDspDataConditionCheckReadFncUsed=false, DcmDspDataSize=32, DcmDspDataType=UINT8_N, DcmDspDataReadFnc=DataServices_R_3E0D_ReadData
          DcmDspData_R_3E0E: DcmDspDataConditionCheckReadFncUsed=false, DcmDspDataSize=32, DcmDspDataType=UINT8_N, DcmDspDataReadFnc=DataServices_R_3E0E_ReadData
          DcmDspData_R_3E0F: DcmDspDataConditionCheckReadFncUsed=false, DcmDspDataSize=32, DcmDspDataType=UINT8_N, DcmDspDataReadFnc=DataServices_R_3E0F_ReadData
          DcmDspData_R_4D{00..09}: DcmDspDataConditionCheckReadFncUsed=false, DcmDspDataSize=8, DcmDspDataType=UINT8_N, DcmDspDataReadFnc=DataServices_R_4D{00..09}_ReadData
          DcmDspData_R_4D0A: DcmDspDataConditionCheckReadFncUsed=false, DcmDspDataSize=8, DcmDspDataType=UINT8_N, DcmDspDataReadFnc=DataServices_R_4D0A_ReadData
          DcmDspData_R_4D0B: DcmDspDataConditionCheckReadFncUsed=false, DcmDspDataSize=8, DcmDspDataType=UINT8_N, DcmDspDataReadFnc=DataServices_R_4D0B_ReadData
          DcmDspData_R_4D0C: DcmDspDataConditionCheckReadFncUsed=false, DcmDspDataSize=8, DcmDspDataType=UINT8_N, DcmDspDataReadFnc=DataServices_R_4D0C_ReadData
          DcmDspData_R_4D0D: DcmDspDataConditionCheckReadFncUsed=false, DcmDspDataSize=8, DcmDspDataType=UINT8_N, DcmDspDataReadFnc=DataServices_R_4D0D_ReadData
          DcmDspData_R_4D0E: DcmDspDataConditionCheckReadFncUsed=false, DcmDspDataSize=8, DcmDspDataType=UINT8_N, DcmDspDataReadFnc=DataServices_R_4D0E_ReadData
          DcmDspData_R_4D0F: DcmDspDataConditionCheckReadFncUsed=false, DcmDspDataSize=8, DcmDspDataType=UINT8_N, DcmDspDataReadFnc=DataServices_R_4D0F_ReadData
          DcmDspData_R_4D{10..19}: DcmDspDataConditionCheckReadFncUsed=false, DcmDspDataSize=8, DcmDspDataType=UINT8_N, DcmDspDataReadFnc=DataServices_R_4D{10..19}_ReadData
          DcmDspData_R_4D1A: DcmDspDataConditionCheckReadFncUsed=false, DcmDspDataSize=8, DcmDspDataType=UINT8_N, DcmDspDataReadFnc=DataServices_R_4D1A_ReadData
          DcmDspData_R_4D1B: DcmDspDataConditionCheckReadFncUsed=false, DcmDspDataSize=8, DcmDspDataType=UINT8_N, DcmDspDataReadFnc=DataServices_R_4D1B_ReadData
          DcmDspData_R_4D1C: DcmDspDataConditionCheckReadFncUsed=false, DcmDspDataSize=8, DcmDspDataType=UINT8_N, DcmDspDataReadFnc=DataServices_R_4D1C_ReadData
          DcmDspData_R_4D1D: DcmDspDataConditionCheckReadFncUsed=false, DcmDspDataSize=8, DcmDspDataType=UINT8_N, DcmDspDataReadFnc=DataServices_R_4D1D_ReadData
          DcmDspData_R_4D1E: DcmDspDataConditionCheckReadFncUsed=false, DcmDspDataSize=8, DcmDspDataType=UINT8_N, DcmDspDataReadFnc=DataServices_R_4D1E_ReadData
          DcmDspData_R_4D1F: DcmDspDataConditionCheckReadFncUsed=false, DcmDspDataSize=8, DcmDspDataType=UINT8_N, DcmDspDataReadFnc=DataServices_R_4D1F_ReadData
          DcmDspData_R_4D{20..26}: DcmDspDataConditionCheckReadFncUsed=false, DcmDspDataSize=8, DcmDspDataType=UINT8_N, DcmDspDataReadFnc=DataServices_R_4D{20..26}_ReadData
          DcmDspData_R_4D{27..29}: DcmDspDataConditionCheckReadFncUsed=false, DcmDspDataSize=16, DcmDspDataType=UINT8_N, DcmDspDataReadFnc=DataServices_R_4D{27..29}_ReadData
          DcmDspData_R_4D2A: DcmDspDataConditionCheckReadFncUsed=false, DcmDspDataSize=16, DcmDspDataType=UINT8_N, DcmDspDataReadFnc=DataServices_R_4D2A_ReadData
          DcmDspData_R_4D2B: DcmDspDataConditionCheckReadFncUsed=false, DcmDspDataSize=16, DcmDspDataType=UINT8_N, DcmDspDataReadFnc=DataServices_R_4D2B_ReadData
          DcmDspData_R_4D2C: DcmDspDataConditionCheckReadFncUsed=false, DcmDspDataSize=16, DcmDspDataType=UINT8_N, DcmDspDataReadFnc=DataServices_R_4D2C_ReadData
          DcmDspData_R_4D2D: DcmDspDataConditionCheckReadFncUsed=false, DcmDspDataSize=16, DcmDspDataType=UINT8_N, DcmDspDataReadFnc=DataServices_R_4D2D_ReadData
          DcmDspData_R_4D2E: DcmDspDataConditionCheckReadFncUsed=false, DcmDspDataSize=16, DcmDspDataType=UINT8_N, DcmDspDataReadFnc=DataServices_R_4D2E_ReadData
          DcmDspData_R_4D2F: DcmDspDataConditionCheckReadFncUsed=false, DcmDspDataSize=16, DcmDspDataType=UINT8_N, DcmDspDataReadFnc=DataServices_R_4D2F_ReadData
          DcmDspData_R_4D{30..32}: DcmDspDataConditionCheckReadFncUsed=false, DcmDspDataSize=16, DcmDspDataType=UINT8_N, DcmDspDataReadFnc=DataServices_R_4D{30..32}_ReadData
          DcmDspData_R_4D33: DcmDspDataConditionCheckReadFncUsed=false, DcmDspDataSize=8, DcmDspDataType=UINT8_N, DcmDspDataReadFnc=DataServices_R_4D33_ReadData
          DcmDspData_R_4D34: DcmDspDataConditionCheckReadFncUsed=false, DcmDspDataSize=16, DcmDspDataType=UINT8_N, DcmDspDataReadFnc=DataServices_R_4D34_ReadData
          DcmDspData_R_4D35: DcmDspDataConditionCheckReadFncUsed=false, DcmDspDataSize=8, DcmDspDataType=UINT8_N, DcmDspDataReadFnc=DataServices_R_4D35_ReadData
          DcmDspData_R_4D36: DcmDspDataConditionCheckReadFncUsed=false, DcmDspDataSize=16, DcmDspDataType=UINT8_N, DcmDspDataReadFnc=DataServices_R_4D36_ReadData
          DcmDspData_R_4D37: DcmDspDataConditionCheckReadFncUsed=false, DcmDspDataSize=8, DcmDspDataType=UINT8_N, DcmDspDataReadFnc=DataServices_R_4D37_ReadData
          DcmDspData_R_4D38: DcmDspDataConditionCheckReadFncUsed=false, DcmDspDataSize=16, DcmDspDataType=UINT8_N, DcmDspDataReadFnc=DataServices_R_4D38_ReadData
          DcmDspData_R_4D39: DcmDspDataConditionCheckReadFncUsed=false, DcmDspDataSize=8, DcmDspDataType=UINT8_N, DcmDspDataReadFnc=DataServices_R_4D39_ReadData
          DcmDspData_R_4D3A: DcmDspDataConditionCheckReadFncUsed=false, DcmDspDataSize=16, DcmDspDataType=UINT8_N, DcmDspDataReadFnc=DataServices_R_4D3A_ReadData
          DcmDspData_R_4D3B: DcmDspDataConditionCheckReadFncUsed=false, DcmDspDataSize=8, DcmDspDataType=UINT8_N, DcmDspDataReadFnc=DataServices_R_4D3B_ReadData
          DcmDspData_R_4D3C: DcmDspDataConditionCheckReadFncUsed=false, DcmDspDataSize=16, DcmDspDataType=UINT8_N, DcmDspDataReadFnc=DataServices_R_4D3C_ReadData
          DcmDspData_R_4D3D: DcmDspDataConditionCheckReadFncUsed=false, DcmDspDataSize=8, DcmDspDataType=UINT8_N, DcmDspDataReadFnc=DataServices_R_4D3D_ReadData
          DcmDspData_R_DFEA: DcmRbDspDataUseAsynchronousServerCallPoint=0, DcmDspDataReadFnc=DataServices_R_DFEA_ReadData, DcmDspDataSize=512, DcmDspDataType=UINT8_N
          DcmDspData_R_DFEB: DcmRbDspDataUseAsynchronousServerCallPoint=0, DcmDspDataReadFnc=DataServices_R_DFEB_ReadData, DcmDspDataSize=512, DcmDspDataType=UINT8_N
          DcmDspData_R_DFEC: DcmRbDspDataUseAsynchronousServerCallPoint=0, DcmDspDataReadFnc=DataServices_R_DFEC_ReadData, DcmDspDataSize=512, DcmDspDataType=UINT8_N
          DcmDspData_R_DFED: DcmRbDspDataUseAsynchronousServerCallPoint=0, DcmDspDataReadFnc=DataServices_R_DFED_ReadData, DcmDspDataSize=512, DcmDspDataType=UINT8_N
          DcmDspData_R_F18A: DcmDspDataConditionCheckReadFncUsed=false, DcmDspDataSize=40, DcmDspDataType=UINT8_N, DcmDspDataReadFnc=DataServices_R_F18A_ReadData
          DcmDspData_R_F197: DcmDspDataConditionCheckReadFncUsed=false, DcmDspDataSize=48, DcmDspDataType=UINT8_N, DcmDspDataReadFnc=DataServices_R_F197_ReadData
          DcmDspData_R_F187: DcmDspDataConditionCheckReadFncUsed=false, DcmDspDataSize=112, DcmDspDataType=UINT8_N, DcmDspDataReadFnc=DataServices_R_F187_ReadData
          DcmDspData_R_F188: DcmDspDataConditionCheckReadFncUsed=false, DcmDspDataSize=112, DcmDspDataType=UINT8_N, DcmDspDataReadFnc=DataServices_R_F188_ReadData
          DcmDspData_R_F191: DcmDspDataConditionCheckReadFncUsed=false, DcmDspDataSize=112, DcmDspDataType=UINT8_N, DcmDspDataReadFnc=DataServices_R_F191_ReadData
          DcmDspData_R_F193: DcmDspDataConditionCheckReadFncUsed=false, DcmDspDataSize=80, DcmDspDataType=UINT8_N, DcmDspDataReadFnc=DataServices_R_F193_ReadData
          DcmDspData_R_F189: DcmDspDataConditionCheckReadFncUsed=false, DcmDspDataSize=80, DcmDspDataType=UINT8_N, DcmDspDataReadFnc=DataServices_R_F189_ReadData
          DcmDspData_R_F190: DcmDspDataConditionCheckReadFncUsed=false, DcmDspDataSize=136, DcmDspDataType=UINT8_N, DcmDspDataReadFnc=DataServices_R_F190_ReadData
          DcmDspData_R_B303: DcmDspDataConditionCheckReadFncUsed=false, DcmDspDataSize=160, DcmDspDataType=UINT8_N, DcmDspDataReadFnc=DataServices_R_B303_ReadData
          DcmDspData_R_F18C: DcmDspDataConditionCheckReadFncUsed=false, DcmDspDataSize=64, DcmDspDataType=UINT8_N, DcmDspDataReadFnc=DataServices_R_F18C_ReadData
        DcmDspRoutineAuthorization_AllSession (DcmDspCommonAuthorization):
          DcmDspCommonAuthorizationSessionRef = ExtendedDiagnosticSession
          DcmDspCommonAuthorizationSessionRef = ProgrammingSession
          DcmDspCommonAuthorizationSessionRef = DefaultSession
        5 x DcmDspData, all with DcmDspDataConditionCheckReadFncUsed=false, DcmDspDataEndianness=BIG_ENDIAN, DcmDspDataType=UINT8_N, DcmDspDataUsePort=USE_DATA_ASYNCH_FNC:
          DcmDspData_R_F1E0: DcmDspDataSize=384, DcmDspDataReadFnc=DataServices_R_F1E0_ReadData
          DcmDspData_R_0B20: DcmDspDataSize=48, DcmDspDataReadFnc=DataServices_R_0B20_ReadData
          DcmDspData_R_0B21: DcmDspDataSize=16, DcmDspDataReadFnc=DataServices_R_0B21_ReadData
          DcmDspData_R_0B22: DcmDspDataSize=32, DcmDspDataReadFnc=DataServices_R_0B22_ReadData
          DcmDspData_R_0B23: DcmDspDataSize=32, DcmDspDataReadFnc=DataServices_R_0B23_ReadData
