AUTOSAR XML (schema 00047)
package /ETAS_Project/EcucModuleConfigurationValuess
  module config Dcm
    DcmConfigSet
      DcmDsp
        C_demo_0010 (DcmDspData):
          DcmRbDspDataUseAsynchronousServerCallPoint = 0
          DcmDspDataConditionCheckReadFncUsed = false
          DcmDspDataSize = 8
          DcmDspDataType = UINT8_N
          DcmDspDataUsePort = USE_DATA_SYNCH_FNC
          DcmDspDataFreezeCurrentStateFnc = Dcm_DataServices_FreezeCurrentState
          DcmDspDataReadFnc = Dcm_DataServices_ReadData
          DcmDspDataResetToDefaultFnc = Dcm_DataServices_ResetToDefault
          DcmDspDataReturnControlToEcuFnc = Dcm_DataServices_ReturnControlToECU
          DcmDspDataShortTermAdjustmentFnc = Dcm_DataServices_ShortTermAdjustment
        DcmDspDid:
          DcmDspDidUsePort = USE_DATA_ELEMENT_SPECIFIC_INTERFACES
          DcmRbAtomicSenderReceiverCommunication = 0
          DcmDspDidIdentifier = 16
          DcmDspDidInfoRef = DcmDspDidInfo_C_DEMO_0010
          DcmDspDidSignal: DcmDspDidDataPos=0, DcmDspDidDataRef=C_demo_0010
        DcmDspDidInfo_C_DEMO_0010 (DcmDspDidInfo): DcmDspDidDynamicallyDefined=false
          DcmDspDidControl:
            DcmDspDidControlMask = DCM_CONTROLMASK_NO
            DcmRbDspIoCtrlResetOnSessSecurityChange = 1
            DcmDspDidFreezeCurrentState = true
            DcmDspDidResetToDefault = true
            DcmDspDidShortTermAdjustment = true
            DcmDspDidControlSecurityLevelRef = DSP_SEC_LEV_L1
            DcmDspDidControlSessionRef = ExtendedDiagnosticSession
          DcmDspDidRead: DcmDspDidReadSessionRef=ExtendedDiagnosticSession, DcmDspDidReadSessionRef=DefaultSession
