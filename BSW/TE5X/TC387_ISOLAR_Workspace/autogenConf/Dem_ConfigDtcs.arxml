AUTOSAR XML (schema 00047)
package /ETAS_Project/EcucModuleConfigurationValuess
  module config Dem: implementation-config-variant=VARIANT-PRE-COMPILE
    DemConfigSet  # ConfigureVesion
      30 x DemObdDTC, all with DemEventOBDReadinessGroup=DEM_OBD_RDY_NONE:
        DemObdDTC_1: DemDtcValue=7437
        DemObdDTC_2: DemDtcValue=7438
        DemObdDTC_9: DemDtcValue=2655
        DemObdDTC_10: DemDtcValue=3047
        DemObdDTC_11: DemDtcValue=3048
        DemObdDTC_12: DemDtcValue=2658
        DemObdDTC_13: DemDtcValue=3051
        DemObdDTC_14: DemDtcValue=3052
        DemObdDTC_15: DemDtcValue=2661
        DemObdDTC_16: DemDtcValue=3055
        DemObdDTC_17: DemDtcValue=3056
        DemObdDTC_19: DemDtcValue=49811
        DemObdDTC_28: DemDtcValue=2628
        DemObdDTC_29: DemDtcValue=7444
        DemObdDTC_32: DemDtcValue=3153
        DemObdDTC_{33..35}: DemDtcValue=3152
        DemObdDTC_38: DemDtcValue=3154
        DemObdDTC_39: DemDtcValue=3154
        DemObdDTC_40: DemDtcValue=3155
        DemObdDTC_41: DemDtcValue=3155
        DemObdDTC_42: DemDtcValue=1379
        DemObdDTC_43: DemDtcValue=1378
        DemObdDTC_49: DemDtcValue=1547
        DemObdDTC_51: DemDtcValue=2641
        DemObdDTC_53: DemDtcValue=6669
        DemObdDTC_54: DemDtcValue=6670
        DemObdDTC_61: DemDtcValue=2673
        DemObdDTC_62: DemDtcValue=3586
      7 x DemPidClass:
        PID_02: DemPidIdentifier=2
          PID_02 (DemPidDataElement): DemPidDataElementClassRef=DemGeneral/PID_02
        PID_04: DemPidIdentifier=4
          PID_04 (DemPidDataElement): DemPidDataElementClassRef=DemGeneral/PID_04
        PID_05: DemPidIdentifier=5
          PID_05 (DemPidDataElement): DemPidDataElementClassRef=DemGeneral/PID_05
        PID_0C: DemPidIdentifier=12
          PID_0C (DemPidDataElement): DemPidDataElementClassRef=DemGeneral/PID_0C
        PID_0D: DemPidIdentifier=13
          PID_0D (DemPidDataElement): DemPidDataElementClassRef=DemGeneral/PID_0D
        PID_42: DemPidIdentifier=66
          PID_42 (DemPidDataElement): DemPidDataElementClassRef=DemGeneral/PID_42
        PID_49: DemPidIdentifier=73
          PID_49 (DemPidDataElement): DemPidDataElementClassRef=DemGeneral/PID_49
      38 x DemObdDTC, all with DemEventOBDReadinessGroup=DEM_OBD_RDY_NONE:
        DemObdDTC_63: DemDtcValue=3587
        DemObdDTC_64: DemDtcValue=2676
        DemObdDTC_65: DemDtcValue=3590
        DemObdDTC_66: DemDtcValue=3591
        DemObdDTC_67: DemDtcValue=2679
        DemObdDTC_68: DemDtcValue=3594
        DemObdDTC_69: DemDtcValue=3595
        DemObdDTC_80: DemDtcValue=2640
        DemObdDTC_81: DemDtcValue=6676
        DemObdDTC_84: DemDtcValue=3173
        DemObdDTC_{85..87}: DemDtcValue=3172
        DemObdDTC_90: DemDtcValue=3174
        DemObdDTC_91: DemDtcValue=3174
        DemObdDTC_92: DemDtcValue=3175
        DemObdDTC_93: DemDtcValue=3175
        DemObdDTC_101: DemDtcValue=2649
        DemObdDTC_102: DemDtcValue=10471
        DemObdDTC_103: DemDtcValue=10474
        DemObdDTC_104: DemDtcValue=2327
        DemObdDTC_105: DemDtcValue=2326
        DemObdDTC_106: DemDtcValue=2325
        DemObdDTC_107: DemDtcValue=10474
        DemObdDTC_108: DemDtcValue=2141
        DemObdDTC_109: DemDtcValue=2141
        DemObdDTC_112: DemDtcValue=2141
        DemObdDTC_113: DemDtcValue=2141
        DemObdDTC_114: DemDtcValue=10468
        DemObdDTC_116: DemDtcValue=10046
        DemObdDTC_118: DemDtcValue=6403
        DemObdDTC_119: DemDtcValue=10475
        DemObdDTC_123: DemDtcValue=10045
        DemObdDTC_124: DemDtcValue=1810
        DemObdDTC_125: DemDtcValue=1811
        DemObdDTC_127: DemDtcValue=536
        DemObdDTC_137: DemDtcValue=3114
        DemObdDTC_138: DemDtcValue=49799
    DemGeneral
      7 x DemDataElementClass:
        PID_02
          PID_02 (DemExternalCSDataElementClass): DemDataElementDataSize=2, DemDataElementUsePort=true
        PID_04
          PID_04 (DemExternalCSDataElementClass): DemDataElementDataSize=1, DemDataElementUsePort=true
        PID_05
          PID_05 (DemExternalCSDataElementClass): DemDataElementDataSize=1, DemDataElementUsePort=true
        PID_0C
          PID_0C (DemExternalCSDataElementClass): DemDataElementDataSize=2, DemDataElementUsePort=true
        PID_0D
          PID_0D (DemExternalCSDataElementClass): DemDataElementDataSize=1, DemDataElementUsePort=true
        PID_42
          PID_42 (DemExternalCSDataElementClass): DemDataElementDataSize=2, DemDataElementUsePort=true
        PID_49
          PID_49 (DemExternalCSDataElementClass): DemDataElementDataSize=1, DemDataElementUsePort=true
      DemFreezeFrameRecordClass_0x01 (DemFreezeFrameRecordClass): DemFreezeFrameRecordNumber=1, DemFreezeFrameRecordTrigger=DEM_TRIGGER_ON_TEST_FAILED, DemFreezeFrameRecordUpdate=DEM_UPDATE_RECORD_NO
      DemFreezeFrameRecordClass_0x02 (DemFreezeFrameRecordClass): DemFreezeFrameRecordNumber=2, DemFreezeFrameRecordTrigger=DEM_TRIGGER_ON_TEST_FAILED, DemFreezeFrameRecordUpdate=DEM_UPDATE_RECORD_YES
      DemFreezeFrameRecNumClass: DemFreezeFrameRecordClassRef=DemFreezeFrameRecordClass_0x02, DemFreezeFrameRecordClassRef=DemFreezeFrameRecordClass_0x01
      5 x DemFreezeFrameClass:
        DemFreezeFrameClass_Ecu{1..4}: DemDidClassRef=Did_Class_D007, DemDidClassRef=Did_Class_D008, DemDidClassRef=Did_Class_D009, DemDidClassRef=Did_Class_D010, DemDidClassRef=Did_Class_D011, DemDidClassRef=Did_Class_D012, DemDidClassRef=Did_Class_D013, DemDidClassRef=Did_Class_D014, DemDidClassRef=Did_Class_D015, DemDidClassRef=Did_Class_D016, DemDidClassRef=Did_Class_D017, DemDidClassRef=Did_Class_D018, DemDidClassRef=Did_Class_D019, DemDidClassRef=Did_Class_D020, DemDidClassRef=Did_Class_D021, DemDidClassRef=Did_Class_D022, DemDidClassRef=Did_Class_D023, DemDidClassRef=Did_Class_D024, DemDidClassRef=Did_Class_D025, DemDidClassRef=Did_Class_D026, DemDidClassRef=Did_Class_D027, DemDidClassRef=Did_Class_D028, DemDidClassRef=Did_Class_D029, DemDidClassRef=Did_Class_D000, DemDidClassRef=Did_Class_D001, DemDidClassRef=Did_Class_D002, DemDidClassRef=Did_Class_D003, DemDidClassRef=Did_Class_D004, DemDidClassRef=Did_Class_D005
        DemFreezeFrameClass_Ecu5: DemDidClassRef=Did_Class_D030, DemDidClassRef=Did_Class_D031, DemDidClassRef=Did_Class_D032, DemDidClassRef=Did_Class_D033, DemDidClassRef=Did_Class_D034, DemDidClassRef=Did_Class_D035, DemDidClassRef=Did_Class_D036, DemDidClassRef=Did_Class_D037, DemDidClassRef=Did_Class_D038, DemDidClassRef=Did_Class_D039, DemDidClassRef=Did_Class_D040, DemDidClassRef=Did_Class_D041, DemDidClassRef=Did_Class_D042, DemDidClassRef=Did_Class_D043, DemDidClassRef=Did_Class_D044, DemDidClassRef=Did_Class_D045, DemDidClassRef=Did_Class_D046, DemDidClassRef=Did_Class_D047, DemDidClassRef=Did_Class_D048, DemDidClassRef=Did_Class_D049
