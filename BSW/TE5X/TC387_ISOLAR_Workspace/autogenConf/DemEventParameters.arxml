[part 2 of 2: package /ETAS_Project/EcucModuleConfigurationValuess]
AUTOSAR XML (schema 00047)
package /ETAS_Project/EcucModuleConfigurationValuess  (continued)
  module config Dem  (continued)
    DemConfigSet  (continued)
      500 x DemEventParameter, all with DemEventFailureCycleCounterThreshold=2, DemEventKind=DEM_EVENT_KIND_SWC, DemFFPrestorageSupported=false, DemReportBehavior=REPORT_AFTER_INIT, DemOperationCycleRef=DemOperationCycle_Ignition:  (continued)
        DemEventParameter_ECU3_DTC52: DemDTCRef=DemDTC_ECU3_DTC52, DemComponentClassRef=DemComponent_ECU3_DTC52
          DemDebounceAlgorithmClass
            DemDebounceCounterBasedClass (DemDebounceCounterBased): DemDebounceCounterBasedClassRef=DemDebounceCounterBasedClass_LostCom
          DemRbEventClass: DemRbEventBufferTime=0, DemRbEventRecoverableInSameOperationCycle=true, DemRbEventStatusBitStorageTestFailed=true
          DemIndicatorAttribute:
            DemIndicatorFailureCycleCounterThreshold = 2
            DemRbIndicatorApiControl = false
            DemIndicatorBehaviour = DEM_INDICATOR_CONTINUOUS
            DemIndicatorHealingCycleCounterThreshold = 3
            DemIndicatorRef = MIL
        DemEventParameter_ECU3_DTC53: DemDTCRef=DemDTC_ECU3_DTC53, DemComponentClassRef=DemComponent_ECU3_DTC53
          DemDebounceAlgorithmClass
            DemDebounceCounterBasedClass (DemDebounceCounterBased): DemDebounceCounterBasedClassRef=DemDebounceCounterBasedClass_LostCom
          DemRbEventClass: DemRbEventBufferTime=0, DemRbEventRecoverableInSameOperationCycle=true, DemRbEventStatusBitStorageTestFailed=true
          DemIndicatorAttribute:
            DemIndicatorFailureCycleCounterThreshold = 2
            DemRbIndicatorApiControl = false
            DemIndicatorBehaviour = DEM_INDICATOR_BLINK_CONT
            DemIndicatorHealingCycleCounterThreshold = 3
            DemIndicatorRef = MIL
        DemEventParameter_ECU3_DTC54: DemDTCRef=DemDTC_ECU3_DTC54, DemComponentClassRef=DemComponent_ECU3_DTC54
          DemDebounceAlgorithmClass
            DemDebounceCounterBasedClass (DemDebounceCounterBased): DemDebounceCounterBasedClassRef=DemDebounceCounterBasedClass_LostCom
          DemRbEventClass: DemRbEventBufferTime=0, DemRbEventRecoverableInSameOperationCycle=true, DemRbEventStatusBitStorageTestFailed=true
          DemIndicatorAttribute:
            DemIndicatorFailureCycleCounterThreshold = 2
            DemRbIndicatorApiControl = false
            DemIndicatorBehaviour = DEM_INDICATOR_BLINK_CONT
            DemIndicatorHealingCycleCounterThreshold = 3
            DemIndicatorRef = MIL
        DemEventParameter_ECU3_DTC55: DemDTCRef=DemDTC_ECU3_DTC55, DemComponentClassRef=DemComponent_ECU3_DTC55
          DemDebounceAlgorithmClass
            DemDebounceCounterBasedClass (DemDebounceCounterBased): DemDebounceCounterBasedClassRef=DemDebounceCounterBasedClass_LostCom
          DemRbEventClass: DemRbEventBufferTime=0, DemRbEventRecoverableInSameOperationCycle=true, DemRbEventStatusBitStorageTestFailed=true
          DemIndicatorAttribute:
            DemIndicatorFailureCycleCounterThreshold = 2
            DemRbIndicatorApiControl = false
            DemIndicatorBehaviour = DEM_INDICATOR_BLINK_CONT
            DemIndicatorHealingCycleCounterThreshold = 3
            DemIndicatorRef = MIL
        DemEventParameter_ECU3_DTC56: DemDTCRef=DemDTC_ECU3_DTC56, DemComponentClassRef=DemComponent_ECU3_DTC56
          DemDebounceAlgorithmClass
            DemDebounceCounterBasedClass (DemDebounceCounterBased): DemDebounceCounterBasedClassRef=DemDebounceCounterBasedClass_LostCom
          DemRbEventClass: DemRbEventBufferTime=0, DemRbEventRecoverableInSameOperationCycle=true, DemRbEventStatusBitStorageTestFailed=true
          DemIndicatorAttribute:
            DemIndicatorFailureCycleCounterThreshold = 2
            DemRbIndicatorApiControl = false
            DemIndicatorBehaviour = DEM_INDICATOR_BLINK_CONT
            DemIndicatorHealingCycleCounterThreshold = 3
            DemIndicatorRef = MIL
        DemEventParameter_ECU3_DTC57: DemDTCRef=DemDTC_ECU3_DTC57, DemComponentClassRef=DemComponent_ECU3_DTC57
          DemDebounceAlgorithmClass
            DemDebounceCounterBasedClass (DemDebounceCounterBased): DemDebounceCounterBasedClassRef=DemDebounceCounterBasedClass_LostCom
          DemRbEventClass: DemRbEventBufferTime=0, DemRbEventRecoverableInSameOperationCycle=true, DemRbEventStatusBitStorageTestFailed=true
          DemIndicatorAttribute:
            DemIndicatorFailureCycleCounterThreshold = 2
            DemRbIndicatorApiControl = false
            DemIndicatorBehaviour = DEM_INDICATOR_BLINK_CONT
            DemIndicatorHealingCycleCounterThreshold = 3
            DemIndicatorRef = MIL
        DemEventParameter_ECU3_DTC58: DemDTCRef=DemDTC_ECU3_DTC58, DemComponentClassRef=DemComponent_ECU3_DTC58
          DemDebounceAlgorithmClass
            DemDebounceCounterBasedClass (DemDebounceCounterBased): DemDebounceCounterBasedClassRef=DemDebounceCounterBasedClass_LostCom
          DemRbEventClass: DemRbEventBufferTime=0, DemRbEventRecoverableInSameOperationCycle=true, DemRbEventStatusBitStorageTestFailed=true
          DemIndicatorAttribute:
            DemIndicatorFailureCycleCounterThreshold = 2
            DemRbIndicatorApiControl = false
            DemIndicatorBehaviour = DEM_INDICATOR_CONTINUOUS
            DemIndicatorHealingCycleCounterThreshold = 3
            DemIndicatorRef = MIL
        DemEventParameter_ECU3_DTC59: DemDTCRef=DemDTC_ECU3_DTC59, DemComponentClassRef=DemComponent_ECU3_DTC59
          DemDebounceAlgorithmClass
            DemDebounceCounterBasedClass (DemDebounceCounterBased): DemDebounceCounterBasedClassRef=DemDebounceCounterBasedClass_LostCom
          DemRbEventClass: DemRbEventBufferTime=0, DemRbEventRecoverableInSameOperationCycle=true, DemRbEventStatusBitStorageTestFailed=true
          DemIndicatorAttribute:
            DemIndicatorFailureCycleCounterThreshold = 2
            DemRbIndicatorApiControl = false
            DemIndicatorBehaviour = DEM_INDICATOR_CONTINUOUS
            DemIndicatorHealingCycleCounterThreshold = 3
            DemIndicatorRef = MIL
        DemEventParameter_ECU3_DTC60: DemDTCRef=DemDTC_ECU3_DTC60, DemComponentClassRef=DemComponent_ECU3_DTC60
          DemDebounceAlgorithmClass
            DemDebounceCounterBasedClass (DemDebounceCounterBased): DemDebounceCounterBasedClassRef=DemDebounceCounterBasedClass_LostCom
          DemRbEventClass: DemRbEventBufferTime=0, DemRbEventRecoverableInSameOperationCycle=true, DemRbEventStatusBitStorageTestFailed=true
          DemIndicatorAttribute:
            DemIndicatorFailureCycleCounterThreshold = 2
            DemRbIndicatorApiControl = false
            DemIndicatorBehaviour = DEM_INDICATOR_CONTINUOUS
            DemIndicatorHealingCycleCounterThreshold = 3
            DemIndicatorRef = MIL
        DemEventParameter_ECU3_DTC61: DemDTCRef=DemDTC_ECU3_DTC61, DemComponentClassRef=DemComponent_ECU3_DTC61
          DemDebounceAlgorithmClass
            DemDebounceCounterBasedClass (DemDebounceCounterBased): DemDebounceCounterBasedClassRef=DemDebounceCounterBasedClass_LostCom
          DemRbEventClass: DemRbEventBufferTime=0, DemRbEventRecoverableInSameOperationCycle=true, DemRbEventStatusBitStorageTestFailed=true
          DemIndicatorAttribute:
            DemIndicatorFailureCycleCounterThreshold = 2
            DemRbIndicatorApiControl = false
            DemIndicatorBehaviour = DEM_INDICATOR_CONTINUOUS
            DemIndicatorHealingCycleCounterThreshold = 3
            DemIndicatorRef = MIL
        DemEventParameter_ECU3_DTC62: DemDTCRef=DemDTC_ECU3_DTC62, DemComponentClassRef=DemComponent_ECU3_DTC62
          DemDebounceAlgorithmClass
            DemDebounceCounterBasedClass (DemDebounceCounterBased): DemDebounceCounterBasedClassRef=DemDebounceCounterBasedClass_LostCom
          DemRbEventClass: DemRbEventBufferTime=0, DemRbEventRecoverableInSameOperationCycle=true, DemRbEventStatusBitStorageTestFailed=true
          DemIndicatorAttribute:
            DemIndicatorFailureCycleCounterThreshold = 2
            DemRbIndicatorApiControl = false
            DemIndicatorBehaviour = DEM_INDICATOR_CONTINUOUS
            DemIndicatorHealingCycleCounterThreshold = 3
            DemIndicatorRef = MIL
        DemEventParameter_ECU3_DTC63: DemDTCRef=DemDTC_ECU3_DTC63, DemComponentClassRef=DemComponent_ECU3_DTC63
          DemDebounceAlgorithmClass
            DemDebounceCounterBasedClass (DemDebounceCounterBased): DemDebounceCounterBasedClassRef=DemDebounceCounterBasedClass_LostCom
          DemRbEventClass: DemRbEventBufferTime=0, DemRbEventRecoverableInSameOperationCycle=true, DemRbEventStatusBitStorageTestFailed=true
        DemEventParameter_ECU3_DTC64: DemDTCRef=DemDTC_ECU3_DTC64, DemComponentClassRef=DemComponent_ECU3_DTC64
          DemDebounceAlgorithmClass
            DemDebounceCounterBasedClass (DemDebounceCounterBased): DemDebounceCounterBasedClassRef=DemDebounceCounterBasedClass_LostCom
          DemRbEventClass: DemRbEventBufferTime=0, DemRbEventRecoverableInSameOperationCycle=true, DemRbEventStatusBitStorageTestFailed=true
        DemEventParameter_ECU3_DTC65: DemDTCRef=DemDTC_ECU3_DTC65, DemComponentClassRef=DemComponent_ECU3_DTC65
          DemDebounceAlgorithmClass
            DemDebounceCounterBasedClass (DemDebounceCounterBased): DemDebounceCounterBasedClassRef=DemDebounceCounterBasedClass_LostCom
          DemRbEventClass: DemRbEventBufferTime=0, DemRbEventRecoverableInSameOperationCycle=true, DemRbEventStatusBitStorageTestFailed=true
        DemEventParameter_ECU3_DTC66: DemComponentClassRef=DemComponent_ECU3_DTC66, DemDTCRef=DemDTC_ECU3_DTC66
          DemEventClassRB (DemRbEventClass): DemRbEventBufferTime=0
          DemDebounceAlgorithmClass
            DemDebounceCounterBasedClass (DemDebounceCounterBased): DemDebounceCounterBasedClassRef=DemDebounceCounterBasedClass_LostCom
        DemEventParameter_ECU3_DTC67: DemComponentClassRef=DemComponent_ECU3_DTC67, DemDTCRef=DemDTC_ECU3_DTC67
          DemEventClassRB (DemRbEventClass): DemRbEventBufferTime=0
          DemDebounceAlgorithmClass
            DemDebounceCounterBasedClass (DemDebounceCounterBased): DemDebounceCounterBasedClassRef=DemDebounceCounterBasedClass_LostCom
        DemEventParameter_ECU3_DTC68: DemComponentClassRef=DemComponent_ECU3_DTC68, DemDTCRef=DemDTC_ECU3_DTC68
          DemEventClassRB (DemRbEventClass): DemRbEventBufferTime=0
          DemDebounceAlgorithmClass
            DemDebounceCounterBasedClass (DemDebounceCounterBased): DemDebounceCounterBasedClassRef=DemDebounceCounterBasedClass_LostCom
        DemEventParameter_ECU3_DTC69: DemComponentClassRef=DemComponent_ECU3_DTC69, DemDTCRef=DemDTC_ECU3_DTC69
          DemEventClassRB (DemRbEventClass): DemRbEventBufferTime=0
          DemDebounceAlgorithmClass
            DemDebounceCounterBasedClass (DemDebounceCounterBased): DemDebounceCounterBasedClassRef=DemDebounceCounterBasedClass_LostCom
        DemEventParameter_ECU3_DTC70: DemDTCRef=DemDTC_ECU3_DTC70, DemComponentClassRef=DemComponent_ECU3_DTC70
          DemDebounceAlgorithmClass
            DemDebounceCounterBasedClass (DemDebounceCounterBased): DemDebounceCounterBasedClassRef=DemDebounceCounterBasedClass_LostCom
          DemRbEventClass: DemRbEventBufferTime=0, DemRbEventRecoverableInSameOperationCycle=true, DemRbEventStatusBitStorageTestFailed=true
        DemEventParameter_ECU3_DTC71: DemComponentClassRef=DemComponent_ECU3_DTC71, DemDTCRef=DemDTC_ECU3_DTC71
          DemEventClassRB (DemRbEventClass): DemRbEventBufferTime=0
          DemDebounceAlgorithmClass
            DemDebounceCounterBasedClass (DemDebounceCounterBased): DemDebounceCounterBasedClassRef=DemDebounceCounterBasedClass_LostCom
          DemIndicatorAttribute:
            DemIndicatorFailureCycleCounterThreshold = 2
            DemRbIndicatorApiControl = false
            DemIndicatorBehaviour = DEM_INDICATOR_CONTINUOUS
            DemIndicatorHealingCycleCounterThreshold = 3
            DemIndicatorRef = MIL
        DemEventParameter_ECU3_DTC72: DemDTCRef=DemDTC_ECU3_DTC72, DemComponentClassRef=DemComponent_ECU3_DTC72
          DemDebounceAlgorithmClass
            DemDebounceCounterBasedClass (DemDebounceCounterBased): DemDebounceCounterBasedClassRef=DemDebounceCounterBasedClass_LostCom
          DemRbEventClass: DemRbEventBufferTime=0, DemRbEventRecoverableInSameOperationCycle=true, DemRbEventStatusBitStorageTestFailed=true
          DemIndicatorAttribute:
            DemIndicatorFailureCycleCounterThreshold = 2
            DemRbIndicatorApiControl = false
            DemIndicatorBehaviour = DEM_INDICATOR_BLINK_CONT
            DemIndicatorHealingCycleCounterThreshold = 3
            DemIndicatorRef = MIL
        DemEventParameter_ECU3_DTC73: DemDTCRef=DemDTC_ECU3_DTC73, DemComponentClassRef=DemComponent_ECU3_DTC73
          DemDebounceAlgorithmClass
            DemDebounceCounterBasedClass (DemDebounceCounterBased): DemDebounceCounterBasedClassRef=DemDebounceCounterBasedClass_LostCom
          DemRbEventClass: DemRbEventBufferTime=0, DemRbEventRecoverableInSameOperationCycle=true, DemRbEventStatusBitStorageTestFailed=true
          DemIndicatorAttribute:
            DemIndicatorFailureCycleCounterThreshold = 2
            DemRbIndicatorApiControl = false
            DemIndicatorBehaviour = DEM_INDICATOR_CONTINUOUS
            DemIndicatorHealingCycleCounterThreshold = 3
            DemIndicatorRef = MIL
        DemEventParameter_ECU3_DTC74: DemComponentClassRef=DemComponent_ECU3_DTC74, DemDTCRef=DemDTC_ECU3_DTC74
          DemDebounceAlgorithmClass
            DemDebounceCounterBasedClass (DemDebounceCounterBased): DemDebounceCounterBasedClassRef=DemDebounceCounterBasedClass_LostCom
          DemIndicatorAttribute:
            DemIndicatorFailureCycleCounterThreshold = 2
            DemRbIndicatorApiControl = 0
            DemIndicatorHealingCycleCounterThreshold = 3
            DemIndicatorBehaviour = DEM_INDICATOR_CONTINUOUS
            DemIndicatorRef = MIL
          DemRbEventClass: DemRbEventBufferTime=0, DemRbEventRecoverableInSameOperationCycle=1, DemRbEventStatusBitStorageTestFailed=true
        DemEventParameter_ECU3_DTC75: DemDTCRef=DemDTC_ECU3_DTC75, DemComponentClassRef=DemComponent_ECU3_DTC75
          DemDebounceAlgorithmClass
            DemDebounceCounterBasedClass (DemDebounceCounterBased): DemDebounceCounterBasedClassRef=DemDebounceCounterBasedClass_LostCom
          DemRbEventClass: DemRbEventBufferTime=0, DemRbEventRecoverableInSameOperationCycle=true, DemRbEventStatusBitStorageTestFailed=true
          DemIndicatorAttribute:
            DemIndicatorFailureCycleCounterThreshold = 2
            DemRbIndicatorApiControl = false
            DemIndicatorBehaviour = DEM_INDICATOR_CONTINUOUS
            DemIndicatorHealingCycleCounterThreshold = 3
            DemIndicatorRef = MIL
        DemEventParameter_ECU3_DTC76: DemDTCRef=DemDTC_ECU3_DTC76, DemComponentClassRef=DemComponent_ECU3_DTC76
          DemDebounceAlgorithmClass
            DemDebounceCounterBasedClass (DemDebounceCounterBased): DemDebounceCounterBasedClassRef=DemDebounceCounterBasedClass_LostCom
          DemRbEventClass: DemRbEventBufferTime=0, DemRbEventRecoverableInSameOperationCycle=true, DemRbEventStatusBitStorageTestFailed=true
          DemIndicatorAttribute:
            DemIndicatorFailureCycleCounterThreshold = 2
            DemRbIndicatorApiControl = false
            DemIndicatorBehaviour = DEM_INDICATOR_CONTINUOUS
            DemIndicatorHealingCycleCounterThreshold = 3
            DemIndicatorRef = MIL
        DemEventParameter_ECU3_DTC77: DemDTCRef=DemDTC_ECU3_DTC77, DemComponentClassRef=DemComponent_ECU3_DTC77
          DemDebounceAlgorithmClass
            DemDebounceCounterBasedClass (DemDebounceCounterBased): DemDebounceCounterBasedClassRef=DemDebounceCounterBasedClass_LostCom
          DemRbEventClass: DemRbEventBufferTime=0, DemRbEventRecoverableInSameOperationCycle=true, DemRbEventStatusBitStorageTestFailed=true
          DemIndicatorAttribute:
            DemIndicatorFailureCycleCounterThreshold = 2
            DemRbIndicatorApiControl = false
            DemIndicatorBehaviour = DEM_INDICATOR_CONTINUOUS
            DemIndicatorHealingCycleCounterThreshold = 3
            DemIndicatorRef = MIL
        DemEventParameter_ECU3_DTC78: DemDTCRef=DemDTC_ECU3_DTC78, DemComponentClassRef=DemComponent_ECU3_DTC78
          DemDebounceAlgorithmClass
            DemDebounceCounterBasedClass (DemDebounceCounterBased): DemDebounceCounterBasedClassRef=DemDebounceCounterBasedClass_LostCom
          DemRbEventClass: DemRbEventBufferTime=0, DemRbEventRecoverableInSameOperationCycle=true, DemRbEventStatusBitStorageTestFailed=true
          DemIndicatorAttribute:
            DemIndicatorFailureCycleCounterThreshold = 2
            DemRbIndicatorApiControl = false
            DemIndicatorBehaviour = DEM_INDICATOR_BLINK_CONT
            DemIndicatorHealingCycleCounterThreshold = 3
            DemIndicatorRef = MIL
        DemEventParameter_ECU3_DTC79: DemDTCRef=DemDTC_ECU3_DTC79, DemComponentClassRef=DemComponent_ECU3_DTC79
          DemDebounceAlgorithmClass
            DemDebounceCounterBasedClass (DemDebounceCounterBased): DemDebounceCounterBasedClassRef=DemDebounceCounterBasedClass_LostCom
          DemRbEventClass: DemRbEventBufferTime=0, DemRbEventRecoverableInSameOperationCycle=true, DemRbEventStatusBitStorageTestFailed=true
          DemIndicatorAttribute:
            DemIndicatorFailureCycleCounterThreshold = 2
            DemRbIndicatorApiControl = false
            DemIndicatorBehaviour = DEM_INDICATOR_BLINK_CONT
            DemIndicatorHealingCycleCounterThreshold = 3
            DemIndicatorRef = MIL
        DemEventParameter_ECU3_DTC80: DemDTCRef=DemDTC_ECU3_DTC80, DemComponentClassRef=DemComponent_ECU3_DTC80
          DemDebounceAlgorithmClass
            DemDebounceCounterBasedClass (DemDebounceCounterBased): DemDebounceCounterBasedClassRef=DemDebounceCounterBasedClass_LostCom
          DemRbEventClass: DemRbEventBufferTime=0, DemRbEventRecoverableInSameOperationCycle=true, DemRbEventStatusBitStorageTestFailed=true
          DemIndicatorAttribute:
            DemIndicatorFailureCycleCounterThreshold = 2
            DemRbIndicatorApiControl = false
            DemIndicatorBehaviour = DEM_INDICATOR_BLINK_CONT
            DemIndicatorHealingCycleCounterThreshold = 3
            DemIndicatorRef = MIL
        DemEventParameter_ECU3_DTC81: DemDTCRef=DemDTC_ECU3_DTC81, DemComponentClassRef=DemComponent_ECU3_DTC81
          DemDebounceAlgorithmClass
            DemDebounceCounterBasedClass (DemDebounceCounterBased): DemDebounceCounterBasedClassRef=DemDebounceCounterBasedClass_LostCom
          DemRbEventClass: DemRbEventBufferTime=0, DemRbEventRecoverableInSameOperationCycle=true, DemRbEventStatusBitStorageTestFailed=true
          DemIndicatorAttribute:
            DemIndicatorFailureCycleCounterThreshold = 2
            DemRbIndicatorApiControl = false
            DemIndicatorBehaviour = DEM_INDICATOR_BLINK_CONT
            DemIndicatorHealingCycleCounterThreshold = 3
            DemIndicatorRef = MIL
        DemEventParameter_ECU3_DTC82: DemDTCRef=DemDTC_ECU3_DTC82, DemComponentClassRef=DemComponent_ECU3_DTC82
          DemDebounceAlgorithmClass
            DemDebounceCounterBasedClass (DemDebounceCounterBased): DemDebounceCounterBasedClassRef=DemDebounceCounterBasedClass_LostCom
          DemRbEventClass: DemRbEventBufferTime=0, DemRbEventRecoverableInSameOperationCycle=true, DemRbEventStatusBitStorageTestFailed=true
          DemIndicatorAttribute:
            DemIndicatorFailureCycleCounterThreshold = 2
            DemRbIndicatorApiControl = false
            DemIndicatorBehaviour = DEM_INDICATOR_BLINK_CONT
            DemIndicatorHealingCycleCounterThreshold = 3
            DemIndicatorRef = MIL
        DemEventParameter_ECU3_DTC83: DemDTCRef=DemDTC_ECU3_DTC83, DemComponentClassRef=DemComponent_ECU3_DTC83
          DemDebounceAlgorithmClass
            DemDebounceCounterBasedClass (DemDebounceCounterBased): DemDebounceCounterBasedClassRef=DemDebounceCounterBasedClass_LostCom
          DemRbEventClass: DemRbEventBufferTime=0, DemRbEventRecoverableInSameOperationCycle=true, DemRbEventStatusBitStorageTestFailed=true
          DemIndicatorAttribute:
            DemIndicatorFailureCycleCounterThreshold = 2
            DemRbIndicatorApiControl = false
            DemIndicatorBehaviour = DEM_INDICATOR_CONTINUOUS
            DemIndicatorHealingCycleCounterThreshold = 3
            DemIndicatorRef = MIL
        DemEventParameter_ECU3_DTC84: DemDTCRef=DemDTC_ECU3_DTC84, DemComponentClassRef=DemComponent_ECU3_DTC84
          DemDebounceAlgorithmClass
            DemDebounceCounterBasedClass (DemDebounceCounterBased): DemDebounceCounterBasedClassRef=DemDebounceCounterBasedClass_LostCom
          DemRbEventClass: DemRbEventBufferTime=0, DemRbEventRecoverableInSameOperationCycle=true, DemRbEventStatusBitStorageTestFailed=true
          DemIndicatorAttribute:
            DemIndicatorFailureCycleCounterThreshold = 2
            DemRbIndicatorApiControl = false
            DemIndicatorBehaviour = DEM_INDICATOR_CONTINUOUS
            DemIndicatorHealingCycleCounterThreshold = 3
            DemIndicatorRef = MIL
        DemEventParameter_ECU3_DTC85: DemDTCRef=DemDTC_ECU3_DTC85, DemComponentClassRef=DemComponent_ECU3_DTC85
          DemDebounceAlgorithmClass
            DemDebounceCounterBasedClass (DemDebounceCounterBased): DemDebounceCounterBasedClassRef=DemDebounceCounterBasedClass_LostCom
          DemRbEventClass: DemRbEventBufferTime=0, DemRbEventRecoverableInSameOperationCycle=true, DemRbEventStatusBitStorageTestFailed=true
          DemIndicatorAttribute:
            DemIndicatorFailureCycleCounterThreshold = 2
            DemRbIndicatorApiControl = false
            DemIndicatorBehaviour = DEM_INDICATOR_CONTINUOUS
            DemIndicatorHealingCycleCounterThreshold = 3
            DemIndicatorRef = MIL
        DemEventParameter_ECU3_DTC86: DemDTCRef=DemDTC_ECU3_DTC86, DemComponentClassRef=DemComponent_ECU3_DTC86
          DemDebounceAlgorithmClass
            DemDebounceCounterBasedClass (DemDebounceCounterBased): DemDebounceCounterBasedClassRef=DemDebounceCounterBasedClass_LostCom
          DemRbEventClass: DemRbEventBufferTime=0, DemRbEventRecoverableInSameOperationCycle=true, DemRbEventStatusBitStorageTestFailed=true
          DemIndicatorAttribute:
            DemIndicatorFailureCycleCounterThreshold = 2
            DemRbIndicatorApiControl = false
            DemIndicatorBehaviour = DEM_INDICATOR_CONTINUOUS
            DemIndicatorHealingCycleCounterThreshold = 3
            DemIndicatorRef = MIL
        DemEventParameter_ECU3_DTC87: DemDTCRef=DemDTC_ECU3_DTC87, DemComponentClassRef=DemComponent_ECU3_DTC87
          DemDebounceAlgorithmClass
            DemDebounceCounterBasedClass (DemDebounceCounterBased): DemDebounceCounterBasedClassRef=DemDebounceCounterBasedClass_LostCom
          DemRbEventClass: DemRbEventBufferTime=0, DemRbEventRecoverableInSameOperationCycle=true, DemRbEventStatusBitStorageTestFailed=true
          DemIndicatorAttribute:
            DemIndicatorFailureCycleCounterThreshold = 2
            DemRbIndicatorApiControl = false
            DemIndicatorBehaviour = DEM_INDICATOR_CONTINUOUS
            DemIndicatorHealingCycleCounterThreshold = 3
            DemIndicatorRef = MIL
        DemEventParameter_ECU3_DTC88: DemDTCRef=DemDTC_ECU3_DTC88, DemComponentClassRef=DemComponent_ECU3_DTC88
          DemDebounceAlgorithmClass
            DemDebounceCounterBasedClass (DemDebounceCounterBased): DemDebounceCounterBasedClassRef=DemDebounceCounterBasedClass_LostCom
          DemRbEventClass: DemRbEventBufferTime=0, DemRbEventRecoverableInSameOperationCycle=true, DemRbEventStatusBitStorageTestFailed=true
        DemEventParameter_ECU3_DTC89: DemDTCRef=DemDTC_ECU3_DTC89, DemComponentClassRef=DemComponent_ECU3_DTC89
          DemDebounceAlgorithmClass
            DemDebounceCounterBasedClass (DemDebounceCounterBased): DemDebounceCounterBasedClassRef=DemDebounceCounterBasedClass_LostCom
          DemRbEventClass: DemRbEventBufferTime=0, DemRbEventRecoverableInSameOperationCycle=true, DemRbEventStatusBitStorageTestFailed=true
        DemEventParameter_ECU3_DTC90: DemDTCRef=DemDTC_ECU3_DTC90, DemComponentClassRef=DemComponent_ECU3_DTC90
          DemDebounceAlgorithmClass
            DemDebounceCounterBasedClass (DemDebounceCounterBased): DemDebounceCounterBasedClassRef=DemDebounceCounterBasedClass_LostCom
          DemRbEventClass: DemRbEventBufferTime=0, DemRbEventRecoverableInSameOperationCycle=true, DemRbEventStatusBitStorageTestFailed=true
        DemEventParameter_ECU3_DTC91: DemComponentClassRef=DemComponent_ECU3_DTC91, DemDTCRef=DemDTC_ECU3_DTC91
          DemEventClassRB (DemRbEventClass): DemRbEventBufferTime=0
          DemDebounceAlgorithmClass
            DemDebounceCounterBasedClass (DemDebounceCounterBased): DemDebounceCounterBasedClassRef=DemDebounceCounterBasedClass_LostCom
        DemEventParameter_ECU3_DTC92: DemComponentClassRef=DemComponent_ECU3_DTC92, DemDTCRef=DemDTC_ECU3_DTC92
          DemEventClassRB (DemRbEventClass): DemRbEventBufferTime=0
          DemDebounceAlgorithmClass
            DemDebounceCounterBasedClass (DemDebounceCounterBased): DemDebounceCounterBasedClassRef=DemDebounceCounterBasedClass_LostCom
        DemEventParameter_ECU3_DTC93: DemComponentClassRef=DemComponent_ECU3_DTC93, DemDTCRef=DemDTC_ECU3_DTC93
          DemEventClassRB (DemRbEventClass): DemRbEventBufferTime=0
          DemDebounceAlgorithmClass
            DemDebounceCounterBasedClass (DemDebounceCounterBased): DemDebounceCounterBasedClassRef=DemDebounceCounterBasedClass_LostCom
        DemEventParameter_ECU3_DTC94: DemComponentClassRef=DemComponent_ECU3_DTC94, DemDTCRef=DemDTC_ECU3_DTC94
          DemEventClassRB (DemRbEventClass): DemRbEventBufferTime=0
          DemDebounceAlgorithmClass
            DemDebounceCounterBasedClass (DemDebounceCounterBased): DemDebounceCounterBasedClassRef=DemDebounceCounterBasedClass_LostCom
        DemEventParameter_ECU3_DTC95: DemDTCRef=DemDTC_ECU3_DTC95, DemComponentClassRef=DemComponent_ECU3_DTC95
          DemDebounceAlgorithmClass
            DemDebounceCounterBasedClass (DemDebounceCounterBased): DemDebounceCounterBasedClassRef=DemDebounceCounterBasedClass_LostCom
          DemRbEventClass: DemRbEventBufferTime=0, DemRbEventRecoverableInSameOperationCycle=true, DemRbEventStatusBitStorageTestFailed=true
        DemEventParameter_ECU3_DTC96: DemComponentClassRef=DemComponent_ECU3_DTC96, DemDTCRef=DemDTC_ECU3_DTC96
          DemEventClassRB (DemRbEventClass): DemRbEventBufferTime=0
          DemDebounceAlgorithmClass
            DemDebounceCounterBasedClass (DemDebounceCounterBased): DemDebounceCounterBasedClassRef=DemDebounceCounterBasedClass_LostCom
          DemIndicatorAttribute:
            DemIndicatorFailureCycleCounterThreshold = 2
            DemRbIndicatorApiControl = false
            DemIndicatorBehaviour = DEM_INDICATOR_CONTINUOUS
            DemIndicatorHealingCycleCounterThreshold = 3
            DemIndicatorRef = MIL
        DemEventParameter_ECU3_DTC97: DemDTCRef=DemDTC_ECU3_DTC97, DemComponentClassRef=DemComponent_ECU3_DTC97
          DemDebounceAlgorithmClass
            DemDebounceCounterBasedClass (DemDebounceCounterBased): DemDebounceCounterBasedClassRef=DemDebounceCounterBasedClass_LostCom
          DemRbEventClass: DemRbEventBufferTime=0, DemRbEventRecoverableInSameOperationCycle=true, DemRbEventStatusBitStorageTestFailed=true
          DemIndicatorAttribute:
            DemIndicatorFailureCycleCounterThreshold = 2
            DemRbIndicatorApiControl = false
            DemIndicatorBehaviour = DEM_INDICATOR_BLINK_CONT
            DemIndicatorHealingCycleCounterThreshold = 3
            DemIndicatorRef = MIL
        DemEventParameter_ECU3_DTC98: DemDTCRef=DemDTC_ECU3_DTC98, DemComponentClassRef=DemComponent_ECU3_DTC98
          DemDebounceAlgorithmClass
            DemDebounceCounterBasedClass (DemDebounceCounterBased): DemDebounceCounterBasedClassRef=DemDebounceCounterBasedClass_LostCom
          DemRbEventClass: DemRbEventBufferTime=0, DemRbEventRecoverableInSameOperationCycle=true, DemRbEventStatusBitStorageTestFailed=true
          DemIndicatorAttribute:
            DemIndicatorFailureCycleCounterThreshold = 2
            DemRbIndicatorApiControl = false
            DemIndicatorBehaviour = DEM_INDICATOR_CONTINUOUS
            DemIndicatorHealingCycleCounterThreshold = 3
            DemIndicatorRef = MIL
        DemEventParameter_ECU3_DTC99: DemComponentClassRef=DemComponent_ECU3_DTC99, DemDTCRef=DemDTC_ECU3_DTC99
          DemDebounceAlgorithmClass
            DemDebounceCounterBasedClass (DemDebounceCounterBased): DemDebounceCounterBasedClassRef=DemDebounceCounterBasedClass_LostCom
          DemIndicatorAttribute:
            DemIndicatorFailureCycleCounterThreshold = 2
            DemRbIndicatorApiControl = 0
            DemIndicatorHealingCycleCounterThreshold = 3
            DemIndicatorBehaviour = DEM_INDICATOR_CONTINUOUS
            DemIndicatorRef = MIL
          DemRbEventClass: DemRbEventBufferTime=0, DemRbEventRecoverableInSameOperationCycle=1, DemRbEventStatusBitStorageTestFailed=true
        DemEventParameter_ECU4_DTC00: DemDTCRef=DemDTC_ECU4_DTC00, DemComponentClassRef=DemComponent_ECU4_DTC00
          DemDebounceAlgorithmClass
            DemDebounceCounterBasedClass (DemDebounceCounterBased): DemDebounceCounterBasedClassRef=DemDebounceCounterBasedClass_LostCom
          DemRbEventClass: DemRbEventBufferTime=0, DemRbEventRecoverableInSameOperationCycle=true, DemRbEventStatusBitStorageTestFailed=true
        DemEventParameter_ECU4_DTC01: DemDTCRef=DemDTC_ECU4_DTC01, DemComponentClassRef=DemComponent_ECU4_DTC01
          DemDebounceAlgorithmClass
            DemDebounceCounterBasedClass (DemDebounceCounterBased): DemDebounceCounterBasedClassRef=DemDebounceCounterBasedClass_LostCom
          DemRbEventClass: DemRbEventBufferTime=0, DemRbEventRecoverableInSameOperationCycle=true, DemRbEventStatusBitStorageTestFailed=true
          DemIndicatorAttribute:
            DemIndicatorFailureCycleCounterThreshold = 2
            DemRbIndicatorApiControl = false
            DemIndicatorBehaviour = DEM_INDICATOR_CONTINUOUS
            DemIndicatorHealingCycleCounterThreshold = 3
            DemIndicatorRef = MIL
        DemEventParameter_ECU4_DTC02: DemDTCRef=DemDTC_ECU4_DTC02, DemComponentClassRef=DemComponent_ECU4_DTC02
          DemDebounceAlgorithmClass
            DemDebounceCounterBasedClass (DemDebounceCounterBased): DemDebounceCounterBasedClassRef=DemDebounceCounterBasedClass_LostCom
          DemRbEventClass: DemRbEventBufferTime=0, DemRbEventRecoverableInSameOperationCycle=true, DemRbEventStatusBitStorageTestFailed=true
          DemIndicatorAttribute:
            DemIndicatorFailureCycleCounterThreshold = 2
            DemRbIndicatorApiControl = false
            DemIndicatorBehaviour = DEM_INDICATOR_CONTINUOUS
            DemIndicatorHealingCycleCounterThreshold = 3
            DemIndicatorRef = MIL
        DemEventParameter_ECU4_DTC03: DemDTCRef=DemDTC_ECU4_DTC03, DemComponentClassRef=DemComponent_ECU4_DTC03
          DemDebounceAlgorithmClass
            DemDebounceCounterBasedClass (DemDebounceCounterBased): DemDebounceCounterBasedClassRef=DemDebounceCounterBasedClass_LostCom
          DemRbEventClass: DemRbEventBufferTime=0, DemRbEventRecoverableInSameOperationCycle=true, DemRbEventStatusBitStorageTestFailed=true
        DemEventParameter_ECU4_DTC04: DemDTCRef=DemDTC_ECU4_DTC04, DemComponentClassRef=DemComponent_ECU4_DTC04
          DemDebounceAlgorithmClass
            DemDebounceCounterBasedClass (DemDebounceCounterBased): DemDebounceCounterBasedClassRef=DemDebounceCounterBasedClass_LostCom
          DemRbEventClass: DemRbEventBufferTime=0, DemRbEventRecoverableInSameOperationCycle=true, DemRbEventStatusBitStorageTestFailed=true
        DemEventParameter_ECU4_DTC05: DemDTCRef=DemDTC_ECU4_DTC05, DemComponentClassRef=DemComponent_ECU4_DTC05
          DemDebounceAlgorithmClass
            DemDebounceCounterBasedClass (DemDebounceCounterBased): DemDebounceCounterBasedClassRef=DemDebounceCounterBasedClass_LostCom
          DemRbEventClass: DemRbEventBufferTime=0, DemRbEventRecoverableInSameOperationCycle=true, DemRbEventStatusBitStorageTestFailed=true
          DemIndicatorAttribute:
            DemIndicatorFailureCycleCounterThreshold = 2
            DemRbIndicatorApiControl = false
            DemIndicatorBehaviour = DEM_INDICATOR_CONTINUOUS
            DemIndicatorHealingCycleCounterThreshold = 3
            DemIndicatorRef = MIL
        DemEventParameter_ECU4_DTC06: DemDTCRef=DemDTC_ECU4_DTC06, DemComponentClassRef=DemComponent_ECU4_DTC06
          DemDebounceAlgorithmClass
            DemDebounceCounterBasedClass (DemDebounceCounterBased): DemDebounceCounterBasedClassRef=DemDebounceCounterBasedClass_LostCom
          DemRbEventClass: DemRbEventBufferTime=0, DemRbEventRecoverableInSameOperationCycle=true, DemRbEventStatusBitStorageTestFailed=true
          DemIndicatorAttribute:
            DemIndicatorFailureCycleCounterThreshold = 2
            DemRbIndicatorApiControl = false
            DemIndicatorBehaviour = DEM_INDICATOR_CONTINUOUS
            DemIndicatorHealingCycleCounterThreshold = 3
            DemIndicatorRef = MIL
        DemEventParameter_ECU4_DTC07: DemDTCRef=DemDTC_ECU4_DTC07, DemComponentClassRef=DemComponent_ECU4_DTC07
          DemDebounceAlgorithmClass
            DemDebounceCounterBasedClass (DemDebounceCounterBased): DemDebounceCounterBasedClassRef=DemDebounceCounterBasedClass_LostCom
          DemRbEventClass: DemRbEventBufferTime=0, DemRbEventRecoverableInSameOperationCycle=true, DemRbEventStatusBitStorageTestFailed=true
        DemEventParameter_ECU4_DTC08: DemDTCRef=DemDTC_ECU4_DTC08, DemComponentClassRef=DemComponent_ECU4_DTC08
          DemDebounceAlgorithmClass
            DemDebounceCounterBasedClass (DemDebounceCounterBased): DemDebounceCounterBasedClassRef=DemDebounceCounterBasedClass_LostCom
          DemRbEventClass: DemRbEventBufferTime=0, DemRbEventRecoverableInSameOperationCycle=true, DemRbEventStatusBitStorageTestFailed=true
          DemIndicatorAttribute:
            DemIndicatorFailureCycleCounterThreshold = 2
            DemRbIndicatorApiControl = false
            DemIndicatorBehaviour = DEM_INDICATOR_BLINK_CONT
            DemIndicatorHealingCycleCounterThreshold = 3
            DemIndicatorRef = MIL
        DemEventParameter_ECU4_DTC09: DemDTCRef=DemDTC_ECU4_DTC09, DemComponentClassRef=DemComponent_ECU4_DTC09
          DemDebounceAlgorithmClass
            DemDebounceCounterBasedClass (DemDebounceCounterBased): DemDebounceCounterBasedClassRef=DemDebounceCounterBasedClass_LostCom
          DemRbEventClass: DemRbEventBufferTime=0, DemRbEventRecoverableInSameOperationCycle=true, DemRbEventStatusBitStorageTestFailed=true
        DemEventParameter_ECU4_DTC10: DemDTCRef=DemDTC_ECU4_DTC10, DemComponentClassRef=DemComponent_ECU4_DTC10
          DemDebounceAlgorithmClass
            DemDebounceCounterBasedClass (DemDebounceCounterBased): DemDebounceCounterBasedClassRef=DemDebounceCounterBasedClass_LostCom
          DemRbEventClass: DemRbEventBufferTime=0, DemRbEventRecoverableInSameOperationCycle=true, DemRbEventStatusBitStorageTestFailed=true
          DemIndicatorAttribute:
            DemIndicatorFailureCycleCounterThreshold = 2
            DemRbIndicatorApiControl = false
            DemIndicatorBehaviour = DEM_INDICATOR_CONTINUOUS
            DemIndicatorHealingCycleCounterThreshold = 3
            DemIndicatorRef = MIL
        DemEventParameter_ECU4_DTC11: DemDTCRef=DemDTC_ECU4_DTC11, DemComponentClassRef=DemComponent_ECU4_DTC11
          DemDebounceAlgorithmClass
            DemDebounceCounterBasedClass (DemDebounceCounterBased): DemDebounceCounterBasedClassRef=DemDebounceCounterBasedClass_LostCom
          DemRbEventClass: DemRbEventBufferTime=0, DemRbEventRecoverableInSameOperationCycle=true, DemRbEventStatusBitStorageTestFailed=true
          DemIndicatorAttribute:
            DemIndicatorFailureCycleCounterThreshold = 2
            DemRbIndicatorApiControl = false
            DemIndicatorBehaviour = DEM_INDICATOR_CONTINUOUS
            DemIndicatorHealingCycleCounterThreshold = 3
            DemIndicatorRef = MIL
        DemEventParameter_ECU4_DTC12: DemDTCRef=DemDTC_ECU4_DTC12, DemComponentClassRef=DemComponent_ECU4_DTC12
          DemDebounceAlgorithmClass
            DemDebounceCounterBasedClass (DemDebounceCounterBased): DemDebounceCounterBasedClassRef=DemDebounceCounterBasedClass_LostCom
          DemRbEventClass: DemRbEventBufferTime=0, DemRbEventRecoverableInSameOperationCycle=true, DemRbEventStatusBitStorageTestFailed=true
          DemIndicatorAttribute:
            DemIndicatorFailureCycleCounterThreshold = 2
            DemRbIndicatorApiControl = false
            DemIndicatorBehaviour = DEM_INDICATOR_BLINK_CONT
            DemIndicatorHealingCycleCounterThreshold = 3
            DemIndicatorRef = MIL
        DemEventParameter_ECU4_DTC13: DemDTCRef=DemDTC_ECU4_DTC13, DemComponentClassRef=DemComponent_ECU4_DTC13
          DemDebounceAlgorithmClass
            DemDebounceCounterBasedClass (DemDebounceCounterBased): DemDebounceCounterBasedClassRef=DemDebounceCounterBasedClass_LostCom
          DemRbEventClass: DemRbEventBufferTime=0, DemRbEventRecoverableInSameOperationCycle=true, DemRbEventStatusBitStorageTestFailed=true
          DemIndicatorAttribute:
            DemIndicatorFailureCycleCounterThreshold = 2
            DemRbIndicatorApiControl = false
            DemIndicatorBehaviour = DEM_INDICATOR_BLINK_CONT
            DemIndicatorHealingCycleCounterThreshold = 3
            DemIndicatorRef = MIL
        DemEventParameter_ECU4_DTC14: DemDTCRef=DemDTC_ECU4_DTC14, DemComponentClassRef=DemComponent_ECU4_DTC14
          DemDebounceAlgorithmClass
            DemDebounceCounterBasedClass (DemDebounceCounterBased): DemDebounceCounterBasedClassRef=DemDebounceCounterBasedClass_LostCom
          DemRbEventClass: DemRbEventBufferTime=0, DemRbEventRecoverableInSameOperationCycle=true, DemRbEventStatusBitStorageTestFailed=true
        DemEventParameter_ECU4_DTC15: DemDTCRef=DemDTC_ECU4_DTC15, DemComponentClassRef=DemComponent_ECU4_DTC15
          DemDebounceAlgorithmClass
            DemDebounceCounterBasedClass (DemDebounceCounterBased): DemDebounceCounterBasedClassRef=DemDebounceCounterBasedClass_LostCom
          DemRbEventClass: DemRbEventBufferTime=0, DemRbEventRecoverableInSameOperationCycle=true, DemRbEventStatusBitStorageTestFailed=true
        DemEventParameter_ECU4_DTC16: DemDTCRef=DemDTC_ECU4_DTC16, DemComponentClassRef=DemComponent_ECU4_DTC16
          DemDebounceAlgorithmClass
            DemDebounceCounterBasedClass (DemDebounceCounterBased): DemDebounceCounterBasedClassRef=DemDebounceCounterBasedClass_LostCom
          DemRbEventClass: DemRbEventBufferTime=0, DemRbEventRecoverableInSameOperationCycle=true, DemRbEventStatusBitStorageTestFailed=true
          DemIndicatorAttribute:
            DemIndicatorFailureCycleCounterThreshold = 2
            DemRbIndicatorApiControl = false
            DemIndicatorBehaviour = DEM_INDICATOR_CONTINUOUS
            DemIndicatorHealingCycleCounterThreshold = 3
            DemIndicatorRef = MIL
        DemEventParameter_ECU4_DTC17: DemDTCRef=DemDTC_ECU4_DTC17, DemComponentClassRef=DemComponent_ECU4_DTC17
          DemDebounceAlgorithmClass
            DemDebounceCounterBasedClass (DemDebounceCounterBased): DemDebounceCounterBasedClassRef=DemDebounceCounterBasedClass_LostCom
          DemRbEventClass: DemRbEventBufferTime=0, DemRbEventRecoverableInSameOperationCycle=true, DemRbEventStatusBitStorageTestFailed=true
          DemIndicatorAttribute:
            DemIndicatorFailureCycleCounterThreshold = 2
            DemRbIndicatorApiControl = false
            DemIndicatorBehaviour = DEM_INDICATOR_CONTINUOUS
            DemIndicatorHealingCycleCounterThreshold = 3
            DemIndicatorRef = MIL
        DemEventParameter_ECU4_DTC18: DemDTCRef=DemDTC_ECU4_DTC18, DemComponentClassRef=DemComponent_ECU4_DTC18
          DemDebounceAlgorithmClass
            DemDebounceCounterBasedClass (DemDebounceCounterBased): DemDebounceCounterBasedClassRef=DemDebounceCounterBasedClass_LostCom
          DemRbEventClass: DemRbEventBufferTime=0, DemRbEventRecoverableInSameOperationCycle=true, DemRbEventStatusBitStorageTestFailed=true
          DemIndicatorAttribute:
            DemIndicatorFailureCycleCounterThreshold = 2
            DemRbIndicatorApiControl = false
            DemIndicatorBehaviour = DEM_INDICATOR_CONTINUOUS
            DemIndicatorHealingCycleCounterThreshold = 3
            DemIndicatorRef = MIL
        DemEventParameter_ECU4_DTC19: DemDTCRef=DemDTC_ECU4_DTC19, DemComponentClassRef=DemComponent_ECU4_DTC19
          DemDebounceAlgorithmClass
            DemDebounceCounterBasedClass (DemDebounceCounterBased): DemDebounceCounterBasedClassRef=DemDebounceCounterBasedClass_LostCom
          DemRbEventClass: DemRbEventBufferTime=0, DemRbEventRecoverableInSameOperationCycle=true, DemRbEventStatusBitStorageTestFailed=true
          DemIndicatorAttribute:
            DemIndicatorFailureCycleCounterThreshold = 2
            DemRbIndicatorApiControl = false
            DemIndicatorBehaviour = DEM_INDICATOR_CONTINUOUS
            DemIndicatorHealingCycleCounterThreshold = 3
            DemIndicatorRef = MIL
        DemEventParameter_ECU4_DTC20: DemDTCRef=DemDTC_ECU4_DTC20, DemComponentClassRef=DemComponent_ECU4_DTC20
          DemDebounceAlgorithmClass
            DemDebounceCounterBasedClass (DemDebounceCounterBased): DemDebounceCounterBasedClassRef=DemDebounceCounterBasedClass_LostCom
          DemRbEventClass: DemRbEventBufferTime=0, DemRbEventRecoverableInSameOperationCycle=true, DemRbEventStatusBitStorageTestFailed=true
          DemIndicatorAttribute:
            DemIndicatorFailureCycleCounterThreshold = 2
            DemRbIndicatorApiControl = false
            DemIndicatorBehaviour = DEM_INDICATOR_CONTINUOUS
            DemIndicatorHealingCycleCounterThreshold = 3
            DemIndicatorRef = MIL
        DemEventParameter_ECU4_DTC21: DemDTCRef=DemDTC_ECU4_DTC21, DemComponentClassRef=DemComponent_ECU4_DTC21
          DemDebounceAlgorithmClass
            DemDebounceCounterBasedClass (DemDebounceCounterBased): DemDebounceCounterBasedClassRef=DemDebounceCounterBasedClass_LostCom
          DemRbEventClass: DemRbEventBufferTime=0, DemRbEventRecoverableInSameOperationCycle=true, DemRbEventStatusBitStorageTestFailed=true
          DemIndicatorAttribute:
            DemIndicatorFailureCycleCounterThreshold = 2
            DemRbIndicatorApiControl = false
            DemIndicatorBehaviour = DEM_INDICATOR_CONTINUOUS
            DemIndicatorHealingCycleCounterThreshold = 3
            DemIndicatorRef = MIL
        DemEventParameter_ECU4_DTC22: DemDTCRef=DemDTC_ECU4_DTC22, DemComponentClassRef=DemComponent_ECU4_DTC22
          DemDebounceAlgorithmClass
            DemDebounceCounterBasedClass (DemDebounceCounterBased): DemDebounceCounterBasedClassRef=DemDebounceCounterBasedClass_LostCom
          DemRbEventClass: DemRbEventBufferTime=0, DemRbEventRecoverableInSameOperationCycle=true, DemRbEventStatusBitStorageTestFailed=true
          DemIndicatorAttribute:
            DemIndicatorFailureCycleCounterThreshold = 2
            DemRbIndicatorApiControl = false
            DemIndicatorBehaviour = DEM_INDICATOR_CONTINUOUS
            DemIndicatorHealingCycleCounterThreshold = 3
            DemIndicatorRef = MIL
        DemEventParameter_ECU4_DTC23: DemDTCRef=DemDTC_ECU4_DTC23, DemComponentClassRef=DemComponent_ECU4_DTC23
          DemDebounceAlgorithmClass
            DemDebounceCounterBasedClass (DemDebounceCounterBased): DemDebounceCounterBasedClassRef=DemDebounceCounterBasedClass_LostCom
          DemRbEventClass: DemRbEventBufferTime=0, DemRbEventRecoverableInSameOperationCycle=true, DemRbEventStatusBitStorageTestFailed=true
          DemIndicatorAttribute:
            DemIndicatorFailureCycleCounterThreshold = 2
            DemRbIndicatorApiControl = false
            DemIndicatorBehaviour = DEM_INDICATOR_CONTINUOUS
            DemIndicatorHealingCycleCounterThreshold = 3
            DemIndicatorRef = MIL
        DemEventParameter_ECU4_DTC24: DemDTCRef=DemDTC_ECU4_DTC24, DemComponentClassRef=DemComponent_ECU4_DTC24
          DemDebounceAlgorithmClass
            DemDebounceCounterBasedClass (DemDebounceCounterBased): DemDebounceCounterBasedClassRef=DemDebounceCounterBasedClass_LostCom
          DemRbEventClass: DemRbEventBufferTime=0, DemRbEventRecoverableInSameOperationCycle=true, DemRbEventStatusBitStorageTestFailed=true
          DemIndicatorAttribute:
            DemIndicatorFailureCycleCounterThreshold = 2
            DemRbIndicatorApiControl = false
            DemIndicatorBehaviour = DEM_INDICATOR_CONTINUOUS
            DemIndicatorHealingCycleCounterThreshold = 3
            DemIndicatorRef = MIL
        DemEventParameter_ECU4_DTC25: DemDTCRef=DemDTC_ECU4_DTC25, DemComponentClassRef=DemComponent_ECU4_DTC25
          DemDebounceAlgorithmClass
            DemDebounceCounterBasedClass (DemDebounceCounterBased): DemDebounceCounterBasedClassRef=DemDebounceCounterBasedClass_LostCom
          DemRbEventClass: DemRbEventBufferTime=0, DemRbEventRecoverableInSameOperationCycle=true, DemRbEventStatusBitStorageTestFailed=true
        DemEventParameter_ECU4_DTC26: DemDTCRef=DemDTC_ECU4_DTC26, DemComponentClassRef=DemComponent_ECU4_DTC26
          DemDebounceAlgorithmClass
            DemDebounceCounterBasedClass (DemDebounceCounterBased): DemDebounceCounterBasedClassRef=DemDebounceCounterBasedClass_LostCom
          DemRbEventClass: DemRbEventBufferTime=0, DemRbEventRecoverableInSameOperationCycle=true, DemRbEventStatusBitStorageTestFailed=true
          DemIndicatorAttribute:
            DemIndicatorFailureCycleCounterThreshold = 2
            DemRbIndicatorApiControl = false
            DemIndicatorBehaviour = DEM_INDICATOR_CONTINUOUS
            DemIndicatorHealingCycleCounterThreshold = 3
            DemIndicatorRef = MIL
        DemEventParameter_ECU4_DTC27: DemDTCRef=DemDTC_ECU4_DTC27, DemComponentClassRef=DemComponent_ECU4_DTC27
          DemDebounceAlgorithmClass
            DemDebounceCounterBasedClass (DemDebounceCounterBased): DemDebounceCounterBasedClassRef=DemDebounceCounterBasedClass_LostCom
          DemRbEventClass: DemRbEventBufferTime=0, DemRbEventRecoverableInSameOperationCycle=true, DemRbEventStatusBitStorageTestFailed=true
          DemIndicatorAttribute:
            DemIndicatorFailureCycleCounterThreshold = 2
            DemRbIndicatorApiControl = false
            DemIndicatorBehaviour = DEM_INDICATOR_CONTINUOUS
            DemIndicatorHealingCycleCounterThreshold = 3
            DemIndicatorRef = MIL
        DemEventParameter_ECU4_DTC28: DemDTCRef=DemDTC_ECU4_DTC28, DemComponentClassRef=DemComponent_ECU4_DTC28
          DemDebounceAlgorithmClass
            DemDebounceCounterBasedClass (DemDebounceCounterBased): DemDebounceCounterBasedClassRef=DemDebounceCounterBasedClass_LostCom
          DemRbEventClass: DemRbEventBufferTime=0, DemRbEventRecoverableInSameOperationCycle=true, DemRbEventStatusBitStorageTestFailed=true
        DemEventParameter_ECU4_DTC29: DemDTCRef=DemDTC_ECU4_DTC29, DemComponentClassRef=DemComponent_ECU4_DTC29
          DemDebounceAlgorithmClass
            DemDebounceCounterBasedClass (DemDebounceCounterBased): DemDebounceCounterBasedClassRef=DemDebounceCounterBasedClass_LostCom
          DemRbEventClass: DemRbEventBufferTime=0, DemRbEventRecoverableInSameOperationCycle=true, DemRbEventStatusBitStorageTestFailed=true
        DemEventParameter_ECU4_DTC30: DemDTCRef=DemDTC_ECU4_DTC30, DemComponentClassRef=DemComponent_ECU4_DTC30
          DemDebounceAlgorithmClass
            DemDebounceCounterBasedClass (DemDebounceCounterBased): DemDebounceCounterBasedClassRef=DemDebounceCounterBasedClass_LostCom
          DemRbEventClass: DemRbEventBufferTime=0, DemRbEventRecoverableInSameOperationCycle=true, DemRbEventStatusBitStorageTestFailed=true
          DemIndicatorAttribute:
            DemIndicatorFailureCycleCounterThreshold = 2
            DemRbIndicatorApiControl = false
            DemIndicatorBehaviour = DEM_INDICATOR_CONTINUOUS
            DemIndicatorHealingCycleCounterThreshold = 3
            DemIndicatorRef = MIL
        DemEventParameter_ECU4_DTC31: DemDTCRef=DemDTC_ECU4_DTC31, DemComponentClassRef=DemComponent_ECU4_DTC31
          DemDebounceAlgorithmClass
            DemDebounceCounterBasedClass (DemDebounceCounterBased): DemDebounceCounterBasedClassRef=DemDebounceCounterBasedClass_LostCom
          DemRbEventClass: DemRbEventBufferTime=0, DemRbEventRecoverableInSameOperationCycle=true, DemRbEventStatusBitStorageTestFailed=true
          DemIndicatorAttribute:
            DemIndicatorFailureCycleCounterThreshold = 2
            DemRbIndicatorApiControl = false
            DemIndicatorBehaviour = DEM_INDICATOR_CONTINUOUS
            DemIndicatorHealingCycleCounterThreshold = 3
            DemIndicatorRef = MIL
        DemEventParameter_ECU4_DTC32: DemDTCRef=DemDTC_ECU4_DTC32, DemComponentClassRef=DemComponent_ECU4_DTC32
          DemDebounceAlgorithmClass
            DemDebounceCounterBasedClass (DemDebounceCounterBased): DemDebounceCounterBasedClassRef=DemDebounceCounterBasedClass_LostCom
          DemRbEventClass: DemRbEventBufferTime=0, DemRbEventRecoverableInSameOperationCycle=true, DemRbEventStatusBitStorageTestFailed=true
        DemEventParameter_ECU4_DTC33: DemDTCRef=DemDTC_ECU4_DTC33, DemComponentClassRef=DemComponent_ECU4_DTC33
          DemDebounceAlgorithmClass
            DemDebounceCounterBasedClass (DemDebounceCounterBased): DemDebounceCounterBasedClassRef=DemDebounceCounterBasedClass_LostCom
          DemRbEventClass: DemRbEventBufferTime=0, DemRbEventRecoverableInSameOperationCycle=true, DemRbEventStatusBitStorageTestFailed=true
          DemIndicatorAttribute:
            DemIndicatorFailureCycleCounterThreshold = 2
            DemRbIndicatorApiControl = false
            DemIndicatorBehaviour = DEM_INDICATOR_BLINK_CONT
            DemIndicatorHealingCycleCounterThreshold = 3
            DemIndicatorRef = MIL
        DemEventParameter_ECU4_DTC34: DemDTCRef=DemDTC_ECU4_DTC34, DemComponentClassRef=DemComponent_ECU4_DTC34
          DemDebounceAlgorithmClass
            DemDebounceCounterBasedClass (DemDebounceCounterBased): DemDebounceCounterBasedClassRef=DemDebounceCounterBasedClass_LostCom
          DemRbEventClass: DemRbEventBufferTime=0, DemRbEventRecoverableInSameOperationCycle=true, DemRbEventStatusBitStorageTestFailed=true
        DemEventParameter_ECU4_DTC35: DemDTCRef=DemDTC_ECU4_DTC35, DemComponentClassRef=DemComponent_ECU4_DTC35
          DemDebounceAlgorithmClass
            DemDebounceCounterBasedClass (DemDebounceCounterBased): DemDebounceCounterBasedClassRef=DemDebounceCounterBasedClass_LostCom
          DemRbEventClass: DemRbEventBufferTime=0, DemRbEventRecoverableInSameOperationCycle=true, DemRbEventStatusBitStorageTestFailed=true
          DemIndicatorAttribute:
            DemIndicatorFailureCycleCounterThreshold = 2
            DemRbIndicatorApiControl = false
            DemIndicatorBehaviour = DEM_INDICATOR_CONTINUOUS
            DemIndicatorHealingCycleCounterThreshold = 3
            DemIndicatorRef = MIL
        DemEventParameter_ECU4_DTC36: DemDTCRef=DemDTC_ECU4_DTC36, DemComponentClassRef=DemComponent_ECU4_DTC36
          DemDebounceAlgorithmClass
            DemDebounceCounterBasedClass (DemDebounceCounterBased): DemDebounceCounterBasedClassRef=DemDebounceCounterBasedClass_LostCom
          DemRbEventClass: DemRbEventBufferTime=0, DemRbEventRecoverableInSameOperationCycle=true, DemRbEventStatusBitStorageTestFailed=true
          DemIndicatorAttribute:
            DemIndicatorFailureCycleCounterThreshold = 2
            DemRbIndicatorApiControl = false
            DemIndicatorBehaviour = DEM_INDICATOR_CONTINUOUS
            DemIndicatorHealingCycleCounterThreshold = 3
            DemIndicatorRef = MIL
        DemEventParameter_ECU4_DTC37: DemDTCRef=DemDTC_ECU4_DTC37, DemComponentClassRef=DemComponent_ECU4_DTC37
          DemDebounceAlgorithmClass
            DemDebounceCounterBasedClass (DemDebounceCounterBased): DemDebounceCounterBasedClassRef=DemDebounceCounterBasedClass_LostCom
          DemRbEventClass: DemRbEventBufferTime=0, DemRbEventRecoverableInSameOperationCycle=true, DemRbEventStatusBitStorageTestFailed=true
          DemIndicatorAttribute:
            DemIndicatorFailureCycleCounterThreshold = 2
            DemRbIndicatorApiControl = false
            DemIndicatorBehaviour = DEM_INDICATOR_BLINK_CONT
            DemIndicatorHealingCycleCounterThreshold = 3
            DemIndicatorRef = MIL
        DemEventParameter_ECU4_DTC38: DemDTCRef=DemDTC_ECU4_DTC38, DemComponentClassRef=DemComponent_ECU4_DTC38
          DemDebounceAlgorithmClass
            DemDebounceCounterBasedClass (DemDebounceCounterBased): DemDebounceCounterBasedClassRef=DemDebounceCounterBasedClass_LostCom
          DemRbEventClass: DemRbEventBufferTime=0, DemRbEventRecoverableInSameOperationCycle=true, DemRbEventStatusBitStorageTestFailed=true
          DemIndicatorAttribute:
            DemIndicatorFailureCycleCounterThreshold = 2
            DemRbIndicatorApiControl = false
            DemIndicatorBehaviour = DEM_INDICATOR_BLINK_CONT
            DemIndicatorHealingCycleCounterThreshold = 3
            DemIndicatorRef = MIL
        DemEventParameter_ECU4_DTC39: DemDTCRef=DemDTC_ECU4_DTC39, DemComponentClassRef=DemComponent_ECU4_DTC39
          DemDebounceAlgorithmClass
            DemDebounceCounterBasedClass (DemDebounceCounterBased): DemDebounceCounterBasedClassRef=DemDebounceCounterBasedClass_LostCom
          DemRbEventClass: DemRbEventBufferTime=0, DemRbEventRecoverableInSameOperationCycle=true, DemRbEventStatusBitStorageTestFailed=true
        DemEventParameter_ECU4_DTC40: DemDTCRef=DemDTC_ECU4_DTC40, DemComponentClassRef=DemComponent_ECU4_DTC40
          DemDebounceAlgorithmClass
            DemDebounceCounterBasedClass (DemDebounceCounterBased): DemDebounceCounterBasedClassRef=DemDebounceCounterBasedClass_LostCom
          DemRbEventClass: DemRbEventBufferTime=0, DemRbEventRecoverableInSameOperationCycle=true, DemRbEventStatusBitStorageTestFailed=true
        DemEventParameter_ECU4_DTC41: DemDTCRef=DemDTC_ECU4_DTC41, DemComponentClassRef=DemComponent_ECU4_DTC41
          DemDebounceAlgorithmClass
            DemDebounceCounterBasedClass (DemDebounceCounterBased): DemDebounceCounterBasedClassRef=DemDebounceCounterBasedClass_LostCom
          DemRbEventClass: DemRbEventBufferTime=0, DemRbEventRecoverableInSameOperationCycle=true, DemRbEventStatusBitStorageTestFailed=true
          DemIndicatorAttribute:
            DemIndicatorFailureCycleCounterThreshold = 2
            DemRbIndicatorApiControl = false
            DemIndicatorBehaviour = DEM_INDICATOR_CONTINUOUS
            DemIndicatorHealingCycleCounterThreshold = 3
            DemIndicatorRef = MIL
        DemEventParameter_ECU4_DTC42: DemDTCRef=DemDTC_ECU4_DTC42, DemComponentClassRef=DemComponent_ECU4_DTC42
          DemDebounceAlgorithmClass
            DemDebounceCounterBasedClass (DemDebounceCounterBased): DemDebounceCounterBasedClassRef=DemDebounceCounterBasedClass_LostCom
          DemRbEventClass: DemRbEventBufferTime=0, DemRbEventRecoverableInSameOperationCycle=true, DemRbEventStatusBitStorageTestFailed=true
          DemIndicatorAttribute:
            DemIndicatorFailureCycleCounterThreshold = 2
            DemRbIndicatorApiControl = false
            DemIndicatorBehaviour = DEM_INDICATOR_CONTINUOUS
            DemIndicatorHealingCycleCounterThreshold = 3
            DemIndicatorRef = MIL
        DemEventParameter_ECU4_DTC43: DemDTCRef=DemDTC_ECU4_DTC43, DemComponentClassRef=DemComponent_ECU4_DTC43
          DemDebounceAlgorithmClass
            DemDebounceCounterBasedClass (DemDebounceCounterBased): DemDebounceCounterBasedClassRef=DemDebounceCounterBasedClass_LostCom
          DemRbEventClass: DemRbEventBufferTime=0, DemRbEventRecoverableInSameOperationCycle=true, DemRbEventStatusBitStorageTestFailed=true
          DemIndicatorAttribute:
            DemIndicatorFailureCycleCounterThreshold = 2
            DemRbIndicatorApiControl = false
            DemIndicatorBehaviour = DEM_INDICATOR_CONTINUOUS
            DemIndicatorHealingCycleCounterThreshold = 3
            DemIndicatorRef = MIL
        DemEventParameter_ECU4_DTC44: DemDTCRef=DemDTC_ECU4_DTC44, DemComponentClassRef=DemComponent_ECU4_DTC44
          DemDebounceAlgorithmClass
            DemDebounceCounterBasedClass (DemDebounceCounterBased): DemDebounceCounterBasedClassRef=DemDebounceCounterBasedClass_LostCom
          DemRbEventClass: DemRbEventBufferTime=0, DemRbEventRecoverableInSameOperationCycle=true, DemRbEventStatusBitStorageTestFailed=true
          DemIndicatorAttribute:
            DemIndicatorFailureCycleCounterThreshold = 2
            DemRbIndicatorApiControl = false
            DemIndicatorBehaviour = DEM_INDICATOR_CONTINUOUS
            DemIndicatorHealingCycleCounterThreshold = 3
            DemIndicatorRef = MIL
        DemEventParameter_ECU4_DTC45: DemDTCRef=DemDTC_ECU4_DTC45, DemComponentClassRef=DemComponent_ECU4_DTC45
          DemDebounceAlgorithmClass
            DemDebounceCounterBasedClass (DemDebounceCounterBased): DemDebounceCounterBasedClassRef=DemDebounceCounterBasedClass_LostCom
          DemRbEventClass: DemRbEventBufferTime=0, DemRbEventRecoverableInSameOperationCycle=true, DemRbEventStatusBitStorageTestFailed=true
          DemIndicatorAttribute:
            DemIndicatorFailureCycleCounterThreshold = 2
            DemRbIndicatorApiControl = false
            DemIndicatorBehaviour = DEM_INDICATOR_CONTINUOUS
            DemIndicatorHealingCycleCounterThreshold = 3
            DemIndicatorRef = MIL
        DemEventParameter_ECU4_DTC46: DemDTCRef=DemDTC_ECU4_DTC46, DemComponentClassRef=DemComponent_ECU4_DTC46
          DemDebounceAlgorithmClass
            DemDebounceCounterBasedClass (DemDebounceCounterBased): DemDebounceCounterBasedClassRef=DemDebounceCounterBasedClass_LostCom
          DemRbEventClass: DemRbEventBufferTime=0, DemRbEventRecoverableInSameOperationCycle=true, DemRbEventStatusBitStorageTestFailed=true
          DemIndicatorAttribute:
            DemIndicatorFailureCycleCounterThreshold = 2
            DemRbIndicatorApiControl = false
            DemIndicatorBehaviour = DEM_INDICATOR_CONTINUOUS
            DemIndicatorHealingCycleCounterThreshold = 3
            DemIndicatorRef = MIL
        DemEventParameter_ECU4_DTC47: DemDTCRef=DemDTC_ECU4_DTC47, DemComponentClassRef=DemComponent_ECU4_DTC47
          DemDebounceAlgorithmClass
            DemDebounceCounterBasedClass (DemDebounceCounterBased): DemDebounceCounterBasedClassRef=DemDebounceCounterBasedClass_LostCom
          DemRbEventClass: DemRbEventBufferTime=0, DemRbEventRecoverableInSameOperationCycle=true, DemRbEventStatusBitStorageTestFailed=true
          DemIndicatorAttribute:
            DemIndicatorFailureCycleCounterThreshold = 2
            DemRbIndicatorApiControl = false
            DemIndicatorBehaviour = DEM_INDICATOR_CONTINUOUS
            DemIndicatorHealingCycleCounterThreshold = 3
            DemIndicatorRef = MIL
        DemEventParameter_ECU4_DTC48: DemDTCRef=DemDTC_ECU4_DTC48, DemComponentClassRef=DemComponent_ECU4_DTC48
          DemDebounceAlgorithmClass
            DemDebounceCounterBasedClass (DemDebounceCounterBased): DemDebounceCounterBasedClassRef=DemDebounceCounterBasedClass_LostCom
          DemRbEventClass: DemRbEventBufferTime=0, DemRbEventRecoverableInSameOperationCycle=true, DemRbEventStatusBitStorageTestFailed=true
          DemIndicatorAttribute:
            DemIndicatorFailureCycleCounterThreshold = 2
            DemRbIndicatorApiControl = false
            DemIndicatorBehaviour = DEM_INDICATOR_CONTINUOUS
            DemIndicatorHealingCycleCounterThreshold = 3
            DemIndicatorRef = MIL
        DemEventParameter_ECU4_DTC49: DemDTCRef=DemDTC_ECU4_DTC49, DemComponentClassRef=DemComponent_ECU4_DTC49
          DemDebounceAlgorithmClass
            DemDebounceCounterBasedClass (DemDebounceCounterBased): DemDebounceCounterBasedClassRef=DemDebounceCounterBasedClass_LostCom
          DemRbEventClass: DemRbEventBufferTime=0, DemRbEventRecoverableInSameOperationCycle=true, DemRbEventStatusBitStorageTestFailed=true
          DemIndicatorAttribute:
            DemIndicatorFailureCycleCounterThreshold = 2
            DemRbIndicatorApiControl = false
            DemIndicatorBehaviour = DEM_INDICATOR_CONTINUOUS
            DemIndicatorHealingCycleCounterThreshold = 3
            DemIndicatorRef = MIL
        DemEventParameter_ECU4_DTC50: DemDTCRef=DemDTC_ECU4_DTC50, DemComponentClassRef=DemComponent_ECU4_DTC50
          DemDebounceAlgorithmClass
            DemDebounceCounterBasedClass (DemDebounceCounterBased): DemDebounceCounterBasedClassRef=DemDebounceCounterBasedClass_LostCom
          DemRbEventClass: DemRbEventBufferTime=0, DemRbEventRecoverableInSameOperationCycle=true, DemRbEventStatusBitStorageTestFailed=true
        DemEventParameter_ECU4_DTC51: DemDTCRef=DemDTC_ECU4_DTC51, DemComponentClassRef=DemComponent_ECU4_DTC51
          DemDebounceAlgorithmClass
            DemDebounceCounterBasedClass (DemDebounceCounterBased): DemDebounceCounterBasedClassRef=DemDebounceCounterBasedClass_LostCom
          DemRbEventClass: DemRbEventBufferTime=0, DemRbEventRecoverableInSameOperationCycle=true, DemRbEventStatusBitStorageTestFailed=true
        DemEventParameter_ECU4_DTC52: DemDTCRef=DemDTC_ECU4_DTC52, DemComponentClassRef=DemComponent_ECU4_DTC52
          DemDebounceAlgorithmClass
            DemDebounceCounterBasedClass (DemDebounceCounterBased): DemDebounceCounterBasedClassRef=DemDebounceCounterBasedClass_LostCom
          DemRbEventClass: DemRbEventBufferTime=0, DemRbEventRecoverableInSameOperationCycle=true, DemRbEventStatusBitStorageTestFailed=true
        DemEventParameter_ECU4_DTC53: DemDTCRef=DemDTC_ECU4_DTC53, DemComponentClassRef=DemComponent_ECU4_DTC53
          DemDebounceAlgorithmClass
            DemDebounceCounterBasedClass (DemDebounceCounterBased): DemDebounceCounterBasedClassRef=DemDebounceCounterBasedClass_LostCom
          DemRbEventClass: DemRbEventBufferTime=0, DemRbEventRecoverableInSameOperationCycle=true, DemRbEventStatusBitStorageTestFailed=true
        DemEventParameter_ECU4_DTC54: DemDTCRef=DemDTC_ECU4_DTC54, DemComponentClassRef=DemComponent_ECU4_DTC54
          DemDebounceAlgorithmClass
            DemDebounceCounterBasedClass (DemDebounceCounterBased): DemDebounceCounterBasedClassRef=DemDebounceCounterBasedClass_LostCom
          DemRbEventClass: DemRbEventBufferTime=0, DemRbEventRecoverableInSameOperationCycle=true, DemRbEventStatusBitStorageTestFailed=true
        DemEventParameter_ECU4_DTC55: DemDTCRef=DemDTC_ECU4_DTC55, DemComponentClassRef=DemComponent_ECU4_DTC55
          DemDebounceAlgorithmClass
            DemDebounceCounterBasedClass (DemDebounceCounterBased): DemDebounceCounterBasedClassRef=DemDebounceCounterBasedClass_LostCom
          DemRbEventClass: DemRbEventBufferTime=0, DemRbEventRecoverableInSameOperationCycle=true, DemRbEventStatusBitStorageTestFailed=true
        DemEventParameter_ECU4_DTC56: DemDTCRef=DemDTC_ECU4_DTC56, DemComponentClassRef=DemComponent_ECU4_DTC56
          DemDebounceAlgorithmClass
            DemDebounceCounterBasedClass (DemDebounceCounterBased): DemDebounceCounterBasedClassRef=DemDebounceCounterBasedClass_LostCom
          DemRbEventClass: DemRbEventBufferTime=0, DemRbEventRecoverableInSameOperationCycle=true, DemRbEventStatusBitStorageTestFailed=true
        DemEventParameter_ECU4_DTC57: DemDTCRef=DemDTC_ECU4_DTC57, DemComponentClassRef=DemComponent_ECU4_DTC57
          DemDebounceAlgorithmClass
            DemDebounceCounterBasedClass (DemDebounceCounterBased): DemDebounceCounterBasedClassRef=DemDebounceCounterBasedClass_LostCom
          DemRbEventClass: DemRbEventBufferTime=0, DemRbEventRecoverableInSameOperationCycle=true, DemRbEventStatusBitStorageTestFailed=true
          DemIndicatorAttribute:
            DemIndicatorFailureCycleCounterThreshold = 2
            DemRbIndicatorApiControl = false
            DemIndicatorBehaviour = DEM_INDICATOR_CONTINUOUS
            DemIndicatorHealingCycleCounterThreshold = 3
            DemIndicatorRef = MIL
        DemEventParameter_ECU4_DTC58: DemDTCRef=DemDTC_ECU4_DTC58, DemComponentClassRef=DemComponent_ECU4_DTC58
          DemDebounceAlgorithmClass
            DemDebounceCounterBasedClass (DemDebounceCounterBased): DemDebounceCounterBasedClassRef=DemDebounceCounterBasedClass_LostCom
          DemRbEventClass: DemRbEventBufferTime=0, DemRbEventRecoverableInSameOperationCycle=true, DemRbEventStatusBitStorageTestFailed=true
          DemIndicatorAttribute:
            DemIndicatorFailureCycleCounterThreshold = 2
            DemRbIndicatorApiControl = false
            DemIndicatorBehaviour = DEM_INDICATOR_CONTINUOUS
            DemIndicatorHealingCycleCounterThreshold = 3
            DemIndicatorRef = MIL
        DemEventParameter_ECU4_DTC59: DemDTCRef=DemDTC_ECU4_DTC59, DemComponentClassRef=DemComponent_ECU4_DTC59
          DemDebounceAlgorithmClass
            DemDebounceCounterBasedClass (DemDebounceCounterBased): DemDebounceCounterBasedClassRef=DemDebounceCounterBasedClass_LostCom
          DemRbEventClass: DemRbEventBufferTime=0, DemRbEventRecoverableInSameOperationCycle=true, DemRbEventStatusBitStorageTestFailed=true
        DemEventParameter_ECU4_DTC60: DemDTCRef=DemDTC_ECU4_DTC60, DemComponentClassRef=DemComponent_ECU4_DTC60
          DemDebounceAlgorithmClass
            DemDebounceCounterBasedClass (DemDebounceCounterBased): DemDebounceCounterBasedClassRef=DemDebounceCounterBasedClass_LostCom
          DemRbEventClass: DemRbEventBufferTime=0, DemRbEventRecoverableInSameOperationCycle=true, DemRbEventStatusBitStorageTestFailed=true
        DemEventParameter_ECU4_DTC61: DemDTCRef=DemDTC_ECU4_DTC61, DemComponentClassRef=DemComponent_ECU4_DTC61
          DemDebounceAlgorithmClass
            DemDebounceCounterBasedClass (DemDebounceCounterBased): DemDebounceCounterBasedClassRef=DemDebounceCounterBasedClass_LostCom
          DemRbEventClass: DemRbEventBufferTime=0, DemRbEventRecoverableInSameOperationCycle=true, DemRbEventStatusBitStorageTestFailed=true
          DemIndicatorAttribute:
            DemIndicatorFailureCycleCounterThreshold = 2
            DemRbIndicatorApiControl = false
            DemIndicatorBehaviour = DEM_INDICATOR_CONTINUOUS
            DemIndicatorHealingCycleCounterThreshold = 3
            DemIndicatorRef = MIL
        DemEventParameter_ECU4_DTC62: DemDTCRef=DemDTC_ECU4_DTC62, DemComponentClassRef=DemComponent_ECU4_DTC62
          DemDebounceAlgorithmClass
            DemDebounceCounterBasedClass (DemDebounceCounterBased): DemDebounceCounterBasedClassRef=DemDebounceCounterBasedClass_LostCom
          DemRbEventClass: DemRbEventBufferTime=0, DemRbEventRecoverableInSameOperationCycle=true, DemRbEventStatusBitStorageTestFailed=true
        DemEventParameter_ECU4_DTC63: DemDTCRef=DemDTC_ECU4_DTC63, DemComponentClassRef=DemComponent_ECU4_DTC63
          DemDebounceAlgorithmClass
            DemDebounceCounterBasedClass (DemDebounceCounterBased): DemDebounceCounterBasedClassRef=DemDebounceCounterBasedClass_LostCom
          DemRbEventClass: DemRbEventBufferTime=0, DemRbEventRecoverableInSameOperationCycle=true, DemRbEventStatusBitStorageTestFailed=true
        DemEventParameter_ECU4_DTC64: DemDTCRef=DemDTC_ECU4_DTC64, DemComponentClassRef=DemComponent_ECU4_DTC64
          DemDebounceAlgorithmClass
            DemDebounceCounterBasedClass (DemDebounceCounterBased): DemDebounceCounterBasedClassRef=DemDebounceCounterBasedClass_LostCom
          DemRbEventClass: DemRbEventBufferTime=0, DemRbEventRecoverableInSameOperationCycle=true, DemRbEventStatusBitStorageTestFailed=true
        DemEventParameter_ECU4_DTC65: DemDTCRef=DemDTC_ECU4_DTC65, DemComponentClassRef=DemComponent_ECU4_DTC65
          DemDebounceAlgorithmClass
            DemDebounceCounterBasedClass (DemDebounceCounterBased): DemDebounceCounterBasedClassRef=DemDebounceCounterBasedClass_LostCom
          DemRbEventClass: DemRbEventBufferTime=0, DemRbEventRecoverableInSameOperationCycle=true, DemRbEventStatusBitStorageTestFailed=true
        DemEventParameter_ECU4_DTC66: DemDTCRef=DemDTC_ECU4_DTC66, DemComponentClassRef=DemComponent_ECU4_DTC66
          DemDebounceAlgorithmClass
            DemDebounceCounterBasedClass (DemDebounceCounterBased): DemDebounceCounterBasedClassRef=DemDebounceCounterBasedClass_LostCom
          DemRbEventClass: DemRbEventBufferTime=0, DemRbEventRecoverableInSameOperationCycle=true, DemRbEventStatusBitStorageTestFailed=true
        DemEventParameter_ECU4_DTC67: DemDTCRef=DemDTC_ECU4_DTC67, DemComponentClassRef=DemComponent_ECU4_DTC67
          DemDebounceAlgorithmClass
            DemDebounceCounterBasedClass (DemDebounceCounterBased): DemDebounceCounterBasedClassRef=DemDebounceCounterBasedClass_LostCom
          DemRbEventClass: DemRbEventBufferTime=0, DemRbEventRecoverableInSameOperationCycle=true, DemRbEventStatusBitStorageTestFailed=true
        DemEventParameter_ECU4_DTC68: DemDTCRef=DemDTC_ECU4_DTC68, DemComponentClassRef=DemComponent_ECU4_DTC68
          DemDebounceAlgorithmClass
            DemDebounceCounterBasedClass (DemDebounceCounterBased): DemDebounceCounterBasedClassRef=DemDebounceCounterBasedClass_LostCom
          DemRbEventClass: DemRbEventBufferTime=0, DemRbEventRecoverableInSameOperationCycle=true, DemRbEventStatusBitStorageTestFailed=true
        DemEventParameter_ECU4_DTC69: DemDTCRef=DemDTC_ECU4_DTC69, DemComponentClassRef=DemComponent_ECU4_DTC69
          DemDebounceAlgorithmClass
            DemDebounceCounterBasedClass (DemDebounceCounterBased): DemDebounceCounterBasedClassRef=DemDebounceCounterBasedClass_LostCom
          DemRbEventClass: DemRbEventBufferTime=0, DemRbEventRecoverableInSameOperationCycle=true, DemRbEventStatusBitStorageTestFailed=true
          DemIndicatorAttribute:
            DemIndicatorFailureCycleCounterThreshold = 2
            DemRbIndicatorApiControl = false
            DemIndicatorBehaviour = DEM_INDICATOR_CONTINUOUS
            DemIndicatorHealingCycleCounterThreshold = 3
            DemIndicatorRef = MIL
        DemEventParameter_ECU4_DTC70: DemDTCRef=DemDTC_ECU4_DTC70, DemComponentClassRef=DemComponent_ECU4_DTC70
          DemDebounceAlgorithmClass
            DemDebounceCounterBasedClass (DemDebounceCounterBased): DemDebounceCounterBasedClassRef=DemDebounceCounterBasedClass_LostCom
          DemRbEventClass: DemRbEventBufferTime=0, DemRbEventRecoverableInSameOperationCycle=true, DemRbEventStatusBitStorageTestFailed=true
          DemIndicatorAttribute:
            DemIndicatorFailureCycleCounterThreshold = 2
            DemRbIndicatorApiControl = false
            DemIndicatorBehaviour = DEM_INDICATOR_CONTINUOUS
            DemIndicatorHealingCycleCounterThreshold = 3
            DemIndicatorRef = MIL
        DemEventParameter_ECU4_DTC71: DemDTCRef=DemDTC_ECU4_DTC71, DemComponentClassRef=DemComponent_ECU4_DTC71
          DemDebounceAlgorithmClass
            DemDebounceCounterBasedClass (DemDebounceCounterBased): DemDebounceCounterBasedClassRef=DemDebounceCounterBasedClass_LostCom
          DemRbEventClass: DemRbEventBufferTime=0, DemRbEventRecoverableInSameOperationCycle=true, DemRbEventStatusBitStorageTestFailed=true
        DemEventParameter_ECU4_DTC72: DemDTCRef=DemDTC_ECU4_DTC72, DemComponentClassRef=DemComponent_ECU4_DTC72
          DemDebounceAlgorithmClass
            DemDebounceCounterBasedClass (DemDebounceCounterBased): DemDebounceCounterBasedClassRef=DemDebounceCounterBasedClass_LostCom
          DemRbEventClass: DemRbEventBufferTime=0, DemRbEventRecoverableInSameOperationCycle=true, DemRbEventStatusBitStorageTestFailed=true
        DemEventParameter_ECU4_DTC73: DemDTCRef=DemDTC_ECU4_DTC73, DemComponentClassRef=DemComponent_ECU4_DTC73
          DemDebounceAlgorithmClass
            DemDebounceCounterBasedClass (DemDebounceCounterBased): DemDebounceCounterBasedClassRef=DemDebounceCounterBasedClass_LostCom
          DemRbEventClass: DemRbEventBufferTime=0, DemRbEventRecoverableInSameOperationCycle=true, DemRbEventStatusBitStorageTestFailed=true
          DemIndicatorAttribute:
            DemIndicatorFailureCycleCounterThreshold = 2
            DemRbIndicatorApiControl = false
            DemIndicatorBehaviour = DEM_INDICATOR_CONTINUOUS
            DemIndicatorHealingCycleCounterThreshold = 3
            DemIndicatorRef = MIL
        DemEventParameter_ECU4_DTC74: DemDTCRef=DemDTC_ECU4_DTC74, DemComponentClassRef=DemComponent_ECU4_DTC74
          DemDebounceAlgorithmClass
            DemDebounceCounterBasedClass (DemDebounceCounterBased): DemDebounceCounterBasedClassRef=DemDebounceCounterBasedClass_LostCom
          DemRbEventClass: DemRbEventBufferTime=0, DemRbEventRecoverableInSameOperationCycle=true, DemRbEventStatusBitStorageTestFailed=true
        DemEventParameter_ECU4_DTC75: DemDTCRef=DemDTC_ECU4_DTC75, DemComponentClassRef=DemComponent_ECU4_DTC75
          DemDebounceAlgorithmClass
            DemDebounceCounterBasedClass (DemDebounceCounterBased): DemDebounceCounterBasedClassRef=DemDebounceCounterBasedClass_LostCom
          DemRbEventClass: DemRbEventBufferTime=0, DemRbEventRecoverableInSameOperationCycle=true, DemRbEventStatusBitStorageTestFailed=true
        DemEventParameter_ECU4_DTC76: DemDTCRef=DemDTC_ECU4_DTC76, DemComponentClassRef=DemComponent_ECU4_DTC76
          DemDebounceAlgorithmClass
            DemDebounceCounterBasedClass (DemDebounceCounterBased): DemDebounceCounterBasedClassRef=DemDebounceCounterBasedClass_LostCom
          DemRbEventClass: DemRbEventBufferTime=0, DemRbEventRecoverableInSameOperationCycle=true, DemRbEventStatusBitStorageTestFailed=true
        DemEventParameter_ECU4_DTC77: DemDTCRef=DemDTC_ECU4_DTC77, DemComponentClassRef=DemComponent_ECU4_DTC77
          DemDebounceAlgorithmClass
            DemDebounceCounterBasedClass (DemDebounceCounterBased): DemDebounceCounterBasedClassRef=DemDebounceCounterBasedClass_LostCom
          DemRbEventClass: DemRbEventBufferTime=0, DemRbEventRecoverableInSameOperationCycle=true, DemRbEventStatusBitStorageTestFailed=true
        DemEventParameter_ECU4_DTC78: DemDTCRef=DemDTC_ECU4_DTC78, DemComponentClassRef=DemComponent_ECU4_DTC78
          DemDebounceAlgorithmClass
            DemDebounceCounterBasedClass (DemDebounceCounterBased): DemDebounceCounterBasedClassRef=DemDebounceCounterBasedClass_LostCom
          DemRbEventClass: DemRbEventBufferTime=0, DemRbEventRecoverableInSameOperationCycle=true, DemRbEventStatusBitStorageTestFailed=true
        DemEventParameter_ECU4_DTC79: DemDTCRef=DemDTC_ECU4_DTC79, DemComponentClassRef=DemComponent_ECU4_DTC79
          DemDebounceAlgorithmClass
            DemDebounceCounterBasedClass (DemDebounceCounterBased): DemDebounceCounterBasedClassRef=DemDebounceCounterBasedClass_LostCom
          DemRbEventClass: DemRbEventBufferTime=0, DemRbEventRecoverableInSameOperationCycle=true, DemRbEventStatusBitStorageTestFailed=true
        DemEventParameter_ECU4_DTC80: DemDTCRef=DemDTC_ECU4_DTC80, DemComponentClassRef=DemComponent_ECU4_DTC80
          DemDebounceAlgorithmClass
            DemDebounceCounterBasedClass (DemDebounceCounterBased): DemDebounceCounterBasedClassRef=DemDebounceCounterBasedClass_LostCom
          DemRbEventClass: DemRbEventBufferTime=0, DemRbEventRecoverableInSameOperationCycle=true, DemRbEventStatusBitStorageTestFailed=true
        DemEventParameter_ECU4_DTC81: DemDTCRef=DemDTC_ECU4_DTC81, DemComponentClassRef=DemComponent_ECU4_DTC81
          DemDebounceAlgorithmClass
            DemDebounceCounterBasedClass (DemDebounceCounterBased): DemDebounceCounterBasedClassRef=DemDebounceCounterBasedClass_LostCom
          DemRbEventClass: DemRbEventBufferTime=0, DemRbEventRecoverableInSameOperationCycle=true, DemRbEventStatusBitStorageTestFailed=true
          DemIndicatorAttribute:
            DemIndicatorFailureCycleCounterThreshold = 2
            DemRbIndicatorApiControl = false
            DemIndicatorBehaviour = DEM_INDICATOR_CONTINUOUS
            DemIndicatorHealingCycleCounterThreshold = 3
            DemIndicatorRef = MIL
        DemEventParameter_ECU4_DTC82: DemDTCRef=DemDTC_ECU4_DTC82, DemComponentClassRef=DemComponent_ECU4_DTC82
          DemDebounceAlgorithmClass
            DemDebounceCounterBasedClass (DemDebounceCounterBased): DemDebounceCounterBasedClassRef=DemDebounceCounterBasedClass_LostCom
          DemRbEventClass: DemRbEventBufferTime=0, DemRbEventRecoverableInSameOperationCycle=true, DemRbEventStatusBitStorageTestFailed=true
          DemIndicatorAttribute:
            DemIndicatorFailureCycleCounterThreshold = 2
            DemRbIndicatorApiControl = false
            DemIndicatorBehaviour = DEM_INDICATOR_CONTINUOUS
            DemIndicatorHealingCycleCounterThreshold = 3
            DemIndicatorRef = MIL
        DemEventParameter_ECU4_DTC83: DemDTCRef=DemDTC_ECU4_DTC83, DemComponentClassRef=DemComponent_ECU4_DTC83
          DemDebounceAlgorithmClass
            DemDebounceCounterBasedClass (DemDebounceCounterBased): DemDebounceCounterBasedClassRef=DemDebounceCounterBasedClass_LostCom
          DemRbEventClass: DemRbEventBufferTime=0, DemRbEventRecoverableInSameOperationCycle=true, DemRbEventStatusBitStorageTestFailed=true
        DemEventParameter_ECU4_DTC84: DemDTCRef=DemDTC_ECU4_DTC84, DemComponentClassRef=DemComponent_ECU4_DTC84
          DemDebounceAlgorithmClass
            DemDebounceCounterBasedClass (DemDebounceCounterBased): DemDebounceCounterBasedClassRef=DemDebounceCounterBasedClass_LostCom
          DemRbEventClass: DemRbEventBufferTime=0, DemRbEventRecoverableInSameOperationCycle=true, DemRbEventStatusBitStorageTestFailed=true
        DemEventParameter_ECU4_DTC85: DemDTCRef=DemDTC_ECU4_DTC85, DemComponentClassRef=DemComponent_ECU4_DTC85
          DemDebounceAlgorithmClass
            DemDebounceCounterBasedClass (DemDebounceCounterBased): DemDebounceCounterBasedClassRef=DemDebounceCounterBasedClass_LostCom
          DemRbEventClass: DemRbEventBufferTime=0, DemRbEventRecoverableInSameOperationCycle=true, DemRbEventStatusBitStorageTestFailed=true
          DemIndicatorAttribute:
            DemIndicatorFailureCycleCounterThreshold = 2
            DemRbIndicatorApiControl = false
            DemIndicatorBehaviour = DEM_INDICATOR_CONTINUOUS
            DemIndicatorHealingCycleCounterThreshold = 3
            DemIndicatorRef = MIL
        DemEventParameter_ECU4_DTC86: DemDTCRef=DemDTC_ECU4_DTC86, DemComponentClassRef=DemComponent_ECU4_DTC86
          DemDebounceAlgorithmClass
            DemDebounceCounterBasedClass (DemDebounceCounterBased): DemDebounceCounterBasedClassRef=DemDebounceCounterBasedClass_LostCom
          DemRbEventClass: DemRbEventBufferTime=0, DemRbEventRecoverableInSameOperationCycle=true, DemRbEventStatusBitStorageTestFailed=true
        DemEventParameter_ECU4_DTC87: DemDTCRef=DemDTC_ECU4_DTC87, DemComponentClassRef=DemComponent_ECU4_DTC87
          DemDebounceAlgorithmClass
            DemDebounceCounterBasedClass (DemDebounceCounterBased): DemDebounceCounterBasedClassRef=DemDebounceCounterBasedClass_LostCom
          DemRbEventClass: DemRbEventBufferTime=0, DemRbEventRecoverableInSameOperationCycle=true, DemRbEventStatusBitStorageTestFailed=true
        DemEventParameter_ECU4_DTC88: DemDTCRef=DemDTC_ECU4_DTC88, DemComponentClassRef=DemComponent_ECU4_DTC88
          DemDebounceAlgorithmClass
            DemDebounceCounterBasedClass (DemDebounceCounterBased): DemDebounceCounterBasedClassRef=DemDebounceCounterBasedClass_LostCom
          DemRbEventClass: DemRbEventBufferTime=0, DemRbEventRecoverableInSameOperationCycle=true, DemRbEventStatusBitStorageTestFailed=true
        DemEventParameter_ECU4_DTC89: DemDTCRef=DemDTC_ECU4_DTC89, DemComponentClassRef=DemComponent_ECU4_DTC89
          DemDebounceAlgorithmClass
            DemDebounceCounterBasedClass (DemDebounceCounterBased): DemDebounceCounterBasedClassRef=DemDebounceCounterBasedClass_LostCom
          DemRbEventClass: DemRbEventBufferTime=0, DemRbEventRecoverableInSameOperationCycle=true, DemRbEventStatusBitStorageTestFailed=true
        DemEventParameter_ECU4_DTC90: DemDTCRef=DemDTC_ECU4_DTC90, DemComponentClassRef=DemComponent_ECU4_DTC90
          DemDebounceAlgorithmClass
            DemDebounceCounterBasedClass (DemDebounceCounterBased): DemDebounceCounterBasedClassRef=DemDebounceCounterBasedClass_LostCom
          DemRbEventClass: DemRbEventBufferTime=0, DemRbEventRecoverableInSameOperationCycle=true, DemRbEventStatusBitStorageTestFailed=true
        DemEventParameter_ECU4_DTC91: DemDTCRef=DemDTC_ECU4_DTC91, DemComponentClassRef=DemComponent_ECU4_DTC91
          DemDebounceAlgorithmClass
            DemDebounceCounterBasedClass (DemDebounceCounterBased): DemDebounceCounterBasedClassRef=DemDebounceCounterBasedClass_LostCom
          DemRbEventClass: DemRbEventBufferTime=0, DemRbEventRecoverableInSameOperationCycle=true, DemRbEventStatusBitStorageTestFailed=true
        DemEventParameter_ECU4_DTC92: DemDTCRef=DemDTC_ECU4_DTC92, DemComponentClassRef=DemComponent_ECU4_DTC92
          DemDebounceAlgorithmClass
            DemDebounceCounterBasedClass (DemDebounceCounterBased): DemDebounceCounterBasedClassRef=DemDebounceCounterBasedClass_LostCom
          DemRbEventClass: DemRbEventBufferTime=0, DemRbEventRecoverableInSameOperationCycle=true, DemRbEventStatusBitStorageTestFailed=true
        DemEventParameter_ECU4_DTC93: DemDTCRef=DemDTC_ECU4_DTC93, DemComponentClassRef=DemComponent_ECU4_DTC93
          DemDebounceAlgorithmClass
            DemDebounceCounterBasedClass (DemDebounceCounterBased): DemDebounceCounterBasedClassRef=DemDebounceCounterBasedClass_LostCom
          DemRbEventClass: DemRbEventBufferTime=0, DemRbEventRecoverableInSameOperationCycle=true, DemRbEventStatusBitStorageTestFailed=true
          DemIndicatorAttribute:
            DemIndicatorFailureCycleCounterThreshold = 2
            DemRbIndicatorApiControl = false
            DemIndicatorBehaviour = DEM_INDICATOR_CONTINUOUS
            DemIndicatorHealingCycleCounterThreshold = 3
            DemIndicatorRef = MIL
        DemEventParameter_ECU4_DTC94: DemDTCRef=DemDTC_ECU4_DTC94, DemComponentClassRef=DemComponent_ECU4_DTC94
          DemDebounceAlgorithmClass
            DemDebounceCounterBasedClass (DemDebounceCounterBased): DemDebounceCounterBasedClassRef=DemDebounceCounterBasedClass_LostCom
          DemRbEventClass: DemRbEventBufferTime=0, DemRbEventRecoverableInSameOperationCycle=true, DemRbEventStatusBitStorageTestFailed=true
          DemIndicatorAttribute:
            DemIndicatorFailureCycleCounterThreshold = 2
            DemRbIndicatorApiControl = false
            DemIndicatorBehaviour = DEM_INDICATOR_CONTINUOUS
            DemIndicatorHealingCycleCounterThreshold = 3
            DemIndicatorRef = MIL
        DemEventParameter_ECU4_DTC95: DemDTCRef=DemDTC_ECU4_DTC95, DemComponentClassRef=DemComponent_ECU4_DTC95
          DemDebounceAlgorithmClass
            DemDebounceCounterBasedClass (DemDebounceCounterBased): DemDebounceCounterBasedClassRef=DemDebounceCounterBasedClass_LostCom
          DemRbEventClass: DemRbEventBufferTime=0, DemRbEventRecoverableInSameOperationCycle=true, DemRbEventStatusBitStorageTestFailed=true
        DemEventParameter_ECU4_DTC96: DemDTCRef=DemDTC_ECU4_DTC96, DemComponentClassRef=DemComponent_ECU4_DTC96
          DemDebounceAlgorithmClass
            DemDebounceCounterBasedClass (DemDebounceCounterBased): DemDebounceCounterBasedClassRef=DemDebounceCounterBasedClass_LostCom
          DemRbEventClass: DemRbEventBufferTime=0, DemRbEventRecoverableInSameOperationCycle=true, DemRbEventStatusBitStorageTestFailed=true
        DemEventParameter_ECU4_DTC97: DemDTCRef=DemDTC_ECU4_DTC97, DemComponentClassRef=DemComponent_ECU4_DTC97
          DemDebounceAlgorithmClass
            DemDebounceCounterBasedClass (DemDebounceCounterBased): DemDebounceCounterBasedClassRef=DemDebounceCounterBasedClass_LostCom
          DemRbEventClass: DemRbEventBufferTime=0, DemRbEventRecoverableInSameOperationCycle=true, DemRbEventStatusBitStorageTestFailed=true
          DemIndicatorAttribute:
            DemIndicatorFailureCycleCounterThreshold = 2
            DemRbIndicatorApiControl = false
            DemIndicatorBehaviour = DEM_INDICATOR_CONTINUOUS
            DemIndicatorHealingCycleCounterThreshold = 3
            DemIndicatorRef = MIL
        DemEventParameter_ECU4_DTC98: DemDTCRef=DemDTC_ECU4_DTC98, DemComponentClassRef=DemComponent_ECU4_DTC98
          DemDebounceAlgorithmClass
            DemDebounceCounterBasedClass (DemDebounceCounterBased): DemDebounceCounterBasedClassRef=DemDebounceCounterBasedClass_LostCom
          DemRbEventClass: DemRbEventBufferTime=0, DemRbEventRecoverableInSameOperationCycle=true, DemRbEventStatusBitStorageTestFailed=true
        DemEventParameter_ECU4_DTC99: DemDTCRef=DemDTC_ECU4_DTC99, DemComponentClassRef=DemComponent_ECU4_DTC99
          DemDebounceAlgorithmClass
            DemDebounceCounterBasedClass (DemDebounceCounterBased): DemDebounceCounterBasedClassRef=DemDebounceCounterBasedClass_LostCom
          DemRbEventClass: DemRbEventBufferTime=0, DemRbEventRecoverableInSameOperationCycle=true, DemRbEventStatusBitStorageTestFailed=true
        DemEventParameter_ECU5_DTC00: DemDTCRef=DemDTC_ECU5_DTC00, DemComponentClassRef=DemComponent_ECU5_DTC00
          DemDebounceAlgorithmClass
            DemDebounceCounterBasedClass (DemDebounceCounterBased): DemDebounceCounterBasedClassRef=DemDebounceCounterBasedClass_LostCom
          DemRbEventClass: DemRbEventBufferTime=0, DemRbEventRecoverableInSameOperationCycle=true, DemRbEventStatusBitStorageTestFailed=true
          DemIndicatorAttribute:
            DemIndicatorFailureCycleCounterThreshold = 2
            DemRbIndicatorApiControl = false
            DemIndicatorBehaviour = DEM_INDICATOR_CONTINUOUS
            DemIndicatorHealingCycleCounterThreshold = 3
            DemIndicatorRef = MIL
        DemEventParameter_ECU5_DTC01: DemDTCRef=DemDTC_ECU5_DTC01, DemComponentClassRef=DemComponent_ECU5_DTC01
          DemDebounceAlgorithmClass
            DemDebounceCounterBasedClass (DemDebounceCounterBased): DemDebounceCounterBasedClassRef=DemDebounceCounterBasedClass_LostCom
          DemRbEventClass: DemRbEventBufferTime=0, DemRbEventRecoverableInSameOperationCycle=true, DemRbEventStatusBitStorageTestFailed=true
        DemEventParameter_ECU5_DTC02: DemComponentClassRef=DemComponent_ECU5_DTC02, DemDTCRef=DemDTC_ECU5_DTC02
          DemEventClassRB (DemRbEventClass): DemRbEventBufferTime=0
          DemDebounceAlgorithmClass
            DemDebounceCounterBasedClass (DemDebounceCounterBased): DemDebounceCounterBasedClassRef=DemDebounceCounterBasedClass_LostCom
        DemEventParameter_ECU5_DTC03: DemDTCRef=DemDTC_ECU5_DTC03, DemComponentClassRef=DemComponent_ECU5_DTC03
          DemDebounceAlgorithmClass
            DemDebounceCounterBasedClass (DemDebounceCounterBased): DemDebounceCounterBasedClassRef=DemDebounceCounterBasedClass_LostCom
          DemRbEventClass: DemRbEventBufferTime=0, DemRbEventRecoverableInSameOperationCycle=true, DemRbEventStatusBitStorageTestFailed=true
        DemEventParameter_ECU5_DTC04: DemDTCRef=DemDTC_ECU5_DTC04, DemComponentClassRef=DemComponent_ECU5_DTC04
          DemDebounceAlgorithmClass
            DemDebounceCounterBasedClass (DemDebounceCounterBased): DemDebounceCounterBasedClassRef=DemDebounceCounterBasedClass_LostCom
          DemRbEventClass: DemRbEventBufferTime=0, DemRbEventRecoverableInSameOperationCycle=true, DemRbEventStatusBitStorageTestFailed=true
        DemEventParameter_ECU5_DTC05: DemDTCRef=DemDTC_ECU5_DTC05, DemComponentClassRef=DemComponent_ECU5_DTC05
          DemDebounceAlgorithmClass
            DemDebounceCounterBasedClass (DemDebounceCounterBased): DemDebounceCounterBasedClassRef=DemDebounceCounterBasedClass_LostCom
          DemRbEventClass: DemRbEventBufferTime=0, DemRbEventRecoverableInSameOperationCycle=true, DemRbEventStatusBitStorageTestFailed=true
          DemIndicatorAttribute:
            DemIndicatorFailureCycleCounterThreshold = 2
            DemRbIndicatorApiControl = false
            DemIndicatorBehaviour = DEM_INDICATOR_CONTINUOUS
            DemIndicatorHealingCycleCounterThreshold = 3
            DemIndicatorRef = MIL
        DemEventParameter_ECU5_DTC06: DemDTCRef=DemDTC_ECU5_DTC06, DemComponentClassRef=DemComponent_ECU5_DTC06
          DemDebounceAlgorithmClass
            DemDebounceCounterBasedClass (DemDebounceCounterBased): DemDebounceCounterBasedClassRef=DemDebounceCounterBasedClass_LostCom
          DemRbEventClass: DemRbEventBufferTime=0, DemRbEventRecoverableInSameOperationCycle=true, DemRbEventStatusBitStorageTestFailed=true
          DemIndicatorAttribute:
            DemIndicatorFailureCycleCounterThreshold = 2
            DemRbIndicatorApiControl = false
            DemIndicatorBehaviour = DEM_INDICATOR_CONTINUOUS
            DemIndicatorHealingCycleCounterThreshold = 3
            DemIndicatorRef = MIL
        DemEventParameter_ECU5_DTC07: DemDTCRef=DemDTC_ECU5_DTC07, DemComponentClassRef=DemComponent_ECU5_DTC07
          DemDebounceAlgorithmClass
            DemDebounceCounterBasedClass (DemDebounceCounterBased): DemDebounceCounterBasedClassRef=DemDebounceCounterBasedClass_LostCom
          DemRbEventClass: DemRbEventBufferTime=0, DemRbEventRecoverableInSameOperationCycle=true, DemRbEventStatusBitStorageTestFailed=true
          DemIndicatorAttribute:
            DemIndicatorFailureCycleCounterThreshold = 2
            DemRbIndicatorApiControl = false
            DemIndicatorBehaviour = DEM_INDICATOR_CONTINUOUS
            DemIndicatorHealingCycleCounterThreshold = 3
            DemIndicatorRef = MIL
        DemEventParameter_ECU5_DTC08: DemDTCRef=DemDTC_ECU5_DTC08, DemComponentClassRef=DemComponent_ECU5_DTC08
          DemDebounceAlgorithmClass
            DemDebounceCounterBasedClass (DemDebounceCounterBased): DemDebounceCounterBasedClassRef=DemDebounceCounterBasedClass_LostCom
          DemRbEventClass: DemRbEventBufferTime=0, DemRbEventRecoverableInSameOperationCycle=true, DemRbEventStatusBitStorageTestFailed=true
          DemIndicatorAttribute:
            DemIndicatorFailureCycleCounterThreshold = 2
            DemRbIndicatorApiControl = false
            DemIndicatorBehaviour = DEM_INDICATOR_CONTINUOUS
            DemIndicatorHealingCycleCounterThreshold = 3
            DemIndicatorRef = MIL
        DemEventParameter_ECU5_DTC09: DemDTCRef=DemDTC_ECU5_DTC09, DemComponentClassRef=DemComponent_ECU5_DTC09
          DemDebounceAlgorithmClass
            DemDebounceCounterBasedClass (DemDebounceCounterBased): DemDebounceCounterBasedClassRef=DemDebounceCounterBasedClass_LostCom
          DemRbEventClass: DemRbEventBufferTime=0, DemRbEventRecoverableInSameOperationCycle=true, DemRbEventStatusBitStorageTestFailed=true
          DemIndicatorAttribute:
            DemIndicatorFailureCycleCounterThreshold = 2
            DemRbIndicatorApiControl = false
            DemIndicatorBehaviour = DEM_INDICATOR_CONTINUOUS
            DemIndicatorHealingCycleCounterThreshold = 3
            DemIndicatorRef = MIL
        DemEventParameter_ECU5_DTC10: DemDTCRef=DemDTC_ECU5_DTC10, DemComponentClassRef=DemComponent_ECU5_DTC10
          DemDebounceAlgorithmClass
            DemDebounceCounterBasedClass (DemDebounceCounterBased): DemDebounceCounterBasedClassRef=DemDebounceCounterBasedClass_LostCom
          DemRbEventClass: DemRbEventBufferTime=0, DemRbEventRecoverableInSameOperationCycle=true, DemRbEventStatusBitStorageTestFailed=true
          DemIndicatorAttribute:
            DemIndicatorFailureCycleCounterThreshold = 2
            DemRbIndicatorApiControl = false
            DemIndicatorBehaviour = DEM_INDICATOR_CONTINUOUS
            DemIndicatorHealingCycleCounterThreshold = 3
            DemIndicatorRef = MIL
        DemEventParameter_ECU5_DTC11: DemDTCRef=DemDTC_ECU5_DTC11, DemComponentClassRef=DemComponent_ECU5_DTC11
          DemDebounceAlgorithmClass
            DemDebounceCounterBasedClass (DemDebounceCounterBased): DemDebounceCounterBasedClassRef=DemDebounceCounterBasedClass_LostCom
          DemRbEventClass: DemRbEventBufferTime=0, DemRbEventRecoverableInSameOperationCycle=true, DemRbEventStatusBitStorageTestFailed=true
          DemIndicatorAttribute:
            DemIndicatorFailureCycleCounterThreshold = 2
            DemRbIndicatorApiControl = false
            DemIndicatorBehaviour = DEM_INDICATOR_CONTINUOUS
            DemIndicatorHealingCycleCounterThreshold = 3
            DemIndicatorRef = MIL
        DemEventParameter_ECU5_DTC12: DemDTCRef=DemDTC_ECU5_DTC12, DemComponentClassRef=DemComponent_ECU5_DTC12
          DemDebounceAlgorithmClass
            DemDebounceCounterBasedClass (DemDebounceCounterBased): DemDebounceCounterBasedClassRef=DemDebounceCounterBasedClass_LostCom
          DemRbEventClass: DemRbEventBufferTime=0, DemRbEventRecoverableInSameOperationCycle=true, DemRbEventStatusBitStorageTestFailed=true
          DemIndicatorAttribute:
            DemIndicatorFailureCycleCounterThreshold = 2
            DemRbIndicatorApiControl = false
            DemIndicatorBehaviour = DEM_INDICATOR_CONTINUOUS
            DemIndicatorHealingCycleCounterThreshold = 3
            DemIndicatorRef = MIL
        DemEventParameter_ECU5_DTC13: DemDTCRef=DemDTC_ECU5_DTC13, DemComponentClassRef=DemComponent_ECU5_DTC13
          DemDebounceAlgorithmClass
            DemDebounceCounterBasedClass (DemDebounceCounterBased): DemDebounceCounterBasedClassRef=DemDebounceCounterBasedClass_LostCom
          DemRbEventClass: DemRbEventBufferTime=0, DemRbEventRecoverableInSameOperationCycle=true, DemRbEventStatusBitStorageTestFailed=true
        DemEventParameter_ECU5_DTC14: DemComponentClassRef=DemComponent_ECU5_DTC14, DemDTCRef=DemDTC_ECU5_DTC14
          DemEventClassRB (DemRbEventClass): DemRbEventBufferTime=0
          DemDebounceAlgorithmClass
            DemDebounceCounterBasedClass (DemDebounceCounterBased): DemDebounceCounterBasedClassRef=DemDebounceCounterBasedClass_LostCom
        DemEventParameter_ECU5_DTC15: DemDTCRef=DemDTC_ECU5_DTC15, DemComponentClassRef=DemComponent_ECU5_DTC15
          DemDebounceAlgorithmClass
            DemDebounceCounterBasedClass (DemDebounceCounterBased): DemDebounceCounterBasedClassRef=DemDebounceCounterBasedClass_LostCom
          DemRbEventClass: DemRbEventBufferTime=0, DemRbEventRecoverableInSameOperationCycle=true, DemRbEventStatusBitStorageTestFailed=true
        DemEventParameter_ECU5_DTC16: DemDTCRef=DemDTC_ECU5_DTC16, DemComponentClassRef=DemComponent_ECU5_DTC16
          DemDebounceAlgorithmClass
            DemDebounceCounterBasedClass (DemDebounceCounterBased): DemDebounceCounterBasedClassRef=DemDebounceCounterBasedClass_LostCom
          DemRbEventClass: DemRbEventBufferTime=0, DemRbEventRecoverableInSameOperationCycle=true, DemRbEventStatusBitStorageTestFailed=true
        DemEventParameter_ECU5_DTC17: DemDTCRef=DemDTC_ECU5_DTC17, DemComponentClassRef=DemComponent_ECU5_DTC17
          DemDebounceAlgorithmClass
            DemDebounceCounterBasedClass (DemDebounceCounterBased): DemDebounceCounterBasedClassRef=DemDebounceCounterBasedClass_LostCom
          DemRbEventClass: DemRbEventBufferTime=0, DemRbEventRecoverableInSameOperationCycle=true, DemRbEventStatusBitStorageTestFailed=true
          DemIndicatorAttribute:
            DemIndicatorFailureCycleCounterThreshold = 2
            DemRbIndicatorApiControl = false
            DemIndicatorBehaviour = DEM_INDICATOR_CONTINUOUS
            DemIndicatorHealingCycleCounterThreshold = 3
            DemIndicatorRef = MIL
        DemEventParameter_ECU5_DTC18: DemDTCRef=DemDTC_ECU5_DTC18, DemComponentClassRef=DemComponent_ECU5_DTC18
          DemDebounceAlgorithmClass
            DemDebounceCounterBasedClass (DemDebounceCounterBased): DemDebounceCounterBasedClassRef=DemDebounceCounterBasedClass_LostCom
          DemRbEventClass: DemRbEventBufferTime=0, DemRbEventRecoverableInSameOperationCycle=true, DemRbEventStatusBitStorageTestFailed=true
          DemIndicatorAttribute:
            DemIndicatorFailureCycleCounterThreshold = 2
            DemRbIndicatorApiControl = false
            DemIndicatorBehaviour = DEM_INDICATOR_CONTINUOUS
            DemIndicatorHealingCycleCounterThreshold = 3
            DemIndicatorRef = MIL
        DemEventParameter_ECU5_DTC19: DemDTCRef=DemDTC_ECU5_DTC19, DemComponentClassRef=DemComponent_ECU5_DTC19
          DemDebounceAlgorithmClass
            DemDebounceCounterBasedClass (DemDebounceCounterBased): DemDebounceCounterBasedClassRef=DemDebounceCounterBasedClass_LostCom
          DemRbEventClass: DemRbEventBufferTime=0, DemRbEventRecoverableInSameOperationCycle=true, DemRbEventStatusBitStorageTestFailed=true
          DemIndicatorAttribute:
            DemIndicatorFailureCycleCounterThreshold = 2
            DemRbIndicatorApiControl = false
            DemIndicatorBehaviour = DEM_INDICATOR_CONTINUOUS
            DemIndicatorHealingCycleCounterThreshold = 3
            DemIndicatorRef = MIL
        DemEventParameter_ECU5_DTC20: DemDTCRef=DemDTC_ECU5_DTC20, DemComponentClassRef=DemComponent_ECU5_DTC20
          DemDebounceAlgorithmClass
            DemDebounceCounterBasedClass (DemDebounceCounterBased): DemDebounceCounterBasedClassRef=DemDebounceCounterBasedClass_LostCom
          DemRbEventClass: DemRbEventBufferTime=0, DemRbEventRecoverableInSameOperationCycle=true, DemRbEventStatusBitStorageTestFailed=true
          DemIndicatorAttribute:
            DemIndicatorFailureCycleCounterThreshold = 2
            DemRbIndicatorApiControl = false
            DemIndicatorBehaviour = DEM_INDICATOR_CONTINUOUS
            DemIndicatorHealingCycleCounterThreshold = 3
            DemIndicatorRef = MIL
        DemEventParameter_ECU5_DTC21: DemDTCRef=DemDTC_ECU5_DTC21, DemComponentClassRef=DemComponent_ECU5_DTC21
          DemDebounceAlgorithmClass
            DemDebounceCounterBasedClass (DemDebounceCounterBased): DemDebounceCounterBasedClassRef=DemDebounceCounterBasedClass_LostCom
          DemRbEventClass: DemRbEventBufferTime=0, DemRbEventRecoverableInSameOperationCycle=true, DemRbEventStatusBitStorageTestFailed=true
          DemIndicatorAttribute:
            DemIndicatorFailureCycleCounterThreshold = 2
            DemRbIndicatorApiControl = false
            DemIndicatorBehaviour = DEM_INDICATOR_CONTINUOUS
            DemIndicatorHealingCycleCounterThreshold = 3
            DemIndicatorRef = MIL
        DemEventParameter_ECU5_DTC22: DemDTCRef=DemDTC_ECU5_DTC22, DemComponentClassRef=DemComponent_ECU5_DTC22
          DemDebounceAlgorithmClass
            DemDebounceCounterBasedClass (DemDebounceCounterBased): DemDebounceCounterBasedClassRef=DemDebounceCounterBasedClass_LostCom
          DemRbEventClass: DemRbEventBufferTime=0, DemRbEventRecoverableInSameOperationCycle=true, DemRbEventStatusBitStorageTestFailed=true
          DemIndicatorAttribute:
            DemIndicatorFailureCycleCounterThreshold = 2
            DemRbIndicatorApiControl = false
            DemIndicatorBehaviour = DEM_INDICATOR_CONTINUOUS
            DemIndicatorHealingCycleCounterThreshold = 3
            DemIndicatorRef = MIL
        DemEventParameter_ECU5_DTC23: DemDTCRef=DemDTC_ECU5_DTC23, DemComponentClassRef=DemComponent_ECU5_DTC23
          DemDebounceAlgorithmClass
            DemDebounceCounterBasedClass (DemDebounceCounterBased): DemDebounceCounterBasedClassRef=DemDebounceCounterBasedClass_LostCom
          DemRbEventClass: DemRbEventBufferTime=0, DemRbEventRecoverableInSameOperationCycle=true, DemRbEventStatusBitStorageTestFailed=true
          DemIndicatorAttribute:
            DemIndicatorFailureCycleCounterThreshold = 2
            DemRbIndicatorApiControl = false
            DemIndicatorBehaviour = DEM_INDICATOR_CONTINUOUS
            DemIndicatorHealingCycleCounterThreshold = 3
            DemIndicatorRef = MIL
        DemEventParameter_ECU5_DTC24: DemDTCRef=DemDTC_ECU5_DTC24, DemComponentClassRef=DemComponent_ECU5_DTC24
          DemDebounceAlgorithmClass
            DemDebounceCounterBasedClass (DemDebounceCounterBased): DemDebounceCounterBasedClassRef=DemDebounceCounterBasedClass_LostCom
          DemRbEventClass: DemRbEventBufferTime=0, DemRbEventRecoverableInSameOperationCycle=true, DemRbEventStatusBitStorageTestFailed=true
          DemIndicatorAttribute:
            DemIndicatorFailureCycleCounterThreshold = 2
            DemRbIndicatorApiControl = false
            DemIndicatorBehaviour = DEM_INDICATOR_CONTINUOUS
            DemIndicatorHealingCycleCounterThreshold = 3
            DemIndicatorRef = MIL
        DemEventParameter_ECU5_DTC25: DemDTCRef=DemDTC_ECU5_DTC25, DemComponentClassRef=DemComponent_ECU5_DTC25
          DemDebounceAlgorithmClass
            DemDebounceCounterBasedClass (DemDebounceCounterBased): DemDebounceCounterBasedClassRef=DemDebounceCounterBasedClass_LostCom
          DemRbEventClass: DemRbEventBufferTime=0, DemRbEventRecoverableInSameOperationCycle=true, DemRbEventStatusBitStorageTestFailed=true
        DemEventParameter_ECU5_DTC26: DemComponentClassRef=DemComponent_ECU5_DTC26, DemDTCRef=DemDTC_ECU5_DTC26
          DemEventClassRB (DemRbEventClass): DemRbEventBufferTime=0
          DemDebounceAlgorithmClass
            DemDebounceCounterBasedClass (DemDebounceCounterBased): DemDebounceCounterBasedClassRef=DemDebounceCounterBasedClass_LostCom
        DemEventParameter_ECU5_DTC27: DemDTCRef=DemDTC_ECU5_DTC27, DemComponentClassRef=DemComponent_ECU5_DTC27
          DemDebounceAlgorithmClass
            DemDebounceCounterBasedClass (DemDebounceCounterBased): DemDebounceCounterBasedClassRef=DemDebounceCounterBasedClass_LostCom
          DemRbEventClass: DemRbEventBufferTime=0, DemRbEventRecoverableInSameOperationCycle=true, DemRbEventStatusBitStorageTestFailed=true
        DemEventParameter_ECU5_DTC28: DemDTCRef=DemDTC_ECU5_DTC28, DemComponentClassRef=DemComponent_ECU5_DTC28
          DemDebounceAlgorithmClass
            DemDebounceCounterBasedClass (DemDebounceCounterBased): DemDebounceCounterBasedClassRef=DemDebounceCounterBasedClass_LostCom
          DemRbEventClass: DemRbEventBufferTime=0, DemRbEventRecoverableInSameOperationCycle=true, DemRbEventStatusBitStorageTestFailed=true
        DemEventParameter_ECU5_DTC29: DemDTCRef=DemDTC_ECU5_DTC29, DemComponentClassRef=DemComponent_ECU5_DTC29
          DemDebounceAlgorithmClass
            DemDebounceCounterBasedClass (DemDebounceCounterBased): DemDebounceCounterBasedClassRef=DemDebounceCounterBasedClass_LostCom
          DemRbEventClass: DemRbEventBufferTime=0, DemRbEventRecoverableInSameOperationCycle=true, DemRbEventStatusBitStorageTestFailed=true
          DemIndicatorAttribute:
            DemIndicatorFailureCycleCounterThreshold = 2
            DemRbIndicatorApiControl = false
            DemIndicatorBehaviour = DEM_INDICATOR_CONTINUOUS
            DemIndicatorHealingCycleCounterThreshold = 3
            DemIndicatorRef = MIL
        DemEventParameter_ECU5_DTC30: DemDTCRef=DemDTC_ECU5_DTC30, DemComponentClassRef=DemComponent_ECU5_DTC30
          DemDebounceAlgorithmClass
            DemDebounceCounterBasedClass (DemDebounceCounterBased): DemDebounceCounterBasedClassRef=DemDebounceCounterBasedClass_LostCom
          DemRbEventClass: DemRbEventBufferTime=0, DemRbEventRecoverableInSameOperationCycle=true, DemRbEventStatusBitStorageTestFailed=true
          DemIndicatorAttribute:
            DemIndicatorFailureCycleCounterThreshold = 2
            DemRbIndicatorApiControl = false
            DemIndicatorBehaviour = DEM_INDICATOR_CONTINUOUS
            DemIndicatorHealingCycleCounterThreshold = 3
            DemIndicatorRef = MIL
        DemEventParameter_ECU5_DTC31: DemDTCRef=DemDTC_ECU5_DTC31, DemComponentClassRef=DemComponent_ECU5_DTC31
          DemDebounceAlgorithmClass
            DemDebounceCounterBasedClass (DemDebounceCounterBased): DemDebounceCounterBasedClassRef=DemDebounceCounterBasedClass_LostCom
          DemRbEventClass: DemRbEventBufferTime=0, DemRbEventRecoverableInSameOperationCycle=true, DemRbEventStatusBitStorageTestFailed=true
          DemIndicatorAttribute:
            DemIndicatorFailureCycleCounterThreshold = 2
            DemRbIndicatorApiControl = false
            DemIndicatorBehaviour = DEM_INDICATOR_CONTINUOUS
            DemIndicatorHealingCycleCounterThreshold = 3
            DemIndicatorRef = MIL
        DemEventParameter_ECU5_DTC32: DemDTCRef=DemDTC_ECU5_DTC32, DemComponentClassRef=DemComponent_ECU5_DTC32
          DemDebounceAlgorithmClass
            DemDebounceCounterBasedClass (DemDebounceCounterBased): DemDebounceCounterBasedClassRef=DemDebounceCounterBasedClass_LostCom
          DemRbEventClass: DemRbEventBufferTime=0, DemRbEventRecoverableInSameOperationCycle=true, DemRbEventStatusBitStorageTestFailed=true
          DemIndicatorAttribute:
            DemIndicatorFailureCycleCounterThreshold = 2
            DemRbIndicatorApiControl = false
            DemIndicatorBehaviour = DEM_INDICATOR_CONTINUOUS
            DemIndicatorHealingCycleCounterThreshold = 3
            DemIndicatorRef = MIL
        DemEventParameter_ECU5_DTC33: DemDTCRef=DemDTC_ECU5_DTC33, DemComponentClassRef=DemComponent_ECU5_DTC33
          DemDebounceAlgorithmClass
            DemDebounceCounterBasedClass (DemDebounceCounterBased): DemDebounceCounterBasedClassRef=DemDebounceCounterBasedClass_LostCom
          DemRbEventClass: DemRbEventBufferTime=0, DemRbEventRecoverableInSameOperationCycle=true, DemRbEventStatusBitStorageTestFailed=true
          DemIndicatorAttribute:
            DemIndicatorFailureCycleCounterThreshold = 2
            DemRbIndicatorApiControl = false
            DemIndicatorBehaviour = DEM_INDICATOR_CONTINUOUS
            DemIndicatorHealingCycleCounterThreshold = 3
            DemIndicatorRef = MIL
        DemEventParameter_ECU5_DTC34: DemDTCRef=DemDTC_ECU5_DTC34, DemComponentClassRef=DemComponent_ECU5_DTC34
          DemDebounceAlgorithmClass
            DemDebounceCounterBasedClass (DemDebounceCounterBased): DemDebounceCounterBasedClassRef=DemDebounceCounterBasedClass_LostCom
          DemRbEventClass: DemRbEventBufferTime=0, DemRbEventRecoverableInSameOperationCycle=true, DemRbEventStatusBitStorageTestFailed=true
          DemIndicatorAttribute:
            DemIndicatorFailureCycleCounterThreshold = 2
            DemRbIndicatorApiControl = false
            DemIndicatorBehaviour = DEM_INDICATOR_CONTINUOUS
            DemIndicatorHealingCycleCounterThreshold = 3
            DemIndicatorRef = MIL
        DemEventParameter_ECU5_DTC35: DemDTCRef=DemDTC_ECU5_DTC35, DemComponentClassRef=DemComponent_ECU5_DTC35
          DemDebounceAlgorithmClass
            DemDebounceCounterBasedClass (DemDebounceCounterBased): DemDebounceCounterBasedClassRef=DemDebounceCounterBasedClass_LostCom
          DemRbEventClass: DemRbEventBufferTime=0, DemRbEventRecoverableInSameOperationCycle=true, DemRbEventStatusBitStorageTestFailed=true
          DemIndicatorAttribute:
            DemIndicatorFailureCycleCounterThreshold = 2
            DemRbIndicatorApiControl = false
            DemIndicatorBehaviour = DEM_INDICATOR_CONTINUOUS
            DemIndicatorHealingCycleCounterThreshold = 3
            DemIndicatorRef = MIL
        DemEventParameter_ECU5_DTC36: DemDTCRef=DemDTC_ECU5_DTC36, DemComponentClassRef=DemComponent_ECU5_DTC36
          DemDebounceAlgorithmClass
            DemDebounceCounterBasedClass (DemDebounceCounterBased): DemDebounceCounterBasedClassRef=DemDebounceCounterBasedClass_LostCom
          DemRbEventClass: DemRbEventBufferTime=0, DemRbEventRecoverableInSameOperationCycle=true, DemRbEventStatusBitStorageTestFailed=true
          DemIndicatorAttribute:
            DemIndicatorFailureCycleCounterThreshold = 2
            DemRbIndicatorApiControl = false
            DemIndicatorBehaviour = DEM_INDICATOR_CONTINUOUS
            DemIndicatorHealingCycleCounterThreshold = 3
            DemIndicatorRef = MIL
        DemEventParameter_ECU5_DTC37: DemDTCRef=DemDTC_ECU5_DTC37, DemComponentClassRef=DemComponent_ECU5_DTC37
          DemDebounceAlgorithmClass
            DemDebounceCounterBasedClass (DemDebounceCounterBased): DemDebounceCounterBasedClassRef=DemDebounceCounterBasedClass_LostCom
          DemRbEventClass: DemRbEventBufferTime=0, DemRbEventRecoverableInSameOperationCycle=true, DemRbEventStatusBitStorageTestFailed=true
        DemEventParameter_ECU5_DTC38: DemComponentClassRef=DemComponent_ECU5_DTC38, DemDTCRef=DemDTC_ECU5_DTC38
          DemEventClassRB (DemRbEventClass): DemRbEventBufferTime=0
          DemDebounceAlgorithmClass
            DemDebounceCounterBasedClass (DemDebounceCounterBased): DemDebounceCounterBasedClassRef=DemDebounceCounterBasedClass_LostCom
        DemEventParameter_ECU5_DTC39: DemDTCRef=DemDTC_ECU5_DTC39, DemComponentClassRef=DemComponent_ECU5_DTC39
          DemDebounceAlgorithmClass
            DemDebounceCounterBasedClass (DemDebounceCounterBased): DemDebounceCounterBasedClassRef=DemDebounceCounterBasedClass_LostCom
          DemRbEventClass: DemRbEventBufferTime=0, DemRbEventRecoverableInSameOperationCycle=true, DemRbEventStatusBitStorageTestFailed=true
        DemEventParameter_ECU5_DTC40: DemDTCRef=DemDTC_ECU5_DTC40, DemComponentClassRef=DemComponent_ECU5_DTC40
          DemDebounceAlgorithmClass
            DemDebounceCounterBasedClass (DemDebounceCounterBased): DemDebounceCounterBasedClassRef=DemDebounceCounterBasedClass_LostCom
          DemRbEventClass: DemRbEventBufferTime=0, DemRbEventRecoverableInSameOperationCycle=true, DemRbEventStatusBitStorageTestFailed=true
        DemEventParameter_ECU5_DTC41: DemDTCRef=DemDTC_ECU5_DTC41, DemComponentClassRef=DemComponent_ECU5_DTC41
          DemDebounceAlgorithmClass
            DemDebounceCounterBasedClass (DemDebounceCounterBased): DemDebounceCounterBasedClassRef=DemDebounceCounterBasedClass_LostCom
          DemRbEventClass: DemRbEventBufferTime=0, DemRbEventRecoverableInSameOperationCycle=true, DemRbEventStatusBitStorageTestFailed=true
          DemIndicatorAttribute:
            DemIndicatorFailureCycleCounterThreshold = 2
            DemRbIndicatorApiControl = false
            DemIndicatorBehaviour = DEM_INDICATOR_CONTINUOUS
            DemIndicatorHealingCycleCounterThreshold = 3
            DemIndicatorRef = MIL
        DemEventParameter_ECU5_DTC42: DemDTCRef=DemDTC_ECU5_DTC42, DemComponentClassRef=DemComponent_ECU5_DTC42
          DemDebounceAlgorithmClass
            DemDebounceCounterBasedClass (DemDebounceCounterBased): DemDebounceCounterBasedClassRef=DemDebounceCounterBasedClass_LostCom
          DemRbEventClass: DemRbEventBufferTime=0, DemRbEventRecoverableInSameOperationCycle=true, DemRbEventStatusBitStorageTestFailed=true
          DemIndicatorAttribute:
            DemIndicatorFailureCycleCounterThreshold = 2
            DemRbIndicatorApiControl = false
            DemIndicatorBehaviour = DEM_INDICATOR_CONTINUOUS
            DemIndicatorHealingCycleCounterThreshold = 3
            DemIndicatorRef = MIL
        DemEventParameter_ECU5_DTC43: DemDTCRef=DemDTC_ECU5_DTC43, DemComponentClassRef=DemComponent_ECU5_DTC43
          DemDebounceAlgorithmClass
            DemDebounceCounterBasedClass (DemDebounceCounterBased): DemDebounceCounterBasedClassRef=DemDebounceCounterBasedClass_LostCom
          DemRbEventClass: DemRbEventBufferTime=0, DemRbEventRecoverableInSameOperationCycle=true, DemRbEventStatusBitStorageTestFailed=true
          DemIndicatorAttribute:
            DemIndicatorFailureCycleCounterThreshold = 2
            DemRbIndicatorApiControl = false
            DemIndicatorBehaviour = DEM_INDICATOR_CONTINUOUS
            DemIndicatorHealingCycleCounterThreshold = 3
            DemIndicatorRef = MIL
        DemEventParameter_ECU5_DTC44: DemDTCRef=DemDTC_ECU5_DTC44, DemComponentClassRef=DemComponent_ECU5_DTC44
          DemDebounceAlgorithmClass
            DemDebounceCounterBasedClass (DemDebounceCounterBased): DemDebounceCounterBasedClassRef=DemDebounceCounterBasedClass_LostCom
          DemRbEventClass: DemRbEventBufferTime=0, DemRbEventRecoverableInSameOperationCycle=true, DemRbEventStatusBitStorageTestFailed=true
          DemIndicatorAttribute:
            DemIndicatorFailureCycleCounterThreshold = 2
            DemRbIndicatorApiControl = false
            DemIndicatorBehaviour = DEM_INDICATOR_CONTINUOUS
            DemIndicatorHealingCycleCounterThreshold = 3
            DemIndicatorRef = MIL
        DemEventParameter_ECU5_DTC45: DemDTCRef=DemDTC_ECU5_DTC45, DemComponentClassRef=DemComponent_ECU5_DTC45
          DemDebounceAlgorithmClass
            DemDebounceCounterBasedClass (DemDebounceCounterBased): DemDebounceCounterBasedClassRef=DemDebounceCounterBasedClass_LostCom
          DemRbEventClass: DemRbEventBufferTime=0, DemRbEventRecoverableInSameOperationCycle=true, DemRbEventStatusBitStorageTestFailed=true
          DemIndicatorAttribute:
            DemIndicatorFailureCycleCounterThreshold = 2
            DemRbIndicatorApiControl = false
            DemIndicatorBehaviour = DEM_INDICATOR_CONTINUOUS
            DemIndicatorHealingCycleCounterThreshold = 3
            DemIndicatorRef = MIL
        DemEventParameter_ECU5_DTC46: DemDTCRef=DemDTC_ECU5_DTC46, DemComponentClassRef=DemComponent_ECU5_DTC46
          DemDebounceAlgorithmClass
            DemDebounceCounterBasedClass (DemDebounceCounterBased): DemDebounceCounterBasedClassRef=DemDebounceCounterBasedClass_LostCom
          DemRbEventClass: DemRbEventBufferTime=0, DemRbEventRecoverableInSameOperationCycle=true, DemRbEventStatusBitStorageTestFailed=true
          DemIndicatorAttribute:
            DemIndicatorFailureCycleCounterThreshold = 2
            DemRbIndicatorApiControl = false
            DemIndicatorBehaviour = DEM_INDICATOR_CONTINUOUS
            DemIndicatorHealingCycleCounterThreshold = 3
            DemIndicatorRef = MIL
        DemEventParameter_ECU5_DTC47: DemDTCRef=DemDTC_ECU5_DTC47, DemComponentClassRef=DemComponent_ECU5_DTC47
          DemDebounceAlgorithmClass
            DemDebounceCounterBasedClass (DemDebounceCounterBased): DemDebounceCounterBasedClassRef=DemDebounceCounterBasedClass_LostCom
          DemRbEventClass: DemRbEventBufferTime=0, DemRbEventRecoverableInSameOperationCycle=true, DemRbEventStatusBitStorageTestFailed=true
          DemIndicatorAttribute:
            DemIndicatorFailureCycleCounterThreshold = 2
            DemRbIndicatorApiControl = false
            DemIndicatorBehaviour = DEM_INDICATOR_CONTINUOUS
            DemIndicatorHealingCycleCounterThreshold = 3
            DemIndicatorRef = MIL
        DemEventParameter_ECU5_DTC48: DemDTCRef=DemDTC_ECU5_DTC48, DemComponentClassRef=DemComponent_ECU5_DTC48
          DemDebounceAlgorithmClass
            DemDebounceCounterBasedClass (DemDebounceCounterBased): DemDebounceCounterBasedClassRef=DemDebounceCounterBasedClass_LostCom
          DemRbEventClass: DemRbEventBufferTime=0, DemRbEventRecoverableInSameOperationCycle=true, DemRbEventStatusBitStorageTestFailed=true
          DemIndicatorAttribute:
            DemIndicatorFailureCycleCounterThreshold = 2
            DemRbIndicatorApiControl = false
            DemIndicatorBehaviour = DEM_INDICATOR_CONTINUOUS
            DemIndicatorHealingCycleCounterThreshold = 3
            DemIndicatorRef = MIL
        DemEventParameter_ECU5_DTC49: DemDTCRef=DemDTC_ECU5_DTC49, DemComponentClassRef=DemComponent_ECU5_DTC49
          DemDebounceAlgorithmClass
            DemDebounceCounterBasedClass (DemDebounceCounterBased): DemDebounceCounterBasedClassRef=DemDebounceCounterBasedClass_LostCom
          DemRbEventClass: DemRbEventBufferTime=0, DemRbEventRecoverableInSameOperationCycle=true, DemRbEventStatusBitStorageTestFailed=true
        DemEventParameter_ECU5_DTC50: DemDTCRef=DemDTC_ECU5_DTC50, DemComponentClassRef=DemComponent_ECU5_DTC50
          DemDebounceAlgorithmClass
            DemDebounceCounterBasedClass (DemDebounceCounterBased): DemDebounceCounterBasedClassRef=DemDebounceCounterBasedClass_LostCom
          DemRbEventClass: DemRbEventBufferTime=0, DemRbEventRecoverableInSameOperationCycle=true, DemRbEventStatusBitStorageTestFailed=true
          DemIndicatorAttribute:
            DemIndicatorFailureCycleCounterThreshold = 2
            DemRbIndicatorApiControl = false
            DemIndicatorBehaviour = DEM_INDICATOR_BLINK_CONT
            DemIndicatorHealingCycleCounterThreshold = 3
            DemIndicatorRef = MIL
        DemEventParameter_ECU5_DTC51: DemDTCRef=DemDTC_ECU5_DTC51, DemComponentClassRef=DemComponent_ECU5_DTC51
          DemDebounceAlgorithmClass
            DemDebounceCounterBasedClass (DemDebounceCounterBased): DemDebounceCounterBasedClassRef=DemDebounceCounterBasedClass_LostCom
          DemRbEventClass: DemRbEventBufferTime=0, DemRbEventRecoverableInSameOperationCycle=true, DemRbEventStatusBitStorageTestFailed=true
          DemIndicatorAttribute:
            DemIndicatorFailureCycleCounterThreshold = 2
            DemRbIndicatorApiControl = false
            DemIndicatorBehaviour = DEM_INDICATOR_BLINK_CONT
            DemIndicatorHealingCycleCounterThreshold = 3
            DemIndicatorRef = MIL
        DemEventParameter_ECU5_DTC52: DemDTCRef=DemDTC_ECU5_DTC52, DemComponentClassRef=DemComponent_ECU5_DTC52
          DemDebounceAlgorithmClass
            DemDebounceCounterBasedClass (DemDebounceCounterBased): DemDebounceCounterBasedClassRef=DemDebounceCounterBasedClass_LostCom
          DemRbEventClass: DemRbEventBufferTime=0, DemRbEventRecoverableInSameOperationCycle=true, DemRbEventStatusBitStorageTestFailed=true
          DemIndicatorAttribute:
            DemIndicatorFailureCycleCounterThreshold = 2
            DemRbIndicatorApiControl = false
            DemIndicatorBehaviour = DEM_INDICATOR_BLINK_CONT
            DemIndicatorHealingCycleCounterThreshold = 3
            DemIndicatorRef = MIL
        DemEventParameter_ECU5_DTC53: DemComponentClassRef=DemComponent_ECU5_DTC53, DemDTCRef=DemDTC_ECU5_DTC53
          DemEventClassRB (DemRbEventClass): DemRbEventBufferTime=0
          DemDebounceAlgorithmClass
            DemDebounceCounterBasedClass (DemDebounceCounterBased): DemDebounceCounterBasedClassRef=DemDebounceCounterBasedClass_LostCom
          DemIndicatorAttribute:
            DemIndicatorFailureCycleCounterThreshold = 2
            DemRbIndicatorApiControl = false
            DemIndicatorBehaviour = DEM_INDICATOR_BLINK_CONT
            DemIndicatorHealingCycleCounterThreshold = 3
            DemIndicatorRef = MIL
        DemEventParameter_ECU5_DTC54: DemComponentClassRef=DemComponent_ECU5_DTC54, DemDTCRef=DemDTC_ECU5_DTC54
          DemEventClassRB (DemRbEventClass): DemRbEventBufferTime=0
          DemDebounceAlgorithmClass
            DemDebounceCounterBasedClass (DemDebounceCounterBased): DemDebounceCounterBasedClassRef=DemDebounceCounterBasedClass_LostCom
          DemIndicatorAttribute:
            DemIndicatorFailureCycleCounterThreshold = 2
            DemRbIndicatorApiControl = false
            DemIndicatorBehaviour = DEM_INDICATOR_BLINK_CONT
            DemIndicatorHealingCycleCounterThreshold = 3
            DemIndicatorRef = MIL
        DemEventParameter_ECU5_DTC55: DemComponentClassRef=DemComponent_ECU5_DTC55, DemDTCRef=DemDTC_ECU5_DTC55
          DemEventClassRB (DemRbEventClass): DemRbEventBufferTime=0
          DemDebounceAlgorithmClass
            DemDebounceCounterBasedClass (DemDebounceCounterBased): DemDebounceCounterBasedClassRef=DemDebounceCounterBasedClass_LostCom
        DemEventParameter_ECU5_DTC56: DemComponentClassRef=DemComponent_ECU5_DTC56, DemDTCRef=DemDTC_ECU5_DTC56
          DemEventClassRB (DemRbEventClass): DemRbEventBufferTime=0
          DemDebounceAlgorithmClass
            DemDebounceCounterBasedClass (DemDebounceCounterBased): DemDebounceCounterBasedClassRef=DemDebounceCounterBasedClass_LostCom
        DemEventParameter_ECU5_DTC57: DemComponentClassRef=DemComponent_ECU5_DTC57, DemDTCRef=DemDTC_ECU5_DTC57
          DemEventClassRB (DemRbEventClass): DemRbEventBufferTime=0
          DemDebounceAlgorithmClass
            DemDebounceCounterBasedClass (DemDebounceCounterBased): DemDebounceCounterBasedClassRef=DemDebounceCounterBasedClass_LostCom
        DemEventParameter_ECU5_DTC58: DemComponentClassRef=DemComponent_ECU5_DTC58, DemDTCRef=DemDTC_ECU5_DTC58
          DemEventClassRB (DemRbEventClass): DemRbEventBufferTime=0
          DemDebounceAlgorithmClass
            DemDebounceCounterBasedClass (DemDebounceCounterBased): DemDebounceCounterBasedClassRef=DemDebounceCounterBasedClass_LostCom
        DemEventParameter_ECU5_DTC59: DemComponentClassRef=DemComponent_ECU5_DTC59, DemDTCRef=DemDTC_ECU5_DTC59
          DemEventClassRB (DemRbEventClass): DemRbEventBufferTime=0
          DemDebounceAlgorithmClass
            DemDebounceCounterBasedClass (DemDebounceCounterBased): DemDebounceCounterBasedClassRef=DemDebounceCounterBasedClass_LostCom
          DemIndicatorAttribute:
            DemIndicatorFailureCycleCounterThreshold = 2
            DemRbIndicatorApiControl = false
            DemIndicatorBehaviour = DEM_INDICATOR_CONTINUOUS
            DemIndicatorHealingCycleCounterThreshold = 3
            DemIndicatorRef = MIL
        DemEventParameter_ECU5_DTC60: DemComponentClassRef=DemComponent_ECU5_DTC60, DemDTCRef=DemDTC_ECU5_DTC60
          DemEventClassRB (DemRbEventClass): DemRbEventBufferTime=0
          DemDebounceAlgorithmClass
            DemDebounceCounterBasedClass (DemDebounceCounterBased): DemDebounceCounterBasedClassRef=DemDebounceCounterBasedClass_LostCom
          DemIndicatorAttribute:
            DemIndicatorFailureCycleCounterThreshold = 2
            DemRbIndicatorApiControl = false
            DemIndicatorBehaviour = DEM_INDICATOR_CONTINUOUS
            DemIndicatorHealingCycleCounterThreshold = 3
            DemIndicatorRef = MIL
        DemEventParameter_ECU5_DTC61: DemComponentClassRef=DemComponent_ECU5_DTC61, DemDTCRef=DemDTC_ECU5_DTC61
          DemEventClassRB (DemRbEventClass): DemRbEventBufferTime=0
          DemDebounceAlgorithmClass
            DemDebounceCounterBasedClass (DemDebounceCounterBased): DemDebounceCounterBasedClassRef=DemDebounceCounterBasedClass_LostCom
          DemIndicatorAttribute:
            DemIndicatorFailureCycleCounterThreshold = 2
            DemRbIndicatorApiControl = false
            DemIndicatorBehaviour = DEM_INDICATOR_CONTINUOUS
            DemIndicatorHealingCycleCounterThreshold = 3
            DemIndicatorRef = MIL
        DemEventParameter_ECU5_DTC62: DemComponentClassRef=DemComponent_ECU5_DTC62, DemDTCRef=DemDTC_ECU5_DTC62
          DemEventClassRB (DemRbEventClass): DemRbEventBufferTime=0
          DemDebounceAlgorithmClass
            DemDebounceCounterBasedClass (DemDebounceCounterBased): DemDebounceCounterBasedClassRef=DemDebounceCounterBasedClass_LostCom
          DemIndicatorAttribute:
            DemIndicatorFailureCycleCounterThreshold = 2
            DemRbIndicatorApiControl = false
            DemIndicatorBehaviour = DEM_INDICATOR_BLINK_CONT
            DemIndicatorHealingCycleCounterThreshold = 3
            DemIndicatorRef = MIL
        DemEventParameter_ECU5_DTC63: DemComponentClassRef=DemComponent_ECU5_DTC63, DemDTCRef=DemDTC_ECU5_DTC63
          DemEventClassRB (DemRbEventClass): DemRbEventBufferTime=0
          DemDebounceAlgorithmClass
            DemDebounceCounterBasedClass (DemDebounceCounterBased): DemDebounceCounterBasedClassRef=DemDebounceCounterBasedClass_LostCom
          DemIndicatorAttribute:
            DemIndicatorFailureCycleCounterThreshold = 2
            DemRbIndicatorApiControl = false
            DemIndicatorBehaviour = DEM_INDICATOR_BLINK_CONT
            DemIndicatorHealingCycleCounterThreshold = 3
            DemIndicatorRef = MIL
        DemEventParameter_ECU5_DTC64: DemComponentClassRef=DemComponent_ECU5_DTC64, DemDTCRef=DemDTC_ECU5_DTC64
          DemEventClassRB (DemRbEventClass): DemRbEventBufferTime=0
          DemDebounceAlgorithmClass
            DemDebounceCounterBasedClass (DemDebounceCounterBased): DemDebounceCounterBasedClassRef=DemDebounceCounterBasedClass_LostCom
        DemEventParameter_ECU5_DTC65: DemComponentClassRef=DemComponent_ECU5_DTC65, DemDTCRef=DemDTC_ECU5_DTC65
          DemEventClassRB (DemRbEventClass): DemRbEventBufferTime=0
          DemDebounceAlgorithmClass
            DemDebounceCounterBasedClass (DemDebounceCounterBased): DemDebounceCounterBasedClassRef=DemDebounceCounterBasedClass_LostCom
        DemEventParameter_ECU5_DTC66: DemComponentClassRef=DemComponent_ECU5_DTC66, DemDTCRef=DemDTC_ECU5_DTC66
          DemEventClassRB (DemRbEventClass): DemRbEventBufferTime=0
          DemDebounceAlgorithmClass
            DemDebounceCounterBasedClass (DemDebounceCounterBased): DemDebounceCounterBasedClassRef=DemDebounceCounterBasedClass_LostCom
        DemEventParameter_ECU5_DTC67: DemComponentClassRef=DemComponent_ECU5_DTC67, DemDTCRef=DemDTC_ECU5_DTC67
          DemEventClassRB (DemRbEventClass): DemRbEventBufferTime=0
          DemDebounceAlgorithmClass
            DemDebounceCounterBasedClass (DemDebounceCounterBased): DemDebounceCounterBasedClassRef=DemDebounceCounterBasedClass_LostCom
          DemIndicatorAttribute:
            DemIndicatorFailureCycleCounterThreshold = 2
            DemRbIndicatorApiControl = false
            DemIndicatorBehaviour = DEM_INDICATOR_CONTINUOUS
            DemIndicatorHealingCycleCounterThreshold = 3
            DemIndicatorRef = MIL
        DemEventParameter_ECU5_DTC68: DemDTCRef=DemDTC_ECU5_DTC68, DemComponentClassRef=DemComponent_ECU5_DTC68
          DemDebounceAlgorithmClass
            DemDebounceCounterBasedClass (DemDebounceCounterBased): DemDebounceCounterBasedClassRef=DemDebounceCounterBasedClass_LostCom
          DemRbEventClass: DemRbEventBufferTime=0, DemRbEventRecoverableInSameOperationCycle=true, DemRbEventStatusBitStorageTestFailed=true
        DemEventParameter_ECU5_DTC69: DemDTCRef=DemDTC_ECU5_DTC69, DemComponentClassRef=DemComponent_ECU5_DTC69
          DemDebounceAlgorithmClass
            DemDebounceCounterBasedClass (DemDebounceCounterBased): DemDebounceCounterBasedClassRef=DemDebounceCounterBasedClass_LostCom
          DemRbEventClass: DemRbEventBufferTime=0, DemRbEventRecoverableInSameOperationCycle=true, DemRbEventStatusBitStorageTestFailed=true
        DemEventParameter_ECU5_DTC70: DemDTCRef=DemDTC_ECU5_DTC70, DemComponentClassRef=DemComponent_ECU5_DTC70
          DemDebounceAlgorithmClass
            DemDebounceCounterBasedClass (DemDebounceCounterBased): DemDebounceCounterBasedClassRef=DemDebounceCounterBasedClass_LostCom
          DemRbEventClass: DemRbEventBufferTime=0, DemRbEventRecoverableInSameOperationCycle=true, DemRbEventStatusBitStorageTestFailed=true
          DemIndicatorAttribute:
            DemIndicatorFailureCycleCounterThreshold = 2
            DemRbIndicatorApiControl = false
            DemIndicatorBehaviour = DEM_INDICATOR_BLINK_CONT
            DemIndicatorHealingCycleCounterThreshold = 3
            DemIndicatorRef = MIL
        DemEventParameter_ECU5_DTC71: DemDTCRef=DemDTC_ECU5_DTC71, DemComponentClassRef=DemComponent_ECU5_DTC71
          DemDebounceAlgorithmClass
            DemDebounceCounterBasedClass (DemDebounceCounterBased): DemDebounceCounterBasedClassRef=DemDebounceCounterBasedClass_LostCom
          DemRbEventClass: DemRbEventBufferTime=0, DemRbEventRecoverableInSameOperationCycle=true, DemRbEventStatusBitStorageTestFailed=true
          DemIndicatorAttribute:
            DemIndicatorFailureCycleCounterThreshold = 2
            DemRbIndicatorApiControl = false
            DemIndicatorBehaviour = DEM_INDICATOR_BLINK_CONT
            DemIndicatorHealingCycleCounterThreshold = 3
            DemIndicatorRef = MIL
        DemEventParameter_ECU5_DTC72: DemDTCRef=DemDTC_ECU5_DTC72, DemComponentClassRef=DemComponent_ECU5_DTC72
          DemDebounceAlgorithmClass
            DemDebounceCounterBasedClass (DemDebounceCounterBased): DemDebounceCounterBasedClassRef=DemDebounceCounterBasedClass_LostCom
          DemRbEventClass: DemRbEventBufferTime=0, DemRbEventRecoverableInSameOperationCycle=true, DemRbEventStatusBitStorageTestFailed=true
          DemIndicatorAttribute:
            DemIndicatorFailureCycleCounterThreshold = 2
            DemRbIndicatorApiControl = false
            DemIndicatorBehaviour = DEM_INDICATOR_BLINK_CONT
            DemIndicatorHealingCycleCounterThreshold = 3
            DemIndicatorRef = MIL
        DemEventParameter_ECU5_DTC73: DemComponentClassRef=DemComponent_ECU5_DTC73, DemDTCRef=DemDTC_ECU5_DTC73
          DemEventClassRB (DemRbEventClass): DemRbEventBufferTime=0
          DemDebounceAlgorithmClass
            DemDebounceCounterBasedClass (DemDebounceCounterBased): DemDebounceCounterBasedClassRef=DemDebounceCounterBasedClass_LostCom
          DemIndicatorAttribute:
            DemIndicatorFailureCycleCounterThreshold = 2
            DemRbIndicatorApiControl = false
            DemIndicatorBehaviour = DEM_INDICATOR_BLINK_CONT
            DemIndicatorHealingCycleCounterThreshold = 3
            DemIndicatorRef = MIL
        DemEventParameter_ECU5_DTC74: DemComponentClassRef=DemComponent_ECU5_DTC74, DemDTCRef=DemDTC_ECU5_DTC74
          DemEventClassRB (DemRbEventClass): DemRbEventBufferTime=0
          DemDebounceAlgorithmClass
            DemDebounceCounterBasedClass (DemDebounceCounterBased): DemDebounceCounterBasedClassRef=DemDebounceCounterBasedClass_LostCom
          DemIndicatorAttribute:
            DemIndicatorFailureCycleCounterThreshold = 2
            DemRbIndicatorApiControl = false
            DemIndicatorBehaviour = DEM_INDICATOR_BLINK_CONT
            DemIndicatorHealingCycleCounterThreshold = 3
            DemIndicatorRef = MIL
        DemEventParameter_ECU5_DTC75: DemComponentClassRef=DemComponent_ECU5_DTC75, DemDTCRef=DemDTC_ECU5_DTC75
          DemEventClassRB (DemRbEventClass): DemRbEventBufferTime=0
          DemDebounceAlgorithmClass
            DemDebounceCounterBasedClass (DemDebounceCounterBased): DemDebounceCounterBasedClassRef=DemDebounceCounterBasedClass_LostCom
        DemEventParameter_ECU5_DTC76: DemComponentClassRef=DemComponent_ECU5_DTC76, DemDTCRef=DemDTC_ECU5_DTC76
          DemEventClassRB (DemRbEventClass): DemRbEventBufferTime=0
          DemDebounceAlgorithmClass
            DemDebounceCounterBasedClass (DemDebounceCounterBased): DemDebounceCounterBasedClassRef=DemDebounceCounterBasedClass_LostCom
        DemEventParameter_ECU5_DTC77: DemComponentClassRef=DemComponent_ECU5_DTC77, DemDTCRef=DemDTC_ECU5_DTC77
          DemEventClassRB (DemRbEventClass): DemRbEventBufferTime=0
          DemDebounceAlgorithmClass
            DemDebounceCounterBasedClass (DemDebounceCounterBased): DemDebounceCounterBasedClassRef=DemDebounceCounterBasedClass_LostCom
        DemEventParameter_ECU5_DTC78: DemComponentClassRef=DemComponent_ECU5_DTC78, DemDTCRef=DemDTC_ECU5_DTC78
          DemEventClassRB (DemRbEventClass): DemRbEventBufferTime=0
          DemDebounceAlgorithmClass
            DemDebounceCounterBasedClass (DemDebounceCounterBased): DemDebounceCounterBasedClassRef=DemDebounceCounterBasedClass_LostCom
        DemEventParameter_ECU5_DTC79: DemComponentClassRef=DemComponent_ECU5_DTC79, DemDTCRef=DemDTC_ECU5_DTC79
          DemEventClassRB (DemRbEventClass): DemRbEventBufferTime=0
          DemDebounceAlgorithmClass
            DemDebounceCounterBasedClass (DemDebounceCounterBased): DemDebounceCounterBasedClassRef=DemDebounceCounterBasedClass_LostCom
          DemIndicatorAttribute:
            DemIndicatorFailureCycleCounterThreshold = 2
            DemRbIndicatorApiControl = false
            DemIndicatorBehaviour = DEM_INDICATOR_CONTINUOUS
            DemIndicatorHealingCycleCounterThreshold = 3
            DemIndicatorRef = MIL
        DemEventParameter_ECU5_DTC80: DemComponentClassRef=DemComponent_ECU5_DTC80, DemDTCRef=DemDTC_ECU5_DTC80
          DemEventClassRB (DemRbEventClass): DemRbEventBufferTime=0
          DemDebounceAlgorithmClass
            DemDebounceCounterBasedClass (DemDebounceCounterBased): DemDebounceCounterBasedClassRef=DemDebounceCounterBasedClass_LostCom
          DemIndicatorAttribute:
            DemIndicatorFailureCycleCounterThreshold = 2
            DemRbIndicatorApiControl = false
            DemIndicatorBehaviour = DEM_INDICATOR_CONTINUOUS
            DemIndicatorHealingCycleCounterThreshold = 3
            DemIndicatorRef = MIL
        DemEventParameter_ECU5_DTC81: DemComponentClassRef=DemComponent_ECU5_DTC81, DemDTCRef=DemDTC_ECU5_DTC81
          DemEventClassRB (DemRbEventClass): DemRbEventBufferTime=0
          DemDebounceAlgorithmClass
            DemDebounceCounterBasedClass (DemDebounceCounterBased): DemDebounceCounterBasedClassRef=DemDebounceCounterBasedClass_LostCom
          DemIndicatorAttribute:
            DemIndicatorFailureCycleCounterThreshold = 2
            DemRbIndicatorApiControl = false
            DemIndicatorBehaviour = DEM_INDICATOR_CONTINUOUS
            DemIndicatorHealingCycleCounterThreshold = 3
            DemIndicatorRef = MIL
        DemEventParameter_ECU5_DTC82: DemComponentClassRef=DemComponent_ECU5_DTC82, DemDTCRef=DemDTC_ECU5_DTC82
          DemEventClassRB (DemRbEventClass): DemRbEventBufferTime=0
          DemDebounceAlgorithmClass
            DemDebounceCounterBasedClass (DemDebounceCounterBased): DemDebounceCounterBasedClassRef=DemDebounceCounterBasedClass_LostCom
          DemIndicatorAttribute:
            DemIndicatorFailureCycleCounterThreshold = 2
            DemRbIndicatorApiControl = false
            DemIndicatorBehaviour = DEM_INDICATOR_BLINK_CONT
            DemIndicatorHealingCycleCounterThreshold = 3
            DemIndicatorRef = MIL
        DemEventParameter_ECU5_DTC83: DemComponentClassRef=DemComponent_ECU5_DTC83, DemDTCRef=DemDTC_ECU5_DTC83
          DemEventClassRB (DemRbEventClass): DemRbEventBufferTime=0
          DemDebounceAlgorithmClass
            DemDebounceCounterBasedClass (DemDebounceCounterBased): DemDebounceCounterBasedClassRef=DemDebounceCounterBasedClass_LostCom
          DemIndicatorAttribute:
            DemIndicatorFailureCycleCounterThreshold = 2
            DemRbIndicatorApiControl = false
            DemIndicatorBehaviour = DEM_INDICATOR_BLINK_CONT
            DemIndicatorHealingCycleCounterThreshold = 3
            DemIndicatorRef = MIL
        DemEventParameter_ECU5_DTC84: DemComponentClassRef=DemComponent_ECU5_DTC84, DemDTCRef=DemDTC_ECU5_DTC84
          DemEventClassRB (DemRbEventClass): DemRbEventBufferTime=0
          DemDebounceAlgorithmClass
            DemDebounceCounterBasedClass (DemDebounceCounterBased): DemDebounceCounterBasedClassRef=DemDebounceCounterBasedClass_LostCom
        DemEventParameter_ECU5_DTC85: DemComponentClassRef=DemComponent_ECU5_DTC85, DemDTCRef=DemDTC_ECU5_DTC85
          DemEventClassRB (DemRbEventClass): DemRbEventBufferTime=0
          DemDebounceAlgorithmClass
            DemDebounceCounterBasedClass (DemDebounceCounterBased): DemDebounceCounterBasedClassRef=DemDebounceCounterBasedClass_LostCom
        DemEventParameter_ECU5_DTC86: DemComponentClassRef=DemComponent_ECU5_DTC86, DemDTCRef=DemDTC_ECU5_DTC86
          DemEventClassRB (DemRbEventClass): DemRbEventBufferTime=0
          DemDebounceAlgorithmClass
            DemDebounceCounterBasedClass (DemDebounceCounterBased): DemDebounceCounterBasedClassRef=DemDebounceCounterBasedClass_LostCom
        DemEventParameter_ECU5_DTC87: DemComponentClassRef=DemComponent_ECU5_DTC87, DemDTCRef=DemDTC_ECU5_DTC87
          DemEventClassRB (DemRbEventClass): DemRbEventBufferTime=0
          DemDebounceAlgorithmClass
            DemDebounceCounterBasedClass (DemDebounceCounterBased): DemDebounceCounterBasedClassRef=DemDebounceCounterBasedClass_LostCom
          DemIndicatorAttribute:
            DemIndicatorFailureCycleCounterThreshold = 2
            DemRbIndicatorApiControl = false
            DemIndicatorBehaviour = DEM_INDICATOR_CONTINUOUS
            DemIndicatorHealingCycleCounterThreshold = 3
            DemIndicatorRef = MIL
        DemEventParameter_ECU5_DTC88: DemDTCRef=DemDTC_ECU5_DTC88, DemComponentClassRef=DemComponent_ECU5_DTC88
          DemDebounceAlgorithmClass
            DemDebounceCounterBasedClass (DemDebounceCounterBased): DemDebounceCounterBasedClassRef=DemDebounceCounterBasedClass_LostCom
          DemRbEventClass: DemRbEventBufferTime=0, DemRbEventRecoverableInSameOperationCycle=true, DemRbEventStatusBitStorageTestFailed=true
        DemEventParameter_ECU5_DTC89: DemDTCRef=DemDTC_ECU5_DTC89, DemComponentClassRef=DemComponent_ECU5_DTC89
          DemDebounceAlgorithmClass
            DemDebounceCounterBasedClass (DemDebounceCounterBased): DemDebounceCounterBasedClassRef=DemDebounceCounterBasedClass_LostCom
          DemRbEventClass: DemRbEventBufferTime=0, DemRbEventRecoverableInSameOperationCycle=true, DemRbEventStatusBitStorageTestFailed=true
        DemEventParameter_ECU5_DTC90: DemDTCRef=DemDTC_ECU5_DTC90, DemComponentClassRef=DemComponent_ECU5_DTC90
          DemDebounceAlgorithmClass
            DemDebounceCounterBasedClass (DemDebounceCounterBased): DemDebounceCounterBasedClassRef=DemDebounceCounterBasedClass_LostCom
          DemRbEventClass: DemRbEventBufferTime=0, DemRbEventRecoverableInSameOperationCycle=true, DemRbEventStatusBitStorageTestFailed=true
          DemIndicatorAttribute:
            DemIndicatorFailureCycleCounterThreshold = 2
            DemRbIndicatorApiControl = false
            DemIndicatorBehaviour = DEM_INDICATOR_BLINK_CONT
            DemIndicatorHealingCycleCounterThreshold = 3
            DemIndicatorRef = MIL
        DemEventParameter_ECU5_DTC91: DemDTCRef=DemDTC_ECU5_DTC91, DemComponentClassRef=DemComponent_ECU5_DTC91
          DemDebounceAlgorithmClass
            DemDebounceCounterBasedClass (DemDebounceCounterBased): DemDebounceCounterBasedClassRef=DemDebounceCounterBasedClass_LostCom
          DemRbEventClass: DemRbEventBufferTime=0, DemRbEventRecoverableInSameOperationCycle=true, DemRbEventStatusBitStorageTestFailed=true
          DemIndicatorAttribute:
            DemIndicatorFailureCycleCounterThreshold = 2
            DemRbIndicatorApiControl = false
            DemIndicatorBehaviour = DEM_INDICATOR_BLINK_CONT
            DemIndicatorHealingCycleCounterThreshold = 3
            DemIndicatorRef = MIL
        DemEventParameter_ECU5_DTC92: DemDTCRef=DemDTC_ECU5_DTC92, DemComponentClassRef=DemComponent_ECU5_DTC92
          DemDebounceAlgorithmClass
            DemDebounceCounterBasedClass (DemDebounceCounterBased): DemDebounceCounterBasedClassRef=DemDebounceCounterBasedClass_LostCom
          DemRbEventClass: DemRbEventBufferTime=0, DemRbEventRecoverableInSameOperationCycle=true, DemRbEventStatusBitStorageTestFailed=true
          DemIndicatorAttribute:
            DemIndicatorFailureCycleCounterThreshold = 2
            DemRbIndicatorApiControl = false
            DemIndicatorBehaviour = DEM_INDICATOR_BLINK_CONT
            DemIndicatorHealingCycleCounterThreshold = 3
            DemIndicatorRef = MIL
        DemEventParameter_ECU5_DTC93: DemComponentClassRef=DemComponent_ECU5_DTC93, DemDTCRef=DemDTC_ECU5_DTC93
          DemEventClassRB (DemRbEventClass): DemRbEventBufferTime=0
          DemDebounceAlgorithmClass
            DemDebounceCounterBasedClass (DemDebounceCounterBased): DemDebounceCounterBasedClassRef=DemDebounceCounterBasedClass_LostCom
          DemIndicatorAttribute:
            DemIndicatorFailureCycleCounterThreshold = 2
            DemRbIndicatorApiControl = false
            DemIndicatorBehaviour = DEM_INDICATOR_BLINK_CONT
            DemIndicatorHealingCycleCounterThreshold = 3
            DemIndicatorRef = MIL
        DemEventParameter_ECU5_DTC94: DemComponentClassRef=DemComponent_ECU5_DTC94, DemDTCRef=DemDTC_ECU5_DTC94
          DemEventClassRB (DemRbEventClass): DemRbEventBufferTime=0
          DemDebounceAlgorithmClass
            DemDebounceCounterBasedClass (DemDebounceCounterBased): DemDebounceCounterBasedClassRef=DemDebounceCounterBasedClass_LostCom
          DemIndicatorAttribute:
            DemIndicatorFailureCycleCounterThreshold = 2
            DemRbIndicatorApiControl = false
            DemIndicatorBehaviour = DEM_INDICATOR_BLINK_CONT
            DemIndicatorHealingCycleCounterThreshold = 3
            DemIndicatorRef = MIL
        DemEventParameter_ECU5_DTC95: DemComponentClassRef=DemComponent_ECU5_DTC95, DemDTCRef=DemDTC_ECU5_DTC95
          DemEventClassRB (DemRbEventClass): DemRbEventBufferTime=0
          DemDebounceAlgorithmClass
            DemDebounceCounterBasedClass (DemDebounceCounterBased): DemDebounceCounterBasedClassRef=DemDebounceCounterBasedClass_LostCom
        DemEventParameter_ECU5_DTC96: DemComponentClassRef=DemComponent_ECU5_DTC96, DemDTCRef=DemDTC_ECU5_DTC96
          DemEventClassRB (DemRbEventClass): DemRbEventBufferTime=0
          DemDebounceAlgorithmClass
            DemDebounceCounterBasedClass (DemDebounceCounterBased): DemDebounceCounterBasedClassRef=DemDebounceCounterBasedClass_LostCom
        DemEventParameter_ECU5_DTC97: DemComponentClassRef=DemComponent_ECU5_DTC97, DemDTCRef=DemDTC_ECU5_DTC97
          DemEventClassRB (DemRbEventClass): DemRbEventBufferTime=0
          DemDebounceAlgorithmClass
            DemDebounceCounterBasedClass (DemDebounceCounterBased): DemDebounceCounterBasedClassRef=DemDebounceCounterBasedClass_LostCom
        DemEventParameter_ECU5_DTC98: DemComponentClassRef=DemComponent_ECU5_DTC98, DemDTCRef=DemDTC_ECU5_DTC98
          DemEventClassRB (DemRbEventClass): DemRbEventBufferTime=0
          DemDebounceAlgorithmClass
            DemDebounceCounterBasedClass (DemDebounceCounterBased): DemDebounceCounterBasedClassRef=DemDebounceCounterBasedClass_LostCom
        DemEventParameter_ECU5_DTC99: DemComponentClassRef=DemComponent_ECU5_DTC99, DemDTCRef=DemDTC_ECU5_DTC99
          DemEventClassRB (DemRbEventClass): DemRbEventBufferTime=0
          DemDebounceAlgorithmClass
            DemDebounceCounterBasedClass (DemDebounceCounterBased): DemDebounceCounterBasedClassRef=DemDebounceCounterBasedClass_LostCom
          DemIndicatorAttribute:
            DemIndicatorFailureCycleCounterThreshold = 2
            DemRbIndicatorApiControl = false
            DemIndicatorBehaviour = DEM_INDICATOR_CONTINUOUS
            DemIndicatorHealingCycleCounterThreshold = 3
            DemIndicatorRef = MIL
