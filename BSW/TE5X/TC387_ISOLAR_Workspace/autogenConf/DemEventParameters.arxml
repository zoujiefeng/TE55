[part 1 of 2: package /ETAS_Project/EcucModuleConfigurationValuess]
AUTOSAR XML (schema 00047)
package /ETAS_Project/EcucModuleConfigurationValuess
  module config Dem
    DemConfigSet
      500 x DemEventParameter, all with DemEventFailureCycleCounterThreshold=2, DemEventKind=DEM_EVENT_KIND_SWC, DemFFPrestorageSupported=false, DemReportBehavior=REPORT_AFTER_INIT, DemOperationCycleRef=DemOperationCycle_Ignition:
        DemEventParameter_ECU1_DTC00: DemComponentClassRef=DemComponent_ECU1_DTC00, DemDTCRef=DemDTC_ECU1_DTC00
          DemDebounceAlgorithmClass
            DemDebounceCounterBasedClass (DemDebounceCounterBased): DemDebounceCounterBasedClassRef=DemDebounceCounterBasedClass_LostCom
          DemIndicatorAttribute:
            DemIndicatorFailureCycleCounterThreshold = 2
            DemRbIndicatorApiControl = 0
            DemIndicatorHealingCycleCounterThreshold = 3
            DemIndicatorBehaviour = DEM_INDICATOR_CONTINUOUS
            DemIndicatorRef = MIL
          DemRbEventClass: DemRbEventBufferTime=0, DemRbEventRecoverableInSameOperationCycle=1, DemRbEventStatusBitStorageTestFailed=true
        DemEventParameter_ECU1_DTC01: DemDTCRef=DemDTC_ECU1_DTC01, DemComponentClassRef=DemComponent_ECU1_DTC01
          DemDebounceAlgorithmClass
            DemDebounceCounterBasedClass (DemDebounceCounterBased): DemDebounceCounterBasedClassRef=DemDebounceCounterBasedClass_LostCom
          DemRbEventClass: DemRbEventBufferTime=0, DemRbEventRecoverableInSameOperationCycle=true, DemRbEventStatusBitStorageTestFailed=true
          DemIndicatorAttribute:
            DemIndicatorFailureCycleCounterThreshold = 2
            DemRbIndicatorApiControl = false
            DemIndicatorBehaviour = DEM_INDICATOR_CONTINUOUS
            DemIndicatorHealingCycleCounterThreshold = 3
            DemIndicatorRef = MIL
        DemEventParameter_ECU1_DTC02: DemDTCRef=DemDTC_ECU1_DTC02, DemComponentClassRef=DemComponent_ECU1_DTC02
          DemDebounceAlgorithmClass
            DemDebounceCounterBasedClass (DemDebounceCounterBased): DemDebounceCounterBasedClassRef=DemDebounceCounterBasedClass_LostCom
          DemRbEventClass: DemRbEventBufferTime=0, DemRbEventRecoverableInSameOperationCycle=true, DemRbEventStatusBitStorageTestFailed=true
          DemIndicatorAttribute:
            DemIndicatorFailureCycleCounterThreshold = 2
            DemRbIndicatorApiControl = false
            DemIndicatorBehaviour = DEM_INDICATOR_CONTINUOUS
            DemIndicatorHealingCycleCounterThreshold = 3
            DemIndicatorRef = MIL
        DemEventParameter_ECU1_DTC03: DemDTCRef=DemDTC_ECU1_DTC03, DemComponentClassRef=DemComponent_ECU1_DTC03
          DemDebounceAlgorithmClass
            DemDebounceCounterBasedClass (DemDebounceCounterBased): DemDebounceCounterBasedClassRef=DemDebounceCounterBasedClass_LostCom
          DemRbEventClass: DemRbEventBufferTime=0, DemRbEventRecoverableInSameOperationCycle=true, DemRbEventStatusBitStorageTestFailed=true
          DemIndicatorAttribute:
            DemIndicatorFailureCycleCounterThreshold = 2
            DemRbIndicatorApiControl = false
            DemIndicatorBehaviour = DEM_INDICATOR_CONTINUOUS
            DemIndicatorHealingCycleCounterThreshold = 3
            DemIndicatorRef = MIL
        DemEventParameter_ECU1_DTC04: DemDTCRef=DemDTC_ECU1_DTC04, DemComponentClassRef=DemComponent_ECU1_DTC04
          DemDebounceAlgorithmClass
            DemDebounceCounterBasedClass (DemDebounceCounterBased): DemDebounceCounterBasedClassRef=DemDebounceCounterBasedClass_LostCom
          DemRbEventClass: DemRbEventBufferTime=0, DemRbEventRecoverableInSameOperationCycle=true, DemRbEventStatusBitStorageTestFailed=true
          DemIndicatorAttribute:
            DemIndicatorFailureCycleCounterThreshold = 2
            DemRbIndicatorApiControl = false
            DemIndicatorBehaviour = DEM_INDICATOR_BLINK_CONT
            DemIndicatorHealingCycleCounterThreshold = 3
            DemIndicatorRef = MIL
        DemEventParameter_ECU1_DTC05: DemDTCRef=DemDTC_ECU1_DTC05, DemComponentClassRef=DemComponent_ECU1_DTC05
          DemDebounceAlgorithmClass
            DemDebounceCounterBasedClass (DemDebounceCounterBased): DemDebounceCounterBasedClassRef=DemDebounceCounterBasedClass_LostCom
          DemRbEventClass: DemRbEventBufferTime=0, DemRbEventRecoverableInSameOperationCycle=true, DemRbEventStatusBitStorageTestFailed=true
          DemIndicatorAttribute:
            DemIndicatorFailureCycleCounterThreshold = 2
            DemRbIndicatorApiControl = false
            DemIndicatorBehaviour = DEM_INDICATOR_BLINK_CONT
            DemIndicatorHealingCycleCounterThreshold = 3
            DemIndicatorRef = MIL
        DemEventParameter_ECU1_DTC06: DemDTCRef=DemDTC_ECU1_DTC06, DemComponentClassRef=DemComponent_ECU1_DTC06
          DemDebounceAlgorithmClass
            DemDebounceCounterBasedClass (DemDebounceCounterBased): DemDebounceCounterBasedClassRef=DemDebounceCounterBasedClass_LostCom
          DemRbEventClass: DemRbEventBufferTime=0, DemRbEventRecoverableInSameOperationCycle=true, DemRbEventStatusBitStorageTestFailed=true
          DemIndicatorAttribute:
            DemIndicatorFailureCycleCounterThreshold = 2
            DemRbIndicatorApiControl = false
            DemIndicatorBehaviour = DEM_INDICATOR_BLINK_CONT
            DemIndicatorHealingCycleCounterThreshold = 3
            DemIndicatorRef = MIL
        DemEventParameter_ECU1_DTC07: DemDTCRef=DemDTC_ECU1_DTC07, DemComponentClassRef=DemComponent_ECU1_DTC07
          DemDebounceAlgorithmClass
            DemDebounceCounterBasedClass (DemDebounceCounterBased): DemDebounceCounterBasedClassRef=DemDebounceCounterBasedClass_LostCom
          DemRbEventClass: DemRbEventBufferTime=0, DemRbEventRecoverableInSameOperationCycle=true, DemRbEventStatusBitStorageTestFailed=true
          DemIndicatorAttribute:
            DemIndicatorFailureCycleCounterThreshold = 2
            DemRbIndicatorApiControl = false
            DemIndicatorBehaviour = DEM_INDICATOR_BLINK_CONT
            DemIndicatorHealingCycleCounterThreshold = 3
            DemIndicatorRef = MIL
        DemEventParameter_ECU1_DTC08: DemDTCRef=DemDTC_ECU1_DTC08, DemComponentClassRef=DemComponent_ECU1_DTC08
          DemDebounceAlgorithmClass
            DemDebounceCounterBasedClass (DemDebounceCounterBased): DemDebounceCounterBasedClassRef=DemDebounceCounterBasedClass_LostCom
          DemRbEventClass: DemRbEventBufferTime=0, DemRbEventRecoverableInSameOperationCycle=true, DemRbEventStatusBitStorageTestFailed=true
          DemIndicatorAttribute:
            DemIndicatorFailureCycleCounterThreshold = 2
            DemRbIndicatorApiControl = false
            DemIndicatorBehaviour = DEM_INDICATOR_BLINK_CONT
            DemIndicatorHealingCycleCounterThreshold = 3
            DemIndicatorRef = MIL
        DemEventParameter_ECU1_DTC09: DemDTCRef=DemDTC_ECU1_DTC09, DemComponentClassRef=DemComponent_ECU1_DTC09
          DemDebounceAlgorithmClass
            DemDebounceCounterBasedClass (DemDebounceCounterBased): DemDebounceCounterBasedClassRef=DemDebounceCounterBasedClass_LostCom
          DemRbEventClass: DemRbEventBufferTime=0, DemRbEventRecoverableInSameOperationCycle=true, DemRbEventStatusBitStorageTestFailed=true
          DemIndicatorAttribute:
            DemIndicatorFailureCycleCounterThreshold = 2
            DemRbIndicatorApiControl = false
            DemIndicatorBehaviour = DEM_INDICATOR_CONTINUOUS
            DemIndicatorHealingCycleCounterThreshold = 3
            DemIndicatorRef = MIL
        DemEventParameter_ECU1_DTC10: DemDTCRef=DemDTC_ECU1_DTC10, DemComponentClassRef=DemComponent_ECU1_DTC10
          DemDebounceAlgorithmClass
            DemDebounceCounterBasedClass (DemDebounceCounterBased): DemDebounceCounterBasedClassRef=DemDebounceCounterBasedClass_LostCom
          DemRbEventClass: DemRbEventBufferTime=0, DemRbEventRecoverableInSameOperationCycle=true, DemRbEventStatusBitStorageTestFailed=true
          DemIndicatorAttribute:
            DemIndicatorFailureCycleCounterThreshold = 2
            DemRbIndicatorApiControl = false
            DemIndicatorBehaviour = DEM_INDICATOR_CONTINUOUS
            DemIndicatorHealingCycleCounterThreshold = 3
            DemIndicatorRef = MIL
        DemEventParameter_ECU1_DTC11: DemDTCRef=DemDTC_ECU1_DTC11, DemComponentClassRef=DemComponent_ECU1_DTC11
          DemDebounceAlgorithmClass
            DemDebounceCounterBasedClass (DemDebounceCounterBased): DemDebounceCounterBasedClassRef=DemDebounceCounterBasedClass_LostCom
          DemRbEventClass: DemRbEventBufferTime=0, DemRbEventRecoverableInSameOperationCycle=true, DemRbEventStatusBitStorageTestFailed=true
          DemIndicatorAttribute:
            DemIndicatorFailureCycleCounterThreshold = 2
            DemRbIndicatorApiControl = false
            DemIndicatorBehaviour = DEM_INDICATOR_CONTINUOUS
            DemIndicatorHealingCycleCounterThreshold = 3
            DemIndicatorRef = MIL
        DemEventParameter_ECU1_DTC12: DemDTCRef=DemDTC_ECU1_DTC12, DemComponentClassRef=DemComponent_ECU1_DTC12
          DemDebounceAlgorithmClass
            DemDebounceCounterBasedClass (DemDebounceCounterBased): DemDebounceCounterBasedClassRef=DemDebounceCounterBasedClass_LostCom
          DemRbEventClass: DemRbEventBufferTime=0, DemRbEventRecoverableInSameOperationCycle=true, DemRbEventStatusBitStorageTestFailed=true
          DemIndicatorAttribute:
            DemIndicatorFailureCycleCounterThreshold = 2
            DemRbIndicatorApiControl = false
            DemIndicatorBehaviour = DEM_INDICATOR_CONTINUOUS
            DemIndicatorHealingCycleCounterThreshold = 3
            DemIndicatorRef = MIL
        DemEventParameter_ECU1_DTC13: DemDTCRef=DemDTC_ECU1_DTC13, DemComponentClassRef=DemComponent_ECU1_DTC13
          DemDebounceAlgorithmClass
            DemDebounceCounterBasedClass (DemDebounceCounterBased): DemDebounceCounterBasedClassRef=DemDebounceCounterBasedClass_LostCom
          DemRbEventClass: DemRbEventBufferTime=0, DemRbEventRecoverableInSameOperationCycle=true, DemRbEventStatusBitStorageTestFailed=true
          DemIndicatorAttribute:
            DemIndicatorFailureCycleCounterThreshold = 2
            DemRbIndicatorApiControl = false
            DemIndicatorBehaviour = DEM_INDICATOR_CONTINUOUS
            DemIndicatorHealingCycleCounterThreshold = 3
            DemIndicatorRef = MIL
        DemEventParameter_ECU1_DTC14: DemDTCRef=DemDTC_ECU1_DTC14, DemComponentClassRef=DemComponent_ECU1_DTC14
          DemDebounceAlgorithmClass
            DemDebounceCounterBasedClass (DemDebounceCounterBased): DemDebounceCounterBasedClassRef=DemDebounceCounterBasedClass_LostCom
          DemRbEventClass: DemRbEventBufferTime=0, DemRbEventRecoverableInSameOperationCycle=true, DemRbEventStatusBitStorageTestFailed=true
        DemEventParameter_ECU1_DTC15: DemDTCRef=DemDTC_ECU1_DTC15, DemComponentClassRef=DemComponent_ECU1_DTC15
          DemDebounceAlgorithmClass
            DemDebounceCounterBasedClass (DemDebounceCounterBased): DemDebounceCounterBasedClassRef=DemDebounceCounterBasedClass_LostCom
          DemRbEventClass: DemRbEventBufferTime=0, DemRbEventRecoverableInSameOperationCycle=true, DemRbEventStatusBitStorageTestFailed=true
        DemEventParameter_ECU1_DTC16: DemDTCRef=DemDTC_ECU1_DTC16, DemComponentClassRef=DemComponent_ECU1_DTC16
          DemDebounceAlgorithmClass
            DemDebounceCounterBasedClass (DemDebounceCounterBased): DemDebounceCounterBasedClassRef=DemDebounceCounterBasedClass_LostCom
          DemRbEventClass: DemRbEventBufferTime=0, DemRbEventRecoverableInSameOperationCycle=true, DemRbEventStatusBitStorageTestFailed=true
        DemEventParameter_ECU1_DTC17: DemComponentClassRef=DemComponent_ECU1_DTC17, DemDTCRef=DemDTC_ECU1_DTC17
          DemEventClassRB (DemRbEventClass): DemRbEventBufferTime=0
          DemDebounceAlgorithmClass
            DemDebounceCounterBasedClass (DemDebounceCounterBased): DemDebounceCounterBasedClassRef=DemDebounceCounterBasedClass_LostCom
        DemEventParameter_ECU1_DTC18: DemComponentClassRef=DemComponent_ECU1_DTC18, DemDTCRef=DemDTC_ECU1_DTC18
          DemEventClassRB (DemRbEventClass): DemRbEventBufferTime=0
          DemDebounceAlgorithmClass
            DemDebounceCounterBasedClass (DemDebounceCounterBased): DemDebounceCounterBasedClassRef=DemDebounceCounterBasedClass_LostCom
        DemEventParameter_ECU1_DTC19: DemComponentClassRef=DemComponent_ECU1_DTC19, DemDTCRef=DemDTC_ECU1_DTC19
          DemEventClassRB (DemRbEventClass): DemRbEventBufferTime=0
          DemDebounceAlgorithmClass
            DemDebounceCounterBasedClass (DemDebounceCounterBased): DemDebounceCounterBasedClassRef=DemDebounceCounterBasedClass_LostCom
        DemEventParameter_ECU1_DTC20: DemComponentClassRef=DemComponent_ECU1_DTC20, DemDTCRef=DemDTC_ECU1_DTC20
          DemEventClassRB (DemRbEventClass): DemRbEventBufferTime=0
          DemDebounceAlgorithmClass
            DemDebounceCounterBasedClass (DemDebounceCounterBased): DemDebounceCounterBasedClassRef=DemDebounceCounterBasedClass_LostCom
        DemEventParameter_ECU1_DTC21: DemDTCRef=DemDTC_ECU1_DTC21, DemComponentClassRef=DemComponent_ECU1_DTC21
          DemDebounceAlgorithmClass
            DemDebounceCounterBasedClass (DemDebounceCounterBased): DemDebounceCounterBasedClassRef=DemDebounceCounterBasedClass_LostCom
          DemRbEventClass: DemRbEventBufferTime=0, DemRbEventRecoverableInSameOperationCycle=true, DemRbEventStatusBitStorageTestFailed=true
        DemEventParameter_ECU1_DTC22: DemComponentClassRef=DemComponent_ECU1_DTC22, DemDTCRef=DemDTC_ECU1_DTC22
          DemEventClassRB (DemRbEventClass): DemRbEventBufferTime=0
          DemDebounceAlgorithmClass
            DemDebounceCounterBasedClass (DemDebounceCounterBased): DemDebounceCounterBasedClassRef=DemDebounceCounterBasedClass_LostCom
          DemIndicatorAttribute:
            DemIndicatorFailureCycleCounterThreshold = 2
            DemRbIndicatorApiControl = false
            DemIndicatorBehaviour = DEM_INDICATOR_CONTINUOUS
            DemIndicatorHealingCycleCounterThreshold = 3
            DemIndicatorRef = MIL
        DemEventParameter_ECU1_DTC23: DemDTCRef=DemDTC_ECU1_DTC23, DemComponentClassRef=DemComponent_ECU1_DTC23
          DemDebounceAlgorithmClass
            DemDebounceCounterBasedClass (DemDebounceCounterBased): DemDebounceCounterBasedClassRef=DemDebounceCounterBasedClass_LostCom
          DemRbEventClass: DemRbEventBufferTime=0, DemRbEventRecoverableInSameOperationCycle=true, DemRbEventStatusBitStorageTestFailed=true
          DemIndicatorAttribute:
            DemIndicatorFailureCycleCounterThreshold = 2
            DemRbIndicatorApiControl = false
            DemIndicatorBehaviour = DEM_INDICATOR_BLINK_CONT
            DemIndicatorHealingCycleCounterThreshold = 3
            DemIndicatorRef = MIL
        DemEventParameter_ECU1_DTC24: DemDTCRef=DemDTC_ECU1_DTC24, DemComponentClassRef=DemComponent_ECU1_DTC24
          DemDebounceAlgorithmClass
            DemDebounceCounterBasedClass (DemDebounceCounterBased): DemDebounceCounterBasedClassRef=DemDebounceCounterBasedClass_LostCom
          DemRbEventClass: DemRbEventBufferTime=0, DemRbEventRecoverableInSameOperationCycle=true, DemRbEventStatusBitStorageTestFailed=true
          DemIndicatorAttribute:
            DemIndicatorFailureCycleCounterThreshold = 2
            DemRbIndicatorApiControl = false
            DemIndicatorBehaviour = DEM_INDICATOR_CONTINUOUS
            DemIndicatorHealingCycleCounterThreshold = 3
            DemIndicatorRef = MIL
        DemEventParameter_ECU1_DTC25: DemComponentClassRef=DemComponent_ECU1_DTC25, DemDTCRef=DemDTC_ECU1_DTC25
          DemDebounceAlgorithmClass
            DemDebounceCounterBasedClass (DemDebounceCounterBased): DemDebounceCounterBasedClassRef=DemDebounceCounterBasedClass_LostCom
          DemIndicatorAttribute:
            DemIndicatorFailureCycleCounterThreshold = 2
            DemRbIndicatorApiControl = 0
            DemIndicatorHealingCycleCounterThreshold = 3
            DemIndicatorBehaviour = DEM_INDICATOR_CONTINUOUS
            DemIndicatorRef = MIL
          DemRbEventClass: DemRbEventBufferTime=0, DemRbEventRecoverableInSameOperationCycle=1, DemRbEventStatusBitStorageTestFailed=true
        DemEventParameter_ECU1_DTC26: DemDTCRef=DemDTC_ECU1_DTC26, DemComponentClassRef=DemComponent_ECU1_DTC26
          DemDebounceAlgorithmClass
            DemDebounceCounterBasedClass (DemDebounceCounterBased): DemDebounceCounterBasedClassRef=DemDebounceCounterBasedClass_LostCom
          DemRbEventClass: DemRbEventBufferTime=0, DemRbEventRecoverableInSameOperationCycle=true, DemRbEventStatusBitStorageTestFailed=true
          DemIndicatorAttribute:
            DemIndicatorFailureCycleCounterThreshold = 2
            DemRbIndicatorApiControl = false
            DemIndicatorBehaviour = DEM_INDICATOR_CONTINUOUS
            DemIndicatorHealingCycleCounterThreshold = 3
            DemIndicatorRef = MIL
        DemEventParameter_ECU1_DTC27: DemDTCRef=DemDTC_ECU1_DTC27, DemComponentClassRef=DemComponent_ECU1_DTC27
          DemDebounceAlgorithmClass
            DemDebounceCounterBasedClass (DemDebounceCounterBased): DemDebounceCounterBasedClassRef=DemDebounceCounterBasedClass_LostCom
          DemRbEventClass: DemRbEventBufferTime=0, DemRbEventRecoverableInSameOperationCycle=true, DemRbEventStatusBitStorageTestFailed=true
          DemIndicatorAttribute:
            DemIndicatorFailureCycleCounterThreshold = 2
            DemRbIndicatorApiControl = false
            DemIndicatorBehaviour = DEM_INDICATOR_CONTINUOUS
            DemIndicatorHealingCycleCounterThreshold = 3
            DemIndicatorRef = MIL
        DemEventParameter_ECU1_DTC28: DemDTCRef=DemDTC_ECU1_DTC28, DemComponentClassRef=DemComponent_ECU1_DTC28
          DemDebounceAlgorithmClass
            DemDebounceCounterBasedClass (DemDebounceCounterBased): DemDebounceCounterBasedClassRef=DemDebounceCounterBasedClass_LostCom
          DemRbEventClass: DemRbEventBufferTime=0, DemRbEventRecoverableInSameOperationCycle=true, DemRbEventStatusBitStorageTestFailed=true
          DemIndicatorAttribute:
            DemIndicatorFailureCycleCounterThreshold = 2
            DemRbIndicatorApiControl = false
            DemIndicatorBehaviour = DEM_INDICATOR_CONTINUOUS
            DemIndicatorHealingCycleCounterThreshold = 3
            DemIndicatorRef = MIL
        DemEventParameter_ECU1_DTC29: DemDTCRef=DemDTC_ECU1_DTC29, DemComponentClassRef=DemComponent_ECU1_DTC29
          DemDebounceAlgorithmClass
            DemDebounceCounterBasedClass (DemDebounceCounterBased): DemDebounceCounterBasedClassRef=DemDebounceCounterBasedClass_LostCom
          DemRbEventClass: DemRbEventBufferTime=0, DemRbEventRecoverableInSameOperationCycle=true, DemRbEventStatusBitStorageTestFailed=true
          DemIndicatorAttribute:
            DemIndicatorFailureCycleCounterThreshold = 2
            DemRbIndicatorApiControl = false
            DemIndicatorBehaviour = DEM_INDICATOR_BLINK_CONT
            DemIndicatorHealingCycleCounterThreshold = 3
            DemIndicatorRef = MIL
        DemEventParameter_ECU1_DTC30: DemDTCRef=DemDTC_ECU1_DTC30, DemComponentClassRef=DemComponent_ECU1_DTC30
          DemDebounceAlgorithmClass
            DemDebounceCounterBasedClass (DemDebounceCounterBased): DemDebounceCounterBasedClassRef=DemDebounceCounterBasedClass_LostCom
          DemRbEventClass: DemRbEventBufferTime=0, DemRbEventRecoverableInSameOperationCycle=true, DemRbEventStatusBitStorageTestFailed=true
          DemIndicatorAttribute:
            DemIndicatorFailureCycleCounterThreshold = 2
            DemRbIndicatorApiControl = false
            DemIndicatorBehaviour = DEM_INDICATOR_BLINK_CONT
            DemIndicatorHealingCycleCounterThreshold = 3
            DemIndicatorRef = MIL
        DemEventParameter_ECU1_DTC31: DemDTCRef=DemDTC_ECU1_DTC31, DemComponentClassRef=DemComponent_ECU1_DTC31
          DemDebounceAlgorithmClass
            DemDebounceCounterBasedClass (DemDebounceCounterBased): DemDebounceCounterBasedClassRef=DemDebounceCounterBasedClass_LostCom
          DemRbEventClass: DemRbEventBufferTime=0, DemRbEventRecoverableInSameOperationCycle=true, DemRbEventStatusBitStorageTestFailed=true
          DemIndicatorAttribute:
            DemIndicatorFailureCycleCounterThreshold = 2
            DemRbIndicatorApiControl = false
            DemIndicatorBehaviour = DEM_INDICATOR_BLINK_CONT
            DemIndicatorHealingCycleCounterThreshold = 3
            DemIndicatorRef = MIL
        DemEventParameter_ECU1_DTC32: DemDTCRef=DemDTC_ECU1_DTC32, DemComponentClassRef=DemComponent_ECU1_DTC32
          DemDebounceAlgorithmClass
            DemDebounceCounterBasedClass (DemDebounceCounterBased): DemDebounceCounterBasedClassRef=DemDebounceCounterBasedClass_LostCom
          DemRbEventClass: DemRbEventBufferTime=0, DemRbEventRecoverableInSameOperationCycle=true, DemRbEventStatusBitStorageTestFailed=true
          DemIndicatorAttribute:
            DemIndicatorFailureCycleCounterThreshold = 2
            DemRbIndicatorApiControl = false
            DemIndicatorBehaviour = DEM_INDICATOR_BLINK_CONT
            DemIndicatorHealingCycleCounterThreshold = 3
            DemIndicatorRef = MIL
        DemEventParameter_ECU1_DTC33: DemDTCRef=DemDTC_ECU1_DTC33, DemComponentClassRef=DemComponent_ECU1_DTC33
          DemDebounceAlgorithmClass
            DemDebounceCounterBasedClass (DemDebounceCounterBased): DemDebounceCounterBasedClassRef=DemDebounceCounterBasedClass_LostCom
          DemRbEventClass: DemRbEventBufferTime=0, DemRbEventRecoverableInSameOperationCycle=true, DemRbEventStatusBitStorageTestFailed=true
          DemIndicatorAttribute:
            DemIndicatorFailureCycleCounterThreshold = 2
            DemRbIndicatorApiControl = false
            DemIndicatorBehaviour = DEM_INDICATOR_BLINK_CONT
            DemIndicatorHealingCycleCounterThreshold = 3
            DemIndicatorRef = MIL
        DemEventParameter_ECU1_DTC34: DemDTCRef=DemDTC_ECU1_DTC34, DemComponentClassRef=DemComponent_ECU1_DTC34
          DemDebounceAlgorithmClass
            DemDebounceCounterBasedClass (DemDebounceCounterBased): DemDebounceCounterBasedClassRef=DemDebounceCounterBasedClass_LostCom
          DemRbEventClass: DemRbEventBufferTime=0, DemRbEventRecoverableInSameOperationCycle=true, DemRbEventStatusBitStorageTestFailed=true
          DemIndicatorAttribute:
            DemIndicatorFailureCycleCounterThreshold = 2
            DemRbIndicatorApiControl = false
            DemIndicatorBehaviour = DEM_INDICATOR_CONTINUOUS
            DemIndicatorHealingCycleCounterThreshold = 3
            DemIndicatorRef = MIL
        DemEventParameter_ECU1_DTC35: DemDTCRef=DemDTC_ECU1_DTC35, DemComponentClassRef=DemComponent_ECU1_DTC35
          DemDebounceAlgorithmClass
            DemDebounceCounterBasedClass (DemDebounceCounterBased): DemDebounceCounterBasedClassRef=DemDebounceCounterBasedClass_LostCom
          DemRbEventClass: DemRbEventBufferTime=0, DemRbEventRecoverableInSameOperationCycle=true, DemRbEventStatusBitStorageTestFailed=true
          DemIndicatorAttribute:
            DemIndicatorFailureCycleCounterThreshold = 2
            DemRbIndicatorApiControl = false
            DemIndicatorBehaviour = DEM_INDICATOR_CONTINUOUS
            DemIndicatorHealingCycleCounterThreshold = 3
            DemIndicatorRef = MIL
        DemEventParameter_ECU1_DTC36: DemDTCRef=DemDTC_ECU1_DTC36, DemComponentClassRef=DemComponent_ECU1_DTC36
          DemDebounceAlgorithmClass
            DemDebounceCounterBasedClass (DemDebounceCounterBased): DemDebounceCounterBasedClassRef=DemDebounceCounterBasedClass_LostCom
          DemRbEventClass: DemRbEventBufferTime=0, DemRbEventRecoverableInSameOperationCycle=true, DemRbEventStatusBitStorageTestFailed=true
          DemIndicatorAttribute:
            DemIndicatorFailureCycleCounterThreshold = 2
            DemRbIndicatorApiControl = false
            DemIndicatorBehaviour = DEM_INDICATOR_CONTINUOUS
            DemIndicatorHealingCycleCounterThreshold = 3
            DemIndicatorRef = MIL
        DemEventParameter_ECU1_DTC37: DemDTCRef=DemDTC_ECU1_DTC37, DemComponentClassRef=DemComponent_ECU1_DTC37
          DemDebounceAlgorithmClass
            DemDebounceCounterBasedClass (DemDebounceCounterBased): DemDebounceCounterBasedClassRef=DemDebounceCounterBasedClass_LostCom
          DemRbEventClass: DemRbEventBufferTime=0, DemRbEventRecoverableInSameOperationCycle=true, DemRbEventStatusBitStorageTestFailed=true
          DemIndicatorAttribute:
            DemIndicatorFailureCycleCounterThreshold = 2
            DemRbIndicatorApiControl = false
            DemIndicatorBehaviour = DEM_INDICATOR_CONTINUOUS
            DemIndicatorHealingCycleCounterThreshold = 3
            DemIndicatorRef = MIL
        DemEventParameter_ECU1_DTC38: DemDTCRef=DemDTC_ECU1_DTC38, DemComponentClassRef=DemComponent_ECU1_DTC38
          DemDebounceAlgorithmClass
            DemDebounceCounterBasedClass (DemDebounceCounterBased): DemDebounceCounterBasedClassRef=DemDebounceCounterBasedClass_LostCom
          DemRbEventClass: DemRbEventBufferTime=0, DemRbEventRecoverableInSameOperationCycle=true, DemRbEventStatusBitStorageTestFailed=true
          DemIndicatorAttribute:
            DemIndicatorFailureCycleCounterThreshold = 2
            DemRbIndicatorApiControl = false
            DemIndicatorBehaviour = DEM_INDICATOR_CONTINUOUS
            DemIndicatorHealingCycleCounterThreshold = 3
            DemIndicatorRef = MIL
        DemEventParameter_ECU1_DTC39: DemDTCRef=DemDTC_ECU1_DTC39, DemComponentClassRef=DemComponent_ECU1_DTC39
          DemDebounceAlgorithmClass
            DemDebounceCounterBasedClass (DemDebounceCounterBased): DemDebounceCounterBasedClassRef=DemDebounceCounterBasedClass_LostCom
          DemRbEventClass: DemRbEventBufferTime=0, DemRbEventRecoverableInSameOperationCycle=true, DemRbEventStatusBitStorageTestFailed=true
        DemEventParameter_ECU1_DTC40: DemDTCRef=DemDTC_ECU1_DTC40, DemComponentClassRef=DemComponent_ECU1_DTC40
          DemDebounceAlgorithmClass
            DemDebounceCounterBasedClass (DemDebounceCounterBased): DemDebounceCounterBasedClassRef=DemDebounceCounterBasedClass_LostCom
          DemRbEventClass: DemRbEventBufferTime=0, DemRbEventRecoverableInSameOperationCycle=true, DemRbEventStatusBitStorageTestFailed=true
        DemEventParameter_ECU1_DTC41: DemDTCRef=DemDTC_ECU1_DTC41, DemComponentClassRef=DemComponent_ECU1_DTC41
          DemDebounceAlgorithmClass
            DemDebounceCounterBasedClass (DemDebounceCounterBased): DemDebounceCounterBasedClassRef=DemDebounceCounterBasedClass_LostCom
          DemRbEventClass: DemRbEventBufferTime=0, DemRbEventRecoverableInSameOperationCycle=true, DemRbEventStatusBitStorageTestFailed=true
        DemEventParameter_ECU1_DTC42: DemComponentClassRef=DemComponent_ECU1_DTC42, DemDTCRef=DemDTC_ECU1_DTC42
          DemEventClassRB (DemRbEventClass): DemRbEventBufferTime=0
          DemDebounceAlgorithmClass
            DemDebounceCounterBasedClass (DemDebounceCounterBased): DemDebounceCounterBasedClassRef=DemDebounceCounterBasedClass_LostCom
        DemEventParameter_ECU1_DTC43: DemComponentClassRef=DemComponent_ECU1_DTC43, DemDTCRef=DemDTC_ECU1_DTC43
          DemEventClassRB (DemRbEventClass): DemRbEventBufferTime=0
          DemDebounceAlgorithmClass
            DemDebounceCounterBasedClass (DemDebounceCounterBased): DemDebounceCounterBasedClassRef=DemDebounceCounterBasedClass_LostCom
        DemEventParameter_ECU1_DTC44: DemComponentClassRef=DemComponent_ECU1_DTC44, DemDTCRef=DemDTC_ECU1_DTC44
          DemEventClassRB (DemRbEventClass): DemRbEventBufferTime=0
          DemDebounceAlgorithmClass
            DemDebounceCounterBasedClass (DemDebounceCounterBased): DemDebounceCounterBasedClassRef=DemDebounceCounterBasedClass_LostCom
        DemEventParameter_ECU1_DTC45: DemComponentClassRef=DemComponent_ECU1_DTC45, DemDTCRef=DemDTC_ECU1_DTC45
          DemEventClassRB (DemRbEventClass): DemRbEventBufferTime=0
          DemDebounceAlgorithmClass
            DemDebounceCounterBasedClass (DemDebounceCounterBased): DemDebounceCounterBasedClassRef=DemDebounceCounterBasedClass_LostCom
        DemEventParameter_ECU1_DTC46: DemDTCRef=DemDTC_ECU1_DTC46, DemComponentClassRef=DemComponent_ECU1_DTC46
          DemDebounceAlgorithmClass
            DemDebounceCounterBasedClass (DemDebounceCounterBased): DemDebounceCounterBasedClassRef=DemDebounceCounterBasedClass_LostCom
          DemRbEventClass: DemRbEventBufferTime=0, DemRbEventRecoverableInSameOperationCycle=true, DemRbEventStatusBitStorageTestFailed=true
        DemEventParameter_ECU1_DTC47: DemComponentClassRef=DemComponent_ECU1_DTC47, DemDTCRef=DemDTC_ECU1_DTC47
          DemEventClassRB (DemRbEventClass): DemRbEventBufferTime=0
          DemDebounceAlgorithmClass
            DemDebounceCounterBasedClass (DemDebounceCounterBased): DemDebounceCounterBasedClassRef=DemDebounceCounterBasedClass_LostCom
          DemIndicatorAttribute:
            DemIndicatorFailureCycleCounterThreshold = 2
            DemRbIndicatorApiControl = false
            DemIndicatorBehaviour = DEM_INDICATOR_CONTINUOUS
            DemIndicatorHealingCycleCounterThreshold = 3
            DemIndicatorRef = MIL
        DemEventParameter_ECU1_DTC48: DemDTCRef=DemDTC_ECU1_DTC48, DemComponentClassRef=DemComponent_ECU1_DTC48
          DemDebounceAlgorithmClass
            DemDebounceCounterBasedClass (DemDebounceCounterBased): DemDebounceCounterBasedClassRef=DemDebounceCounterBasedClass_LostCom
          DemRbEventClass: DemRbEventBufferTime=0, DemRbEventRecoverableInSameOperationCycle=true, DemRbEventStatusBitStorageTestFailed=true
          DemIndicatorAttribute:
            DemIndicatorFailureCycleCounterThreshold = 2
            DemRbIndicatorApiControl = false
            DemIndicatorBehaviour = DEM_INDICATOR_BLINK_CONT
            DemIndicatorHealingCycleCounterThreshold = 3
            DemIndicatorRef = MIL
        DemEventParameter_ECU1_DTC49: DemDTCRef=DemDTC_ECU1_DTC49, DemComponentClassRef=DemComponent_ECU1_DTC49
          DemDebounceAlgorithmClass
            DemDebounceCounterBasedClass (DemDebounceCounterBased): DemDebounceCounterBasedClassRef=DemDebounceCounterBasedClass_LostCom
          DemRbEventClass: DemRbEventBufferTime=0, DemRbEventRecoverableInSameOperationCycle=true, DemRbEventStatusBitStorageTestFailed=true
          DemIndicatorAttribute:
            DemIndicatorFailureCycleCounterThreshold = 2
            DemRbIndicatorApiControl = false
            DemIndicatorBehaviour = DEM_INDICATOR_CONTINUOUS
            DemIndicatorHealingCycleCounterThreshold = 3
            DemIndicatorRef = MIL
        DemEventParameter_ECU1_DTC50: DemDTCRef=DemDTC_ECU1_DTC50, DemComponentClassRef=DemComponent_ECU1_DTC50
          DemDebounceAlgorithmClass
            DemDebounceCounterBasedClass (DemDebounceCounterBased): DemDebounceCounterBasedClassRef=DemDebounceCounterBasedClass_LostCom
          DemRbEventClass: DemRbEventBufferTime=0, DemRbEventRecoverableInSameOperationCycle=true, DemRbEventStatusBitStorageTestFailed=true
        DemEventParameter_ECU1_DTC51: DemDTCRef=DemDTC_ECU1_DTC51, DemComponentClassRef=DemComponent_ECU1_DTC51
          DemDebounceAlgorithmClass
            DemDebounceCounterBasedClass (DemDebounceCounterBased): DemDebounceCounterBasedClassRef=DemDebounceCounterBasedClass_LostCom
          DemRbEventClass: DemRbEventBufferTime=0, DemRbEventRecoverableInSameOperationCycle=true, DemRbEventStatusBitStorageTestFailed=true
          DemIndicatorAttribute:
            DemIndicatorFailureCycleCounterThreshold = 2
            DemRbIndicatorApiControl = false
            DemIndicatorBehaviour = DEM_INDICATOR_CONTINUOUS
            DemIndicatorHealingCycleCounterThreshold = 3
            DemIndicatorRef = MIL
        DemEventParameter_ECU1_DTC52: DemDTCRef=DemDTC_ECU1_DTC52, DemComponentClassRef=DemComponent_ECU1_DTC52
          DemDebounceAlgorithmClass
            DemDebounceCounterBasedClass (DemDebounceCounterBased): DemDebounceCounterBasedClassRef=DemDebounceCounterBasedClass_LostCom
          DemRbEventClass: DemRbEventBufferTime=0, DemRbEventRecoverableInSameOperationCycle=true, DemRbEventStatusBitStorageTestFailed=true
          DemIndicatorAttribute:
            DemIndicatorFailureCycleCounterThreshold = 2
            DemRbIndicatorApiControl = false
            DemIndicatorBehaviour = DEM_INDICATOR_CONTINUOUS
            DemIndicatorHealingCycleCounterThreshold = 3
            DemIndicatorRef = MIL
        DemEventParameter_ECU1_DTC53: DemDTCRef=DemDTC_ECU1_DTC53, DemComponentClassRef=DemComponent_ECU1_DTC53
          DemDebounceAlgorithmClass
            DemDebounceCounterBasedClass (DemDebounceCounterBased): DemDebounceCounterBasedClassRef=DemDebounceCounterBasedClass_LostCom
          DemRbEventClass: DemRbEventBufferTime=0, DemRbEventRecoverableInSameOperationCycle=true, DemRbEventStatusBitStorageTestFailed=true
        DemEventParameter_ECU1_DTC54: DemDTCRef=DemDTC_ECU1_DTC54, DemComponentClassRef=DemComponent_ECU1_DTC54
          DemDebounceAlgorithmClass
            DemDebounceCounterBasedClass (DemDebounceCounterBased): DemDebounceCounterBasedClassRef=DemDebounceCounterBasedClass_LostCom
          DemRbEventClass: DemRbEventBufferTime=0, DemRbEventRecoverableInSameOperationCycle=true, DemRbEventStatusBitStorageTestFailed=true
        DemEventParameter_ECU1_DTC55: DemDTCRef=DemDTC_ECU1_DTC55, DemComponentClassRef=DemComponent_ECU1_DTC55
          DemDebounceAlgorithmClass
            DemDebounceCounterBasedClass (DemDebounceCounterBased): DemDebounceCounterBasedClassRef=DemDebounceCounterBasedClass_LostCom
          DemRbEventClass: DemRbEventBufferTime=0, DemRbEventRecoverableInSameOperationCycle=true, DemRbEventStatusBitStorageTestFailed=true
          DemIndicatorAttribute:
            DemIndicatorFailureCycleCounterThreshold = 2
            DemRbIndicatorApiControl = false
            DemIndicatorBehaviour = DEM_INDICATOR_CONTINUOUS
            DemIndicatorHealingCycleCounterThreshold = 3
            DemIndicatorRef = MIL
        DemEventParameter_ECU1_DTC56: DemDTCRef=DemDTC_ECU1_DTC56, DemComponentClassRef=DemComponent_ECU1_DTC56
          DemDebounceAlgorithmClass
            DemDebounceCounterBasedClass (DemDebounceCounterBased): DemDebounceCounterBasedClassRef=DemDebounceCounterBasedClass_LostCom
          DemRbEventClass: DemRbEventBufferTime=0, DemRbEventRecoverableInSameOperationCycle=true, DemRbEventStatusBitStorageTestFailed=true
          DemIndicatorAttribute:
            DemIndicatorFailureCycleCounterThreshold = 2
            DemRbIndicatorApiControl = false
            DemIndicatorBehaviour = DEM_INDICATOR_CONTINUOUS
            DemIndicatorHealingCycleCounterThreshold = 3
            DemIndicatorRef = MIL
        DemEventParameter_ECU1_DTC57: DemDTCRef=DemDTC_ECU1_DTC57, DemComponentClassRef=DemComponent_ECU1_DTC57
          DemDebounceAlgorithmClass
            DemDebounceCounterBasedClass (DemDebounceCounterBased): DemDebounceCounterBasedClassRef=DemDebounceCounterBasedClass_LostCom
          DemRbEventClass: DemRbEventBufferTime=0, DemRbEventRecoverableInSameOperationCycle=true, DemRbEventStatusBitStorageTestFailed=true
        DemEventParameter_ECU1_DTC58: DemDTCRef=DemDTC_ECU1_DTC58, DemComponentClassRef=DemComponent_ECU1_DTC58
          DemDebounceAlgorithmClass
            DemDebounceCounterBasedClass (DemDebounceCounterBased): DemDebounceCounterBasedClassRef=DemDebounceCounterBasedClass_LostCom
          DemRbEventClass: DemRbEventBufferTime=0, DemRbEventRecoverableInSameOperationCycle=true, DemRbEventStatusBitStorageTestFailed=true
          DemIndicatorAttribute:
            DemIndicatorFailureCycleCounterThreshold = 2
            DemRbIndicatorApiControl = false
            DemIndicatorBehaviour = DEM_INDICATOR_BLINK_CONT
            DemIndicatorHealingCycleCounterThreshold = 3
            DemIndicatorRef = MIL
        DemEventParameter_ECU1_DTC59: DemDTCRef=DemDTC_ECU1_DTC59, DemComponentClassRef=DemComponent_ECU1_DTC59
          DemDebounceAlgorithmClass
            DemDebounceCounterBasedClass (DemDebounceCounterBased): DemDebounceCounterBasedClassRef=DemDebounceCounterBasedClass_LostCom
          DemRbEventClass: DemRbEventBufferTime=0, DemRbEventRecoverableInSameOperationCycle=true, DemRbEventStatusBitStorageTestFailed=true
        DemEventParameter_ECU1_DTC60: DemDTCRef=DemDTC_ECU1_DTC60, DemComponentClassRef=DemComponent_ECU1_DTC60
          DemDebounceAlgorithmClass
            DemDebounceCounterBasedClass (DemDebounceCounterBased): DemDebounceCounterBasedClassRef=DemDebounceCounterBasedClass_LostCom
          DemRbEventClass: DemRbEventBufferTime=0, DemRbEventRecoverableInSameOperationCycle=true, DemRbEventStatusBitStorageTestFailed=true
          DemIndicatorAttribute:
            DemIndicatorFailureCycleCounterThreshold = 2
            DemRbIndicatorApiControl = false
            DemIndicatorBehaviour = DEM_INDICATOR_CONTINUOUS
            DemIndicatorHealingCycleCounterThreshold = 3
            DemIndicatorRef = MIL
        DemEventParameter_ECU1_DTC61: DemDTCRef=DemDTC_ECU1_DTC61, DemComponentClassRef=DemComponent_ECU1_DTC61
          DemDebounceAlgorithmClass
            DemDebounceCounterBasedClass (DemDebounceCounterBased): DemDebounceCounterBasedClassRef=DemDebounceCounterBasedClass_LostCom
          DemRbEventClass: DemRbEventBufferTime=0, DemRbEventRecoverableInSameOperationCycle=true, DemRbEventStatusBitStorageTestFailed=true
          DemIndicatorAttribute:
            DemIndicatorFailureCycleCounterThreshold = 2
            DemRbIndicatorApiControl = false
            DemIndicatorBehaviour = DEM_INDICATOR_CONTINUOUS
            DemIndicatorHealingCycleCounterThreshold = 3
            DemIndicatorRef = MIL
        DemEventParameter_ECU1_DTC62: DemDTCRef=DemDTC_ECU1_DTC62, DemComponentClassRef=DemComponent_ECU1_DTC62
          DemDebounceAlgorithmClass
            DemDebounceCounterBasedClass (DemDebounceCounterBased): DemDebounceCounterBasedClassRef=DemDebounceCounterBasedClass_LostCom
          DemRbEventClass: DemRbEventBufferTime=0, DemRbEventRecoverableInSameOperationCycle=true, DemRbEventStatusBitStorageTestFailed=true
          DemIndicatorAttribute:
            DemIndicatorFailureCycleCounterThreshold = 2
            DemRbIndicatorApiControl = false
            DemIndicatorBehaviour = DEM_INDICATOR_BLINK_CONT
            DemIndicatorHealingCycleCounterThreshold = 3
            DemIndicatorRef = MIL
        DemEventParameter_ECU1_DTC63: DemDTCRef=DemDTC_ECU1_DTC63, DemComponentClassRef=DemComponent_ECU1_DTC63
          DemDebounceAlgorithmClass
            DemDebounceCounterBasedClass (DemDebounceCounterBased): DemDebounceCounterBasedClassRef=DemDebounceCounterBasedClass_LostCom
          DemRbEventClass: DemRbEventBufferTime=0, DemRbEventRecoverableInSameOperationCycle=true, DemRbEventStatusBitStorageTestFailed=true
          DemIndicatorAttribute:
            DemIndicatorFailureCycleCounterThreshold = 2
            DemRbIndicatorApiControl = false
            DemIndicatorBehaviour = DEM_INDICATOR_BLINK_CONT
            DemIndicatorHealingCycleCounterThreshold = 3
            DemIndicatorRef = MIL
        DemEventParameter_ECU1_DTC64: DemDTCRef=DemDTC_ECU1_DTC64, DemComponentClassRef=DemComponent_ECU1_DTC64
          DemDebounceAlgorithmClass
            DemDebounceCounterBasedClass (DemDebounceCounterBased): DemDebounceCounterBasedClassRef=DemDebounceCounterBasedClass_LostCom
          DemRbEventClass: DemRbEventBufferTime=0, DemRbEventRecoverableInSameOperationCycle=true, DemRbEventStatusBitStorageTestFailed=true
        DemEventParameter_ECU1_DTC65: DemDTCRef=DemDTC_ECU1_DTC65, DemComponentClassRef=DemComponent_ECU1_DTC65
          DemDebounceAlgorithmClass
            DemDebounceCounterBasedClass (DemDebounceCounterBased): DemDebounceCounterBasedClassRef=DemDebounceCounterBasedClass_LostCom
          DemRbEventClass: DemRbEventBufferTime=0, DemRbEventRecoverableInSameOperationCycle=true, DemRbEventStatusBitStorageTestFailed=true
        DemEventParameter_ECU1_DTC66: DemDTCRef=DemDTC_ECU1_DTC66, DemComponentClassRef=DemComponent_ECU1_DTC66
          DemDebounceAlgorithmClass
            DemDebounceCounterBasedClass (DemDebounceCounterBased): DemDebounceCounterBasedClassRef=DemDebounceCounterBasedClass_LostCom
          DemRbEventClass: DemRbEventBufferTime=0, DemRbEventRecoverableInSameOperationCycle=true, DemRbEventStatusBitStorageTestFailed=true
          DemIndicatorAttribute:
            DemIndicatorFailureCycleCounterThreshold = 2
            DemRbIndicatorApiControl = false
            DemIndicatorBehaviour = DEM_INDICATOR_CONTINUOUS
            DemIndicatorHealingCycleCounterThreshold = 3
            DemIndicatorRef = MIL
        DemEventParameter_ECU1_DTC67: DemDTCRef=DemDTC_ECU1_DTC67, DemComponentClassRef=DemComponent_ECU1_DTC67
          DemDebounceAlgorithmClass
            DemDebounceCounterBasedClass (DemDebounceCounterBased): DemDebounceCounterBasedClassRef=DemDebounceCounterBasedClass_LostCom
          DemRbEventClass: DemRbEventBufferTime=0, DemRbEventRecoverableInSameOperationCycle=true, DemRbEventStatusBitStorageTestFailed=true
          DemIndicatorAttribute:
            DemIndicatorFailureCycleCounterThreshold = 2
            DemRbIndicatorApiControl = false
            DemIndicatorBehaviour = DEM_INDICATOR_CONTINUOUS
            DemIndicatorHealingCycleCounterThreshold = 3
            DemIndicatorRef = MIL
        DemEventParameter_ECU1_DTC68: DemDTCRef=DemDTC_ECU1_DTC68, DemComponentClassRef=DemComponent_ECU1_DTC68
          DemDebounceAlgorithmClass
            DemDebounceCounterBasedClass (DemDebounceCounterBased): DemDebounceCounterBasedClassRef=DemDebounceCounterBasedClass_LostCom
          DemRbEventClass: DemRbEventBufferTime=0, DemRbEventRecoverableInSameOperationCycle=true, DemRbEventStatusBitStorageTestFailed=true
          DemIndicatorAttribute:
            DemIndicatorFailureCycleCounterThreshold = 2
            DemRbIndicatorApiControl = false
            DemIndicatorBehaviour = DEM_INDICATOR_CONTINUOUS
            DemIndicatorHealingCycleCounterThreshold = 3
            DemIndicatorRef = MIL
        DemEventParameter_ECU1_DTC69: DemDTCRef=DemDTC_ECU1_DTC69, DemComponentClassRef=DemComponent_ECU1_DTC69
          DemDebounceAlgorithmClass
            DemDebounceCounterBasedClass (DemDebounceCounterBased): DemDebounceCounterBasedClassRef=DemDebounceCounterBasedClass_LostCom
          DemRbEventClass: DemRbEventBufferTime=0, DemRbEventRecoverableInSameOperationCycle=true, DemRbEventStatusBitStorageTestFailed=true
          DemIndicatorAttribute:
            DemIndicatorFailureCycleCounterThreshold = 2
            DemRbIndicatorApiControl = false
            DemIndicatorBehaviour = DEM_INDICATOR_CONTINUOUS
            DemIndicatorHealingCycleCounterThreshold = 3
            DemIndicatorRef = MIL
        DemEventParameter_ECU1_DTC70: DemDTCRef=DemDTC_ECU1_DTC70, DemComponentClassRef=DemComponent_ECU1_DTC70
          DemDebounceAlgorithmClass
            DemDebounceCounterBasedClass (DemDebounceCounterBased): DemDebounceCounterBasedClassRef=DemDebounceCounterBasedClass_LostCom
          DemRbEventClass: DemRbEventBufferTime=0, DemRbEventRecoverableInSameOperationCycle=true, DemRbEventStatusBitStorageTestFailed=true
          DemIndicatorAttribute:
            DemIndicatorFailureCycleCounterThreshold = 2
            DemRbIndicatorApiControl = false
            DemIndicatorBehaviour = DEM_INDICATOR_CONTINUOUS
            DemIndicatorHealingCycleCounterThreshold = 3
            DemIndicatorRef = MIL
        DemEventParameter_ECU1_DTC71: DemDTCRef=DemDTC_ECU1_DTC71, DemComponentClassRef=DemComponent_ECU1_DTC71
          DemDebounceAlgorithmClass
            DemDebounceCounterBasedClass (DemDebounceCounterBased): DemDebounceCounterBasedClassRef=DemDebounceCounterBasedClass_LostCom
          DemRbEventClass: DemRbEventBufferTime=0, DemRbEventRecoverableInSameOperationCycle=true, DemRbEventStatusBitStorageTestFailed=true
          DemIndicatorAttribute:
            DemIndicatorFailureCycleCounterThreshold = 2
            DemRbIndicatorApiControl = false
            DemIndicatorBehaviour = DEM_INDICATOR_CONTINUOUS
            DemIndicatorHealingCycleCounterThreshold = 3
            DemIndicatorRef = MIL
        DemEventParameter_ECU1_DTC72: DemDTCRef=DemDTC_ECU1_DTC72, DemComponentClassRef=DemComponent_ECU1_DTC72
          DemDebounceAlgorithmClass
            DemDebounceCounterBasedClass (DemDebounceCounterBased): DemDebounceCounterBasedClassRef=DemDebounceCounterBasedClass_LostCom
          DemRbEventClass: DemRbEventBufferTime=0, DemRbEventRecoverableInSameOperationCycle=true, DemRbEventStatusBitStorageTestFailed=true
          DemIndicatorAttribute:
            DemIndicatorFailureCycleCounterThreshold = 2
            DemRbIndicatorApiControl = false
            DemIndicatorBehaviour = DEM_INDICATOR_CONTINUOUS
            DemIndicatorHealingCycleCounterThreshold = 3
            DemIndicatorRef = MIL
        DemEventParameter_ECU1_DTC73: DemDTCRef=DemDTC_ECU1_DTC73, DemComponentClassRef=DemComponent_ECU1_DTC73
          DemDebounceAlgorithmClass
            DemDebounceCounterBasedClass (DemDebounceCounterBased): DemDebounceCounterBasedClassRef=DemDebounceCounterBasedClass_LostCom
          DemRbEventClass: DemRbEventBufferTime=0, DemRbEventRecoverableInSameOperationCycle=true, DemRbEventStatusBitStorageTestFailed=true
          DemIndicatorAttribute:
            DemIndicatorFailureCycleCounterThreshold = 2
            DemRbIndicatorApiControl = false
            DemIndicatorBehaviour = DEM_INDICATOR_CONTINUOUS
            DemIndicatorHealingCycleCounterThreshold = 3
            DemIndicatorRef = MIL
        DemEventParameter_ECU1_DTC74: DemDTCRef=DemDTC_ECU1_DTC74, DemComponentClassRef=DemComponent_ECU1_DTC74
          DemDebounceAlgorithmClass
            DemDebounceCounterBasedClass (DemDebounceCounterBased): DemDebounceCounterBasedClassRef=DemDebounceCounterBasedClass_LostCom
          DemRbEventClass: DemRbEventBufferTime=0, DemRbEventRecoverableInSameOperationCycle=true, DemRbEventStatusBitStorageTestFailed=true
          DemIndicatorAttribute:
            DemIndicatorFailureCycleCounterThreshold = 2
            DemRbIndicatorApiControl = false
            DemIndicatorBehaviour = DEM_INDICATOR_CONTINUOUS
            DemIndicatorHealingCycleCounterThreshold = 3
            DemIndicatorRef = MIL
        DemEventParameter_ECU1_DTC75: DemDTCRef=DemDTC_ECU1_DTC75, DemComponentClassRef=DemComponent_ECU1_DTC75
          DemDebounceAlgorithmClass
            DemDebounceCounterBasedClass (DemDebounceCounterBased): DemDebounceCounterBasedClassRef=DemDebounceCounterBasedClass_LostCom
          DemRbEventClass: DemRbEventBufferTime=0, DemRbEventRecoverableInSameOperationCycle=true, DemRbEventStatusBitStorageTestFailed=true
        DemEventParameter_ECU1_DTC76: DemDTCRef=DemDTC_ECU1_DTC76, DemComponentClassRef=DemComponent_ECU1_DTC76
          DemDebounceAlgorithmClass
            DemDebounceCounterBasedClass (DemDebounceCounterBased): DemDebounceCounterBasedClassRef=DemDebounceCounterBasedClass_LostCom
          DemRbEventClass: DemRbEventBufferTime=0, DemRbEventRecoverableInSameOperationCycle=true, DemRbEventStatusBitStorageTestFailed=true
          DemIndicatorAttribute:
            DemIndicatorFailureCycleCounterThreshold = 2
            DemRbIndicatorApiControl = false
            DemIndicatorBehaviour = DEM_INDICATOR_CONTINUOUS
            DemIndicatorHealingCycleCounterThreshold = 3
            DemIndicatorRef = MIL
        DemEventParameter_ECU1_DTC77: DemDTCRef=DemDTC_ECU1_DTC77, DemComponentClassRef=DemComponent_ECU1_DTC77
          DemDebounceAlgorithmClass
            DemDebounceCounterBasedClass (DemDebounceCounterBased): DemDebounceCounterBasedClassRef=DemDebounceCounterBasedClass_LostCom
          DemRbEventClass: DemRbEventBufferTime=0, DemRbEventRecoverableInSameOperationCycle=true, DemRbEventStatusBitStorageTestFailed=true
          DemIndicatorAttribute:
            DemIndicatorFailureCycleCounterThreshold = 2
            DemRbIndicatorApiControl = false
            DemIndicatorBehaviour = DEM_INDICATOR_CONTINUOUS
            DemIndicatorHealingCycleCounterThreshold = 3
            DemIndicatorRef = MIL
        DemEventParameter_ECU1_DTC78: DemDTCRef=DemDTC_ECU1_DTC78, DemComponentClassRef=DemComponent_ECU1_DTC78
          DemDebounceAlgorithmClass
            DemDebounceCounterBasedClass (DemDebounceCounterBased): DemDebounceCounterBasedClassRef=DemDebounceCounterBasedClass_LostCom
          DemRbEventClass: DemRbEventBufferTime=0, DemRbEventRecoverableInSameOperationCycle=true, DemRbEventStatusBitStorageTestFailed=true
        DemEventParameter_ECU1_DTC79: DemDTCRef=DemDTC_ECU1_DTC79, DemComponentClassRef=DemComponent_ECU1_DTC79
          DemDebounceAlgorithmClass
            DemDebounceCounterBasedClass (DemDebounceCounterBased): DemDebounceCounterBasedClassRef=DemDebounceCounterBasedClass_LostCom
          DemRbEventClass: DemRbEventBufferTime=0, DemRbEventRecoverableInSameOperationCycle=true, DemRbEventStatusBitStorageTestFailed=true
        DemEventParameter_ECU1_DTC80: DemDTCRef=DemDTC_ECU1_DTC80, DemComponentClassRef=DemComponent_ECU1_DTC80
          DemDebounceAlgorithmClass
            DemDebounceCounterBasedClass (DemDebounceCounterBased): DemDebounceCounterBasedClassRef=DemDebounceCounterBasedClass_LostCom
          DemRbEventClass: DemRbEventBufferTime=0, DemRbEventRecoverableInSameOperationCycle=true, DemRbEventStatusBitStorageTestFailed=true
          DemIndicatorAttribute:
            DemIndicatorFailureCycleCounterThreshold = 2
            DemRbIndicatorApiControl = false
            DemIndicatorBehaviour = DEM_INDICATOR_CONTINUOUS
            DemIndicatorHealingCycleCounterThreshold = 3
            DemIndicatorRef = MIL
        DemEventParameter_ECU1_DTC81: DemDTCRef=DemDTC_ECU1_DTC81, DemComponentClassRef=DemComponent_ECU1_DTC81
          DemDebounceAlgorithmClass
            DemDebounceCounterBasedClass (DemDebounceCounterBased): DemDebounceCounterBasedClassRef=DemDebounceCounterBasedClass_LostCom
          DemRbEventClass: DemRbEventBufferTime=0, DemRbEventRecoverableInSameOperationCycle=true, DemRbEventStatusBitStorageTestFailed=true
          DemIndicatorAttribute:
            DemIndicatorFailureCycleCounterThreshold = 2
            DemRbIndicatorApiControl = false
            DemIndicatorBehaviour = DEM_INDICATOR_CONTINUOUS
            DemIndicatorHealingCycleCounterThreshold = 3
            DemIndicatorRef = MIL
        DemEventParameter_ECU1_DTC82: DemDTCRef=DemDTC_ECU1_DTC82, DemComponentClassRef=DemComponent_ECU1_DTC82
          DemDebounceAlgorithmClass
            DemDebounceCounterBasedClass (DemDebounceCounterBased): DemDebounceCounterBasedClassRef=DemDebounceCounterBasedClass_LostCom
          DemRbEventClass: DemRbEventBufferTime=0, DemRbEventRecoverableInSameOperationCycle=true, DemRbEventStatusBitStorageTestFailed=true
        DemEventParameter_ECU1_DTC83: DemDTCRef=DemDTC_ECU1_DTC83, DemComponentClassRef=DemComponent_ECU1_DTC83
          DemDebounceAlgorithmClass
            DemDebounceCounterBasedClass (DemDebounceCounterBased): DemDebounceCounterBasedClassRef=DemDebounceCounterBasedClass_LostCom
          DemRbEventClass: DemRbEventBufferTime=0, DemRbEventRecoverableInSameOperationCycle=true, DemRbEventStatusBitStorageTestFailed=true
          DemIndicatorAttribute:
            DemIndicatorFailureCycleCounterThreshold = 2
            DemRbIndicatorApiControl = false
            DemIndicatorBehaviour = DEM_INDICATOR_BLINK_CONT
            DemIndicatorHealingCycleCounterThreshold = 3
            DemIndicatorRef = MIL
        DemEventParameter_ECU1_DTC84: DemDTCRef=DemDTC_ECU1_DTC84, DemComponentClassRef=DemComponent_ECU1_DTC84
          DemDebounceAlgorithmClass
            DemDebounceCounterBasedClass (DemDebounceCounterBased): DemDebounceCounterBasedClassRef=DemDebounceCounterBasedClass_LostCom
          DemRbEventClass: DemRbEventBufferTime=0, DemRbEventRecoverableInSameOperationCycle=true, DemRbEventStatusBitStorageTestFailed=true
        DemEventParameter_ECU1_DTC85: DemDTCRef=DemDTC_ECU1_DTC85, DemComponentClassRef=DemComponent_ECU1_DTC85
          DemDebounceAlgorithmClass
            DemDebounceCounterBasedClass (DemDebounceCounterBased): DemDebounceCounterBasedClassRef=DemDebounceCounterBasedClass_LostCom
          DemRbEventClass: DemRbEventBufferTime=0, DemRbEventRecoverableInSameOperationCycle=true, DemRbEventStatusBitStorageTestFailed=true
          DemIndicatorAttribute:
            DemIndicatorFailureCycleCounterThreshold = 2
            DemRbIndicatorApiControl = false
            DemIndicatorBehaviour = DEM_INDICATOR_CONTINUOUS
            DemIndicatorHealingCycleCounterThreshold = 3
            DemIndicatorRef = MIL
        DemEventParameter_ECU1_DTC86: DemDTCRef=DemDTC_ECU1_DTC86, DemComponentClassRef=DemComponent_ECU1_DTC86
          DemDebounceAlgorithmClass
            DemDebounceCounterBasedClass (DemDebounceCounterBased): DemDebounceCounterBasedClassRef=DemDebounceCounterBasedClass_LostCom
          DemRbEventClass: DemRbEventBufferTime=0, DemRbEventRecoverableInSameOperationCycle=true, DemRbEventStatusBitStorageTestFailed=true
          DemIndicatorAttribute:
            DemIndicatorFailureCycleCounterThreshold = 2
            DemRbIndicatorApiControl = false
            DemIndicatorBehaviour = DEM_INDICATOR_CONTINUOUS
            DemIndicatorHealingCycleCounterThreshold = 3
            DemIndicatorRef = MIL
        DemEventParameter_ECU1_DTC87: DemDTCRef=DemDTC_ECU1_DTC87, DemComponentClassRef=DemComponent_ECU1_DTC87
          DemDebounceAlgorithmClass
            DemDebounceCounterBasedClass (DemDebounceCounterBased): DemDebounceCounterBasedClassRef=DemDebounceCounterBasedClass_LostCom
          DemRbEventClass: DemRbEventBufferTime=0, DemRbEventRecoverableInSameOperationCycle=true, DemRbEventStatusBitStorageTestFailed=true
          DemIndicatorAttribute:
            DemIndicatorFailureCycleCounterThreshold = 2
            DemRbIndicatorApiControl = false
            DemIndicatorBehaviour = DEM_INDICATOR_BLINK_CONT
            DemIndicatorHealingCycleCounterThreshold = 3
            DemIndicatorRef = MIL
        DemEventParameter_ECU1_DTC88: DemDTCRef=DemDTC_ECU1_DTC88, DemComponentClassRef=DemComponent_ECU1_DTC88
          DemDebounceAlgorithmClass
            DemDebounceCounterBasedClass (DemDebounceCounterBased): DemDebounceCounterBasedClassRef=DemDebounceCounterBasedClass_LostCom
          DemRbEventClass: DemRbEventBufferTime=0, DemRbEventRecoverableInSameOperationCycle=true, DemRbEventStatusBitStorageTestFailed=true
          DemIndicatorAttribute:
            DemIndicatorFailureCycleCounterThreshold = 2
            DemRbIndicatorApiControl = false
            DemIndicatorBehaviour = DEM_INDICATOR_BLINK_CONT
            DemIndicatorHealingCycleCounterThreshold = 3
            DemIndicatorRef = MIL
        DemEventParameter_ECU1_DTC89: DemDTCRef=DemDTC_ECU1_DTC89, DemComponentClassRef=DemComponent_ECU1_DTC89
          DemDebounceAlgorithmClass
            DemDebounceCounterBasedClass (DemDebounceCounterBased): DemDebounceCounterBasedClassRef=DemDebounceCounterBasedClass_LostCom
          DemRbEventClass: DemRbEventBufferTime=0, DemRbEventRecoverableInSameOperationCycle=true, DemRbEventStatusBitStorageTestFailed=true
        DemEventParameter_ECU1_DTC90: DemDTCRef=DemDTC_ECU1_DTC90, DemComponentClassRef=DemComponent_ECU1_DTC90
          DemDebounceAlgorithmClass
            DemDebounceCounterBasedClass (DemDebounceCounterBased): DemDebounceCounterBasedClassRef=DemDebounceCounterBasedClass_LostCom
          DemRbEventClass: DemRbEventBufferTime=0, DemRbEventRecoverableInSameOperationCycle=true, DemRbEventStatusBitStorageTestFailed=true
        DemEventParameter_ECU1_DTC91: DemDTCRef=DemDTC_ECU1_DTC91, DemComponentClassRef=DemComponent_ECU1_DTC91
          DemDebounceAlgorithmClass
            DemDebounceCounterBasedClass (DemDebounceCounterBased): DemDebounceCounterBasedClassRef=DemDebounceCounterBasedClass_LostCom
          DemRbEventClass: DemRbEventBufferTime=0, DemRbEventRecoverableInSameOperationCycle=true, DemRbEventStatusBitStorageTestFailed=true
          DemIndicatorAttribute:
            DemIndicatorFailureCycleCounterThreshold = 2
            DemRbIndicatorApiControl = false
            DemIndicatorBehaviour = DEM_INDICATOR_CONTINUOUS
            DemIndicatorHealingCycleCounterThreshold = 3
            DemIndicatorRef = MIL
        DemEventParameter_ECU1_DTC92: DemDTCRef=DemDTC_ECU1_DTC92, DemComponentClassRef=DemComponent_ECU1_DTC92
          DemDebounceAlgorithmClass
            DemDebounceCounterBasedClass (DemDebounceCounterBased): DemDebounceCounterBasedClassRef=DemDebounceCounterBasedClass_LostCom
          DemRbEventClass: DemRbEventBufferTime=0, DemRbEventRecoverableInSameOperationCycle=true, DemRbEventStatusBitStorageTestFailed=true
          DemIndicatorAttribute:
            DemIndicatorFailureCycleCounterThreshold = 2
            DemRbIndicatorApiControl = false
            DemIndicatorBehaviour = DEM_INDICATOR_CONTINUOUS
            DemIndicatorHealingCycleCounterThreshold = 3
            DemIndicatorRef = MIL
        DemEventParameter_ECU1_DTC93: DemDTCRef=DemDTC_ECU1_DTC93, DemComponentClassRef=DemComponent_ECU1_DTC93
          DemDebounceAlgorithmClass
            DemDebounceCounterBasedClass (DemDebounceCounterBased): DemDebounceCounterBasedClassRef=DemDebounceCounterBasedClass_LostCom
          DemRbEventClass: DemRbEventBufferTime=0, DemRbEventRecoverableInSameOperationCycle=true, DemRbEventStatusBitStorageTestFailed=true
          DemIndicatorAttribute:
            DemIndicatorFailureCycleCounterThreshold = 2
            DemRbIndicatorApiControl = false
            DemIndicatorBehaviour = DEM_INDICATOR_CONTINUOUS
            DemIndicatorHealingCycleCounterThreshold = 3
            DemIndicatorRef = MIL
        DemEventParameter_ECU1_DTC94: DemDTCRef=DemDTC_ECU1_DTC94, DemComponentClassRef=DemComponent_ECU1_DTC94
          DemDebounceAlgorithmClass
            DemDebounceCounterBasedClass (DemDebounceCounterBased): DemDebounceCounterBasedClassRef=DemDebounceCounterBasedClass_LostCom
          DemRbEventClass: DemRbEventBufferTime=0, DemRbEventRecoverableInSameOperationCycle=true, DemRbEventStatusBitStorageTestFailed=true
          DemIndicatorAttribute:
            DemIndicatorFailureCycleCounterThreshold = 2
            DemRbIndicatorApiControl = false
            DemIndicatorBehaviour = DEM_INDICATOR_CONTINUOUS
            DemIndicatorHealingCycleCounterThreshold = 3
            DemIndicatorRef = MIL
        DemEventParameter_ECU1_DTC95: DemDTCRef=DemDTC_ECU1_DTC95, DemComponentClassRef=DemComponent_ECU1_DTC95
          DemDebounceAlgorithmClass
            DemDebounceCounterBasedClass (DemDebounceCounterBased): DemDebounceCounterBasedClassRef=DemDebounceCounterBasedClass_LostCom
          DemRbEventClass: DemRbEventBufferTime=0, DemRbEventRecoverableInSameOperationCycle=true, DemRbEventStatusBitStorageTestFailed=true
          DemIndicatorAttribute:
            DemIndicatorFailureCycleCounterThreshold = 2
            DemRbIndicatorApiControl = false
            DemIndicatorBehaviour = DEM_INDICATOR_CONTINUOUS
            DemIndicatorHealingCycleCounterThreshold = 3
            DemIndicatorRef = MIL
        DemEventParameter_ECU1_DTC96: DemDTCRef=DemDTC_ECU1_DTC96, DemComponentClassRef=DemComponent_ECU1_DTC96
          DemDebounceAlgorithmClass
            DemDebounceCounterBasedClass (DemDebounceCounterBased): DemDebounceCounterBasedClassRef=DemDebounceCounterBasedClass_LostCom
          DemRbEventClass: DemRbEventBufferTime=0, DemRbEventRecoverableInSameOperationCycle=true, DemRbEventStatusBitStorageTestFailed=true
          DemIndicatorAttribute:
            DemIndicatorFailureCycleCounterThreshold = 2
            DemRbIndicatorApiControl = false
            DemIndicatorBehaviour = DEM_INDICATOR_CONTINUOUS
            DemIndicatorHealingCycleCounterThreshold = 3
            DemIndicatorRef = MIL
        DemEventParameter_ECU1_DTC97: DemDTCRef=DemDTC_ECU1_DTC97, DemComponentClassRef=DemComponent_ECU1_DTC97
          DemDebounceAlgorithmClass
            DemDebounceCounterBasedClass (DemDebounceCounterBased): DemDebounceCounterBasedClassRef=DemDebounceCounterBasedClass_LostCom
          DemRbEventClass: DemRbEventBufferTime=0, DemRbEventRecoverableInSameOperationCycle=true, DemRbEventStatusBitStorageTestFailed=true
          DemIndicatorAttribute:
            DemIndicatorFailureCycleCounterThreshold = 2
            DemRbIndicatorApiControl = false
            DemIndicatorBehaviour = DEM_INDICATOR_CONTINUOUS
            DemIndicatorHealingCycleCounterThreshold = 3
            DemIndicatorRef = MIL
        DemEventParameter_ECU1_DTC98: DemDTCRef=DemDTC_ECU1_DTC98, DemComponentClassRef=DemComponent_ECU1_DTC98
          DemDebounceAlgorithmClass
            DemDebounceCounterBasedClass (DemDebounceCounterBased): DemDebounceCounterBasedClassRef=DemDebounceCounterBasedClass_LostCom
          DemRbEventClass: DemRbEventBufferTime=0, DemRbEventRecoverableInSameOperationCycle=true, DemRbEventStatusBitStorageTestFailed=true
          DemIndicatorAttribute:
            DemIndicatorFailureCycleCounterThreshold = 2
            DemRbIndicatorApiControl = false
            DemIndicatorBehaviour = DEM_INDICATOR_CONTINUOUS
            DemIndicatorHealingCycleCounterThreshold = 3
            DemIndicatorRef = MIL
        DemEventParameter_ECU1_DTC99: DemDTCRef=DemDTC_ECU1_DTC99, DemComponentClassRef=DemComponent_ECU1_DTC99
          DemDebounceAlgorithmClass
            DemDebounceCounterBasedClass (DemDebounceCounterBased): DemDebounceCounterBasedClassRef=DemDebounceCounterBasedClass_LostCom
          DemRbEventClass: DemRbEventBufferTime=0, DemRbEventRecoverableInSameOperationCycle=true, DemRbEventStatusBitStorageTestFailed=true
          DemIndicatorAttribute:
            DemIndicatorFailureCycleCounterThreshold = 2
            DemRbIndicatorApiControl = false
            DemIndicatorBehaviour = DEM_INDICATOR_CONTINUOUS
            DemIndicatorHealingCycleCounterThreshold = 3
            DemIndicatorRef = MIL
        DemEventParameter_ECU2_DTC00: DemDTCRef=DemDTC_ECU2_DTC00, DemComponentClassRef=DemComponent_ECU2_DTC00
          DemDebounceAlgorithmClass
            DemDebounceCounterBasedClass (DemDebounceCounterBased): DemDebounceCounterBasedClassRef=DemDebounceCounterBasedClass_LostCom
          DemRbEventClass: DemRbEventBufferTime=0, DemRbEventRecoverableInSameOperationCycle=true, DemRbEventStatusBitStorageTestFailed=true
        DemEventParameter_ECU2_DTC01: DemDTCRef=DemDTC_ECU2_DTC01, DemComponentClassRef=DemComponent_ECU2_DTC01
          DemDebounceAlgorithmClass
            DemDebounceCounterBasedClass (DemDebounceCounterBased): DemDebounceCounterBasedClassRef=DemDebounceCounterBasedClass_LostCom
          DemRbEventClass: DemRbEventBufferTime=0, DemRbEventRecoverableInSameOperationCycle=true, DemRbEventStatusBitStorageTestFailed=true
        DemEventParameter_ECU2_DTC02: DemDTCRef=DemDTC_ECU2_DTC02, DemComponentClassRef=DemComponent_ECU2_DTC02
          DemDebounceAlgorithmClass
            DemDebounceCounterBasedClass (DemDebounceCounterBased): DemDebounceCounterBasedClassRef=DemDebounceCounterBasedClass_LostCom
          DemRbEventClass: DemRbEventBufferTime=0, DemRbEventRecoverableInSameOperationCycle=true, DemRbEventStatusBitStorageTestFailed=true
        DemEventParameter_ECU2_DTC03: DemDTCRef=DemDTC_ECU2_DTC03, DemComponentClassRef=DemComponent_ECU2_DTC03
          DemDebounceAlgorithmClass
            DemDebounceCounterBasedClass (DemDebounceCounterBased): DemDebounceCounterBasedClassRef=DemDebounceCounterBasedClass_LostCom
          DemRbEventClass: DemRbEventBufferTime=0, DemRbEventRecoverableInSameOperationCycle=true, DemRbEventStatusBitStorageTestFailed=true
        DemEventParameter_ECU2_DTC04: DemDTCRef=DemDTC_ECU2_DTC04, DemComponentClassRef=DemComponent_ECU2_DTC04
          DemDebounceAlgorithmClass
            DemDebounceCounterBasedClass (DemDebounceCounterBased): DemDebounceCounterBasedClassRef=DemDebounceCounterBasedClass_LostCom
          DemRbEventClass: DemRbEventBufferTime=0, DemRbEventRecoverableInSameOperationCycle=true, DemRbEventStatusBitStorageTestFailed=true
        DemEventParameter_ECU2_DTC05: DemDTCRef=DemDTC_ECU2_DTC05, DemComponentClassRef=DemComponent_ECU2_DTC05
          DemDebounceAlgorithmClass
            DemDebounceCounterBasedClass (DemDebounceCounterBased): DemDebounceCounterBasedClassRef=DemDebounceCounterBasedClass_LostCom
          DemRbEventClass: DemRbEventBufferTime=0, DemRbEventRecoverableInSameOperationCycle=true, DemRbEventStatusBitStorageTestFailed=true
        DemEventParameter_ECU2_DTC06: DemDTCRef=DemDTC_ECU2_DTC06, DemComponentClassRef=DemComponent_ECU2_DTC06
          DemDebounceAlgorithmClass
            DemDebounceCounterBasedClass (DemDebounceCounterBased): DemDebounceCounterBasedClassRef=DemDebounceCounterBasedClass_LostCom
          DemRbEventClass: DemRbEventBufferTime=0, DemRbEventRecoverableInSameOperationCycle=true, DemRbEventStatusBitStorageTestFailed=true
        DemEventParameter_ECU2_DTC07: DemDTCRef=DemDTC_ECU2_DTC07, DemComponentClassRef=DemComponent_ECU2_DTC07
          DemDebounceAlgorithmClass
            DemDebounceCounterBasedClass (DemDebounceCounterBased): DemDebounceCounterBasedClassRef=DemDebounceCounterBasedClass_LostCom
          DemRbEventClass: DemRbEventBufferTime=0, DemRbEventRecoverableInSameOperationCycle=true, DemRbEventStatusBitStorageTestFailed=true
          DemIndicatorAttribute:
            DemIndicatorFailureCycleCounterThreshold = 2
            DemRbIndicatorApiControl = false
            DemIndicatorBehaviour = DEM_INDICATOR_CONTINUOUS
            DemIndicatorHealingCycleCounterThreshold = 3
            DemIndicatorRef = MIL
        DemEventParameter_ECU2_DTC08: DemDTCRef=DemDTC_ECU2_DTC08, DemComponentClassRef=DemComponent_ECU2_DTC08
          DemDebounceAlgorithmClass
            DemDebounceCounterBasedClass (DemDebounceCounterBased): DemDebounceCounterBasedClassRef=DemDebounceCounterBasedClass_LostCom
          DemRbEventClass: DemRbEventBufferTime=0, DemRbEventRecoverableInSameOperationCycle=true, DemRbEventStatusBitStorageTestFailed=true
          DemIndicatorAttribute:
            DemIndicatorFailureCycleCounterThreshold = 2
            DemRbIndicatorApiControl = false
            DemIndicatorBehaviour = DEM_INDICATOR_CONTINUOUS
            DemIndicatorHealingCycleCounterThreshold = 3
            DemIndicatorRef = MIL
        DemEventParameter_ECU2_DTC09: DemDTCRef=DemDTC_ECU2_DTC09, DemComponentClassRef=DemComponent_ECU2_DTC09
          DemDebounceAlgorithmClass
            DemDebounceCounterBasedClass (DemDebounceCounterBased): DemDebounceCounterBasedClassRef=DemDebounceCounterBasedClass_LostCom
          DemRbEventClass: DemRbEventBufferTime=0, DemRbEventRecoverableInSameOperationCycle=true, DemRbEventStatusBitStorageTestFailed=true
        DemEventParameter_ECU2_DTC10: DemDTCRef=DemDTC_ECU2_DTC10, DemComponentClassRef=DemComponent_ECU2_DTC10
          DemDebounceAlgorithmClass
            DemDebounceCounterBasedClass (DemDebounceCounterBased): DemDebounceCounterBasedClassRef=DemDebounceCounterBasedClass_LostCom
          DemRbEventClass: DemRbEventBufferTime=0, DemRbEventRecoverableInSameOperationCycle=true, DemRbEventStatusBitStorageTestFailed=true
        DemEventParameter_ECU2_DTC11: DemDTCRef=DemDTC_ECU2_DTC11, DemComponentClassRef=DemComponent_ECU2_DTC11
          DemDebounceAlgorithmClass
            DemDebounceCounterBasedClass (DemDebounceCounterBased): DemDebounceCounterBasedClassRef=DemDebounceCounterBasedClass_LostCom
          DemRbEventClass: DemRbEventBufferTime=0, DemRbEventRecoverableInSameOperationCycle=true, DemRbEventStatusBitStorageTestFailed=true
          DemIndicatorAttribute:
            DemIndicatorFailureCycleCounterThreshold = 2
            DemRbIndicatorApiControl = false
            DemIndicatorBehaviour = DEM_INDICATOR_CONTINUOUS
            DemIndicatorHealingCycleCounterThreshold = 3
            DemIndicatorRef = MIL
        DemEventParameter_ECU2_DTC12: DemDTCRef=DemDTC_ECU2_DTC12, DemComponentClassRef=DemComponent_ECU2_DTC12
          DemDebounceAlgorithmClass
            DemDebounceCounterBasedClass (DemDebounceCounterBased): DemDebounceCounterBasedClassRef=DemDebounceCounterBasedClass_LostCom
          DemRbEventClass: DemRbEventBufferTime=0, DemRbEventRecoverableInSameOperationCycle=true, DemRbEventStatusBitStorageTestFailed=true
        DemEventParameter_ECU2_DTC13: DemDTCRef=DemDTC_ECU2_DTC13, DemComponentClassRef=DemComponent_ECU2_DTC13
          DemDebounceAlgorithmClass
            DemDebounceCounterBasedClass (DemDebounceCounterBased): DemDebounceCounterBasedClassRef=DemDebounceCounterBasedClass_LostCom
          DemRbEventClass: DemRbEventBufferTime=0, DemRbEventRecoverableInSameOperationCycle=true, DemRbEventStatusBitStorageTestFailed=true
        DemEventParameter_ECU2_DTC14: DemDTCRef=DemDTC_ECU2_DTC14, DemComponentClassRef=DemComponent_ECU2_DTC14
          DemDebounceAlgorithmClass
            DemDebounceCounterBasedClass (DemDebounceCounterBased): DemDebounceCounterBasedClassRef=DemDebounceCounterBasedClass_LostCom
          DemRbEventClass: DemRbEventBufferTime=0, DemRbEventRecoverableInSameOperationCycle=true, DemRbEventStatusBitStorageTestFailed=true
        DemEventParameter_ECU2_DTC15: DemDTCRef=DemDTC_ECU2_DTC15, DemComponentClassRef=DemComponent_ECU2_DTC15
          DemDebounceAlgorithmClass
            DemDebounceCounterBasedClass (DemDebounceCounterBased): DemDebounceCounterBasedClassRef=DemDebounceCounterBasedClass_LostCom
          DemRbEventClass: DemRbEventBufferTime=0, DemRbEventRecoverableInSameOperationCycle=true, DemRbEventStatusBitStorageTestFailed=true
        DemEventParameter_ECU2_DTC16: DemDTCRef=DemDTC_ECU2_DTC16, DemComponentClassRef=DemComponent_ECU2_DTC16
          DemDebounceAlgorithmClass
            DemDebounceCounterBasedClass (DemDebounceCounterBased): DemDebounceCounterBasedClassRef=DemDebounceCounterBasedClass_LostCom
          DemRbEventClass: DemRbEventBufferTime=0, DemRbEventRecoverableInSameOperationCycle=true, DemRbEventStatusBitStorageTestFailed=true
        DemEventParameter_ECU2_DTC17: DemDTCRef=DemDTC_ECU2_DTC17, DemComponentClassRef=DemComponent_ECU2_DTC17
          DemDebounceAlgorithmClass
            DemDebounceCounterBasedClass (DemDebounceCounterBased): DemDebounceCounterBasedClassRef=DemDebounceCounterBasedClass_LostCom
          DemRbEventClass: DemRbEventBufferTime=0, DemRbEventRecoverableInSameOperationCycle=true, DemRbEventStatusBitStorageTestFailed=true
        DemEventParameter_ECU2_DTC18: DemDTCRef=DemDTC_ECU2_DTC18, DemComponentClassRef=DemComponent_ECU2_DTC18
          DemDebounceAlgorithmClass
            DemDebounceCounterBasedClass (DemDebounceCounterBased): DemDebounceCounterBasedClassRef=DemDebounceCounterBasedClass_LostCom
          DemRbEventClass: DemRbEventBufferTime=0, DemRbEventRecoverableInSameOperationCycle=true, DemRbEventStatusBitStorageTestFailed=true
        DemEventParameter_ECU2_DTC19: DemDTCRef=DemDTC_ECU2_DTC19, DemComponentClassRef=DemComponent_ECU2_DTC19
          DemDebounceAlgorithmClass
            DemDebounceCounterBasedClass (DemDebounceCounterBased): DemDebounceCounterBasedClassRef=DemDebounceCounterBasedClass_LostCom
          DemRbEventClass: DemRbEventBufferTime=0, DemRbEventRecoverableInSameOperationCycle=true, DemRbEventStatusBitStorageTestFailed=true
          DemIndicatorAttribute:
            DemIndicatorFailureCycleCounterThreshold = 2
            DemRbIndicatorApiControl = false
            DemIndicatorBehaviour = DEM_INDICATOR_CONTINUOUS
            DemIndicatorHealingCycleCounterThreshold = 3
            DemIndicatorRef = MIL
        DemEventParameter_ECU2_DTC20: DemDTCRef=DemDTC_ECU2_DTC20, DemComponentClassRef=DemComponent_ECU2_DTC20
          DemDebounceAlgorithmClass
            DemDebounceCounterBasedClass (DemDebounceCounterBased): DemDebounceCounterBasedClassRef=DemDebounceCounterBasedClass_LostCom
          DemRbEventClass: DemRbEventBufferTime=0, DemRbEventRecoverableInSameOperationCycle=true, DemRbEventStatusBitStorageTestFailed=true
          DemIndicatorAttribute:
            DemIndicatorFailureCycleCounterThreshold = 2
            DemRbIndicatorApiControl = false
            DemIndicatorBehaviour = DEM_INDICATOR_CONTINUOUS
            DemIndicatorHealingCycleCounterThreshold = 3
            DemIndicatorRef = MIL
        DemEventParameter_ECU2_DTC21: DemDTCRef=DemDTC_ECU2_DTC21, DemComponentClassRef=DemComponent_ECU2_DTC21
          DemDebounceAlgorithmClass
            DemDebounceCounterBasedClass (DemDebounceCounterBased): DemDebounceCounterBasedClassRef=DemDebounceCounterBasedClass_LostCom
          DemRbEventClass: DemRbEventBufferTime=0, DemRbEventRecoverableInSameOperationCycle=true, DemRbEventStatusBitStorageTestFailed=true
        DemEventParameter_ECU2_DTC22: DemDTCRef=DemDTC_ECU2_DTC22, DemComponentClassRef=DemComponent_ECU2_DTC22
          DemDebounceAlgorithmClass
            DemDebounceCounterBasedClass (DemDebounceCounterBased): DemDebounceCounterBasedClassRef=DemDebounceCounterBasedClass_LostCom
          DemRbEventClass: DemRbEventBufferTime=0, DemRbEventRecoverableInSameOperationCycle=true, DemRbEventStatusBitStorageTestFailed=true
        DemEventParameter_ECU2_DTC23: DemDTCRef=DemDTC_ECU2_DTC23, DemComponentClassRef=DemComponent_ECU2_DTC23
          DemDebounceAlgorithmClass
            DemDebounceCounterBasedClass (DemDebounceCounterBased): DemDebounceCounterBasedClassRef=DemDebounceCounterBasedClass_LostCom
          DemRbEventClass: DemRbEventBufferTime=0, DemRbEventRecoverableInSameOperationCycle=true, DemRbEventStatusBitStorageTestFailed=true
          DemIndicatorAttribute:
            DemIndicatorFailureCycleCounterThreshold = 2
            DemRbIndicatorApiControl = false
            DemIndicatorBehaviour = DEM_INDICATOR_CONTINUOUS
            DemIndicatorHealingCycleCounterThreshold = 3
            DemIndicatorRef = MIL
        DemEventParameter_ECU2_DTC24: DemDTCRef=DemDTC_ECU2_DTC24, DemComponentClassRef=DemComponent_ECU2_DTC24
          DemDebounceAlgorithmClass
            DemDebounceCounterBasedClass (DemDebounceCounterBased): DemDebounceCounterBasedClassRef=DemDebounceCounterBasedClass_LostCom
          DemRbEventClass: DemRbEventBufferTime=0, DemRbEventRecoverableInSameOperationCycle=true, DemRbEventStatusBitStorageTestFailed=true
        DemEventParameter_ECU2_DTC25: DemDTCRef=DemDTC_ECU2_DTC25, DemComponentClassRef=DemComponent_ECU2_DTC25
          DemDebounceAlgorithmClass
            DemDebounceCounterBasedClass (DemDebounceCounterBased): DemDebounceCounterBasedClassRef=DemDebounceCounterBasedClass_LostCom
          DemRbEventClass: DemRbEventBufferTime=0, DemRbEventRecoverableInSameOperationCycle=true, DemRbEventStatusBitStorageTestFailed=true
        DemEventParameter_ECU2_DTC26: DemDTCRef=DemDTC_ECU2_DTC26, DemComponentClassRef=DemComponent_ECU2_DTC26
          DemDebounceAlgorithmClass
            DemDebounceCounterBasedClass (DemDebounceCounterBased): DemDebounceCounterBasedClassRef=DemDebounceCounterBasedClass_LostCom
          DemRbEventClass: DemRbEventBufferTime=0, DemRbEventRecoverableInSameOperationCycle=true, DemRbEventStatusBitStorageTestFailed=true
        DemEventParameter_ECU2_DTC27: DemDTCRef=DemDTC_ECU2_DTC27, DemComponentClassRef=DemComponent_ECU2_DTC27
          DemDebounceAlgorithmClass
            DemDebounceCounterBasedClass (DemDebounceCounterBased): DemDebounceCounterBasedClassRef=DemDebounceCounterBasedClass_LostCom
          DemRbEventClass: DemRbEventBufferTime=0, DemRbEventRecoverableInSameOperationCycle=true, DemRbEventStatusBitStorageTestFailed=true
        DemEventParameter_ECU2_DTC28: DemDTCRef=DemDTC_ECU2_DTC28, DemComponentClassRef=DemComponent_ECU2_DTC28
          DemDebounceAlgorithmClass
            DemDebounceCounterBasedClass (DemDebounceCounterBased): DemDebounceCounterBasedClassRef=DemDebounceCounterBasedClass_LostCom
          DemRbEventClass: DemRbEventBufferTime=0, DemRbEventRecoverableInSameOperationCycle=true, DemRbEventStatusBitStorageTestFailed=true
        DemEventParameter_ECU2_DTC29: DemDTCRef=DemDTC_ECU2_DTC29, DemComponentClassRef=DemComponent_ECU2_DTC29
          DemDebounceAlgorithmClass
            DemDebounceCounterBasedClass (DemDebounceCounterBased): DemDebounceCounterBasedClassRef=DemDebounceCounterBasedClass_LostCom
          DemRbEventClass: DemRbEventBufferTime=0, DemRbEventRecoverableInSameOperationCycle=true, DemRbEventStatusBitStorageTestFailed=true
        DemEventParameter_ECU2_DTC30: DemDTCRef=DemDTC_ECU2_DTC30, DemComponentClassRef=DemComponent_ECU2_DTC30
          DemDebounceAlgorithmClass
            DemDebounceCounterBasedClass (DemDebounceCounterBased): DemDebounceCounterBasedClassRef=DemDebounceCounterBasedClass_LostCom
          DemRbEventClass: DemRbEventBufferTime=0, DemRbEventRecoverableInSameOperationCycle=true, DemRbEventStatusBitStorageTestFailed=true
        DemEventParameter_ECU2_DTC31: DemDTCRef=DemDTC_ECU2_DTC31, DemComponentClassRef=DemComponent_ECU2_DTC31
          DemDebounceAlgorithmClass
            DemDebounceCounterBasedClass (DemDebounceCounterBased): DemDebounceCounterBasedClassRef=DemDebounceCounterBasedClass_LostCom
          DemRbEventClass: DemRbEventBufferTime=0, DemRbEventRecoverableInSameOperationCycle=true, DemRbEventStatusBitStorageTestFailed=true
          DemIndicatorAttribute:
            DemIndicatorFailureCycleCounterThreshold = 2
            DemRbIndicatorApiControl = false
            DemIndicatorBehaviour = DEM_INDICATOR_CONTINUOUS
            DemIndicatorHealingCycleCounterThreshold = 3
            DemIndicatorRef = MIL
        DemEventParameter_ECU2_DTC32: DemDTCRef=DemDTC_ECU2_DTC32, DemComponentClassRef=DemComponent_ECU2_DTC32
          DemDebounceAlgorithmClass
            DemDebounceCounterBasedClass (DemDebounceCounterBased): DemDebounceCounterBasedClassRef=DemDebounceCounterBasedClass_LostCom
          DemRbEventClass: DemRbEventBufferTime=0, DemRbEventRecoverableInSameOperationCycle=true, DemRbEventStatusBitStorageTestFailed=true
          DemIndicatorAttribute:
            DemIndicatorFailureCycleCounterThreshold = 2
            DemRbIndicatorApiControl = false
            DemIndicatorBehaviour = DEM_INDICATOR_CONTINUOUS
            DemIndicatorHealingCycleCounterThreshold = 3
            DemIndicatorRef = MIL
        DemEventParameter_ECU2_DTC33: DemDTCRef=DemDTC_ECU2_DTC33, DemComponentClassRef=DemComponent_ECU2_DTC33
          DemDebounceAlgorithmClass
            DemDebounceCounterBasedClass (DemDebounceCounterBased): DemDebounceCounterBasedClassRef=DemDebounceCounterBasedClass_LostCom
          DemRbEventClass: DemRbEventBufferTime=0, DemRbEventRecoverableInSameOperationCycle=true, DemRbEventStatusBitStorageTestFailed=true
        DemEventParameter_ECU2_DTC34: DemDTCRef=DemDTC_ECU2_DTC34, DemComponentClassRef=DemComponent_ECU2_DTC34
          DemDebounceAlgorithmClass
            DemDebounceCounterBasedClass (DemDebounceCounterBased): DemDebounceCounterBasedClassRef=DemDebounceCounterBasedClass_LostCom
          DemRbEventClass: DemRbEventBufferTime=0, DemRbEventRecoverableInSameOperationCycle=true, DemRbEventStatusBitStorageTestFailed=true
        DemEventParameter_ECU2_DTC35: DemDTCRef=DemDTC_ECU2_DTC35, DemComponentClassRef=DemComponent_ECU2_DTC35
          DemDebounceAlgorithmClass
            DemDebounceCounterBasedClass (DemDebounceCounterBased): DemDebounceCounterBasedClassRef=DemDebounceCounterBasedClass_LostCom
          DemRbEventClass: DemRbEventBufferTime=0, DemRbEventRecoverableInSameOperationCycle=true, DemRbEventStatusBitStorageTestFailed=true
          DemIndicatorAttribute:
            DemIndicatorFailureCycleCounterThreshold = 2
            DemRbIndicatorApiControl = false
            DemIndicatorBehaviour = DEM_INDICATOR_CONTINUOUS
            DemIndicatorHealingCycleCounterThreshold = 3
            DemIndicatorRef = MIL
        DemEventParameter_ECU2_DTC36: DemDTCRef=DemDTC_ECU2_DTC36, DemComponentClassRef=DemComponent_ECU2_DTC36
          DemDebounceAlgorithmClass
            DemDebounceCounterBasedClass (DemDebounceCounterBased): DemDebounceCounterBasedClassRef=DemDebounceCounterBasedClass_LostCom
          DemRbEventClass: DemRbEventBufferTime=0, DemRbEventRecoverableInSameOperationCycle=true, DemRbEventStatusBitStorageTestFailed=true
        DemEventParameter_ECU2_DTC37: DemDTCRef=DemDTC_ECU2_DTC37, DemComponentClassRef=DemComponent_ECU2_DTC37
          DemDebounceAlgorithmClass
            DemDebounceCounterBasedClass (DemDebounceCounterBased): DemDebounceCounterBasedClassRef=DemDebounceCounterBasedClass_LostCom
          DemRbEventClass: DemRbEventBufferTime=0, DemRbEventRecoverableInSameOperationCycle=true, DemRbEventStatusBitStorageTestFailed=true
        DemEventParameter_ECU2_DTC38: DemDTCRef=DemDTC_ECU2_DTC38, DemComponentClassRef=DemComponent_ECU2_DTC38
          DemDebounceAlgorithmClass
            DemDebounceCounterBasedClass (DemDebounceCounterBased): DemDebounceCounterBasedClassRef=DemDebounceCounterBasedClass_LostCom
          DemRbEventClass: DemRbEventBufferTime=0, DemRbEventRecoverableInSameOperationCycle=true, DemRbEventStatusBitStorageTestFailed=true
        DemEventParameter_ECU2_DTC39: DemDTCRef=DemDTC_ECU2_DTC39, DemComponentClassRef=DemComponent_ECU2_DTC39
          DemDebounceAlgorithmClass
            DemDebounceCounterBasedClass (DemDebounceCounterBased): DemDebounceCounterBasedClassRef=DemDebounceCounterBasedClass_LostCom
          DemRbEventClass: DemRbEventBufferTime=0, DemRbEventRecoverableInSameOperationCycle=true, DemRbEventStatusBitStorageTestFailed=true
        DemEventParameter_ECU2_DTC40: DemDTCRef=DemDTC_ECU2_DTC40, DemComponentClassRef=DemComponent_ECU2_DTC40
          DemDebounceAlgorithmClass
            DemDebounceCounterBasedClass (DemDebounceCounterBased): DemDebounceCounterBasedClassRef=DemDebounceCounterBasedClass_LostCom
          DemRbEventClass: DemRbEventBufferTime=0, DemRbEventRecoverableInSameOperationCycle=true, DemRbEventStatusBitStorageTestFailed=true
        DemEventParameter_ECU2_DTC41: DemDTCRef=DemDTC_ECU2_DTC41, DemComponentClassRef=DemComponent_ECU2_DTC41
          DemDebounceAlgorithmClass
            DemDebounceCounterBasedClass (DemDebounceCounterBased): DemDebounceCounterBasedClassRef=DemDebounceCounterBasedClass_LostCom
          DemRbEventClass: DemRbEventBufferTime=0, DemRbEventRecoverableInSameOperationCycle=true, DemRbEventStatusBitStorageTestFailed=true
        DemEventParameter_ECU2_DTC42: DemDTCRef=DemDTC_ECU2_DTC42, DemComponentClassRef=DemComponent_ECU2_DTC42
          DemDebounceAlgorithmClass
            DemDebounceCounterBasedClass (DemDebounceCounterBased): DemDebounceCounterBasedClassRef=DemDebounceCounterBasedClass_LostCom
          DemRbEventClass: DemRbEventBufferTime=0, DemRbEventRecoverableInSameOperationCycle=true, DemRbEventStatusBitStorageTestFailed=true
        DemEventParameter_ECU2_DTC43: DemDTCRef=DemDTC_ECU2_DTC43, DemComponentClassRef=DemComponent_ECU2_DTC43
          DemDebounceAlgorithmClass
            DemDebounceCounterBasedClass (DemDebounceCounterBased): DemDebounceCounterBasedClassRef=DemDebounceCounterBasedClass_LostCom
          DemRbEventClass: DemRbEventBufferTime=0, DemRbEventRecoverableInSameOperationCycle=true, DemRbEventStatusBitStorageTestFailed=true
          DemIndicatorAttribute:
            DemIndicatorFailureCycleCounterThreshold = 2
            DemRbIndicatorApiControl = false
            DemIndicatorBehaviour = DEM_INDICATOR_CONTINUOUS
            DemIndicatorHealingCycleCounterThreshold = 3
            DemIndicatorRef = MIL
        DemEventParameter_ECU2_DTC44: DemDTCRef=DemDTC_ECU2_DTC44, DemComponentClassRef=DemComponent_ECU2_DTC44
          DemDebounceAlgorithmClass
            DemDebounceCounterBasedClass (DemDebounceCounterBased): DemDebounceCounterBasedClassRef=DemDebounceCounterBasedClass_LostCom
          DemRbEventClass: DemRbEventBufferTime=0, DemRbEventRecoverableInSameOperationCycle=true, DemRbEventStatusBitStorageTestFailed=true
          DemIndicatorAttribute:
            DemIndicatorFailureCycleCounterThreshold = 2
            DemRbIndicatorApiControl = false
            DemIndicatorBehaviour = DEM_INDICATOR_CONTINUOUS
            DemIndicatorHealingCycleCounterThreshold = 3
            DemIndicatorRef = MIL
        DemEventParameter_ECU2_DTC45: DemDTCRef=DemDTC_ECU2_DTC45, DemComponentClassRef=DemComponent_ECU2_DTC45
          DemDebounceAlgorithmClass
            DemDebounceCounterBasedClass (DemDebounceCounterBased): DemDebounceCounterBasedClassRef=DemDebounceCounterBasedClass_LostCom
          DemRbEventClass: DemRbEventBufferTime=0, DemRbEventRecoverableInSameOperationCycle=true, DemRbEventStatusBitStorageTestFailed=true
        DemEventParameter_ECU2_DTC46: DemDTCRef=DemDTC_ECU2_DTC46, DemComponentClassRef=DemComponent_ECU2_DTC46
          DemDebounceAlgorithmClass
            DemDebounceCounterBasedClass (DemDebounceCounterBased): DemDebounceCounterBasedClassRef=DemDebounceCounterBasedClass_LostCom
          DemRbEventClass: DemRbEventBufferTime=0, DemRbEventRecoverableInSameOperationCycle=true, DemRbEventStatusBitStorageTestFailed=true
        DemEventParameter_ECU2_DTC47: DemDTCRef=DemDTC_ECU2_DTC47, DemComponentClassRef=DemComponent_ECU2_DTC47
          DemDebounceAlgorithmClass
            DemDebounceCounterBasedClass (DemDebounceCounterBased): DemDebounceCounterBasedClassRef=DemDebounceCounterBasedClass_LostCom
          DemRbEventClass: DemRbEventBufferTime=0, DemRbEventRecoverableInSameOperationCycle=true, DemRbEventStatusBitStorageTestFailed=true
          DemIndicatorAttribute:
            DemIndicatorFailureCycleCounterThreshold = 2
            DemRbIndicatorApiControl = false
            DemIndicatorBehaviour = DEM_INDICATOR_CONTINUOUS
            DemIndicatorHealingCycleCounterThreshold = 3
            DemIndicatorRef = MIL
        DemEventParameter_ECU2_DTC48: DemDTCRef=DemDTC_ECU2_DTC48, DemComponentClassRef=DemComponent_ECU2_DTC48
          DemDebounceAlgorithmClass
            DemDebounceCounterBasedClass (DemDebounceCounterBased): DemDebounceCounterBasedClassRef=DemDebounceCounterBasedClass_LostCom
          DemRbEventClass: DemRbEventBufferTime=0, DemRbEventRecoverableInSameOperationCycle=true, DemRbEventStatusBitStorageTestFailed=true
        DemEventParameter_ECU2_DTC49: DemDTCRef=DemDTC_ECU2_DTC49, DemComponentClassRef=DemComponent_ECU2_DTC49
          DemDebounceAlgorithmClass
            DemDebounceCounterBasedClass (DemDebounceCounterBased): DemDebounceCounterBasedClassRef=DemDebounceCounterBasedClass_LostCom
          DemRbEventClass: DemRbEventBufferTime=0, DemRbEventRecoverableInSameOperationCycle=true, DemRbEventStatusBitStorageTestFailed=true
        DemEventParameter_ECU2_DTC50: DemDTCRef=DemDTC_ECU2_DTC50, DemComponentClassRef=DemComponent_ECU2_DTC50
          DemDebounceAlgorithmClass
            DemDebounceCounterBasedClass (DemDebounceCounterBased): DemDebounceCounterBasedClassRef=DemDebounceCounterBasedClass_LostCom
          DemRbEventClass: DemRbEventBufferTime=0, DemRbEventRecoverableInSameOperationCycle=true, DemRbEventStatusBitStorageTestFailed=true
          DemIndicatorAttribute:
            DemIndicatorFailureCycleCounterThreshold = 2
            DemRbIndicatorApiControl = false
            DemIndicatorBehaviour = DEM_INDICATOR_CONTINUOUS
            DemIndicatorHealingCycleCounterThreshold = 3
            DemIndicatorRef = MIL
        DemEventParameter_ECU2_DTC51: DemDTCRef=DemDTC_ECU2_DTC51, DemComponentClassRef=DemComponent_ECU2_DTC51
          DemDebounceAlgorithmClass
            DemDebounceCounterBasedClass (DemDebounceCounterBased): DemDebounceCounterBasedClassRef=DemDebounceCounterBasedClass_LostCom
          DemRbEventClass: DemRbEventBufferTime=0, DemRbEventRecoverableInSameOperationCycle=true, DemRbEventStatusBitStorageTestFailed=true
        DemEventParameter_ECU2_DTC52: DemComponentClassRef=DemComponent_ECU2_DTC52, DemDTCRef=DemDTC_ECU2_DTC52
          DemEventClassRB (DemRbEventClass): DemRbEventBufferTime=0
          DemDebounceAlgorithmClass
            DemDebounceCounterBasedClass (DemDebounceCounterBased): DemDebounceCounterBasedClassRef=DemDebounceCounterBasedClass_LostCom
        DemEventParameter_ECU2_DTC53: DemDTCRef=DemDTC_ECU2_DTC53, DemComponentClassRef=DemComponent_ECU2_DTC53
          DemDebounceAlgorithmClass
            DemDebounceCounterBasedClass (DemDebounceCounterBased): DemDebounceCounterBasedClassRef=DemDebounceCounterBasedClass_LostCom
          DemRbEventClass: DemRbEventBufferTime=0, DemRbEventRecoverableInSameOperationCycle=true, DemRbEventStatusBitStorageTestFailed=true
        DemEventParameter_ECU2_DTC54: DemDTCRef=DemDTC_ECU2_DTC54, DemComponentClassRef=DemComponent_ECU2_DTC54
          DemDebounceAlgorithmClass
            DemDebounceCounterBasedClass (DemDebounceCounterBased): DemDebounceCounterBasedClassRef=DemDebounceCounterBasedClass_LostCom
          DemRbEventClass: DemRbEventBufferTime=0, DemRbEventRecoverableInSameOperationCycle=true, DemRbEventStatusBitStorageTestFailed=true
        DemEventParameter_ECU2_DTC55: DemDTCRef=DemDTC_ECU2_DTC55, DemComponentClassRef=DemComponent_ECU2_DTC55
          DemDebounceAlgorithmClass
            DemDebounceCounterBasedClass (DemDebounceCounterBased): DemDebounceCounterBasedClassRef=DemDebounceCounterBasedClass_LostCom
          DemRbEventClass: DemRbEventBufferTime=0, DemRbEventRecoverableInSameOperationCycle=true, DemRbEventStatusBitStorageTestFailed=true
          DemIndicatorAttribute:
            DemIndicatorFailureCycleCounterThreshold = 2
            DemRbIndicatorApiControl = false
            DemIndicatorBehaviour = DEM_INDICATOR_CONTINUOUS
            DemIndicatorHealingCycleCounterThreshold = 3
            DemIndicatorRef = MIL
        DemEventParameter_ECU2_DTC56: DemDTCRef=DemDTC_ECU2_DTC56, DemComponentClassRef=DemComponent_ECU2_DTC56
          DemDebounceAlgorithmClass
            DemDebounceCounterBasedClass (DemDebounceCounterBased): DemDebounceCounterBasedClassRef=DemDebounceCounterBasedClass_LostCom
          DemRbEventClass: DemRbEventBufferTime=0, DemRbEventRecoverableInSameOperationCycle=true, DemRbEventStatusBitStorageTestFailed=true
          DemIndicatorAttribute:
            DemIndicatorFailureCycleCounterThreshold = 2
            DemRbIndicatorApiControl = false
            DemIndicatorBehaviour = DEM_INDICATOR_CONTINUOUS
            DemIndicatorHealingCycleCounterThreshold = 3
            DemIndicatorRef = MIL
        DemEventParameter_ECU2_DTC57: DemDTCRef=DemDTC_ECU2_DTC57, DemComponentClassRef=DemComponent_ECU2_DTC57
          DemDebounceAlgorithmClass
            DemDebounceCounterBasedClass (DemDebounceCounterBased): DemDebounceCounterBasedClassRef=DemDebounceCounterBasedClass_LostCom
          DemRbEventClass: DemRbEventBufferTime=0, DemRbEventRecoverableInSameOperationCycle=true, DemRbEventStatusBitStorageTestFailed=true
          DemIndicatorAttribute:
            DemIndicatorFailureCycleCounterThreshold = 2
            DemRbIndicatorApiControl = false
            DemIndicatorBehaviour = DEM_INDICATOR_CONTINUOUS
            DemIndicatorHealingCycleCounterThreshold = 3
            DemIndicatorRef = MIL
        DemEventParameter_ECU2_DTC58: DemDTCRef=DemDTC_ECU2_DTC58, DemComponentClassRef=DemComponent_ECU2_DTC58
          DemDebounceAlgorithmClass
            DemDebounceCounterBasedClass (DemDebounceCounterBased): DemDebounceCounterBasedClassRef=DemDebounceCounterBasedClass_LostCom
          DemRbEventClass: DemRbEventBufferTime=0, DemRbEventRecoverableInSameOperationCycle=true, DemRbEventStatusBitStorageTestFailed=true
          DemIndicatorAttribute:
            DemIndicatorFailureCycleCounterThreshold = 2
            DemRbIndicatorApiControl = false
            DemIndicatorBehaviour = DEM_INDICATOR_CONTINUOUS
            DemIndicatorHealingCycleCounterThreshold = 3
            DemIndicatorRef = MIL
        DemEventParameter_ECU2_DTC59: DemDTCRef=DemDTC_ECU2_DTC59, DemComponentClassRef=DemComponent_ECU2_DTC59
          DemDebounceAlgorithmClass
            DemDebounceCounterBasedClass (DemDebounceCounterBased): DemDebounceCounterBasedClassRef=DemDebounceCounterBasedClass_LostCom
          DemRbEventClass: DemRbEventBufferTime=0, DemRbEventRecoverableInSameOperationCycle=true, DemRbEventStatusBitStorageTestFailed=true
          DemIndicatorAttribute:
            DemIndicatorFailureCycleCounterThreshold = 2
            DemRbIndicatorApiControl = false
            DemIndicatorBehaviour = DEM_INDICATOR_CONTINUOUS
            DemIndicatorHealingCycleCounterThreshold = 3
            DemIndicatorRef = MIL
        DemEventParameter_ECU2_DTC60: DemDTCRef=DemDTC_ECU2_DTC60, DemComponentClassRef=DemComponent_ECU2_DTC60
          DemDebounceAlgorithmClass
            DemDebounceCounterBasedClass (DemDebounceCounterBased): DemDebounceCounterBasedClassRef=DemDebounceCounterBasedClass_LostCom
          DemRbEventClass: DemRbEventBufferTime=0, DemRbEventRecoverableInSameOperationCycle=true, DemRbEventStatusBitStorageTestFailed=true
          DemIndicatorAttribute:
            DemIndicatorFailureCycleCounterThreshold = 2
            DemRbIndicatorApiControl = false
            DemIndicatorBehaviour = DEM_INDICATOR_CONTINUOUS
            DemIndicatorHealingCycleCounterThreshold = 3
            DemIndicatorRef = MIL
        DemEventParameter_ECU2_DTC61: DemDTCRef=DemDTC_ECU2_DTC61, DemComponentClassRef=DemComponent_ECU2_DTC61
          DemDebounceAlgorithmClass
            DemDebounceCounterBasedClass (DemDebounceCounterBased): DemDebounceCounterBasedClassRef=DemDebounceCounterBasedClass_LostCom
          DemRbEventClass: DemRbEventBufferTime=0, DemRbEventRecoverableInSameOperationCycle=true, DemRbEventStatusBitStorageTestFailed=true
          DemIndicatorAttribute:
            DemIndicatorFailureCycleCounterThreshold = 2
            DemRbIndicatorApiControl = false
            DemIndicatorBehaviour = DEM_INDICATOR_CONTINUOUS
            DemIndicatorHealingCycleCounterThreshold = 3
            DemIndicatorRef = MIL
        DemEventParameter_ECU2_DTC62: DemDTCRef=DemDTC_ECU2_DTC62, DemComponentClassRef=DemComponent_ECU2_DTC62
          DemDebounceAlgorithmClass
            DemDebounceCounterBasedClass (DemDebounceCounterBased): DemDebounceCounterBasedClassRef=DemDebounceCounterBasedClass_LostCom
          DemRbEventClass: DemRbEventBufferTime=0, DemRbEventRecoverableInSameOperationCycle=true, DemRbEventStatusBitStorageTestFailed=true
          DemIndicatorAttribute:
            DemIndicatorFailureCycleCounterThreshold = 2
            DemRbIndicatorApiControl = false
            DemIndicatorBehaviour = DEM_INDICATOR_CONTINUOUS
            DemIndicatorHealingCycleCounterThreshold = 3
            DemIndicatorRef = MIL
        DemEventParameter_ECU2_DTC63: DemDTCRef=DemDTC_ECU2_DTC63, DemComponentClassRef=DemComponent_ECU2_DTC63
          DemDebounceAlgorithmClass
            DemDebounceCounterBasedClass (DemDebounceCounterBased): DemDebounceCounterBasedClassRef=DemDebounceCounterBasedClass_LostCom
          DemRbEventClass: DemRbEventBufferTime=0, DemRbEventRecoverableInSameOperationCycle=true, DemRbEventStatusBitStorageTestFailed=true
        DemEventParameter_ECU2_DTC64: DemComponentClassRef=DemComponent_ECU2_DTC64, DemDTCRef=DemDTC_ECU2_DTC64
          DemEventClassRB (DemRbEventClass): DemRbEventBufferTime=0
          DemDebounceAlgorithmClass
            DemDebounceCounterBasedClass (DemDebounceCounterBased): DemDebounceCounterBasedClassRef=DemDebounceCounterBasedClass_LostCom
        DemEventParameter_ECU2_DTC65: DemDTCRef=DemDTC_ECU2_DTC65, DemComponentClassRef=DemComponent_ECU2_DTC65
          DemDebounceAlgorithmClass
            DemDebounceCounterBasedClass (DemDebounceCounterBased): DemDebounceCounterBasedClassRef=DemDebounceCounterBasedClass_LostCom
          DemRbEventClass: DemRbEventBufferTime=0, DemRbEventRecoverableInSameOperationCycle=true, DemRbEventStatusBitStorageTestFailed=true
        DemEventParameter_ECU2_DTC66: DemDTCRef=DemDTC_ECU2_DTC66, DemComponentClassRef=DemComponent_ECU2_DTC66
          DemDebounceAlgorithmClass
            DemDebounceCounterBasedClass (DemDebounceCounterBased): DemDebounceCounterBasedClassRef=DemDebounceCounterBasedClass_LostCom
          DemRbEventClass: DemRbEventBufferTime=0, DemRbEventRecoverableInSameOperationCycle=true, DemRbEventStatusBitStorageTestFailed=true
        DemEventParameter_ECU2_DTC67: DemDTCRef=DemDTC_ECU2_DTC67, DemComponentClassRef=DemComponent_ECU2_DTC67
          DemDebounceAlgorithmClass
            DemDebounceCounterBasedClass (DemDebounceCounterBased): DemDebounceCounterBasedClassRef=DemDebounceCounterBasedClass_LostCom
          DemRbEventClass: DemRbEventBufferTime=0, DemRbEventRecoverableInSameOperationCycle=true, DemRbEventStatusBitStorageTestFailed=true
          DemIndicatorAttribute:
            DemIndicatorFailureCycleCounterThreshold = 2
            DemRbIndicatorApiControl = false
            DemIndicatorBehaviour = DEM_INDICATOR_CONTINUOUS
            DemIndicatorHealingCycleCounterThreshold = 3
            DemIndicatorRef = MIL
        DemEventParameter_ECU2_DTC68: DemDTCRef=DemDTC_ECU2_DTC68, DemComponentClassRef=DemComponent_ECU2_DTC68
          DemDebounceAlgorithmClass
            DemDebounceCounterBasedClass (DemDebounceCounterBased): DemDebounceCounterBasedClassRef=DemDebounceCounterBasedClass_LostCom
          DemRbEventClass: DemRbEventBufferTime=0, DemRbEventRecoverableInSameOperationCycle=true, DemRbEventStatusBitStorageTestFailed=true
          DemIndicatorAttribute:
            DemIndicatorFailureCycleCounterThreshold = 2
            DemRbIndicatorApiControl = false
            DemIndicatorBehaviour = DEM_INDICATOR_CONTINUOUS
            DemIndicatorHealingCycleCounterThreshold = 3
            DemIndicatorRef = MIL
        DemEventParameter_ECU2_DTC69: DemDTCRef=DemDTC_ECU2_DTC69, DemComponentClassRef=DemComponent_ECU2_DTC69
          DemDebounceAlgorithmClass
            DemDebounceCounterBasedClass (DemDebounceCounterBased): DemDebounceCounterBasedClassRef=DemDebounceCounterBasedClass_LostCom
          DemRbEventClass: DemRbEventBufferTime=0, DemRbEventRecoverableInSameOperationCycle=true, DemRbEventStatusBitStorageTestFailed=true
          DemIndicatorAttribute:
            DemIndicatorFailureCycleCounterThreshold = 2
            DemRbIndicatorApiControl = false
            DemIndicatorBehaviour = DEM_INDICATOR_CONTINUOUS
            DemIndicatorHealingCycleCounterThreshold = 3
            DemIndicatorRef = MIL
        DemEventParameter_ECU2_DTC70: DemDTCRef=DemDTC_ECU2_DTC70, DemComponentClassRef=DemComponent_ECU2_DTC70
          DemDebounceAlgorithmClass
            DemDebounceCounterBasedClass (DemDebounceCounterBased): DemDebounceCounterBasedClassRef=DemDebounceCounterBasedClass_LostCom
          DemRbEventClass: DemRbEventBufferTime=0, DemRbEventRecoverableInSameOperationCycle=true, DemRbEventStatusBitStorageTestFailed=true
          DemIndicatorAttribute:
            DemIndicatorFailureCycleCounterThreshold = 2
            DemRbIndicatorApiControl = false
            DemIndicatorBehaviour = DEM_INDICATOR_CONTINUOUS
            DemIndicatorHealingCycleCounterThreshold = 3
            DemIndicatorRef = MIL
        DemEventParameter_ECU2_DTC71: DemDTCRef=DemDTC_ECU2_DTC71, DemComponentClassRef=DemComponent_ECU2_DTC71
          DemDebounceAlgorithmClass
            DemDebounceCounterBasedClass (DemDebounceCounterBased): DemDebounceCounterBasedClassRef=DemDebounceCounterBasedClass_LostCom
          DemRbEventClass: DemRbEventBufferTime=0, DemRbEventRecoverableInSameOperationCycle=true, DemRbEventStatusBitStorageTestFailed=true
          DemIndicatorAttribute:
            DemIndicatorFailureCycleCounterThreshold = 2
            DemRbIndicatorApiControl = false
            DemIndicatorBehaviour = DEM_INDICATOR_CONTINUOUS
            DemIndicatorHealingCycleCounterThreshold = 3
            DemIndicatorRef = MIL
        DemEventParameter_ECU2_DTC72: DemDTCRef=DemDTC_ECU2_DTC72, DemComponentClassRef=DemComponent_ECU2_DTC72
          DemDebounceAlgorithmClass
            DemDebounceCounterBasedClass (DemDebounceCounterBased): DemDebounceCounterBasedClassRef=DemDebounceCounterBasedClass_LostCom
          DemRbEventClass: DemRbEventBufferTime=0, DemRbEventRecoverableInSameOperationCycle=true, DemRbEventStatusBitStorageTestFailed=true
          DemIndicatorAttribute:
            DemIndicatorFailureCycleCounterThreshold = 2
            DemRbIndicatorApiControl = false
            DemIndicatorBehaviour = DEM_INDICATOR_CONTINUOUS
            DemIndicatorHealingCycleCounterThreshold = 3
            DemIndicatorRef = MIL
        DemEventParameter_ECU2_DTC73: DemDTCRef=DemDTC_ECU2_DTC73, DemComponentClassRef=DemComponent_ECU2_DTC73
          DemDebounceAlgorithmClass
            DemDebounceCounterBasedClass (DemDebounceCounterBased): DemDebounceCounterBasedClassRef=DemDebounceCounterBasedClass_LostCom
          DemRbEventClass: DemRbEventBufferTime=0, DemRbEventRecoverableInSameOperationCycle=true, DemRbEventStatusBitStorageTestFailed=true
          DemIndicatorAttribute:
            DemIndicatorFailureCycleCounterThreshold = 2
            DemRbIndicatorApiControl = false
            DemIndicatorBehaviour = DEM_INDICATOR_CONTINUOUS
            DemIndicatorHealingCycleCounterThreshold = 3
            DemIndicatorRef = MIL
        DemEventParameter_ECU2_DTC74: DemDTCRef=DemDTC_ECU2_DTC74, DemComponentClassRef=DemComponent_ECU2_DTC74
          DemDebounceAlgorithmClass
            DemDebounceCounterBasedClass (DemDebounceCounterBased): DemDebounceCounterBasedClassRef=DemDebounceCounterBasedClass_LostCom
          DemRbEventClass: DemRbEventBufferTime=0, DemRbEventRecoverableInSameOperationCycle=true, DemRbEventStatusBitStorageTestFailed=true
          DemIndicatorAttribute:
            DemIndicatorFailureCycleCounterThreshold = 2
            DemRbIndicatorApiControl = false
            DemIndicatorBehaviour = DEM_INDICATOR_CONTINUOUS
            DemIndicatorHealingCycleCounterThreshold = 3
            DemIndicatorRef = MIL
        DemEventParameter_ECU2_DTC75: DemDTCRef=DemDTC_ECU2_DTC75, DemComponentClassRef=DemComponent_ECU2_DTC75
          DemDebounceAlgorithmClass
            DemDebounceCounterBasedClass (DemDebounceCounterBased): DemDebounceCounterBasedClassRef=DemDebounceCounterBasedClass_LostCom
          DemRbEventClass: DemRbEventBufferTime=0, DemRbEventRecoverableInSameOperationCycle=true, DemRbEventStatusBitStorageTestFailed=true
        DemEventParameter_ECU2_DTC76: DemComponentClassRef=DemComponent_ECU2_DTC76, DemDTCRef=DemDTC_ECU2_DTC76
          DemEventClassRB (DemRbEventClass): DemRbEventBufferTime=0
          DemDebounceAlgorithmClass
            DemDebounceCounterBasedClass (DemDebounceCounterBased): DemDebounceCounterBasedClassRef=DemDebounceCounterBasedClass_LostCom
        DemEventParameter_ECU2_DTC77: DemDTCRef=DemDTC_ECU2_DTC77, DemComponentClassRef=DemComponent_ECU2_DTC77
          DemDebounceAlgorithmClass
            DemDebounceCounterBasedClass (DemDebounceCounterBased): DemDebounceCounterBasedClassRef=DemDebounceCounterBasedClass_LostCom
          DemRbEventClass: DemRbEventBufferTime=0, DemRbEventRecoverableInSameOperationCycle=true, DemRbEventStatusBitStorageTestFailed=true
        DemEventParameter_ECU2_DTC78: DemDTCRef=DemDTC_ECU2_DTC78, DemComponentClassRef=DemComponent_ECU2_DTC78
          DemDebounceAlgorithmClass
            DemDebounceCounterBasedClass (DemDebounceCounterBased): DemDebounceCounterBasedClassRef=DemDebounceCounterBasedClass_LostCom
          DemRbEventClass: DemRbEventBufferTime=0, DemRbEventRecoverableInSameOperationCycle=true, DemRbEventStatusBitStorageTestFailed=true
        DemEventParameter_ECU2_DTC79: DemDTCRef=DemDTC_ECU2_DTC79, DemComponentClassRef=DemComponent_ECU2_DTC79
          DemDebounceAlgorithmClass
            DemDebounceCounterBasedClass (DemDebounceCounterBased): DemDebounceCounterBasedClassRef=DemDebounceCounterBasedClass_LostCom
          DemRbEventClass: DemRbEventBufferTime=0, DemRbEventRecoverableInSameOperationCycle=true, DemRbEventStatusBitStorageTestFailed=true
          DemIndicatorAttribute:
            DemIndicatorFailureCycleCounterThreshold = 2
            DemRbIndicatorApiControl = false
            DemIndicatorBehaviour = DEM_INDICATOR_CONTINUOUS
            DemIndicatorHealingCycleCounterThreshold = 3
            DemIndicatorRef = MIL
        DemEventParameter_ECU2_DTC80: DemDTCRef=DemDTC_ECU2_DTC80, DemComponentClassRef=DemComponent_ECU2_DTC80
          DemDebounceAlgorithmClass
            DemDebounceCounterBasedClass (DemDebounceCounterBased): DemDebounceCounterBasedClassRef=DemDebounceCounterBasedClass_LostCom
          DemRbEventClass: DemRbEventBufferTime=0, DemRbEventRecoverableInSameOperationCycle=true, DemRbEventStatusBitStorageTestFailed=true
          DemIndicatorAttribute:
            DemIndicatorFailureCycleCounterThreshold = 2
            DemRbIndicatorApiControl = false
            DemIndicatorBehaviour = DEM_INDICATOR_CONTINUOUS
            DemIndicatorHealingCycleCounterThreshold = 3
            DemIndicatorRef = MIL
        DemEventParameter_ECU2_DTC81: DemDTCRef=DemDTC_ECU2_DTC81, DemComponentClassRef=DemComponent_ECU2_DTC81
          DemDebounceAlgorithmClass
            DemDebounceCounterBasedClass (DemDebounceCounterBased): DemDebounceCounterBasedClassRef=DemDebounceCounterBasedClass_LostCom
          DemRbEventClass: DemRbEventBufferTime=0, DemRbEventRecoverableInSameOperationCycle=true, DemRbEventStatusBitStorageTestFailed=true
          DemIndicatorAttribute:
            DemIndicatorFailureCycleCounterThreshold = 2
            DemRbIndicatorApiControl = false
            DemIndicatorBehaviour = DEM_INDICATOR_CONTINUOUS
            DemIndicatorHealingCycleCounterThreshold = 3
            DemIndicatorRef = MIL
        DemEventParameter_ECU2_DTC82: DemDTCRef=DemDTC_ECU2_DTC82, DemComponentClassRef=DemComponent_ECU2_DTC82
          DemDebounceAlgorithmClass
            DemDebounceCounterBasedClass (DemDebounceCounterBased): DemDebounceCounterBasedClassRef=DemDebounceCounterBasedClass_LostCom
          DemRbEventClass: DemRbEventBufferTime=0, DemRbEventRecoverableInSameOperationCycle=true, DemRbEventStatusBitStorageTestFailed=true
          DemIndicatorAttribute:
            DemIndicatorFailureCycleCounterThreshold = 2
            DemRbIndicatorApiControl = false
            DemIndicatorBehaviour = DEM_INDICATOR_CONTINUOUS
            DemIndicatorHealingCycleCounterThreshold = 3
            DemIndicatorRef = MIL
        DemEventParameter_ECU2_DTC83: DemDTCRef=DemDTC_ECU2_DTC83, DemComponentClassRef=DemComponent_ECU2_DTC83
          DemDebounceAlgorithmClass
            DemDebounceCounterBasedClass (DemDebounceCounterBased): DemDebounceCounterBasedClassRef=DemDebounceCounterBasedClass_LostCom
          DemRbEventClass: DemRbEventBufferTime=0, DemRbEventRecoverableInSameOperationCycle=true, DemRbEventStatusBitStorageTestFailed=true
          DemIndicatorAttribute:
            DemIndicatorFailureCycleCounterThreshold = 2
            DemRbIndicatorApiControl = false
            DemIndicatorBehaviour = DEM_INDICATOR_CONTINUOUS
            DemIndicatorHealingCycleCounterThreshold = 3
            DemIndicatorRef = MIL
        DemEventParameter_ECU2_DTC84: DemDTCRef=DemDTC_ECU2_DTC84, DemComponentClassRef=DemComponent_ECU2_DTC84
          DemDebounceAlgorithmClass
            DemDebounceCounterBasedClass (DemDebounceCounterBased): DemDebounceCounterBasedClassRef=DemDebounceCounterBasedClass_LostCom
          DemRbEventClass: DemRbEventBufferTime=0, DemRbEventRecoverableInSameOperationCycle=true, DemRbEventStatusBitStorageTestFailed=true
          DemIndicatorAttribute:
            DemIndicatorFailureCycleCounterThreshold = 2
            DemRbIndicatorApiControl = false
            DemIndicatorBehaviour = DEM_INDICATOR_CONTINUOUS
            DemIndicatorHealingCycleCounterThreshold = 3
            DemIndicatorRef = MIL
        DemEventParameter_ECU2_DTC85: DemDTCRef=DemDTC_ECU2_DTC85, DemComponentClassRef=DemComponent_ECU2_DTC85
          DemDebounceAlgorithmClass
            DemDebounceCounterBasedClass (DemDebounceCounterBased): DemDebounceCounterBasedClassRef=DemDebounceCounterBasedClass_LostCom
          DemRbEventClass: DemRbEventBufferTime=0, DemRbEventRecoverableInSameOperationCycle=true, DemRbEventStatusBitStorageTestFailed=true
          DemIndicatorAttribute:
            DemIndicatorFailureCycleCounterThreshold = 2
            DemRbIndicatorApiControl = false
            DemIndicatorBehaviour = DEM_INDICATOR_CONTINUOUS
            DemIndicatorHealingCycleCounterThreshold = 3
            DemIndicatorRef = MIL
        DemEventParameter_ECU2_DTC86: DemDTCRef=DemDTC_ECU2_DTC86, DemComponentClassRef=DemComponent_ECU2_DTC86
          DemDebounceAlgorithmClass
            DemDebounceCounterBasedClass (DemDebounceCounterBased): DemDebounceCounterBasedClassRef=DemDebounceCounterBasedClass_LostCom
          DemRbEventClass: DemRbEventBufferTime=0, DemRbEventRecoverableInSameOperationCycle=true, DemRbEventStatusBitStorageTestFailed=true
          DemIndicatorAttribute:
            DemIndicatorFailureCycleCounterThreshold = 2
            DemRbIndicatorApiControl = false
            DemIndicatorBehaviour = DEM_INDICATOR_CONTINUOUS
            DemIndicatorHealingCycleCounterThreshold = 3
            DemIndicatorRef = MIL
        DemEventParameter_ECU2_DTC87: DemDTCRef=DemDTC_ECU2_DTC87, DemComponentClassRef=DemComponent_ECU2_DTC87
          DemDebounceAlgorithmClass
            DemDebounceCounterBasedClass (DemDebounceCounterBased): DemDebounceCounterBasedClassRef=DemDebounceCounterBasedClass_LostCom
          DemRbEventClass: DemRbEventBufferTime=0, DemRbEventRecoverableInSameOperationCycle=true, DemRbEventStatusBitStorageTestFailed=true
        DemEventParameter_ECU2_DTC88: DemComponentClassRef=DemComponent_ECU2_DTC88, DemDTCRef=DemDTC_ECU2_DTC88
          DemEventClassRB (DemRbEventClass): DemRbEventBufferTime=0
          DemDebounceAlgorithmClass
            DemDebounceCounterBasedClass (DemDebounceCounterBased): DemDebounceCounterBasedClassRef=DemDebounceCounterBasedClass_LostCom
        DemEventParameter_ECU2_DTC89: DemDTCRef=DemDTC_ECU2_DTC89, DemComponentClassRef=DemComponent_ECU2_DTC89
          DemDebounceAlgorithmClass
            DemDebounceCounterBasedClass (DemDebounceCounterBased): DemDebounceCounterBasedClassRef=DemDebounceCounterBasedClass_LostCom
          DemRbEventClass: DemRbEventBufferTime=0, DemRbEventRecoverableInSameOperationCycle=true, DemRbEventStatusBitStorageTestFailed=true
        DemEventParameter_ECU2_DTC90: DemDTCRef=DemDTC_ECU2_DTC90, DemComponentClassRef=DemComponent_ECU2_DTC90
          DemDebounceAlgorithmClass
            DemDebounceCounterBasedClass (DemDebounceCounterBased): DemDebounceCounterBasedClassRef=DemDebounceCounterBasedClass_LostCom
          DemRbEventClass: DemRbEventBufferTime=0, DemRbEventRecoverableInSameOperationCycle=true, DemRbEventStatusBitStorageTestFailed=true
        DemEventParameter_ECU2_DTC91: DemDTCRef=DemDTC_ECU2_DTC91, DemComponentClassRef=DemComponent_ECU2_DTC91
          DemDebounceAlgorithmClass
            DemDebounceCounterBasedClass (DemDebounceCounterBased): DemDebounceCounterBasedClassRef=DemDebounceCounterBasedClass_LostCom
          DemRbEventClass: DemRbEventBufferTime=0, DemRbEventRecoverableInSameOperationCycle=true, DemRbEventStatusBitStorageTestFailed=true
          DemIndicatorAttribute:
            DemIndicatorFailureCycleCounterThreshold = 2
            DemRbIndicatorApiControl = false
            DemIndicatorBehaviour = DEM_INDICATOR_CONTINUOUS
            DemIndicatorHealingCycleCounterThreshold = 3
            DemIndicatorRef = MIL
        DemEventParameter_ECU2_DTC92: DemDTCRef=DemDTC_ECU2_DTC92, DemComponentClassRef=DemComponent_ECU2_DTC92
          DemDebounceAlgorithmClass
            DemDebounceCounterBasedClass (DemDebounceCounterBased): DemDebounceCounterBasedClassRef=DemDebounceCounterBasedClass_LostCom
          DemRbEventClass: DemRbEventBufferTime=0, DemRbEventRecoverableInSameOperationCycle=true, DemRbEventStatusBitStorageTestFailed=true
          DemIndicatorAttribute:
            DemIndicatorFailureCycleCounterThreshold = 2
            DemRbIndicatorApiControl = false
            DemIndicatorBehaviour = DEM_INDICATOR_CONTINUOUS
            DemIndicatorHealingCycleCounterThreshold = 3
            DemIndicatorRef = MIL
        DemEventParameter_ECU2_DTC93: DemDTCRef=DemDTC_ECU2_DTC93, DemComponentClassRef=DemComponent_ECU2_DTC93
          DemDebounceAlgorithmClass
            DemDebounceCounterBasedClass (DemDebounceCounterBased): DemDebounceCounterBasedClassRef=DemDebounceCounterBasedClass_LostCom
          DemRbEventClass: DemRbEventBufferTime=0, DemRbEventRecoverableInSameOperationCycle=true, DemRbEventStatusBitStorageTestFailed=true
          DemIndicatorAttribute:
            DemIndicatorFailureCycleCounterThreshold = 2
            DemRbIndicatorApiControl = false
            DemIndicatorBehaviour = DEM_INDICATOR_CONTINUOUS
            DemIndicatorHealingCycleCounterThreshold = 3
            DemIndicatorRef = MIL
        DemEventParameter_ECU2_DTC94: DemDTCRef=DemDTC_ECU2_DTC94, DemComponentClassRef=DemComponent_ECU2_DTC94
          DemDebounceAlgorithmClass
            DemDebounceCounterBasedClass (DemDebounceCounterBased): DemDebounceCounterBasedClassRef=DemDebounceCounterBasedClass_LostCom
          DemRbEventClass: DemRbEventBufferTime=0, DemRbEventRecoverableInSameOperationCycle=true, DemRbEventStatusBitStorageTestFailed=true
          DemIndicatorAttribute:
            DemIndicatorFailureCycleCounterThreshold = 2
            DemRbIndicatorApiControl = false
            DemIndicatorBehaviour = DEM_INDICATOR_CONTINUOUS
            DemIndicatorHealingCycleCounterThreshold = 3
            DemIndicatorRef = MIL
        DemEventParameter_ECU2_DTC95: DemDTCRef=DemDTC_ECU2_DTC95, DemComponentClassRef=DemComponent_ECU2_DTC95
          DemDebounceAlgorithmClass
            DemDebounceCounterBasedClass (DemDebounceCounterBased): DemDebounceCounterBasedClassRef=DemDebounceCounterBasedClass_LostCom
          DemRbEventClass: DemRbEventBufferTime=0, DemRbEventRecoverableInSameOperationCycle=true, DemRbEventStatusBitStorageTestFailed=true
          DemIndicatorAttribute:
            DemIndicatorFailureCycleCounterThreshold = 2
            DemRbIndicatorApiControl = false
            DemIndicatorBehaviour = DEM_INDICATOR_CONTINUOUS
            DemIndicatorHealingCycleCounterThreshold = 3
            DemIndicatorRef = MIL
        DemEventParameter_ECU2_DTC96: DemDTCRef=DemDTC_ECU2_DTC96, DemComponentClassRef=DemComponent_ECU2_DTC96
          DemDebounceAlgorithmClass
            DemDebounceCounterBasedClass (DemDebounceCounterBased): DemDebounceCounterBasedClassRef=DemDebounceCounterBasedClass_LostCom
          DemRbEventClass: DemRbEventBufferTime=0, DemRbEventRecoverableInSameOperationCycle=true, DemRbEventStatusBitStorageTestFailed=true
          DemIndicatorAttribute:
            DemIndicatorFailureCycleCounterThreshold = 2
            DemRbIndicatorApiControl = false
            DemIndicatorBehaviour = DEM_INDICATOR_CONTINUOUS
            DemIndicatorHealingCycleCounterThreshold = 3
            DemIndicatorRef = MIL
        DemEventParameter_ECU2_DTC97: DemDTCRef=DemDTC_ECU2_DTC97, DemComponentClassRef=DemComponent_ECU2_DTC97
          DemDebounceAlgorithmClass
            DemDebounceCounterBasedClass (DemDebounceCounterBased): DemDebounceCounterBasedClassRef=DemDebounceCounterBasedClass_LostCom
          DemRbEventClass: DemRbEventBufferTime=0, DemRbEventRecoverableInSameOperationCycle=true, DemRbEventStatusBitStorageTestFailed=true
          DemIndicatorAttribute:
            DemIndicatorFailureCycleCounterThreshold = 2
            DemRbIndicatorApiControl = false
            DemIndicatorBehaviour = DEM_INDICATOR_CONTINUOUS
            DemIndicatorHealingCycleCounterThreshold = 3
            DemIndicatorRef = MIL
        DemEventParameter_ECU2_DTC98: DemDTCRef=DemDTC_ECU2_DTC98, DemComponentClassRef=DemComponent_ECU2_DTC98
          DemDebounceAlgorithmClass
            DemDebounceCounterBasedClass (DemDebounceCounterBased): DemDebounceCounterBasedClassRef=DemDebounceCounterBasedClass_LostCom
          DemRbEventClass: DemRbEventBufferTime=0, DemRbEventRecoverableInSameOperationCycle=true, DemRbEventStatusBitStorageTestFailed=true
          DemIndicatorAttribute:
            DemIndicatorFailureCycleCounterThreshold = 2
            DemRbIndicatorApiControl = false
            DemIndicatorBehaviour = DEM_INDICATOR_CONTINUOUS
            DemIndicatorHealingCycleCounterThreshold = 3
            DemIndicatorRef = MIL
        DemEventParameter_ECU2_DTC99: DemDTCRef=DemDTC_ECU2_DTC99, DemComponentClassRef=DemComponent_ECU2_DTC99
          DemDebounceAlgorithmClass
            DemDebounceCounterBasedClass (DemDebounceCounterBased): DemDebounceCounterBasedClassRef=DemDebounceCounterBasedClass_LostCom
          DemRbEventClass: DemRbEventBufferTime=0, DemRbEventRecoverableInSameOperationCycle=true, DemRbEventStatusBitStorageTestFailed=true
        DemEventParameter_ECU3_DTC00: DemDTCRef=DemDTC_ECU3_DTC00, DemComponentClassRef=DemComponent_ECU3_DTC00
          DemDebounceAlgorithmClass
            DemDebounceCounterBasedClass (DemDebounceCounterBased): DemDebounceCounterBasedClassRef=DemDebounceCounterBasedClass_LostCom
          DemRbEventClass: DemRbEventBufferTime=0, DemRbEventRecoverableInSameOperationCycle=true, DemRbEventStatusBitStorageTestFailed=true
          DemIndicatorAttribute:
            DemIndicatorFailureCycleCounterThreshold = 2
            DemRbIndicatorApiControl = false
            DemIndicatorBehaviour = DEM_INDICATOR_BLINK_CONT
            DemIndicatorHealingCycleCounterThreshold = 3
            DemIndicatorRef = MIL
        DemEventParameter_ECU3_DTC01: DemDTCRef=DemDTC_ECU3_DTC01, DemComponentClassRef=DemComponent_ECU3_DTC01
          DemDebounceAlgorithmClass
            DemDebounceCounterBasedClass (DemDebounceCounterBased): DemDebounceCounterBasedClassRef=DemDebounceCounterBasedClass_LostCom
          DemRbEventClass: DemRbEventBufferTime=0, DemRbEventRecoverableInSameOperationCycle=true, DemRbEventStatusBitStorageTestFailed=true
          DemIndicatorAttribute:
            DemIndicatorFailureCycleCounterThreshold = 2
            DemRbIndicatorApiControl = false
            DemIndicatorBehaviour = DEM_INDICATOR_BLINK_CONT
            DemIndicatorHealingCycleCounterThreshold = 3
            DemIndicatorRef = MIL
        DemEventParameter_ECU3_DTC02: DemDTCRef=DemDTC_ECU3_DTC02, DemComponentClassRef=DemComponent_ECU3_DTC02
          DemDebounceAlgorithmClass
            DemDebounceCounterBasedClass (DemDebounceCounterBased): DemDebounceCounterBasedClassRef=DemDebounceCounterBasedClass_LostCom
          DemRbEventClass: DemRbEventBufferTime=0, DemRbEventRecoverableInSameOperationCycle=true, DemRbEventStatusBitStorageTestFailed=true
          DemIndicatorAttribute:
            DemIndicatorFailureCycleCounterThreshold = 2
            DemRbIndicatorApiControl = false
            DemIndicatorBehaviour = DEM_INDICATOR_BLINK_CONT
            DemIndicatorHealingCycleCounterThreshold = 3
            DemIndicatorRef = MIL
        DemEventParameter_ECU3_DTC03: DemComponentClassRef=DemComponent_ECU3_DTC03, DemDTCRef=DemDTC_ECU3_DTC03
          DemEventClassRB (DemRbEventClass): DemRbEventBufferTime=0
          DemDebounceAlgorithmClass
            DemDebounceCounterBasedClass (DemDebounceCounterBased): DemDebounceCounterBasedClassRef=DemDebounceCounterBasedClass_LostCom
          DemIndicatorAttribute:
            DemIndicatorFailureCycleCounterThreshold = 2
            DemRbIndicatorApiControl = false
            DemIndicatorBehaviour = DEM_INDICATOR_BLINK_CONT
            DemIndicatorHealingCycleCounterThreshold = 3
            DemIndicatorRef = MIL
        DemEventParameter_ECU3_DTC04: DemComponentClassRef=DemComponent_ECU3_DTC04, DemDTCRef=DemDTC_ECU3_DTC04
          DemEventClassRB (DemRbEventClass): DemRbEventBufferTime=0
          DemDebounceAlgorithmClass
            DemDebounceCounterBasedClass (DemDebounceCounterBased): DemDebounceCounterBasedClassRef=DemDebounceCounterBasedClass_LostCom
          DemIndicatorAttribute:
            DemIndicatorFailureCycleCounterThreshold = 2
            DemRbIndicatorApiControl = false
            DemIndicatorBehaviour = DEM_INDICATOR_BLINK_CONT
            DemIndicatorHealingCycleCounterThreshold = 3
            DemIndicatorRef = MIL
        DemEventParameter_ECU3_DTC05: DemComponentClassRef=DemComponent_ECU3_DTC05, DemDTCRef=DemDTC_ECU3_DTC05
          DemEventClassRB (DemRbEventClass): DemRbEventBufferTime=0
          DemDebounceAlgorithmClass
            DemDebounceCounterBasedClass (DemDebounceCounterBased): DemDebounceCounterBasedClassRef=DemDebounceCounterBasedClass_LostCom
        DemEventParameter_ECU3_DTC06: DemComponentClassRef=DemComponent_ECU3_DTC06, DemDTCRef=DemDTC_ECU3_DTC06
          DemEventClassRB (DemRbEventClass): DemRbEventBufferTime=0
          DemDebounceAlgorithmClass
            DemDebounceCounterBasedClass (DemDebounceCounterBased): DemDebounceCounterBasedClassRef=DemDebounceCounterBasedClass_LostCom
        DemEventParameter_ECU3_DTC07: DemComponentClassRef=DemComponent_ECU3_DTC07, DemDTCRef=DemDTC_ECU3_DTC07
          DemEventClassRB (DemRbEventClass): DemRbEventBufferTime=0
          DemDebounceAlgorithmClass
            DemDebounceCounterBasedClass (DemDebounceCounterBased): DemDebounceCounterBasedClassRef=DemDebounceCounterBasedClass_LostCom
        DemEventParameter_ECU3_DTC08: DemComponentClassRef=DemComponent_ECU3_DTC08, DemDTCRef=DemDTC_ECU3_DTC08
          DemEventClassRB (DemRbEventClass): DemRbEventBufferTime=0
          DemDebounceAlgorithmClass
            DemDebounceCounterBasedClass (DemDebounceCounterBased): DemDebounceCounterBasedClassRef=DemDebounceCounterBasedClass_LostCom
        DemEventParameter_ECU3_DTC09: DemComponentClassRef=DemComponent_ECU3_DTC09, DemDTCRef=DemDTC_ECU3_DTC09
          DemEventClassRB (DemRbEventClass): DemRbEventBufferTime=0
          DemDebounceAlgorithmClass
            DemDebounceCounterBasedClass (DemDebounceCounterBased): DemDebounceCounterBasedClassRef=DemDebounceCounterBasedClass_LostCom
          DemIndicatorAttribute:
            DemIndicatorFailureCycleCounterThreshold = 2
            DemRbIndicatorApiControl = false
            DemIndicatorBehaviour = DEM_INDICATOR_CONTINUOUS
            DemIndicatorHealingCycleCounterThreshold = 3
            DemIndicatorRef = MIL
        DemEventParameter_ECU3_DTC10: DemComponentClassRef=DemComponent_ECU3_DTC10, DemDTCRef=DemDTC_ECU3_DTC10
          DemEventClassRB (DemRbEventClass): DemRbEventBufferTime=0
          DemDebounceAlgorithmClass
            DemDebounceCounterBasedClass (DemDebounceCounterBased): DemDebounceCounterBasedClassRef=DemDebounceCounterBasedClass_LostCom
          DemIndicatorAttribute:
            DemIndicatorFailureCycleCounterThreshold = 2
            DemRbIndicatorApiControl = false
            DemIndicatorBehaviour = DEM_INDICATOR_CONTINUOUS
            DemIndicatorHealingCycleCounterThreshold = 3
            DemIndicatorRef = MIL
        DemEventParameter_ECU3_DTC11: DemComponentClassRef=DemComponent_ECU3_DTC11, DemDTCRef=DemDTC_ECU3_DTC11
          DemEventClassRB (DemRbEventClass): DemRbEventBufferTime=0
          DemDebounceAlgorithmClass
            DemDebounceCounterBasedClass (DemDebounceCounterBased): DemDebounceCounterBasedClassRef=DemDebounceCounterBasedClass_LostCom
          DemIndicatorAttribute:
            DemIndicatorFailureCycleCounterThreshold = 2
            DemRbIndicatorApiControl = false
            DemIndicatorBehaviour = DEM_INDICATOR_CONTINUOUS
            DemIndicatorHealingCycleCounterThreshold = 3
            DemIndicatorRef = MIL
        DemEventParameter_ECU3_DTC12: DemComponentClassRef=DemComponent_ECU3_DTC12, DemDTCRef=DemDTC_ECU3_DTC12
          DemEventClassRB (DemRbEventClass): DemRbEventBufferTime=0
          DemDebounceAlgorithmClass
            DemDebounceCounterBasedClass (DemDebounceCounterBased): DemDebounceCounterBasedClassRef=DemDebounceCounterBasedClass_LostCom
          DemIndicatorAttribute:
            DemIndicatorFailureCycleCounterThreshold = 2
            DemRbIndicatorApiControl = false
            DemIndicatorBehaviour = DEM_INDICATOR_BLINK_CONT
            DemIndicatorHealingCycleCounterThreshold = 3
            DemIndicatorRef = MIL
        DemEventParameter_ECU3_DTC13: DemComponentClassRef=DemComponent_ECU3_DTC13, DemDTCRef=DemDTC_ECU3_DTC13
          DemEventClassRB (DemRbEventClass): DemRbEventBufferTime=0
          DemDebounceAlgorithmClass
            DemDebounceCounterBasedClass (DemDebounceCounterBased): DemDebounceCounterBasedClassRef=DemDebounceCounterBasedClass_LostCom
          DemIndicatorAttribute:
            DemIndicatorFailureCycleCounterThreshold = 2
            DemRbIndicatorApiControl = false
            DemIndicatorBehaviour = DEM_INDICATOR_BLINK_CONT
            DemIndicatorHealingCycleCounterThreshold = 3
            DemIndicatorRef = MIL
        DemEventParameter_ECU3_DTC14: DemComponentClassRef=DemComponent_ECU3_DTC14, DemDTCRef=DemDTC_ECU3_DTC14
          DemEventClassRB (DemRbEventClass): DemRbEventBufferTime=0
          DemDebounceAlgorithmClass
            DemDebounceCounterBasedClass (DemDebounceCounterBased): DemDebounceCounterBasedClassRef=DemDebounceCounterBasedClass_LostCom
        DemEventParameter_ECU3_DTC15: DemComponentClassRef=DemComponent_ECU3_DTC15, DemDTCRef=DemDTC_ECU3_DTC15
          DemEventClassRB (DemRbEventClass): DemRbEventBufferTime=0
          DemDebounceAlgorithmClass
            DemDebounceCounterBasedClass (DemDebounceCounterBased): DemDebounceCounterBasedClassRef=DemDebounceCounterBasedClass_LostCom
        DemEventParameter_ECU3_DTC16: DemComponentClassRef=DemComponent_ECU3_DTC16, DemDTCRef=DemDTC_ECU3_DTC16
          DemEventClassRB (DemRbEventClass): DemRbEventBufferTime=0
          DemDebounceAlgorithmClass
            DemDebounceCounterBasedClass (DemDebounceCounterBased): DemDebounceCounterBasedClassRef=DemDebounceCounterBasedClass_LostCom
        DemEventParameter_ECU3_DTC17: DemComponentClassRef=DemComponent_ECU3_DTC17, DemDTCRef=DemDTC_ECU3_DTC17
          DemEventClassRB (DemRbEventClass): DemRbEventBufferTime=0
          DemDebounceAlgorithmClass
            DemDebounceCounterBasedClass (DemDebounceCounterBased): DemDebounceCounterBasedClassRef=DemDebounceCounterBasedClass_LostCom
          DemIndicatorAttribute:
            DemIndicatorFailureCycleCounterThreshold = 2
            DemRbIndicatorApiControl = false
            DemIndicatorBehaviour = DEM_INDICATOR_CONTINUOUS
            DemIndicatorHealingCycleCounterThreshold = 3
            DemIndicatorRef = MIL
        DemEventParameter_ECU3_DTC18: DemDTCRef=DemDTC_ECU3_DTC18, DemComponentClassRef=DemComponent_ECU3_DTC18
          DemDebounceAlgorithmClass
            DemDebounceCounterBasedClass (DemDebounceCounterBased): DemDebounceCounterBasedClassRef=DemDebounceCounterBasedClass_LostCom
          DemRbEventClass: DemRbEventBufferTime=0, DemRbEventRecoverableInSameOperationCycle=true, DemRbEventStatusBitStorageTestFailed=true
        DemEventParameter_ECU3_DTC19: DemDTCRef=DemDTC_ECU3_DTC19, DemComponentClassRef=DemComponent_ECU3_DTC19
          DemDebounceAlgorithmClass
            DemDebounceCounterBasedClass (DemDebounceCounterBased): DemDebounceCounterBasedClassRef=DemDebounceCounterBasedClass_LostCom
          DemRbEventClass: DemRbEventBufferTime=0, DemRbEventRecoverableInSameOperationCycle=true, DemRbEventStatusBitStorageTestFailed=true
        DemEventParameter_ECU3_DTC20: DemDTCRef=DemDTC_ECU3_DTC20, DemComponentClassRef=DemComponent_ECU3_DTC20
          DemDebounceAlgorithmClass
            DemDebounceCounterBasedClass (DemDebounceCounterBased): DemDebounceCounterBasedClassRef=DemDebounceCounterBasedClass_LostCom
          DemRbEventClass: DemRbEventBufferTime=0, DemRbEventRecoverableInSameOperationCycle=true, DemRbEventStatusBitStorageTestFailed=true
          DemIndicatorAttribute:
            DemIndicatorFailureCycleCounterThreshold = 2
            DemRbIndicatorApiControl = false
            DemIndicatorBehaviour = DEM_INDICATOR_BLINK_CONT
            DemIndicatorHealingCycleCounterThreshold = 3
            DemIndicatorRef = MIL
        DemEventParameter_ECU3_DTC21: DemDTCRef=DemDTC_ECU3_DTC21, DemComponentClassRef=DemComponent_ECU3_DTC21
          DemDebounceAlgorithmClass
            DemDebounceCounterBasedClass (DemDebounceCounterBased): DemDebounceCounterBasedClassRef=DemDebounceCounterBasedClass_LostCom
          DemRbEventClass: DemRbEventBufferTime=0, DemRbEventRecoverableInSameOperationCycle=true, DemRbEventStatusBitStorageTestFailed=true
          DemIndicatorAttribute:
            DemIndicatorFailureCycleCounterThreshold = 2
            DemRbIndicatorApiControl = false
            DemIndicatorBehaviour = DEM_INDICATOR_BLINK_CONT
            DemIndicatorHealingCycleCounterThreshold = 3
            DemIndicatorRef = MIL
        DemEventParameter_ECU3_DTC22: DemDTCRef=DemDTC_ECU3_DTC22, DemComponentClassRef=DemComponent_ECU3_DTC22
          DemDebounceAlgorithmClass
            DemDebounceCounterBasedClass (DemDebounceCounterBased): DemDebounceCounterBasedClassRef=DemDebounceCounterBasedClass_LostCom
          DemRbEventClass: DemRbEventBufferTime=0, DemRbEventRecoverableInSameOperationCycle=true, DemRbEventStatusBitStorageTestFailed=true
          DemIndicatorAttribute:
            DemIndicatorFailureCycleCounterThreshold = 2
            DemRbIndicatorApiControl = false
            DemIndicatorBehaviour = DEM_INDICATOR_BLINK_CONT
            DemIndicatorHealingCycleCounterThreshold = 3
            DemIndicatorRef = MIL
        DemEventParameter_ECU3_DTC23: DemComponentClassRef=DemComponent_ECU3_DTC23, DemDTCRef=DemDTC_ECU3_DTC23
          DemEventClassRB (DemRbEventClass): DemRbEventBufferTime=0
          DemDebounceAlgorithmClass
            DemDebounceCounterBasedClass (DemDebounceCounterBased): DemDebounceCounterBasedClassRef=DemDebounceCounterBasedClass_LostCom
          DemIndicatorAttribute:
            DemIndicatorFailureCycleCounterThreshold = 2
            DemRbIndicatorApiControl = false
            DemIndicatorBehaviour = DEM_INDICATOR_BLINK_CONT
            DemIndicatorHealingCycleCounterThreshold = 3
            DemIndicatorRef = MIL
        DemEventParameter_ECU3_DTC24: DemComponentClassRef=DemComponent_ECU3_DTC24, DemDTCRef=DemDTC_ECU3_DTC24
          DemEventClassRB (DemRbEventClass): DemRbEventBufferTime=0
          DemDebounceAlgorithmClass
            DemDebounceCounterBasedClass (DemDebounceCounterBased): DemDebounceCounterBasedClassRef=DemDebounceCounterBasedClass_LostCom
          DemIndicatorAttribute:
            DemIndicatorFailureCycleCounterThreshold = 2
            DemRbIndicatorApiControl = false
            DemIndicatorBehaviour = DEM_INDICATOR_BLINK_CONT
            DemIndicatorHealingCycleCounterThreshold = 3
            DemIndicatorRef = MIL
        DemEventParameter_ECU3_DTC25: DemComponentClassRef=DemComponent_ECU3_DTC25, DemDTCRef=DemDTC_ECU3_DTC25
          DemEventClassRB (DemRbEventClass): DemRbEventBufferTime=0
          DemDebounceAlgorithmClass
            DemDebounceCounterBasedClass (DemDebounceCounterBased): DemDebounceCounterBasedClassRef=DemDebounceCounterBasedClass_LostCom
        DemEventParameter_ECU3_DTC26: DemComponentClassRef=DemComponent_ECU3_DTC26, DemDTCRef=DemDTC_ECU3_DTC26
          DemEventClassRB (DemRbEventClass): DemRbEventBufferTime=0
          DemDebounceAlgorithmClass
            DemDebounceCounterBasedClass (DemDebounceCounterBased): DemDebounceCounterBasedClassRef=DemDebounceCounterBasedClass_LostCom
        DemEventParameter_ECU3_DTC27: DemComponentClassRef=DemComponent_ECU3_DTC27, DemDTCRef=DemDTC_ECU3_DTC27
          DemEventClassRB (DemRbEventClass): DemRbEventBufferTime=0
          DemDebounceAlgorithmClass
            DemDebounceCounterBasedClass (DemDebounceCounterBased): DemDebounceCounterBasedClassRef=DemDebounceCounterBasedClass_LostCom
        DemEventParameter_ECU3_DTC28: DemComponentClassRef=DemComponent_ECU3_DTC28, DemDTCRef=DemDTC_ECU3_DTC28
          DemEventClassRB (DemRbEventClass): DemRbEventBufferTime=0
          DemDebounceAlgorithmClass
            DemDebounceCounterBasedClass (DemDebounceCounterBased): DemDebounceCounterBasedClassRef=DemDebounceCounterBasedClass_LostCom
        DemEventParameter_ECU3_DTC29: DemComponentClassRef=DemComponent_ECU3_DTC29, DemDTCRef=DemDTC_ECU3_DTC29
          DemEventClassRB (DemRbEventClass): DemRbEventBufferTime=0
          DemDebounceAlgorithmClass
            DemDebounceCounterBasedClass (DemDebounceCounterBased): DemDebounceCounterBasedClassRef=DemDebounceCounterBasedClass_LostCom
          DemIndicatorAttribute:
            DemIndicatorFailureCycleCounterThreshold = 2
            DemRbIndicatorApiControl = false
            DemIndicatorBehaviour = DEM_INDICATOR_CONTINUOUS
            DemIndicatorHealingCycleCounterThreshold = 3
            DemIndicatorRef = MIL
        DemEventParameter_ECU3_DTC30: DemComponentClassRef=DemComponent_ECU3_DTC30, DemDTCRef=DemDTC_ECU3_DTC30
          DemEventClassRB (DemRbEventClass): DemRbEventBufferTime=0
          DemDebounceAlgorithmClass
            DemDebounceCounterBasedClass (DemDebounceCounterBased): DemDebounceCounterBasedClassRef=DemDebounceCounterBasedClass_LostCom
          DemIndicatorAttribute:
            DemIndicatorFailureCycleCounterThreshold = 2
            DemRbIndicatorApiControl = false
            DemIndicatorBehaviour = DEM_INDICATOR_CONTINUOUS
            DemIndicatorHealingCycleCounterThreshold = 3
            DemIndicatorRef = MIL
        DemEventParameter_ECU3_DTC31: DemComponentClassRef=DemComponent_ECU3_DTC31, DemDTCRef=DemDTC_ECU3_DTC31
          DemEventClassRB (DemRbEventClass): DemRbEventBufferTime=0
          DemDebounceAlgorithmClass
            DemDebounceCounterBasedClass (DemDebounceCounterBased): DemDebounceCounterBasedClassRef=DemDebounceCounterBasedClass_LostCom
          DemIndicatorAttribute:
            DemIndicatorFailureCycleCounterThreshold = 2
            DemRbIndicatorApiControl = false
            DemIndicatorBehaviour = DEM_INDICATOR_CONTINUOUS
            DemIndicatorHealingCycleCounterThreshold = 3
            DemIndicatorRef = MIL
        DemEventParameter_ECU3_DTC32: DemComponentClassRef=DemComponent_ECU3_DTC32, DemDTCRef=DemDTC_ECU3_DTC32
          DemEventClassRB (DemRbEventClass): DemRbEventBufferTime=0
          DemDebounceAlgorithmClass
            DemDebounceCounterBasedClass (DemDebounceCounterBased): DemDebounceCounterBasedClassRef=DemDebounceCounterBasedClass_LostCom
          DemIndicatorAttribute:
            DemIndicatorFailureCycleCounterThreshold = 2
            DemRbIndicatorApiControl = false
            DemIndicatorBehaviour = DEM_INDICATOR_BLINK_CONT
            DemIndicatorHealingCycleCounterThreshold = 3
            DemIndicatorRef = MIL
        DemEventParameter_ECU3_DTC33: DemComponentClassRef=DemComponent_ECU3_DTC33, DemDTCRef=DemDTC_ECU3_DTC33
          DemEventClassRB (DemRbEventClass): DemRbEventBufferTime=0
          DemDebounceAlgorithmClass
            DemDebounceCounterBasedClass (DemDebounceCounterBased): DemDebounceCounterBasedClassRef=DemDebounceCounterBasedClass_LostCom
          DemIndicatorAttribute:
            DemIndicatorFailureCycleCounterThreshold = 2
            DemRbIndicatorApiControl = false
            DemIndicatorBehaviour = DEM_INDICATOR_BLINK_CONT
            DemIndicatorHealingCycleCounterThreshold = 3
            DemIndicatorRef = MIL
        DemEventParameter_ECU3_DTC34: DemComponentClassRef=DemComponent_ECU3_DTC34, DemDTCRef=DemDTC_ECU3_DTC34
          DemEventClassRB (DemRbEventClass): DemRbEventBufferTime=0
          DemDebounceAlgorithmClass
            DemDebounceCounterBasedClass (DemDebounceCounterBased): DemDebounceCounterBasedClassRef=DemDebounceCounterBasedClass_LostCom
        DemEventParameter_ECU3_DTC35: DemComponentClassRef=DemComponent_ECU3_DTC35, DemDTCRef=DemDTC_ECU3_DTC35
          DemEventClassRB (DemRbEventClass): DemRbEventBufferTime=0
          DemDebounceAlgorithmClass
            DemDebounceCounterBasedClass (DemDebounceCounterBased): DemDebounceCounterBasedClassRef=DemDebounceCounterBasedClass_LostCom
        DemEventParameter_ECU3_DTC36: DemComponentClassRef=DemComponent_ECU3_DTC36, DemDTCRef=DemDTC_ECU3_DTC36
          DemEventClassRB (DemRbEventClass): DemRbEventBufferTime=0
          DemDebounceAlgorithmClass
            DemDebounceCounterBasedClass (DemDebounceCounterBased): DemDebounceCounterBasedClassRef=DemDebounceCounterBasedClass_LostCom
        DemEventParameter_ECU3_DTC37: DemComponentClassRef=DemComponent_ECU3_DTC37, DemDTCRef=DemDTC_ECU3_DTC37
          DemEventClassRB (DemRbEventClass): DemRbEventBufferTime=0
          DemDebounceAlgorithmClass
            DemDebounceCounterBasedClass (DemDebounceCounterBased): DemDebounceCounterBasedClassRef=DemDebounceCounterBasedClass_LostCom
          DemIndicatorAttribute:
            DemIndicatorFailureCycleCounterThreshold = 2
            DemRbIndicatorApiControl = false
            DemIndicatorBehaviour = DEM_INDICATOR_CONTINUOUS
            DemIndicatorHealingCycleCounterThreshold = 3
            DemIndicatorRef = MIL
        DemEventParameter_ECU3_DTC38: DemDTCRef=DemDTC_ECU3_DTC38, DemComponentClassRef=DemComponent_ECU3_DTC38
          DemDebounceAlgorithmClass
            DemDebounceCounterBasedClass (DemDebounceCounterBased): DemDebounceCounterBasedClassRef=DemDebounceCounterBasedClass_LostCom
          DemRbEventClass: DemRbEventBufferTime=0, DemRbEventRecoverableInSameOperationCycle=true, DemRbEventStatusBitStorageTestFailed=true
        DemEventParameter_ECU3_DTC39: DemDTCRef=DemDTC_ECU3_DTC39, DemComponentClassRef=DemComponent_ECU3_DTC39
          DemDebounceAlgorithmClass
            DemDebounceCounterBasedClass (DemDebounceCounterBased): DemDebounceCounterBasedClassRef=DemDebounceCounterBasedClass_LostCom
          DemRbEventClass: DemRbEventBufferTime=0, DemRbEventRecoverableInSameOperationCycle=true, DemRbEventStatusBitStorageTestFailed=true
        DemEventParameter_ECU3_DTC40: DemDTCRef=DemDTC_ECU3_DTC40, DemComponentClassRef=DemComponent_ECU3_DTC40
          DemDebounceAlgorithmClass
            DemDebounceCounterBasedClass (DemDebounceCounterBased): DemDebounceCounterBasedClassRef=DemDebounceCounterBasedClass_LostCom
          DemRbEventClass: DemRbEventBufferTime=0, DemRbEventRecoverableInSameOperationCycle=true, DemRbEventStatusBitStorageTestFailed=true
          DemIndicatorAttribute:
            DemIndicatorFailureCycleCounterThreshold = 2
            DemRbIndicatorApiControl = false
            DemIndicatorBehaviour = DEM_INDICATOR_BLINK_CONT
            DemIndicatorHealingCycleCounterThreshold = 3
            DemIndicatorRef = MIL
        DemEventParameter_ECU3_DTC41: DemDTCRef=DemDTC_ECU3_DTC41, DemComponentClassRef=DemComponent_ECU3_DTC41
          DemDebounceAlgorithmClass
            DemDebounceCounterBasedClass (DemDebounceCounterBased): DemDebounceCounterBasedClassRef=DemDebounceCounterBasedClass_LostCom
          DemRbEventClass: DemRbEventBufferTime=0, DemRbEventRecoverableInSameOperationCycle=true, DemRbEventStatusBitStorageTestFailed=true
          DemIndicatorAttribute:
            DemIndicatorFailureCycleCounterThreshold = 2
            DemRbIndicatorApiControl = false
            DemIndicatorBehaviour = DEM_INDICATOR_BLINK_CONT
            DemIndicatorHealingCycleCounterThreshold = 3
            DemIndicatorRef = MIL
        DemEventParameter_ECU3_DTC42: DemDTCRef=DemDTC_ECU3_DTC42, DemComponentClassRef=DemComponent_ECU3_DTC42
          DemDebounceAlgorithmClass
            DemDebounceCounterBasedClass (DemDebounceCounterBased): DemDebounceCounterBasedClassRef=DemDebounceCounterBasedClass_LostCom
          DemRbEventClass: DemRbEventBufferTime=0, DemRbEventRecoverableInSameOperationCycle=true, DemRbEventStatusBitStorageTestFailed=true
          DemIndicatorAttribute:
            DemIndicatorFailureCycleCounterThreshold = 2
            DemRbIndicatorApiControl = false
            DemIndicatorBehaviour = DEM_INDICATOR_BLINK_CONT
            DemIndicatorHealingCycleCounterThreshold = 3
            DemIndicatorRef = MIL
        DemEventParameter_ECU3_DTC43: DemComponentClassRef=DemComponent_ECU3_DTC43, DemDTCRef=DemDTC_ECU3_DTC43
          DemEventClassRB (DemRbEventClass): DemRbEventBufferTime=0
          DemDebounceAlgorithmClass
            DemDebounceCounterBasedClass (DemDebounceCounterBased): DemDebounceCounterBasedClassRef=DemDebounceCounterBasedClass_LostCom
          DemIndicatorAttribute:
            DemIndicatorFailureCycleCounterThreshold = 2
            DemRbIndicatorApiControl = false
            DemIndicatorBehaviour = DEM_INDICATOR_BLINK_CONT
            DemIndicatorHealingCycleCounterThreshold = 3
            DemIndicatorRef = MIL
        DemEventParameter_ECU3_DTC44: DemComponentClassRef=DemComponent_ECU3_DTC44, DemDTCRef=DemDTC_ECU3_DTC44
          DemEventClassRB (DemRbEventClass): DemRbEventBufferTime=0
          DemDebounceAlgorithmClass
            DemDebounceCounterBasedClass (DemDebounceCounterBased): DemDebounceCounterBasedClassRef=DemDebounceCounterBasedClass_LostCom
          DemIndicatorAttribute:
            DemIndicatorFailureCycleCounterThreshold = 2
            DemRbIndicatorApiControl = false
            DemIndicatorBehaviour = DEM_INDICATOR_BLINK_CONT
            DemIndicatorHealingCycleCounterThreshold = 3
            DemIndicatorRef = MIL
        DemEventParameter_ECU3_DTC45: DemComponentClassRef=DemComponent_ECU3_DTC45, DemDTCRef=DemDTC_ECU3_DTC45
          DemEventClassRB (DemRbEventClass): DemRbEventBufferTime=0
          DemDebounceAlgorithmClass
            DemDebounceCounterBasedClass (DemDebounceCounterBased): DemDebounceCounterBasedClassRef=DemDebounceCounterBasedClass_LostCom
        DemEventParameter_ECU3_DTC46: DemComponentClassRef=DemComponent_ECU3_DTC46, DemDTCRef=DemDTC_ECU3_DTC46
          DemEventClassRB (DemRbEventClass): DemRbEventBufferTime=0
          DemDebounceAlgorithmClass
            DemDebounceCounterBasedClass (DemDebounceCounterBased): DemDebounceCounterBasedClassRef=DemDebounceCounterBasedClass_LostCom
        DemEventParameter_ECU3_DTC47: DemComponentClassRef=DemComponent_ECU3_DTC47, DemDTCRef=DemDTC_ECU3_DTC47
          DemEventClassRB (DemRbEventClass): DemRbEventBufferTime=0
          DemDebounceAlgorithmClass
            DemDebounceCounterBasedClass (DemDebounceCounterBased): DemDebounceCounterBasedClassRef=DemDebounceCounterBasedClass_LostCom
        DemEventParameter_ECU3_DTC48: DemComponentClassRef=DemComponent_ECU3_DTC48, DemDTCRef=DemDTC_ECU3_DTC48
          DemEventClassRB (DemRbEventClass): DemRbEventBufferTime=0
          DemDebounceAlgorithmClass
            DemDebounceCounterBasedClass (DemDebounceCounterBased): DemDebounceCounterBasedClassRef=DemDebounceCounterBasedClass_LostCom
        DemEventParameter_ECU3_DTC49: DemComponentClassRef=DemComponent_ECU3_DTC49, DemDTCRef=DemDTC_ECU3_DTC49
          DemEventClassRB (DemRbEventClass): DemRbEventBufferTime=0
          DemDebounceAlgorithmClass
            DemDebounceCounterBasedClass (DemDebounceCounterBased): DemDebounceCounterBasedClassRef=DemDebounceCounterBasedClass_LostCom
          DemIndicatorAttribute:
            DemIndicatorFailureCycleCounterThreshold = 2
            DemRbIndicatorApiControl = false
            DemIndicatorBehaviour = DEM_INDICATOR_CONTINUOUS
            DemIndicatorHealingCycleCounterThreshold = 3
            DemIndicatorRef = MIL
        DemEventParameter_ECU3_DTC50: DemDTCRef=DemDTC_ECU3_DTC50, DemComponentClassRef=DemComponent_ECU3_DTC50
          DemDebounceAlgorithmClass
            DemDebounceCounterBasedClass (DemDebounceCounterBased): DemDebounceCounterBasedClassRef=DemDebounceCounterBasedClass_LostCom
          DemRbEventClass: DemRbEventBufferTime=0, DemRbEventRecoverableInSameOperationCycle=true, DemRbEventStatusBitStorageTestFailed=true
          DemIndicatorAttribute:
            DemIndicatorFailureCycleCounterThreshold = 2
            DemRbIndicatorApiControl = false
            DemIndicatorBehaviour = DEM_INDICATOR_CONTINUOUS
            DemIndicatorHealingCycleCounterThreshold = 3
            DemIndicatorRef = MIL
        DemEventParameter_ECU3_DTC51: DemDTCRef=DemDTC_ECU3_DTC51, DemComponentClassRef=DemComponent_ECU3_DTC51
          DemDebounceAlgorithmClass
            DemDebounceCounterBasedClass (DemDebounceCounterBased): DemDebounceCounterBasedClassRef=DemDebounceCounterBasedClass_LostCom
          DemRbEventClass: DemRbEventBufferTime=0, DemRbEventRecoverableInSameOperationCycle=true, DemRbEventStatusBitStorageTestFailed=true
          DemIndicatorAttribute:
            DemIndicatorFailureCycleCounterThreshold = 2
            DemRbIndicatorApiControl = false
            DemIndicatorBehaviour = DEM_INDICATOR_CONTINUOUS
            DemIndicatorHealingCycleCounterThreshold = 3
            DemIndicatorRef = MIL
