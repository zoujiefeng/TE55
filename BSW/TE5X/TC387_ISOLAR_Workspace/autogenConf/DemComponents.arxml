AUTOSAR XML (schema 00047)
package /ETAS_Project/EcucModuleConfigurationValuess
  module config Dem
    DemConfigSet
      500 x DemComponent:
        DemComponent_ECU1_DTC{00..99}: DemComponentIgnoresPriority=false
        DemComponent_ECU2_DTC{00..99}: DemComponentIgnoresPriority=false
        DemComponent_ECU3_DTC{00..09}: DemComponentIgnoresPriority=false
        DemComponent_ECU3_DTC10: DemComponentIgnoresPriority=0
        DemComponent_ECU3_DTC{11..29}: DemComponentIgnoresPriority=false
        DemComponent_ECU3_DTC30: DemComponentIgnoresPriority=0
        DemComponent_ECU3_DTC{31..99}: DemComponentIgnoresPriority=false
        DemComponent_ECU4_DTC{00..99}: DemComponentIgnoresPriority=false
        DemComponent_ECU5_DTC{00..59}: DemComponentIgnoresPriority=false
        DemComponent_ECU5_DTC60: DemComponentIgnoresPriority=0
        DemComponent_ECU5_DTC{61..79}: DemComponentIgnoresPriority=false
        DemComponent_ECU5_DTC80: DemComponentIgnoresPriority=0
        DemComponent_ECU5_DTC{81..99}: DemComponentIgnoresPriority=false
