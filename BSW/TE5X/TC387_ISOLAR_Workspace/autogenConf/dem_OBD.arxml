AUTOSAR XML (schema 00047)
package /ETAS_Project/EcucModuleConfigurationValuess
  module config Dem: implementation-config-variant=VARIANT-PRE-COMPILE
    DemConfigSet
      DemDtrs
        Mid01 (DemDtr): DemDtrCompuDenominator0=1.0, DemDtrCompuNumerator0=0.0, DemDtrCompuNumerator1=1.0, DemDtrId=0, DemDtrMid=1, DemDtrTid=5, DemDtrUasid=47
    DemGeneral
      DEM_OPCYC_PFC (DemOperationCycle): DemLeadingCycleRef=DemOperationCycle_Ignition
      DEM_OPCYC_WARMUP (DemOperationCycle): DemLeadingCycleRef=DemOperationCycle_Ignition
      MIL_Indicator (DemIndicator)
      MIL (DemIndicator)
