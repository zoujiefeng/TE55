AUTOSAR XML (schema 00047)
package /ETAS_Project/EcucModuleConfigurationValuess
  module config Dcm
    DcmConfigSet
      DcmDsd
      DcmDsp:
        DcmRbDspLimitRDBIRespToBufSize = 0
        DcmRbDspRdbiPagedBufferEnabled = 0
        DcmRbDspRmbaPagedBufferEnabled = 0
        DcmRbDspRdtcPagedBufferEnabled = 0
        DcmRbDspSequenceCheckRequestDownloadDisabled = 0
        DcmRbDspSequenceCheckRequestUploadDisabled = 0
        DcmRbDspSesSecUsedInProtocol = UDS
        DcmRbDspTransferDataMaxLenChkRequired = 1
        DcmRbDspAutoConfigureDEMOBDPIDs = 0
        DcmDspMemory
          DcmDspMemoryIdInfo_0 (DcmDspMemoryIdInfo): DcmDspMemoryIdValue=0
            DcmDspReadMemoryRangeByLabelInfo:
              DcmDspReadMemoryRangeByLabelHigh = 0xAF03FFFF
              DcmDspReadMemoryRangeByLabelLow = 0xAF000000
              DcmDspReadMemoryRangeSessionLevelRef = ExtendedDiagnosticSession
            DcmDspReadMemoryRangeInfo: DcmDspReadMemoryRangeHigh=2936274943, DcmDspReadMemoryRangeLow=2936012800, DcmDspReadMemoryRangeSessionLevelRef=ExtendedDiagnosticSession
        DcmDspSecurity: DcmRbDspSecurityDelayTimerMonitor=REQUEST_SEED, DcmRbDspSecurityNRCExceedNoOfAttempt=NumAttDelayAndNumAttLock, DcmRbDspSecurityStoreSeed=false
      DcmDsl
