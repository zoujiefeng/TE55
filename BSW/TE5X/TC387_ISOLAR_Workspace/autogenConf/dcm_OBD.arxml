AUTOSAR XML (schema 00047)
package /ETAS_Project/EcucModuleConfigurationValuess
  module config Dcm: implementation-config-variant=VARIANT-PRE-COMPILE
    DcmConfigSet
      DcmDsd
        DcmDsdServiceTable_OBD (DcmDsdServiceTable)
          7 x DcmDsdService, all with DcmDsdSidTabSubfuncAvail=false:
            ClearEmissionRelatedData: DcmDsdSidTabFnc=Dcm_DcmObdMode04, DcmDsdSidTabServiceId=4, DcmRbDsdSidTabSidInitFunction=Dcm_DcmObdMode04_Ini
            RequestCurrentPowertrainDiagnosticData: DcmDsdSidTabFnc=Dcm_DcmObdMode01, DcmDsdSidTabServiceId=1, DcmRbDsdSidTabSidInitFunction=NULL_PTR
            RequestEmissionRelatedDtcsConfirmedClass: DcmDsdSidTabFnc=Dcm_DcmObdMode37A, DcmDsdSidTabServiceId=3, DcmRbDsdSidTabSidInitFunction=NULL_PTR
            RequestEmissionRelatedDtcsPendingClass: DcmDsdSidTabFnc=Dcm_DcmObdMode37A, DcmDsdSidTabServiceId=7, DcmRbDsdSidTabSidInitFunction=NULL_PTR
            RequestEmissionRelatedDtcPermStatus: DcmDsdSidTabFnc=Dcm_DcmObdMode37A, DcmDsdSidTabServiceId=10, DcmRbDsdSidTabSidInitFunction=NULL_PTR
            RequestPowertrainFreezeFrameData: DcmDsdSidTabServiceId=2, DcmRbDsdSidTabSidInitFunction=NULL_PTR, DcmDsdSidTabFnc=Dcm_DcmObdMode02
            RequestVehicleInfo: DcmDsdSidTabFnc=Dcm_DcmObdMode09, DcmDsdSidTabServiceId=9, DcmRbDsdSidTabSidInitFunction=Dcm_DcmObdMode09_Ini
      DcmDsl
        DcmDslDiagResp
        DcmDslProtocol
          DcmDslProtocolRow_OBD (DcmDslProtocolRow):
            DcmDslProtocolID = DCM_OBD_ON_CAN
            DcmDslProtocolMaximumResponseSize = 4095
            DcmDslProtocolPriority = 0
            DcmRbDslProtocolNRC21OnPriorityAssessmentReject = false
            DcmSendRespPendOnTransToBoot = true
            DcmTimStrP2ServerAdjust = 0.01
            DcmTimStrP2StarServerAdjust = 0.01
            DcmDslProtocolRxBufferRef = DcmDslBuffer_OBD_Rx
            DcmDslProtocolTxBufferRef = DcmDslBuffer_OBD_Tx
            DcmDemClientRef = DemClient
            DcmDslProtocolSIDTable = DcmDsdServiceTable_OBD
            DcmDslConnection_CAN (DcmDslConnection)
              DcmDslMainConnection: DcmDslProtocolRxTesterSourceAddr=241, DcmDslProtocolComMChannelRef=Can_Network_CanNodeNum_01
                OBD_Rx_Func_PduR2Dcm (DcmDslProtocolRx): DcmDslProtocolRxAddrType=DCM_FUNCTIONAL_TYPE, DcmDslProtocolRxPduRef=DcmPdu_PduR2Dcm_CanNodeNum_01_FunRequest
                OBD_Tx_Phys_Dcm2PduR (DcmDslProtocolTx): DcmDslProtocolTxPduRef=DcmPdu_Dcm2PduR_CanNodeNum_01_PhyResponse
        DcmDslBuffer_OBD_Tx (DcmDslBuffer): DcmDslBufferSize=2048
        DcmDslBuffer_OBD_Rx (DcmDslBuffer): DcmDslBufferSize=2048
      DcmDsp: DcmRbDspRdtcPagedBufferEnabled=false
        3 x DcmDspPid:
          DcmDspPid_01: DcmDspPidIdentifier=1, DcmDspPidService=DCM_SERVICE_01, DcmDspPidSize=4
            DcmDspPidData_01 (DcmDspPidData): DcmDspPidDataPos=0, DcmDspPidDataSize=32
              DcmDspPidService01:
                DcmDspPidDataEndianness = LITTLE_ENDIAN
                DcmDspPidDataUsePort = USE_DATA_SYNCH_FNC
                DcmDspPidDataType = UINT8_N
                DcmDspPidDataReadFnc = Dem_DcmReadDataOfPID01
          DcmDspPid_02: DcmDspPidService=DCM_SERVICE_02, DcmDspPidIdentifier=2, DcmDspPidSize=2
            DcmDspPidData_02 (DcmDspPidData): DcmDspPidDataPos=0, DcmDspPidDataSize=16
              DcmDspPidService02: DcmDspPidDataDemRef=PID_02
          DcmDspPid_04: DcmDspPidIdentifier=4, DcmDspPidService=DCM_SERVICE_01_02, DcmDspPidSize=1
            DcmDspPidData_04 (DcmDspPidData): DcmDspPidDataPos=0, DcmDspPidDataSize=8
              DcmDspPidService01_04 (DcmDspPidService01): DcmDspPidDataEndianness=LITTLE_ENDIAN, DcmDspPidDataUsePort=USE_DATA_SYNCH_CLIENT_SERVER, DcmDspPidDataType=UINT8_N
              DcmDspPidService02: DcmDspPidDataDemRef=PID_04, DcmRbDspPidDemDataElementClassRef=PID_04
        VIT_04 (DcmDspVehInfo): DcmDspVehInfoNODIProvResp=false, DcmDspVehInfoInfoType=4
          DcmDspVehInfoData_04 (DcmDspVehInfoData): DcmDspVehInfoDataOrder=0, DcmDspVehInfoDataSize=16, DcmDspVehInfoDataUsePort=true
        VIT_06 (DcmDspVehInfo): DcmDspVehInfoInfoType=6, DcmDspVehInfoNODIProvResp=false
          VIT_06_0 (DcmDspVehInfoData): DcmDspVehInfoDataOrder=0, DcmDspVehInfoDataSize=4, DcmDspVehInfoDataUsePort=true
        9 x DcmDspPid:
          DcmDspPid_05: DcmDspPidIdentifier=5, DcmDspPidService=DCM_SERVICE_01_02, DcmDspPidSize=1
            DcmDspPidData_05 (DcmDspPidData): DcmDspPidDataPos=0, DcmDspPidDataSize=8
              DcmDspPidService01_05 (DcmDspPidService01): DcmDspPidDataEndianness=LITTLE_ENDIAN, DcmDspPidDataType=UINT8_N, DcmDspPidDataUsePort=USE_DATA_SYNCH_CLIENT_SERVER
              DcmDspPidService02: DcmDspPidDataDemRef=PID_05, DcmRbDspPidDemDataElementClassRef=PID_05
          DcmDspPid_0C: DcmDspPidIdentifier=12, DcmDspPidService=DCM_SERVICE_01_02, DcmDspPidSize=2
            DcmDspPidData_0C (DcmDspPidData): DcmDspPidDataPos=0, DcmDspPidDataSize=16
              DcmDspPidService01_0C (DcmDspPidService01): DcmDspPidDataEndianness=LITTLE_ENDIAN, DcmDspPidDataType=UINT8_N, DcmDspPidDataUsePort=USE_DATA_SYNCH_CLIENT_SERVER
              DcmDspPidService02: DcmDspPidDataDemRef=PID_0C, DcmRbDspPidDemDataElementClassRef=PID_0C
          DcmDspPid_0D: DcmDspPidIdentifier=13, DcmDspPidService=DCM_SERVICE_01_02, DcmDspPidSize=1
            DcmDspPidData_0D (DcmDspPidData): DcmDspPidDataPos=0, DcmDspPidDataSize=8
              DcmDspPidService01_0D (DcmDspPidService01): DcmDspPidDataEndianness=LITTLE_ENDIAN, DcmDspPidDataType=UINT8_N, DcmDspPidDataUsePort=USE_DATA_SYNCH_CLIENT_SERVER
              DcmDspPidService02: DcmDspPidDataDemRef=PID_0D, DcmRbDspPidDemDataElementClassRef=PID_0D
          DcmDspPid_21: DcmDspPidIdentifier=33, DcmDspPidService=DCM_SERVICE_01, DcmDspPidSize=2
            DcmDspPidData_21 (DcmDspPidData): DcmDspPidDataPos=0, DcmDspPidDataSize=16
              DcmDspPidService01_21 (DcmDspPidService01): DcmDspPidDataEndianness=LITTLE_ENDIAN, DcmDspPidDataType=UINT8_N, DcmDspPidDataUsePort=USE_DATA_SYNCH_CLIENT_SERVER
          DcmDspPid_30: DcmDspPidIdentifier=48, DcmDspPidService=DCM_SERVICE_01, DcmDspPidSize=1
            DcmDspPidData_30 (DcmDspPidData): DcmDspPidDataPos=0, DcmDspPidDataSize=8
              DcmDspPidService01_30 (DcmDspPidService01): DcmDspPidDataEndianness=LITTLE_ENDIAN, DcmDspPidDataType=UINT8_N, DcmDspPidDataUsePort=USE_DATA_SYNCH_CLIENT_SERVER
          DcmDspPid_31: DcmDspPidIdentifier=49, DcmDspPidService=DCM_SERVICE_01, DcmDspPidSize=2
            DcmDspPidData_31 (DcmDspPidData): DcmDspPidDataPos=0, DcmDspPidDataSize=16
              DcmDspPidService01_31 (DcmDspPidService01): DcmDspPidDataEndianness=LITTLE_ENDIAN, DcmDspPidDataType=UINT8_N, DcmDspPidDataUsePort=USE_DATA_SYNCH_CLIENT_SERVER
          DcmDspPid_41: DcmDspPidIdentifier=65, DcmDspPidService=DCM_SERVICE_01, DcmDspPidSize=4
            DcmDspPidData_41 (DcmDspPidData): DcmDspPidDataPos=0, DcmDspPidDataSize=32
              DcmDspPidService01_41 (DcmDspPidService01): DcmDspPidDataEndianness=LITTLE_ENDIAN, DcmDspPidDataType=UINT8_N, DcmDspPidDataUsePort=USE_DATA_SYNCH_CLIENT_SERVER
          DcmDspPid_42: DcmDspPidIdentifier=66, DcmDspPidService=DCM_SERVICE_01_02, DcmDspPidSize=2
            DcmDspPidData_42 (DcmDspPidData): DcmDspPidDataPos=0, DcmDspPidDataSize=16
              DcmDspPidService01_42 (DcmDspPidService01): DcmDspPidDataEndianness=LITTLE_ENDIAN, DcmDspPidDataType=UINT8_N, DcmDspPidDataUsePort=USE_DATA_SYNCH_CLIENT_SERVER
              DcmDspPidService02: DcmDspPidDataDemRef=PID_42, DcmRbDspPidDemDataElementClassRef=PID_42
          DcmDspPid_49: DcmDspPidIdentifier=73, DcmDspPidService=DCM_SERVICE_01_02, DcmDspPidSize=1
            DcmDspPidData_49 (DcmDspPidData): DcmDspPidDataPos=0, DcmDspPidDataSize=8
              DcmDspPidService01_49 (DcmDspPidService01): DcmDspPidDataEndianness=LITTLE_ENDIAN, DcmDspPidDataType=UINT8_N, DcmDspPidDataUsePort=USE_DATA_SYNCH_CLIENT_SERVER
              DcmDspPidService02: DcmDspPidDataDemRef=PID_49, DcmRbDspPidDemDataElementClassRef=PID_49
        VIT_0A (DcmDspVehInfo): DcmDspVehInfoInfoType=10, DcmDspVehInfoNODIProvResp=false
          DcmDspVehInfoData_0A (DcmDspVehInfoData): DcmDspVehInfoDataOrder=0, DcmDspVehInfoDataSize=20, DcmDspVehInfoDataUsePort=true
      DcmPageBufferCfg
