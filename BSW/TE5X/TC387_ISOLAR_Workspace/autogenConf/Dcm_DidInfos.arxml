AUTOSAR XML (schema 00047)
package /ETAS_Project/EcucModuleConfigurationValuess
  module config Dcm
    DcmConfigSet
      DcmDsp
        6 x DcmDspDidInfo, all with DcmDspDidDynamicallyDefined=false:
          DidInfo_Ext_R
            DcmDspDidRead: DcmDspDidReadSessionRef=ExtendedDiagnosticSession, DcmDspDidReadSessionRef=DefaultSession
          DidInfo_Ext_RW
            DcmDspDidRead: DcmDspDidReadSessionRef=ExtendedDiagnosticSession, DcmDspDidReadSessionRef=DefaultSession
            DcmDspDidWrite: DcmDspDidWriteSessionRef=ExtendedDiagnosticSession
          DidInfo_Ext_W_L1
            DcmDspDidWrite: DcmDspDidWriteSessionRef=ExtendedDiagnosticSession, DcmDspDidWriteSecurityLevelRef=DSP_SEC_LEV_L1
          DidInfo_Ext_RW_L1
            DcmDspDidWrite: DcmDspDidWriteSessionRef=ExtendedDiagnosticSession, DcmDspDidWriteSecurityLevelRef=DSP_SEC_LEV_L1
            DcmDspDidRead: DcmDspDidReadSessionRef=ExtendedDiagnosticSession, DcmDspDidReadSessionRef=DefaultSession
          DidInfo_R_DefExt
            DcmDspDidRead: DcmDspDidReadSessionRef=DefaultSession, DcmDspDidReadSessionRef=ExtendedDiagnosticSession
          DidInfo_R_DefExt_W_Ext_L1
            DcmDspDidRead: DcmDspDidReadSessionRef=DefaultSession, DcmDspDidReadSessionRef=ExtendedDiagnosticSession
            DcmDspDidWrite: DcmDspDidWriteSessionRef=ExtendedDiagnosticSession, DcmDspDidWriteSecurityLevelRef=DSP_SEC_LEV_L1
