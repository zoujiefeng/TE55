AUTOSAR XML (schema 00047)
package /ETAS_Project/EcucModuleConfigurationValuess
  module config Dem
    DemConfigSet
      500 x DemEventParameter:
        DemEventParameter_ECU1_DTC{00..32}: DemEventAvailable=true
        DemEventParameter_ECU1_DTC{33..99}: DemEventAvailable=false
        DemEventParameter_ECU2_DTC{00..99}: DemEventAvailable=false
        DemEventParameter_ECU3_DTC{00..11}: DemEventAvailable=true
        DemEventParameter_ECU3_DTC{12..99}: DemEventAvailable=false
        DemEventParameter_ECU4_DTC{00..12}: DemEventAvailable=true
        DemEventParameter_ECU4_DTC{13..99}: DemEventAvailable=false
        DemEventParameter_ECU5_DTC{00..21}: DemEventAvailable=true
        DemEventParameter_ECU5_DTC{22..99}: DemEventAvailable=false
