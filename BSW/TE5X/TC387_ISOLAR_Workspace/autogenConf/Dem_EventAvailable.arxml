AUTOSAR XML (schema 00047)
package /ETAS_Project/EcucModuleConfigurationValuess
  module config Dem
    DemConfigSet
      500 x DemEventParameter:
        DemEventParameter_ECU1_DTC{00..33}: DemEventAvailable=true
        DemEventParameter_ECU1_DTC{34..99}: DemEventAvailable=false
        DemEventParameter_ECU2_DTC{00..99}: DemEventAvailable=false
        DemEventParameter_ECU3_DTC{00..12}: DemEventAvailable=true
        DemEventParameter_ECU3_DTC{13..99}: DemEventAvailable=false
        DemEventParameter_ECU4_DTC{00..12}: DemEventAvailable=true
        DemEventParameter_ECU4_DTC{13..99}: DemEventAvailable=false
        DemEventParameter_ECU5_DTC{00..22}: DemEventAvailable=true
        DemEventParameter_ECU5_DTC{23..99}: DemEventAvailable=false
