AUTOSAR XML (schema 00047)
package /ETAS_Project/EcucModuleConfigurationValuess
  module config Dcm
    DcmConfigSet
      DcmDsp
        6 x DcmDspRoutine:
          DcmDspRoutine_0203: DcmRbDspStopRoutineOnSessionChange=true, DcmDspRoutineIdentifier=515, DcmDspRoutineUsePort=true
            DcmDspDrive_0203_StartRoutine (DcmDspStartRoutine): DcmDspStartRoutineCommonAuthorizationRef=DcmDspRoutineAuthorization_OnlyExt
              DcmDspStartRoutineOut
                DcmDspStartRoutineOutSignal: DcmDspRoutineSignalEndianness=LITTLE_ENDIAN, DcmDspRoutineSignalLength=8, DcmDspRoutineSignalPos=0, DcmDspRoutineSignalType=UINT8
            DcmDspDrive_0203_RequestRoutineResults (DcmDspRequestRoutineResults): DcmDspRequestRoutineResultsCommonAuthorizationRef=DcmDspRoutineAuthorization_OnlyExt
              DcmDspRequestRoutineResultsOut_0 (DcmDspRequestRoutineResultsOut)
                DcmDspRequestRoutineResultsOutSignal_0 (DcmDspRequestRoutineResultsOutSignal): DcmDspRoutineSignalEndianness=LITTLE_ENDIAN, DcmDspRoutineSignalLength=8, DcmDspRoutineSignalPos=0, DcmDspRoutineSignalType=UINT8
          DcmDspRoutine_GCUZeroPositionLearn_A207: DcmRbDspStopRoutineOnSessionChange=0, DcmDspRoutineIdentifier=41479, DcmDspRoutineUsePort=false
            DcmDspRequestRoutineResults:
              DcmDspRequestRoutineResultsFnc = DcmDspRequestRoutine_GcuPosSelfLearning
              DcmDspRequestRoutineResultsCommonAuthorizationRef = DcmDspRoutineAuthorization_OnlyExt
              DcmDspRequestRoutineResultsOut
                DcmDspRequestRoutineResultsOutSignal_0 (DcmDspRequestRoutineResultsOutSignal): DcmDspRoutineSignalEndianness=BIG_ENDIAN, DcmDspRoutineSignalPos=0, DcmDspRoutineSignalType=UINT8
            DcmDspStartRoutine: DcmDspStartRoutineFnc=DcmDspStartRoutine_GcuPosSelfLearning, DcmDspStartRoutineCommonAuthorizationRef=DcmDspRoutineAuthorization_OnlyExt
          DcmDspRoutine_StartSwap_815F: DcmRbDspStopRoutineOnSessionChange=0, DcmDspRoutineIdentifier=33119, DcmDspRoutineUsePort=false
            DcmDspStartRoutine: DcmDspStartRoutineFnc=DcmDspStartRoutine_StartSwapCallback, DcmDspStartRoutineCommonAuthorizationRef=DcmDspRoutineAuthorization_OnlyExt
          DcmDspRoutine_StayInBoot_F518: DcmRbDspStopRoutineOnSessionChange=0, DcmDspRoutineIdentifier=62744, DcmDspRoutineUsePort=false
            DcmDspStartRoutine: DcmDspStartRoutineFnc=DcmDspStartRoutine_StayInBootCallback, DcmDspStartRoutineCommonAuthorizationRef=DcmDspRoutineAuthorization_AllSession
              DcmDspStartRoutineIn
                DcmDspStartRoutineInSignal_0 (DcmDspStartRoutineInSignal): DcmDspRoutineSignalEndianness=BIG_ENDIAN, DcmDspRoutineSignalPos=0, DcmDspRoutineSignalType=VARIABLE_LENGTH, DcmDspRoutineSignalLength=24
          DcmDspRoutine_TCUPositionLearnin_A206: DcmRbDspStopRoutineOnSessionChange=0, DcmDspRoutineIdentifier=41478, DcmDspRoutineUsePort=false
            DcmDspStartRoutine: DcmDspStartRoutineFnc=DcmDspStartRoutine_TcuPosLearning, DcmDspStartRoutineCommonAuthorizationRef=DcmDspRoutineAuthorization_OnlyExt
            DcmDspRequestRoutineResults:
              DcmDspRequestRoutineResultsFnc = DcmDspRequestRoutine_TcuPosLearning
              DcmDspRequestRoutineResultsCommonAuthorizationRef = DcmDspRoutineAuthorization_OnlyExt
              DcmDspRequestRoutineResultsOut
                DcmDspRequestRoutineResultsOutSignal_0 (DcmDspRequestRoutineResultsOutSignal): DcmDspRoutineSignalPos=0, DcmDspRoutineSignalType=UINT8, DcmDspRoutineSignalEndianness=BIG_ENDIAN
          DcmDspRoutine_ZeroPositionLearn_A205: DcmRbDspStopRoutineOnSessionChange=0, DcmDspRoutineIdentifier=41477, DcmDspRoutineUsePort=false
            DcmDspRequestRoutineResults:
              DcmDspRequestRoutineResultsFnc = DcmDspRequestRoutine_ZeroPosSelfLearning
              DcmDspRequestRoutineResultsCommonAuthorizationRef = DcmDspRoutineAuthorization_OnlyExt
              DcmDspRequestRoutineResultsOut
                DcmDspRequestRoutineResultsOutSignal_0 (DcmDspRequestRoutineResultsOutSignal): DcmDspRoutineSignalEndianness=BIG_ENDIAN, DcmDspRoutineSignalPos=0, DcmDspRoutineSignalType=UINT8
            DcmDspStartRoutine: DcmDspStartRoutineFnc=DcmDspStartRoutine_ZeroPosSelfLearning, DcmDspStartRoutineCommonAuthorizationRef=DcmDspRoutineAuthorization_OnlyExt
        DcmDspRoutineAuthorization_OnlyExt (DcmDspCommonAuthorization): DcmDspCommonAuthorizationSessionRef=ExtendedDiagnosticSession
