AUTOSAR XML (schema 00047)
package /ETAS_Project/EcucModuleConfigurationValuess
  ecuc value collection EcucValueCollection_0: ecu-extract=EXTR_IPC
    ecuc-values:
      Dem
      WdgIf
      Rte
      Cdd
      Xcp
      Os
      Platform
      EcuC
      Spi
      rba_MemLib
      CanTp
      CanNm
      Bfx
      EcuM
      CanSM
      WdgM
      Wdg
      MemIf
      Mfx
      Nm
      Com
      NvM
      Fee
      ComM
      ComStack
      Dcm
      CanIf
      Can
      Det
      PduR
      Crc
      BswM
      CanTrcv
      E2E_0
      rba_ArxmlGen
      NvM
      NvM
