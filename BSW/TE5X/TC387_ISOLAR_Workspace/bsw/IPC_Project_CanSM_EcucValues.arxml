AUTOSAR XML (schema 00047)
package /ETAS_Project/EcucModuleConfigurationValuess
  module config CanSM: implementation-config-variant=VARIANT-PRE-COMPILE
    CanSMConfiguration: CanSMModeRequestRepetitionMax=5, CanSMModeRequestRepetitionTime=0.07
      4 x CanSMManagerNetwork, all with CanSMBorCounterL1ToL2=5, CanSMBorTimeTxEnsured=0.02, CanSMBorTxConfirmationPolling=false:
        Can_Network_CANNODE_00: CanSMBorTimeL1=0.04, CanSMBorTimeL2=0.2, CanSMComMNetworkHandleRef=Can_Network_CanNodeNum_00
          Can_Network_CANNODE_00 (CanSMController): CanSMControllerId=CanIf_CanNodeNum_00
          CanSMDemEventParameterRefs: CanSMRbDynCreate_CANSM_E_BUS_OFF=Disabled, CANSM_E_BUS_OFF=DemEventParameter_ECU1_DTC21
        Can_Network_CANNODE_01: CanSMBorTimeL1=0.1, CanSMBorTimeL2=1.0, CanSMComMNetworkHandleRef=Can_Network_CanNodeNum_01, CanSMTransceiverId=CanIfTrcvCfg_0
          Can_Network_CANNODE_01 (CanSMController): CanSMControllerId=CanIf_CanNodeNum_01
          CanSMDemEventParameterRefs: CanSMRbDynCreate_CANSM_E_BUS_OFF=Disabled, CANSM_E_BUS_OFF=DemEventParameter_ECU1_DTC21
        Can_Network_CANNODE_02: CanSMBorTimeL1=0.04, CanSMBorTimeL2=0.2, CanSMComMNetworkHandleRef=Can_Network_CanNodeNum_02
          Can_Network_CANNODE_02 (CanSMController): CanSMControllerId=CanIf_CanNodeNum_02
          CanSMDemEventParameterRefs_0 (CanSMDemEventParameterRefs): CanSMRbDynCreate_CANSM_E_BUS_OFF=Disabled, CANSM_E_BUS_OFF=DemEventParameter_ECU1_DTC21
        Can_Network_CANNODE_03: CanSMBorTimeL1=0.04, CanSMBorTimeL2=0.2, CanSMComMNetworkHandleRef=Can_Network_CanNodeNum_03
          Can_Network_CANNODE_03 (CanSMController): CanSMControllerId=CanIf_CanNodeNum_03
          CanSMDemEventParameterRefs_0 (CanSMDemEventParameterRefs): CanSMRbDynCreate_CANSM_E_BUS_OFF=Disabled, CANSM_E_BUS_OFF=DemEventParameter_ECU1_DTC21
    CanSMGeneral: CanSMMainFunctionTimePeriod=0.01, CanSMDevErrorDetect=true, CanSMVersionInfoApi=false
