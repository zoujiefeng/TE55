AUTOSAR XML (schema 00047)
package /ETAS_Project/EcucModuleConfigurationValuess
  module config rba_MemLib: implementation-config-variant=PRECONFIGURED-CONFIGURATION
    rba_MemLibCentral: rba_MemLibCentralEnablePrototype=false, rba_MemLibVersionInfoApi=false
