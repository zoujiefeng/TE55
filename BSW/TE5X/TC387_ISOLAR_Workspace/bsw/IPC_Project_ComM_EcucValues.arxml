AUTOSAR XML (schema 00047)
package /ETAS_Project/EcucModuleConfigurationValuess
  module config ComM: implementation-config-variant=VARIANT-PRE-COMPILE
    ComMConfigSet
      Can_Network_CanNodeNum_00 (ComMChannel):
        ComMNoCom = false
        ComMFullCommRequestNotificationEnabled = false
        ComMMainFunctionPeriod = 0.01
        ComMBusType = COMM_BUS_TYPE_CAN
        ComMNoWakeUpInhibitionNvmStorage = false
        ComMNoWakeup = false
        ComMChannelId = 0
        ComMNetworkManagement: ComMNmVariant=LIGHT, ComMNmLightTimeout=255.0, ComMPncNmRequest=false
        ComMUserPerChannel_Can_Network_CanNodeNum_00 (ComMUserPerChannel): ComMUserChannel=ComMUser_Can_Network_CanNodeNum_00
      Can_Network_CanNodeNum_01 (ComMChannel):
        ComMNoCom = false
        ComMFullCommRequestNotificationEnabled = false
        ComMMainFunctionPeriod = 0.01
        ComMBusType = COMM_BUS_TYPE_CAN
        ComMNoWakeUpInhibitionNvmStorage = false
        ComMNoWakeup = false
        ComMChannelId = 1
        ComMNetworkManagement: ComMPncNmRequest=false, ComMNmVariant=FULL, ComMNmLightTimeout=2.0
        ComMUserPerChannel_Can_Network_CanNodeNum_01 (ComMUserPerChannel): ComMUserChannel=ComMUser_Can_Network_CanNodeNum_01
      ComMUser_Can_Network_CanNodeNum_00 (ComMUser): ComMUserIdentifier=0
      ComMUser_Can_Network_CanNodeNum_01 (ComMUser): ComMUserIdentifier=1
      Can_Network_CanNodeNum_02 (ComMChannel):
        ComMFullCommRequestNotificationEnabled = 0
        ComMMainFunctionPeriod = 0.01
        ComMNoCom = 0
        ComMNoWakeup = 0
        ComMBusType = COMM_BUS_TYPE_CAN
        ComMChannelId = 2
        ComMNoWakeUpInhibitionNvmStorage = false
        ComMNetworkManagement: ComMNmLightTimeout=2.0, ComMNmVariant=LIGHT, ComMPncNmRequest=false
        ComMUserPerChannel_Can_Network_CanNodeNum_02 (ComMUserPerChannel): ComMUserChannel=ComMUser_Can_Network_CanNodeNum_02
      ComMUser_Can_Network_CanNodeNum_02 (ComMUser): ComMUserIdentifier=2
      ComMUser_Can_Network_CanNodeNum_03 (ComMUser): ComMUserIdentifier=3
      Can_Network_CanNodeNum_03 (ComMChannel):
        ComMFullCommRequestNotificationEnabled = 0
        ComMMainFunctionPeriod = 0.01
        ComMNoCom = 0
        ComMNoWakeup = 0
        ComMBusType = COMM_BUS_TYPE_CAN
        ComMChannelId = 3
        ComMNoWakeUpInhibitionNvmStorage = false
        ComMNetworkManagement: ComMNmLightTimeout=2.0, ComMNmVariant=LIGHT, ComMPncNmRequest=false
        ComMUserPerChannel_Can_Network_CanNodeNum_03 (ComMUserPerChannel): ComMUserChannel=ComMUser_Can_Network_CanNodeNum_03
    ComMGeneral:
      ComMResetAfterForcingNoComm = false
      ComMModeLimitationEnabled = true
      ComMPncGatewayEnabled = false
      ComMNmPassiveModeEnable = false
      ComMEcuGroupClassification = 0
      ComMDevErrorDetect = true
      ComMWakeupInhibitionEnabled = false
      ComMPncSupport = false
      ComMTMinFullComModeDuration = 0.01
      ComMVersionInfoApi = false
      ComMRteEnabled = true
      ComMSynchronousWakeUp = false
