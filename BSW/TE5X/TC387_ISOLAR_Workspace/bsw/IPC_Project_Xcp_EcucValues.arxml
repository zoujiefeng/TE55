AUTOSAR XML (schema 00047)
package /ETAS_Project/EcucModuleConfigurationValuess
  module config Xcp: implementation-config-variant=VARIANT-PRE-COMPILE
    XcpConfig
      Can_Network_XCP_Channel (XcpTransportLayer):
        XcpMaxDto = 8
        XcpTransportLayerType = CAN
        XcpTransportLayerName = Transport
        XcpMaxCto = 8
        XcpDaqOverloadIndication = OVERLOAD_INDICATION_PID
        XcpIdentificationFieldType = ABSOLUTE
        XcpTimestampType = TWO_BYTE
        XCP_RX_Broadcast (XcpRxPdu): XcpRxPacketType=STIM, XcpRxPduRef=XcpPdu_CanIf2Xcp_CanNodeNum_00_Rx_Broadcast
        XCP_RX_CMD (XcpRxPdu): XcpRxPacketType=CMD, XcpRxPduRef=XcpPdu_CanIf2Xcp_CanNodeNum_00_Rx_Cmd
        4 x XcpTxPdu:
          XCP_TX_DAQ0: XcpTxPacketType=DAQ, XcpTxPduRef=XcpPdu_Xcp2CanIf_CanNodeNum_00_Tx_Daq0, XcpEventChannelRef=Event_10ms_Raster
          XCP_TX_DAQ1: XcpTxPacketType=DAQ, XcpTxPduRef=XcpPdu_Xcp2CanIf_CanNodeNum_00_Tx_Daq1, XcpEventChannelRef=Event_50ms_Raster
          XCP_TX_DAQ2: XcpTxPacketType=DAQ, XcpTxPduRef=XcpPdu_Xcp2CanIf_CanNodeNum_00_Tx_Daq2, XcpEventChannelRef=Event_100ms_Raster
          XCP_TX_RES: XcpTxPacketType=RES_ERR_EV_SERV, XcpTxPduRef=XcpPdu_Xcp2CanIf_CanNodeNum_00_Tx_Res
    XcpGeneral: XcpVersion=VERSION_1_2, XcpVersionInfoApi=false, XcpCmdReceivedNotification=true
