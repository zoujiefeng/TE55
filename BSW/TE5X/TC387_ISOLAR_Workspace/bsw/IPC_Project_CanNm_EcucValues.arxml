AUTOSAR XML (schema 00047)
package /ETAS_Project/EcucModuleConfigurationValuess
  module config CanNm: implementation-config-variant=VARIANT-PRE-COMPILE
    CanNmGlobalConfig:
      CanNmVersionInfoApi = false
      CanNmCoordinatorSyncSupport = false
      CanNmBusLoadReductionEnabled = false
      CanNmMainFunctionPeriod = 0.001
      CanNmRemoteSleepIndEnabled = false
      CanNmDevErrorDetect = true
      CanNmImmediateTxconfEnabled = false
      CanNmBusSynchronizationEnabled = false
      CanNmImmediateRestartEnabled = false
      CanNmPassiveModeEnabled = false
      CanNmComUserDataSupport = false
      CanNmComControlEnabled = true
      CanNmRepeatMsgIndEnabled = true
      CanNmStateChangeIndEnabled = true
      CanNmUserDataEnabled = true
      CanNmNodeDetectionEnabled = true
      CanNmNodeIdEnabled = true
      CanNmPduRxIndicationEnabled = true
      CanNmCC_CanNmCluster_0_1 (CanNmChannelConfig):
        CanNmBusLoadReductionActive = false
        CanNmImmediateNmTransmissions = 10
        CanNmImmediateNmCycleTime = 0.02
        CanNmRetryFirstMessageRequest = false
        CanNmCarWakeUpRxEnabled = false
        CanNmPnEnabled = false
        CanNmRemoteSleepIndTime = 0.01
        CanNmWaitBusSleepTime = 2.0
        CanNmMsgCycleOffset = 0.0
        CanNmRepeatMessageTime = 1.5
        CanNmTimeoutTime = 2.0
        CanNmMsgReducedTime = 0.2
        CanNmMsgTimeoutTime = 2.0
        CanNmNodeId = 154
        CanNmPduCbvPosition = CANNM_PDU_BYTE_1
        CanNmPduNidPosition = CANNM_PDU_BYTE_0
        CanNmMsgCycleTime = 0.5
        CanNmActiveWakeupBitEnabled = true
        CanNmAllNmMessagesKeepAwake = true
        CanNmComMNetworkHandleRef = Can_Network_CanNodeNum_01
        CanNmPdu_CanNodeNum_01_RIPC (CanNmRxPdu): CanNmRxPduRef=CanNmPdu_CanIf2CanNm_CanNodeNum_01_RIPC
        CanNmPdu_CanNodeNum_01_IPC (CanNmTxPdu): CanNmTxPduRef=CanNmPdu_CanNm2CanIf_CanNodeNum_01_IPC
        CanNmPdu_CanNodeNum_01_IPC_UserData (CanNmUserDataTxPdu): CanNmTxUserDataPduRef=CanNmPdu_PduR2CanNm_CanNodeNum_01_IPC_UserData
