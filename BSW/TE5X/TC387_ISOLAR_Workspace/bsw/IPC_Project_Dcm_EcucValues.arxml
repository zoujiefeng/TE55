AUTOSAR XML (schema 00047)
package /ETAS_Project/EcucModuleConfigurationValuess
  module config Dcm: implementation-config-variant=VARIANT-PRE-COMPILE
    DcmConfigSet
      DcmDsp:
        DcmRbDspLimitRDBIRespToBufSize = 0
        DcmRbDspRdbiPagedBufferEnabled = 0
        DcmRbDspRmbaPagedBufferEnabled = false
        DcmRbDspRdtcPagedBufferEnabled = 0
        DcmRbDspSequenceCheckRequestDownloadDisabled = 0
        DcmRbDspSequenceCheckRequestUploadDisabled = 0
        DcmRbDspSesSecUsedInProtocol = UDS
        DcmRbDspTransferDataMaxLenChkRequired = 1
        DcmRbDspAutoConfigureDEMOBDPIDs = 0
        DcmDspSecurity: DcmRbDspSecurityDelayTimerMonitor=REQUEST_SEED, DcmRbDspSecurityNRCExceedNoOfAttempt=NumAttDelayAndNumAttLock, DcmRbDspSecurityStoreSeed=false
