AUTOSAR XML (schema 00047)
package /ETAS_Project/EcucModuleConfigurationValuess
  module config CanTp: implementation-config-variant=VARIANT-PRE-COMPILE
    CanTpConfig
    CanTpGeneral
