AUTOSAR XML (schema 00047)
package /ETAS_Project/EcucModuleConfigurationValuess
  module config Fee: implementation-config-variant=VARIANT-PRE-COMPILE
    FeeGeneral:
      FeeRbFsSelect = FS1
      FeeVirtualPageSize = 8
      FeeSetModeSupported = false
      FeeDevErrorDetect = true
      FeeRbMachineType = MCU_RB_MANUAL_CFG
      FeeNvmJobEndNotification = Fee_NvmJobEndNotification
      FeeNvmJobErrorNotification = Fee_NvmJobErrorNotification
      FeeVersionInfoApi = false
      FeePollingMode = true
      FeeIndex = 0
      FeeRbConfirmSingleStorageBlockloss = true
      FeeRbSectorTable: FlsRbErasedValue=0x0, FeeRbHeaderRecheckActive=false, FeeRbFastCacheInitActive=true, FlsRbPageSize=8
        FeeRbSector_0 (FeeRbSector): FlsRbSectorSize=65536
        FeeRbSector_1 (FeeRbSector): FlsRbSectorSize=65536
    FeePublishedInformation
