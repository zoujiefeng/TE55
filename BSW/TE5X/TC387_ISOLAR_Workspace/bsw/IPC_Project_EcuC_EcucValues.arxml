AUTOSAR XML (schema 00047)
package /ETAS_Project/EcucModuleConfigurationValuess
  module config EcuC: implementation-config-variant=VARIANT-PRE-COMPILE
    EcucConfigSet
      EcucPduCollection: PduIdTypeEnum=uint16, PduLengthTypeEnum=uint16
        567 x Pdu, all with PduLength=8:
          XcpPdu_CanIf2Xcp_CanNodeNum_00_Rx_Broadcast
          XcpPdu_CanIf2Xcp_CanNodeNum_00_Rx_Cmd
          XcpPdu_Xcp2CanIf_CanNodeNum_00_Tx_Daq{0..2}
          XcpPdu_Xcp2CanIf_CanNodeNum_00_Tx_Res
          CcpPdu_CanIf2Cdd_CanNodeNum_00_Rx_Cro
          CcpPdu_Cdd2CanIf_CanNodeNum_00_Tx_Daq{0..2}
          CcpPdu_Cdd2CanIf_CanNodeNum_00_Tx_Dto
          CanNmPdu_CanIf2CanNm_CanNodeNum_01_RIPC
          CanNmPdu_PduR2CanNm_CanNodeNum_01_IPC_UserData
          CanNmPdu_CanNm2CanIf_CanNodeNum_01_IPC
          DcmPdu_CanIf2CanTp_CanNodeNum_01_FunRequest
          DcmPdu_CanTp2PduR_CanNodeNum_01_FunRequest
          DcmPdu_PduR2Dcm_CanNodeNum_01_FunRequest
          DcmPdu_CanIf2CanTp_CanNodeNum_01_PhyRequest
          DcmPdu_CanTp2PduR_CanNodeNum_01_PhyRequest
          DcmPdu_PduR2Dcm_CanNodeNum_01_PhyRequest
          DcmPdu_Dcm2PduR_CanNodeNum_01_PhyResponse
          DcmPdu_PduR2CanTp_CanNodeNum_01_PhyResponse
          DcmPdu_CanTp2CanIf_CanNodeNum_01_PhyResponse
          CanPdu_CanIf2PduR_CanNodeNum_01_Rx_01
          CanPdu_PduR2Com_CanNodeNum_01_Rx_01
          CanPdu_CanIf2PduR_CanNodeNum_01_Rx_02
          CanPdu_PduR2Com_CanNodeNum_01_Rx_02
          CanPdu_CanIf2PduR_CanNodeNum_01_Rx_03
          CanPdu_PduR2Com_CanNodeNum_01_Rx_03
          CanPdu_CanIf2PduR_CanNodeNum_01_Rx_04
          CanPdu_PduR2Com_CanNodeNum_01_Rx_04
          CanPdu_CanIf2PduR_CanNodeNum_01_Rx_05
          CanPdu_PduR2Com_CanNodeNum_01_Rx_05
          CanPdu_CanIf2PduR_CanNodeNum_01_Rx_06
          CanPdu_PduR2Com_CanNodeNum_01_Rx_06
          CanPdu_CanIf2PduR_CanNodeNum_01_Rx_07
          CanPdu_PduR2Com_CanNodeNum_01_Rx_07
          CanPdu_CanIf2PduR_CanNodeNum_01_Rx_08
          CanPdu_PduR2Com_CanNodeNum_01_Rx_08
          CanPdu_CanIf2PduR_CanNodeNum_01_Rx_09
          CanPdu_PduR2Com_CanNodeNum_01_Rx_09
          CanPdu_CanIf2PduR_CanNodeNum_01_Rx_10
          CanPdu_PduR2Com_CanNodeNum_01_Rx_10
          CanPdu_CanIf2PduR_CanNodeNum_01_Rx_11
          CanPdu_PduR2Com_CanNodeNum_01_Rx_11
          CanPdu_CanIf2PduR_CanNodeNum_01_Rx_12
          CanPdu_PduR2Com_CanNodeNum_01_Rx_12
          CanPdu_CanIf2PduR_CanNodeNum_01_Rx_13
          CanPdu_PduR2Com_CanNodeNum_01_Rx_13
          CanPdu_CanIf2PduR_CanNodeNum_01_Rx_14
          CanPdu_PduR2Com_CanNodeNum_01_Rx_14
          CanPdu_CanIf2PduR_CanNodeNum_01_Rx_15
          CanPdu_PduR2Com_CanNodeNum_01_Rx_15
          CanPdu_CanIf2PduR_CanNodeNum_01_Rx_16
          CanPdu_PduR2Com_CanNodeNum_01_Rx_16
          CanPdu_CanIf2PduR_CanNodeNum_01_Rx_17
          CanPdu_PduR2Com_CanNodeNum_01_Rx_17
          CanPdu_CanIf2PduR_CanNodeNum_01_Rx_18
          CanPdu_PduR2Com_CanNodeNum_01_Rx_18
          CanPdu_CanIf2PduR_CanNodeNum_01_Rx_19
          CanPdu_PduR2Com_CanNodeNum_01_Rx_19
          CanPdu_CanIf2PduR_CanNodeNum_01_Rx_20
          CanPdu_PduR2Com_CanNodeNum_01_Rx_20
          CanPdu_CanIf2PduR_CanNodeNum_01_Rx_21
          CanPdu_PduR2Com_CanNodeNum_01_Rx_21
          CanPdu_CanIf2PduR_CanNodeNum_01_Rx_22
          CanPdu_PduR2Com_CanNodeNum_01_Rx_22
          CanPdu_CanIf2PduR_CanNodeNum_01_Rx_23
          CanPdu_PduR2Com_CanNodeNum_01_Rx_23
          CanPdu_CanIf2PduR_CanNodeNum_01_Rx_24
          CanPdu_PduR2Com_CanNodeNum_01_Rx_24
          CanPdu_CanIf2PduR_CanNodeNum_01_Rx_25
          CanPdu_PduR2Com_CanNodeNum_01_Rx_25
          CanPdu_CanIf2PduR_CanNodeNum_01_Rx_26
          CanPdu_PduR2Com_CanNodeNum_01_Rx_26
          CanPdu_CanIf2PduR_CanNodeNum_01_Rx_27
          CanPdu_PduR2Com_CanNodeNum_01_Rx_27
          CanPdu_CanIf2PduR_CanNodeNum_01_Rx_28
          CanPdu_PduR2Com_CanNodeNum_01_Rx_28
          CanPdu_CanIf2PduR_CanNodeNum_01_Rx_29
          CanPdu_PduR2Com_CanNodeNum_01_Rx_29
          CanPdu_CanIf2PduR_CanNodeNum_01_Rx_30
          CanPdu_PduR2Com_CanNodeNum_01_Rx_30
          CanPdu_CanIf2PduR_CanNodeNum_01_Rx_31
          CanPdu_PduR2Com_CanNodeNum_01_Rx_31
          CanPdu_CanIf2PduR_CanNodeNum_01_Rx_32
          CanPdu_PduR2Com_CanNodeNum_01_Rx_32
          CanPdu_CanIf2PduR_CanNodeNum_01_Rx_33
          CanPdu_PduR2Com_CanNodeNum_01_Rx_33
          CanPdu_CanIf2PduR_CanNodeNum_01_Rx_34
          CanPdu_PduR2Com_CanNodeNum_01_Rx_34
          CanPdu_CanIf2PduR_CanNodeNum_01_Rx_35
          CanPdu_PduR2Com_CanNodeNum_01_Rx_35
          CanPdu_CanIf2PduR_CanNodeNum_01_Rx_36
          CanPdu_PduR2Com_CanNodeNum_01_Rx_36
          CanPdu_CanIf2PduR_CanNodeNum_01_Rx_37
          CanPdu_PduR2Com_CanNodeNum_01_Rx_37
          CanPdu_CanIf2PduR_CanNodeNum_01_Rx_38
          CanPdu_PduR2Com_CanNodeNum_01_Rx_38
          CanPdu_CanIf2PduR_CanNodeNum_01_Rx_39
          CanPdu_PduR2Com_CanNodeNum_01_Rx_39
          CanPdu_CanIf2PduR_CanNodeNum_01_Rx_40
          CanPdu_PduR2Com_CanNodeNum_01_Rx_40
          CanPdu_Com2PduR_CanNodeNum_01_TxBasic_01
          CanPdu_PduR2CanIf_CanNodeNum_01_TxBasic_01
          CanPdu_Com2PduR_CanNodeNum_01_TxBasic_02
          CanPdu_PduR2CanIf_CanNodeNum_01_TxBasic_02
          CanPdu_Com2PduR_CanNodeNum_01_TxBasic_03
          CanPdu_PduR2CanIf_CanNodeNum_01_TxBasic_03
          CanPdu_Com2PduR_CanNodeNum_01_TxBasic_04
          CanPdu_PduR2CanIf_CanNodeNum_01_TxBasic_04
          CanPdu_Com2PduR_CanNodeNum_01_TxBasic_05
          CanPdu_PduR2CanIf_CanNodeNum_01_TxBasic_05
          CanPdu_Com2PduR_CanNodeNum_01_TxBasic_06
          CanPdu_PduR2CanIf_CanNodeNum_01_TxBasic_06
          CanPdu_Com2PduR_CanNodeNum_01_TxBasic_07
          CanPdu_PduR2CanIf_CanNodeNum_01_TxBasic_07
          CanPdu_Com2PduR_CanNodeNum_01_TxBasic_08
          CanPdu_PduR2CanIf_CanNodeNum_01_TxBasic_08
          CanPdu_Com2PduR_CanNodeNum_01_TxBasic_09
          CanPdu_PduR2CanIf_CanNodeNum_01_TxBasic_09
          CanPdu_Com2PduR_CanNodeNum_01_TxBasic_10
          CanPdu_PduR2CanIf_CanNodeNum_01_TxBasic_10
          CanPdu_Com2PduR_CanNodeNum_01_TxBasic_11
          CanPdu_PduR2CanIf_CanNodeNum_01_TxBasic_11
          CanPdu_Com2PduR_CanNodeNum_01_TxBasic_12
          CanPdu_PduR2CanIf_CanNodeNum_01_TxBasic_12
          CanPdu_Com2PduR_CanNodeNum_01_TxBasic_13
          CanPdu_PduR2CanIf_CanNodeNum_01_TxBasic_13
          CanPdu_Com2PduR_CanNodeNum_01_TxBasic_14
          CanPdu_PduR2CanIf_CanNodeNum_01_TxBasic_14
          CanPdu_Com2PduR_CanNodeNum_01_TxBasic_15
          CanPdu_PduR2CanIf_CanNodeNum_01_TxBasic_15
          CanPdu_Com2PduR_CanNodeNum_01_TxBasic_16
          CanPdu_PduR2CanIf_CanNodeNum_01_TxBasic_16
          CanPdu_Com2PduR_CanNodeNum_01_TxBasic_17
          CanPdu_PduR2CanIf_CanNodeNum_01_TxBasic_17
          CanPdu_Com2PduR_CanNodeNum_01_TxBasic_18
          CanPdu_PduR2CanIf_CanNodeNum_01_TxBasic_18
          CanPdu_Com2PduR_CanNodeNum_01_TxBasic_19
          CanPdu_PduR2CanIf_CanNodeNum_01_TxBasic_19
          CanPdu_Com2PduR_CanNodeNum_01_TxBasic_20
          CanPdu_PduR2CanIf_CanNodeNum_01_TxBasic_20
          CanPdu_Com2PduR_CanNodeNum_01_Tx_01
          CanPdu_PduR2CanIf_CanNodeNum_01_Tx_01
          CanPdu_Com2PduR_CanNodeNum_01_Tx_02
          CanPdu_PduR2CanIf_CanNodeNum_01_Tx_02
          CanPdu_Com2PduR_CanNodeNum_01_Tx_03
          CanPdu_PduR2CanIf_CanNodeNum_01_Tx_03
          CanPdu_Com2PduR_CanNodeNum_01_Tx_04
          CanPdu_PduR2CanIf_CanNodeNum_01_Tx_04
          CanPdu_Com2PduR_CanNodeNum_01_Tx_05
          CanPdu_PduR2CanIf_CanNodeNum_01_Tx_05
          CanPdu_Com2PduR_CanNodeNum_01_Tx_06
          CanPdu_PduR2CanIf_CanNodeNum_01_Tx_06
          CanPdu_Com2PduR_CanNodeNum_01_Tx_07
          CanPdu_PduR2CanIf_CanNodeNum_01_Tx_07
          CanPdu_Com2PduR_CanNodeNum_01_Tx_08
          CanPdu_PduR2CanIf_CanNodeNum_01_Tx_08
          CanPdu_Com2PduR_CanNodeNum_01_Tx_09
          CanPdu_PduR2CanIf_CanNodeNum_01_Tx_09
          CanPdu_Com2PduR_CanNodeNum_01_Tx_10
          CanPdu_PduR2CanIf_CanNodeNum_01_Tx_10
          CanPdu_Com2PduR_CanNodeNum_01_Tx_11
          CanPdu_PduR2CanIf_CanNodeNum_01_Tx_11
          CanPdu_Com2PduR_CanNodeNum_01_Tx_12
          CanPdu_PduR2CanIf_CanNodeNum_01_Tx_12
          CanPdu_Com2PduR_CanNodeNum_01_Tx_13
          CanPdu_PduR2CanIf_CanNodeNum_01_Tx_13
          CanPdu_Com2PduR_CanNodeNum_01_Tx_14
          CanPdu_PduR2CanIf_CanNodeNum_01_Tx_14
          CanPdu_Com2PduR_CanNodeNum_01_Tx_15
          CanPdu_PduR2CanIf_CanNodeNum_01_Tx_15
          CanPdu_Com2PduR_CanNodeNum_01_Tx_16
          CanPdu_PduR2CanIf_CanNodeNum_01_Tx_16
          CanPdu_Com2PduR_CanNodeNum_01_Tx_17
          CanPdu_PduR2CanIf_CanNodeNum_01_Tx_17
          CanPdu_Com2PduR_CanNodeNum_01_Tx_18
          CanPdu_PduR2CanIf_CanNodeNum_01_Tx_18
          CanPdu_Com2PduR_CanNodeNum_01_Tx_19
          CanPdu_PduR2CanIf_CanNodeNum_01_Tx_19
          CanPdu_Com2PduR_CanNodeNum_01_Tx_20
          CanPdu_PduR2CanIf_CanNodeNum_01_Tx_20
          CanPdu_Com2PduR_CanNodeNum_01_Tx_21
          CanPdu_PduR2CanIf_CanNodeNum_01_Tx_21
          CanPdu_Com2PduR_CanNodeNum_01_Tx_22
          CanPdu_PduR2CanIf_CanNodeNum_01_Tx_22
          CanPdu_Com2PduR_CanNodeNum_01_Tx_23
          CanPdu_PduR2CanIf_CanNodeNum_01_Tx_23
          CanPdu_Com2PduR_CanNodeNum_01_Tx_24
          CanPdu_PduR2CanIf_CanNodeNum_01_Tx_24
          CanPdu_Com2PduR_CanNodeNum_01_Tx_25
          CanPdu_PduR2CanIf_CanNodeNum_01_Tx_25
          CanPdu_Com2PduR_CanNodeNum_01_Tx_25_00
          CanPdu_PduR2CanIf_CanNodeNum_01_Tx_25_00
          CanPdu_Com2PduR_CanNodeNum_01_Tx_25_01
          CanPdu_PduR2CanIf_CanNodeNum_01_Tx_25_01
          CanPdu_Com2PduR_CanNodeNum_01_Tx_26
          CanPdu_PduR2CanIf_CanNodeNum_01_Tx_26
          ReservePdu_CanNodeNum_02_A
          ReservePdu_CanNodeNum_02_B
          ReservePdu_CanNodeNum_02_C
          ReservePdu_CanNodeNum_02_D
          ReservePdu_CanNodeNum_02_E
          ReservePdu_CanNodeNum_02_F
          ReservePdu_CanNodeNum_02_G
          ReservePdu_CanNodeNum_02_H
          ReservePdu_CanNodeNum_02_I
          ReservePdu_CanNodeNum_02_J
          ReservePdu_CanNodeNum_02_K
          ReservePdu_CanNodeNum_02_L
          CanPdu_CanIf2PduR_CanNodeNum_02_Rx_01
          CanPdu_PduR2Com_CanNodeNum_02_Rx_01
          CanPdu_CanIf2PduR_CanNodeNum_02_Rx_02
          CanPdu_PduR2Com_CanNodeNum_02_Rx_02
          CanPdu_CanIf2PduR_CanNodeNum_02_Rx_03
          CanPdu_PduR2Com_CanNodeNum_02_Rx_03
          CanPdu_CanIf2PduR_CanNodeNum_02_Rx_04
          CanPdu_PduR2Com_CanNodeNum_02_Rx_04
          CanPdu_CanIf2PduR_CanNodeNum_02_Rx_05
          CanPdu_PduR2Com_CanNodeNum_02_Rx_05
          CanPdu_CanIf2PduR_CanNodeNum_02_Rx_06
          CanPdu_PduR2Com_CanNodeNum_02_Rx_06
          CanPdu_CanIf2PduR_CanNodeNum_02_Rx_07
          CanPdu_PduR2Com_CanNodeNum_02_Rx_07
          CanPdu_CanIf2PduR_CanNodeNum_02_Rx_08
          CanPdu_PduR2Com_CanNodeNum_02_Rx_08
          CanPdu_CanIf2PduR_CanNodeNum_02_Rx_09
          CanPdu_PduR2Com_CanNodeNum_02_Rx_09
          CanPdu_CanIf2PduR_CanNodeNum_02_Rx_10
          CanPdu_PduR2Com_CanNodeNum_02_Rx_10
          CanPdu_CanIf2PduR_CanNodeNum_02_Rx_11
          CanPdu_PduR2Com_CanNodeNum_02_Rx_11
          CanPdu_CanIf2PduR_CanNodeNum_02_Rx_12
          CanPdu_PduR2Com_CanNodeNum_02_Rx_12
          CanPdu_CanIf2PduR_CanNodeNum_02_Rx_13
          CanPdu_PduR2Com_CanNodeNum_02_Rx_13
          CanPdu_CanIf2PduR_CanNodeNum_02_Rx_14
          CanPdu_PduR2Com_CanNodeNum_02_Rx_14
          CanPdu_CanIf2PduR_CanNodeNum_02_Rx_15
          CanPdu_PduR2Com_CanNodeNum_02_Rx_15
          CanPdu_CanIf2PduR_CanNodeNum_02_Rx_16
          CanPdu_PduR2Com_CanNodeNum_02_Rx_16
          CanPdu_CanIf2PduR_CanNodeNum_02_Rx_17
          CanPdu_PduR2Com_CanNodeNum_02_Rx_17
          CanPdu_CanIf2PduR_CanNodeNum_02_Rx_18
          CanPdu_PduR2Com_CanNodeNum_02_Rx_18
          CanPdu_CanIf2PduR_CanNodeNum_02_Rx_19
          CanPdu_PduR2Com_CanNodeNum_02_Rx_19
          CanPdu_CanIf2PduR_CanNodeNum_02_Rx_20
          CanPdu_PduR2Com_CanNodeNum_02_Rx_20
          CanPdu_CanIf2PduR_CanNodeNum_02_Rx_21
          CanPdu_PduR2Com_CanNodeNum_02_Rx_21
          CanPdu_CanIf2PduR_CanNodeNum_02_Rx_22
          CanPdu_PduR2Com_CanNodeNum_02_Rx_22
          CanPdu_CanIf2PduR_CanNodeNum_02_Rx_23
          CanPdu_PduR2Com_CanNodeNum_02_Rx_23
          CanPdu_CanIf2PduR_CanNodeNum_02_Rx_24
          CanPdu_PduR2Com_CanNodeNum_02_Rx_24
          CanPdu_CanIf2PduR_CanNodeNum_02_Rx_25
          CanPdu_PduR2Com_CanNodeNum_02_Rx_25
          CanPdu_CanIf2PduR_CanNodeNum_02_Rx_26
          CanPdu_PduR2Com_CanNodeNum_02_Rx_26
          CanPdu_CanIf2PduR_CanNodeNum_02_Rx_27
          CanPdu_PduR2Com_CanNodeNum_02_Rx_27
          CanPdu_CanIf2PduR_CanNodeNum_02_Rx_28
          CanPdu_PduR2Com_CanNodeNum_02_Rx_28
          CanPdu_CanIf2PduR_CanNodeNum_02_Rx_29
          CanPdu_PduR2Com_CanNodeNum_02_Rx_29
          CanPdu_CanIf2PduR_CanNodeNum_02_Rx_30
          CanPdu_PduR2Com_CanNodeNum_02_Rx_30
          CanPdu_CanIf2PduR_CanNodeNum_02_Rx_31
          CanPdu_PduR2Com_CanNodeNum_02_Rx_31
          CanPdu_CanIf2PduR_CanNodeNum_02_Rx_32
          CanPdu_PduR2Com_CanNodeNum_02_Rx_32
          CanPdu_CanIf2PduR_CanNodeNum_02_Rx_33
          CanPdu_PduR2Com_CanNodeNum_02_Rx_33
          CanPdu_CanIf2PduR_CanNodeNum_02_Rx_34
          CanPdu_PduR2Com_CanNodeNum_02_Rx_34
          CanPdu_CanIf2PduR_CanNodeNum_02_Rx_35
          CanPdu_PduR2Com_CanNodeNum_02_Rx_35
          CanPdu_CanIf2PduR_CanNodeNum_02_Rx_36
          CanPdu_PduR2Com_CanNodeNum_02_Rx_36
          CanPdu_CanIf2PduR_CanNodeNum_02_Rx_37
          CanPdu_PduR2Com_CanNodeNum_02_Rx_37
          CanPdu_CanIf2PduR_CanNodeNum_02_Rx_38
          CanPdu_PduR2Com_CanNodeNum_02_Rx_38
          CanPdu_CanIf2PduR_CanNodeNum_02_Rx_39
          CanPdu_PduR2Com_CanNodeNum_02_Rx_39
          CanPdu_CanIf2PduR_CanNodeNum_02_Rx_40
          CanPdu_PduR2Com_CanNodeNum_02_Rx_40
          CanPdu_Com2PduR_CanNodeNum_02_TxBasic_01
          CanPdu_PduR2CanIf_CanNodeNum_02_TxBasic_01
          CanPdu_Com2PduR_CanNodeNum_02_TxBasic_02
          CanPdu_PduR2CanIf_CanNodeNum_02_TxBasic_02
          CanPdu_Com2PduR_CanNodeNum_02_TxBasic_03
          CanPdu_PduR2CanIf_CanNodeNum_02_TxBasic_03
          CanPdu_Com2PduR_CanNodeNum_02_TxBasic_04
          CanPdu_PduR2CanIf_CanNodeNum_02_TxBasic_04
          CanPdu_Com2PduR_CanNodeNum_02_TxBasic_05
          CanPdu_PduR2CanIf_CanNodeNum_02_TxBasic_05
          CanPdu_Com2PduR_CanNodeNum_02_TxBasic_06
          CanPdu_PduR2CanIf_CanNodeNum_02_TxBasic_06
          CanPdu_Com2PduR_CanNodeNum_02_TxBasic_07
          CanPdu_PduR2CanIf_CanNodeNum_02_TxBasic_07
          CanPdu_Com2PduR_CanNodeNum_02_TxBasic_08
          CanPdu_PduR2CanIf_CanNodeNum_02_TxBasic_08
          CanPdu_Com2PduR_CanNodeNum_02_TxBasic_09
          CanPdu_PduR2CanIf_CanNodeNum_02_TxBasic_09
          CanPdu_Com2PduR_CanNodeNum_02_TxBasic_10
          CanPdu_PduR2CanIf_CanNodeNum_02_TxBasic_10
          CanPdu_Com2PduR_CanNodeNum_02_TxBasic_11
          CanPdu_PduR2CanIf_CanNodeNum_02_TxBasic_11
          CanPdu_Com2PduR_CanNodeNum_02_TxBasic_12
          CanPdu_PduR2CanIf_CanNodeNum_02_TxBasic_12
          CanPdu_Com2PduR_CanNodeNum_02_TxBasic_13
          CanPdu_PduR2CanIf_CanNodeNum_02_TxBasic_13
          CanPdu_Com2PduR_CanNodeNum_02_TxBasic_14
          CanPdu_PduR2CanIf_CanNodeNum_02_TxBasic_14
          CanPdu_Com2PduR_CanNodeNum_02_TxBasic_15
          CanPdu_PduR2CanIf_CanNodeNum_02_TxBasic_15
          CanPdu_Com2PduR_CanNodeNum_02_TxBasic_16
          CanPdu_PduR2CanIf_CanNodeNum_02_TxBasic_16
          CanPdu_Com2PduR_CanNodeNum_02_TxBasic_17
          CanPdu_PduR2CanIf_CanNodeNum_02_TxBasic_17
          CanPdu_Com2PduR_CanNodeNum_02_TxBasic_18
          CanPdu_PduR2CanIf_CanNodeNum_02_TxBasic_18
          CanPdu_Com2PduR_CanNodeNum_02_TxBasic_19
          CanPdu_PduR2CanIf_CanNodeNum_02_TxBasic_19
          CanPdu_Com2PduR_CanNodeNum_02_TxBasic_20
          CanPdu_PduR2CanIf_CanNodeNum_02_TxBasic_20
          CanPdu_Com2PduR_CanNodeNum_02_Tx_01
          CanPdu_PduR2CanIf_CanNodeNum_02_Tx_01
          CanPdu_Com2PduR_CanNodeNum_02_Tx_02
          CanPdu_PduR2CanIf_CanNodeNum_02_Tx_02
          CanPdu_Com2PduR_CanNodeNum_02_Tx_03
          CanPdu_PduR2CanIf_CanNodeNum_02_Tx_03
          CanPdu_Com2PduR_CanNodeNum_02_Tx_04
          CanPdu_PduR2CanIf_CanNodeNum_02_Tx_04
          CanPdu_Com2PduR_CanNodeNum_02_Tx_05
          CanPdu_PduR2CanIf_CanNodeNum_02_Tx_05
          CanPdu_Com2PduR_CanNodeNum_02_Tx_06
          CanPdu_PduR2CanIf_CanNodeNum_02_Tx_06
          CanPdu_Com2PduR_CanNodeNum_02_Tx_07
          CanPdu_PduR2CanIf_CanNodeNum_02_Tx_07
          CanPdu_Com2PduR_CanNodeNum_02_Tx_08
          CanPdu_PduR2CanIf_CanNodeNum_02_Tx_08
          CanPdu_Com2PduR_CanNodeNum_02_Tx_09
          CanPdu_PduR2CanIf_CanNodeNum_02_Tx_09
          CanPdu_Com2PduR_CanNodeNum_02_Tx_10
          CanPdu_PduR2CanIf_CanNodeNum_02_Tx_10
          CanPdu_Com2PduR_CanNodeNum_02_Tx_11
          CanPdu_PduR2CanIf_CanNodeNum_02_Tx_11
          CanPdu_Com2PduR_CanNodeNum_02_Tx_12
          CanPdu_PduR2CanIf_CanNodeNum_02_Tx_12
          CanPdu_Com2PduR_CanNodeNum_02_Tx_13
          CanPdu_PduR2CanIf_CanNodeNum_02_Tx_13
          CanPdu_Com2PduR_CanNodeNum_02_Tx_14
          CanPdu_PduR2CanIf_CanNodeNum_02_Tx_14
          CanPdu_Com2PduR_CanNodeNum_02_Tx_15
          CanPdu_PduR2CanIf_CanNodeNum_02_Tx_15
          CanPdu_Com2PduR_CanNodeNum_02_Tx_16
          CanPdu_PduR2CanIf_CanNodeNum_02_Tx_16
          CanPdu_Com2PduR_CanNodeNum_02_Tx_17
          CanPdu_PduR2CanIf_CanNodeNum_02_Tx_17
          CanPdu_Com2PduR_CanNodeNum_02_Tx_18
          CanPdu_PduR2CanIf_CanNodeNum_02_Tx_18
          CanPdu_Com2PduR_CanNodeNum_02_Tx_19
          CanPdu_PduR2CanIf_CanNodeNum_02_Tx_19
          CanPdu_Com2PduR_CanNodeNum_02_Tx_20
          CanPdu_PduR2CanIf_CanNodeNum_02_Tx_20
          CanPdu_Com2PduR_CanNodeNum_02_Tx_21
          CanPdu_PduR2CanIf_CanNodeNum_02_Tx_21
          CanPdu_Com2PduR_CanNodeNum_02_Tx_22
          CanPdu_PduR2CanIf_CanNodeNum_02_Tx_22
          CanPdu_Com2PduR_CanNodeNum_02_Tx_23
          CanPdu_PduR2CanIf_CanNodeNum_02_Tx_23
          CanPdu_Com2PduR_CanNodeNum_02_Tx_24
          CanPdu_PduR2CanIf_CanNodeNum_02_Tx_24
          CanPdu_Com2PduR_CanNodeNum_02_Tx_25
          CanPdu_PduR2CanIf_CanNodeNum_02_Tx_25
          CanPdu_Com2PduR_CanNodeNum_02_Tx_26
          CanPdu_PduR2CanIf_CanNodeNum_02_Tx_26
          ReservePdu_CanNodeNum_03_A
          ReservePdu_CanNodeNum_03_B
          ReservePdu_CanNodeNum_03_C
          ReservePdu_CanNodeNum_03_D
          ReservePdu_CanNodeNum_03_E
          ReservePdu_CanNodeNum_03_F
          ReservePdu_CanNodeNum_03_G
          ReservePdu_CanNodeNum_03_H
          ReservePdu_CanNodeNum_03_I
          ReservePdu_CanNodeNum_03_J
          ReservePdu_CanNodeNum_03_K
          ReservePdu_CanNodeNum_03_L
          CanPdu_CanIf2PduR_CanNodeNum_03_Rx_01
          CanPdu_PduR2Com_CanNodeNum_03_Rx_01
          CanPdu_CanIf2PduR_CanNodeNum_03_Rx_02
          CanPdu_PduR2Com_CanNodeNum_03_Rx_02
          CanPdu_CanIf2PduR_CanNodeNum_03_Rx_03
          CanPdu_PduR2Com_CanNodeNum_03_Rx_03
          CanPdu_CanIf2PduR_CanNodeNum_03_Rx_04
          CanPdu_PduR2Com_CanNodeNum_03_Rx_04
          CanPdu_CanIf2PduR_CanNodeNum_03_Rx_05
          CanPdu_PduR2Com_CanNodeNum_03_Rx_05
          CanPdu_CanIf2PduR_CanNodeNum_03_Rx_06
          CanPdu_PduR2Com_CanNodeNum_03_Rx_06
          CanPdu_CanIf2PduR_CanNodeNum_03_Rx_07
          CanPdu_PduR2Com_CanNodeNum_03_Rx_07
          CanPdu_CanIf2PduR_CanNodeNum_03_Rx_08
          CanPdu_PduR2Com_CanNodeNum_03_Rx_08
          CanPdu_CanIf2PduR_CanNodeNum_03_Rx_09
          CanPdu_PduR2Com_CanNodeNum_03_Rx_09
          CanPdu_CanIf2PduR_CanNodeNum_03_Rx_10
          CanPdu_PduR2Com_CanNodeNum_03_Rx_10
          CanPdu_CanIf2PduR_CanNodeNum_03_Rx_11
          CanPdu_PduR2Com_CanNodeNum_03_Rx_11
          CanPdu_CanIf2PduR_CanNodeNum_03_Rx_12
          CanPdu_PduR2Com_CanNodeNum_03_Rx_12
          CanPdu_CanIf2PduR_CanNodeNum_03_Rx_13
          CanPdu_PduR2Com_CanNodeNum_03_Rx_13
          CanPdu_CanIf2PduR_CanNodeNum_03_Rx_14
          CanPdu_PduR2Com_CanNodeNum_03_Rx_14
          CanPdu_CanIf2PduR_CanNodeNum_03_Rx_15
          CanPdu_PduR2Com_CanNodeNum_03_Rx_15
          CanPdu_CanIf2PduR_CanNodeNum_03_Rx_16
          CanPdu_PduR2Com_CanNodeNum_03_Rx_16
          CanPdu_CanIf2PduR_CanNodeNum_03_Rx_17
          CanPdu_PduR2Com_CanNodeNum_03_Rx_17
          CanPdu_CanIf2PduR_CanNodeNum_03_Rx_18
          CanPdu_PduR2Com_CanNodeNum_03_Rx_18
          CanPdu_CanIf2PduR_CanNodeNum_03_Rx_19
          CanPdu_PduR2Com_CanNodeNum_03_Rx_19
          CanPdu_CanIf2PduR_CanNodeNum_03_Rx_20
          CanPdu_PduR2Com_CanNodeNum_03_Rx_20
          CanPdu_CanIf2PduR_CanNodeNum_03_Rx_21
          CanPdu_PduR2Com_CanNodeNum_03_Rx_21
          CanPdu_CanIf2PduR_CanNodeNum_03_Rx_22
          CanPdu_PduR2Com_CanNodeNum_03_Rx_22
          CanPdu_CanIf2PduR_CanNodeNum_03_Rx_23
          CanPdu_PduR2Com_CanNodeNum_03_Rx_23
          CanPdu_CanIf2PduR_CanNodeNum_03_Rx_24
          CanPdu_PduR2Com_CanNodeNum_03_Rx_24
          CanPdu_CanIf2PduR_CanNodeNum_03_Rx_25
          CanPdu_PduR2Com_CanNodeNum_03_Rx_25
          CanPdu_CanIf2PduR_CanNodeNum_03_Rx_26
          CanPdu_PduR2Com_CanNodeNum_03_Rx_26
          CanPdu_CanIf2PduR_CanNodeNum_03_Rx_27
          CanPdu_PduR2Com_CanNodeNum_03_Rx_27
          CanPdu_CanIf2PduR_CanNodeNum_03_Rx_28
          CanPdu_PduR2Com_CanNodeNum_03_Rx_28
          CanPdu_CanIf2PduR_CanNodeNum_03_Rx_29
          CanPdu_PduR2Com_CanNodeNum_03_Rx_29
          CanPdu_CanIf2PduR_CanNodeNum_03_Rx_30
          CanPdu_PduR2Com_CanNodeNum_03_Rx_30
          CanPdu_CanIf2PduR_CanNodeNum_03_Rx_31
          CanPdu_PduR2Com_CanNodeNum_03_Rx_31
          CanPdu_CanIf2PduR_CanNodeNum_03_Rx_32
          CanPdu_PduR2Com_CanNodeNum_03_Rx_32
          CanPdu_CanIf2PduR_CanNodeNum_03_Rx_33
          CanPdu_PduR2Com_CanNodeNum_03_Rx_33
          CanPdu_CanIf2PduR_CanNodeNum_03_Rx_34
          CanPdu_PduR2Com_CanNodeNum_03_Rx_34
          CanPdu_CanIf2PduR_CanNodeNum_03_Rx_35
          CanPdu_PduR2Com_CanNodeNum_03_Rx_35
          CanPdu_CanIf2PduR_CanNodeNum_03_Rx_36
          CanPdu_PduR2Com_CanNodeNum_03_Rx_36
          CanPdu_CanIf2PduR_CanNodeNum_03_Rx_37
          CanPdu_PduR2Com_CanNodeNum_03_Rx_37
          CanPdu_CanIf2PduR_CanNodeNum_03_Rx_38
          CanPdu_PduR2Com_CanNodeNum_03_Rx_38
          CanPdu_CanIf2PduR_CanNodeNum_03_Rx_39
          CanPdu_PduR2Com_CanNodeNum_03_Rx_39
          CanPdu_CanIf2PduR_CanNodeNum_03_Rx_40
          CanPdu_PduR2Com_CanNodeNum_03_Rx_40
          CanPdu_Com2PduR_CanNodeNum_03_TxBasic_01
          CanPdu_PduR2CanIf_CanNodeNum_03_TxBasic_01
          CanPdu_Com2PduR_CanNodeNum_03_TxBasic_02
          CanPdu_PduR2CanIf_CanNodeNum_03_TxBasic_02
          CanPdu_Com2PduR_CanNodeNum_03_TxBasic_03
          CanPdu_PduR2CanIf_CanNodeNum_03_TxBasic_03
          CanPdu_Com2PduR_CanNodeNum_03_TxBasic_04
          CanPdu_PduR2CanIf_CanNodeNum_03_TxBasic_04
          CanPdu_Com2PduR_CanNodeNum_03_TxBasic_05
          CanPdu_PduR2CanIf_CanNodeNum_03_TxBasic_05
          CanPdu_Com2PduR_CanNodeNum_03_TxBasic_06
          CanPdu_PduR2CanIf_CanNodeNum_03_TxBasic_06
          CanPdu_Com2PduR_CanNodeNum_03_TxBasic_07
          CanPdu_PduR2CanIf_CanNodeNum_03_TxBasic_07
          CanPdu_Com2PduR_CanNodeNum_03_TxBasic_08
          CanPdu_PduR2CanIf_CanNodeNum_03_TxBasic_08
          CanPdu_Com2PduR_CanNodeNum_03_TxBasic_09
          CanPdu_PduR2CanIf_CanNodeNum_03_TxBasic_09
          CanPdu_Com2PduR_CanNodeNum_03_TxBasic_10
          CanPdu_PduR2CanIf_CanNodeNum_03_TxBasic_10
          CanPdu_Com2PduR_CanNodeNum_03_TxBasic_11
          CanPdu_PduR2CanIf_CanNodeNum_03_TxBasic_11
          CanPdu_Com2PduR_CanNodeNum_03_TxBasic_12
          CanPdu_PduR2CanIf_CanNodeNum_03_TxBasic_12
          CanPdu_Com2PduR_CanNodeNum_03_TxBasic_13
          CanPdu_PduR2CanIf_CanNodeNum_03_TxBasic_13
          CanPdu_Com2PduR_CanNodeNum_03_TxBasic_14
          CanPdu_PduR2CanIf_CanNodeNum_03_TxBasic_14
          CanPdu_Com2PduR_CanNodeNum_03_TxBasic_15
          CanPdu_PduR2CanIf_CanNodeNum_03_TxBasic_15
          CanPdu_Com2PduR_CanNodeNum_03_TxBasic_16
          CanPdu_PduR2CanIf_CanNodeNum_03_TxBasic_16
          CanPdu_Com2PduR_CanNodeNum_03_TxBasic_17
          CanPdu_PduR2CanIf_CanNodeNum_03_TxBasic_17
          CanPdu_Com2PduR_CanNodeNum_03_TxBasic_18
          CanPdu_PduR2CanIf_CanNodeNum_03_TxBasic_18
          CanPdu_Com2PduR_CanNodeNum_03_TxBasic_19
          CanPdu_PduR2CanIf_CanNodeNum_03_TxBasic_19
          CanPdu_Com2PduR_CanNodeNum_03_TxBasic_20
          CanPdu_PduR2CanIf_CanNodeNum_03_TxBasic_20
          CanPdu_Com2PduR_CanNodeNum_03_Tx_01
          CanPdu_PduR2CanIf_CanNodeNum_03_Tx_01
          CanPdu_Com2PduR_CanNodeNum_03_Tx_02
          CanPdu_PduR2CanIf_CanNodeNum_03_Tx_02
          CanPdu_Com2PduR_CanNodeNum_03_Tx_03
          CanPdu_PduR2CanIf_CanNodeNum_03_Tx_03
          CanPdu_Com2PduR_CanNodeNum_03_Tx_04
          CanPdu_PduR2CanIf_CanNodeNum_03_Tx_04
          CanPdu_Com2PduR_CanNodeNum_03_Tx_05
          CanPdu_PduR2CanIf_CanNodeNum_03_Tx_05
          CanPdu_Com2PduR_CanNodeNum_03_Tx_06
          CanPdu_PduR2CanIf_CanNodeNum_03_Tx_06
          CanPdu_Com2PduR_CanNodeNum_03_Tx_07
          CanPdu_PduR2CanIf_CanNodeNum_03_Tx_07
          CanPdu_Com2PduR_CanNodeNum_03_Tx_08
          CanPdu_PduR2CanIf_CanNodeNum_03_Tx_08
          CanPdu_Com2PduR_CanNodeNum_03_Tx_09
          CanPdu_PduR2CanIf_CanNodeNum_03_Tx_09
          CanPdu_Com2PduR_CanNodeNum_03_Tx_10
          CanPdu_PduR2CanIf_CanNodeNum_03_Tx_10
          CanPdu_Com2PduR_CanNodeNum_03_Tx_11
          CanPdu_PduR2CanIf_CanNodeNum_03_Tx_11
          CanPdu_Com2PduR_CanNodeNum_03_Tx_12
          CanPdu_PduR2CanIf_CanNodeNum_03_Tx_12
          CanPdu_Com2PduR_CanNodeNum_03_Tx_13
          CanPdu_PduR2CanIf_CanNodeNum_03_Tx_13
          CanPdu_Com2PduR_CanNodeNum_03_Tx_14
          CanPdu_PduR2CanIf_CanNodeNum_03_Tx_14
          CanPdu_Com2PduR_CanNodeNum_03_Tx_15
          CanPdu_PduR2CanIf_CanNodeNum_03_Tx_15
          CanPdu_Com2PduR_CanNodeNum_03_Tx_16
          CanPdu_PduR2CanIf_CanNodeNum_03_Tx_16
          CanPdu_Com2PduR_CanNodeNum_03_Tx_17
          CanPdu_PduR2CanIf_CanNodeNum_03_Tx_17
          CanPdu_Com2PduR_CanNodeNum_03_Tx_18
          CanPdu_PduR2CanIf_CanNodeNum_03_Tx_18
          CanPdu_Com2PduR_CanNodeNum_03_Tx_19
          CanPdu_PduR2CanIf_CanNodeNum_03_Tx_19
          CanPdu_Com2PduR_CanNodeNum_03_Tx_20
          CanPdu_PduR2CanIf_CanNodeNum_03_Tx_20
          CanPdu_Com2PduR_CanNodeNum_03_Tx_21
          CanPdu_PduR2CanIf_CanNodeNum_03_Tx_21
          CanPdu_Com2PduR_CanNodeNum_03_Tx_22
          CanPdu_PduR2CanIf_CanNodeNum_03_Tx_22
          CanPdu_Com2PduR_CanNodeNum_03_Tx_23
          CanPdu_PduR2CanIf_CanNodeNum_03_Tx_23
          CanPdu_Com2PduR_CanNodeNum_03_Tx_24
          CanPdu_PduR2CanIf_CanNodeNum_03_Tx_24
          CanPdu_Com2PduR_CanNodeNum_03_Tx_25
          CanPdu_PduR2CanIf_CanNodeNum_03_Tx_25
          CanPdu_Com2PduR_CanNodeNum_03_Tx_26
          CanPdu_PduR2CanIf_CanNodeNum_03_Tx_26
    EcuCRbSettings: EcuCRbRteInUse=true, EcuCRbArRelease=AR42_Rev2
