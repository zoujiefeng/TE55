AUTOSAR XML (schema 00047)
package /ETAS_Project/EcucModuleConfigurationValuess
  module config Nm: implementation-config-variant=VARIANT-PRE-COMPILE
    NmGlobalConfig
      NmGlobalFeatures:
        NmCoordinatorSyncSupport = false
        NmCoordinatorSupportEnabled = false
        NmBusSynchronizationEnabled = false
        NmCarWakeUpRxEnabled = false
        NmRemoteSleepIndEnabled = false
        NmPassiveModeEnabled = false
        NmComUserDataSupport = false
        NmComControlEnabled = true
        NmUserDataEnabled = true
        NmNodeDetectionEnabled = true
        NmNodeIdEnabled = true
        NmStateChangeIndEnabled = true
        NmPduRxIndicationEnabled = true
        NmRepeatMsgIndEnabled = true
      NmGlobalProperties: NmCycletimeMainFunction=0.01, NmVersionInfoApi=true, NmDevErrorDetect=true
      NmGlobalConstants:
        NmNumberOfChannels = 1
        NmRxIndicationCallback = Nm_RxIndicationCallback
        NmStateChangeIndCallback = Nm_StateChangeIndication
        NmRemoteSleepCancelCallback = TestNm_RemoteSleepCancellation
        NmRemoteSleepIndCallback = TestNm_RemoteSleepIndication
    NmChannelConfig_CanNmCluster_0_1 (NmChannelConfig):
      NmChannelSleepMaster = false
      NmStateReportEnabled = false
      NmShutdownDelayTimer = 0.0
      NmSynchronizingNetwork = false
      NmNodeDetectionEnabled = true
      NmNodeIdEnabled = true
      NmRepeatMsgIndEnabled = true
      NmComMChannelRef = Can_Network_CanNodeNum_01
      NmBusType
        NmStandardBusNmConfig: NmStandardBusType=NM_BUSNM_CANNM
