AUTOSAR XML (schema 00047)
package /ETAS_Project/EcucModuleConfigurationValuess
  module config NvM: implementation-config-variant=VARIANT-PRE-COMPILE
    NvMCommon:
      NvMJobPrioritization = false
      NvMSizeStandardJobQueue = 20
      NvMBswMMultiBlockJobStatusInformation = true
      NvMDevErrorDetect = true
      NvMDynamicConfiguration = false
      NvMCrcNumOfBytes = 1
      NvMDrvModeSwitch = false
      NvMMainFunctionPeriod = 0.001
      NvMMultiBlockCallback = NULL_PTR
      NvMVersionInfoApi = false
      NvMSetRamBlockStatusApi = true
      NvMRbSetWriteAllTriggerApi = true
      NvMPollingMode = true
      NvMCompiledConfigId = 2
      NvMApiConfigClass = NVM_API_CONFIG_CLASS_3
      NvMRbAuxInterface = 0
      NvMRbGenArxmlVersion = NVM_GEN_ARXML_VERSION_402
      NvMRbInitAtLayoutChange = 0
      NvMRbRamInitCheck = NVM_RB_RAM_INIT_CHECK_NONE
      NvMRbRemoveNonResistantBlocks = 0
      NvMRbReqMonitor = NVM_RB_REQ_MON_DISABLED
      NvMRbRuntimeRamBlockConfiguration = 0
      NvMRbSetWriteAllTriggerApi = 1
      NvMRepeatMirrorOperations = 0
