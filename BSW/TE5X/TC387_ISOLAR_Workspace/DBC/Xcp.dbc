VERSION ""

NS_ :

BS_:

BU_: IPC

BO_ 818 XCP_RX_Broadcast: 8 Vector__XXX
 SG_ XCP_SIG2 : 7|64@0+ (1,0) [0|0] ""  IPC

BO_ 1914 XCP_TX_DAQ2: 8 IPC

BO_ 1913 XCP_TX_DAQ1: 8 IPC

BO_ 1912 XCP_TX_DAQ0: 8 IPC

BO_ 819 XCP_RX_CMD: 8 Vector__XXX
 SG_ XCP_SIG1 : 7|64@0+ (1,0) [0|0] ""  IPC

BO_ 1911 XCP_TX_RES: 8 IPC

BA_DEF_ BO_  "XcpResp" ENUM  "no","yes";
BA_DEF_ BO_  "XcpReq" ENUM  "no","yes";
BA_DEF_ BO_  "GenMsgSendType" ENUM  "Periodic","Event","Mixed","IfActive","POE","PA";
BA_DEF_ BO_  "GenMsgCycleTime" FLOAT 0 300000;
BA_DEF_  "BusType" STRING ;
BA_DEF_DEF_  "XcpResp" "no";
BA_DEF_DEF_  "XcpReq" "no";
BA_DEF_DEF_  "GenMsgSendType" "Periodic";
BA_DEF_DEF_  "GenMsgCycleTime" 0;
BA_DEF_DEF_  "BusType" "CAN";
BA_ "GenMsgCycleTime" BO_ 818 10;
BA_ "XcpReq" BO_ 818 1;
BA_ "XcpResp" BO_ 1914 1;
BA_ "GenMsgCycleTime" BO_ 1914 100;
BA_ "XcpResp" BO_ 1913 1;
BA_ "GenMsgCycleTime" BO_ 1913 50;
BA_ "XcpResp" BO_ 1912 1;
BA_ "GenMsgCycleTime" BO_ 1912 10;
BA_ "XcpReq" BO_ 819 1;
BA_ "GenMsgSendType" BO_ 819 1;
BA_ "XcpResp" BO_ 1911 1;
BA_ "GenMsgSendType" BO_ 1911 1;
