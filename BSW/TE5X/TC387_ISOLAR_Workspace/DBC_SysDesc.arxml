AUTOSAR XML (schema 00047)
package /Systems
  system System: category=SYSTEM_EXTRACT
    system mapping SystemMapping
      sw-mappings:
        swc to ecu mapping SwcToEcuMapping_0: ecu-instance=IPC
          component:
            RootSwCompositionPrototype_0.CPT_ASW_BASE
            RootSwCompositionPrototype_0.CPT_ASW_CORE{0..2}
            RootSwCompositionPrototype_0.CPT_ASW_DCM
            RootSwCompositionPrototype_0.CPT_ASW_DEM
            RootSwCompositionPrototype_0.CPT_ASW_NM
            RootSwCompositionPrototype_0.CPT_ASW_NVM
            RootSwCompositionPrototype_0.CPT_ASW_WDG
            RootSwCompositionPrototype_0.CPT_ASW_XCP
            RootSwCompositionPrototype_0.CPT_CDD_CORE{0..2}
            RootSwCompositionPrototype_0.CPT_BswM
            RootSwCompositionPrototype_0.CPT_ComM
            RootSwCompositionPrototype_0.CPT_Dcm
            RootSwCompositionPrototype_0.CPT_Dem
            RootSwCompositionPrototype_0.CPT_Det
            RootSwCompositionPrototype_0.CPT_EcuM
            RootSwCompositionPrototype_0.CPT_NvM
            RootSwCompositionPrototype_0.CPT_WdgM
            RootSwCompositionPrototype_0.CPT_rba_DiagLib
            RootSwCompositionPrototype_0.CPT_ASW_COM
            RootSwCompositionPrototype_0.CPT_RSID
            RootSwCompositionPrototype_0.CPT_SWC_DEM
            RootSwCompositionPrototype_0.CPT_ASW_CORE3
            RootSwCompositionPrototype_0.CPT_CDD_CORE3
    root-software-compositions:
      root sw composition prototype RootSwCompositionPrototype_0: software-composition=TopLevelComposition
package /DBC_SysDesc_CanNetwork/Pkg_Cluster
  can cluster Can_Network: protocol-name=CAN
    can physical channel Can_Network_Channel: comm-connectors=Conn_Can_Network_CANNODE_0_IPC
      frame RIPC_600_NM: id 0x600, to IPC, frame-length=8, can-addressing-mode=STANDARD, can-frame-rx-behavior=ANY
        nm pdu RIPC_600_NM: length=8, nm-data-information=false, nm-vote-information=false
      frame IPC_633_NM: id 0x633, from IPC, frame-length=8, can-addressing-mode=STANDARD
        nm pdu IPC_633_NM: length=8, nm-data-information=false, nm-vote-information=false
      frame Diag_Functional_request: id 0x7DF, to IPC, frame-length=8, can-addressing-mode=STANDARD, can-frame-rx-behavior=ANY
        dcm i pdu Diag_Functional_request: length=8, diag-pdu-type=DIAG-REQUEST
      frame Diag_Physical_request: id 0x7E3, to IPC, frame-length=8, can-addressing-mode=STANDARD, can-frame-rx-behavior=ANY
        dcm i pdu Diag_Physical_request: length=8, diag-pdu-type=DIAG-REQUEST
      frame Diag_Physical_response: id 0x7EB, from IPC, frame-length=8, can-addressing-mode=STANDARD
        dcm i pdu Diag_Physical_response: length=8, diag-pdu-type=DIAG-RESPONSE
      pdu triggering PduTrig_TEST_receive: pdu=?
      pdu triggering PduTrig_TEST_send: pdu=?
  can cluster Can_Network_XCP: protocol-name=CAN
    can physical channel Can_Network_XCP_Channel: comm-connectors=Conn_Can_Network_CANNODE_1_IPC
      frame XCP_RX_Broadcast: id 0x332, to IPC, frame-length=8, can-addressing-mode=STANDARD, can-frame-rx-behavior=ANY
        general purpose i pdu XCP_RX_Broadcast: category=XCP, length=8
      frame XCP_RX_CMD: id 0x333, to IPC, frame-length=8, can-addressing-mode=STANDARD, can-frame-rx-behavior=ANY
        general purpose i pdu XCP_RX_CMD: category=XCP, length=8
      frame XCP_TX_DAQ0: id 0x778, from IPC, frame-length=8, can-addressing-mode=STANDARD
        general purpose i pdu XCP_TX_DAQ0: category=XCP, length=8
      frame XCP_TX_DAQ1: id 0x779, from IPC, frame-length=8, can-addressing-mode=STANDARD
        general purpose i pdu XCP_TX_DAQ1: category=XCP, length=8
      frame XCP_TX_DAQ2: id 0x77A, from IPC, frame-length=8, can-addressing-mode=STANDARD
        general purpose i pdu XCP_TX_DAQ2: category=XCP, length=8
      frame XCP_TX_RES: id 0x777, from IPC, frame-length=8, can-addressing-mode=STANDARD
        general purpose i pdu XCP_TX_RES: category=XCP, length=8
      frame CCP_RX_CRO_MCU: id 0x317, to IPC, frame-length=8, can-addressing-mode=STANDARD, can-frame-rx-behavior=ANY
        n pdu CCP_RX_CRO_MCU: length=8
      frame CCP_TX_DAQ0_MCU: id 0x216, from IPC, frame-length=8, can-addressing-mode=STANDARD
        n pdu CCP_TX_DAQ0_MCU: length=8
      frame CCP_TX_DAQ1_MCU: id 0x215, from IPC, frame-length=8, can-addressing-mode=STANDARD
        n pdu CCP_TX_DAQ1_MCU: length=8
      frame CCP_TX_DTO_MCU: id 0x318, from IPC, frame-length=8, can-addressing-mode=STANDARD
        n pdu CCP_TX_DTO_MCU: length=8
      frame CCP_TX_DAQ2_MCU: id 0x217, from IPC, frame-length=8, can-addressing-mode=STANDARD
        n pdu CCP_TX_DAQ2_MCU: length=8
package /DBC_SysDesc_CanNetwork/Pkg_Nm
  nm config NmConfig_0
    can nm cluster CanNmCluster_0: communication-cluster=Can_Network, nm-channel-id=1, nm-channel-sleep-master=false, nm-synchronizing-network=false, nm-busload-reduction-active=false, nm-car-wake-up-filter-enabled=false, nm-car-wake-up-rx-enabled=false, nm-channel-active=false
      can nm node CanNmMode_IPC_Can_Network_CANNODE_0: controller=Can_Network_CANNODE_0, nm-if-ecu=NmEcu_IPC, nm-node-id=1, nm-passive-mode-enabled=false, rx-nm-pdu=RIPC_600_NM, tx-nm-pdu=IPC_633_NM, nm-range-config={lower-can-id=1536, upper-can-id=1587}
    nm-if-ecus:
      nm ecu NmEcu_IPC:
        bus-specific-nm-ecu=can-nm-ecu=nm-repeat-msg-indication-enabled=false
        ecu-instance=IPC
        nm-bus-synchronization-enabled=false
        nm-com-control-enabled=false
        nm-coordinator=nm-node=CanNmMode_IPC_Can_Network_CANNODE_0
        nm-multiple-channels-enabled=false
        nm-node-detection-enabled=false
        nm-node-id-enabled=false
        nm-passive-mode-enabled=false
        nm-pdu-rx-indication-enabled=false
        nm-remote-sleep-ind-enabled=false
        nm-repeat-msg-ind-enabled=false
        nm-state-change-ind-enabled=false
        nm-user-data-enabled=false
package /DBC_SysDesc_CanNetwork/Pkg_Ecu
  ecu instance IPC: com-configuration-gw-time-base=0.005, com-configuration-rx-time-base=0.01, com-configuration-tx-time-base=0.01, sleep-mode-supported=false, wake-up-over-bus-supported=false
    can communication controller Can_Network_CANNODE_0: can-controller-attributes=can-controller-configuration={prop-seg=0, sync-jump-width=0, time-seg-1=10, time-seg-2=0}
    can communication controller Can_Network_CANNODE_1: can-controller-attributes=can-controller-configuration={prop-seg=0, sync-jump-width=0, time-seg-1=10, time-seg-2=0}
    can communication connector Conn_Can_Network_CANNODE_0_IPC: comm-controller=Can_Network_CANNODE_0
    can communication connector Conn_Can_Network_CANNODE_1_IPC: comm-controller=Can_Network_CANNODE_1
package /DBC_SysDesc_CanNetwork/Pkg_CompuMethod
  compu method CompuMethod_NMNode: raw=phys for phys 0..255
  compu method CompuMethod_RepeatMessageRequestBit1: raw=phys for phys 0..1; unit I
  compu method CompuMethod_NMWakeupSource: raw=phys for phys 0..255
  compu method CompuMethod_NMWakeupStype: raw=phys for phys 0..15; unit I
  compu method CompuMethod_ActiveWakeupBit: raw=phys for phys 0..1; unit I
  compu method CompuMethod_NMWakeupPower: raw=phys for phys 0..15
  compu method CompuMethod_RepeatSts: raw=phys for phys 0..1; unit I
  compu method CompuMethod_rls_lightSWReason: raw=phys for phys 0..7
package /DBC_SysDesc_CanNetwork/Pkg_Units
  16 x unit:
    I
    NOUNIT
    Nm
    rpm
    kW
    W
    Ampere
    pct
    Min
    km_h
    km
    V
    ohm
    degreeC
    degree
    Hz
