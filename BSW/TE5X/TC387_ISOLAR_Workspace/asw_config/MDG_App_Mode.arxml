AUTOSAR XML (schema 00047)
package /MDG_App_Mode
  mode declaration group MDG_App_Mode: category=EXPLICIT_ORDER, initial-mode=NONE
    4 x mode:
      NONE: value=0
      SWC_REQUEST_SHUTDOWN: value=16
      ECUM_WAKEUP: value=17
      ECUM_NOWAKEUP: value=18
package /ModeRequestInterface
  sender receiver interface ModeRequestInterface
    data AppMode: type=Enum_AppMode
package /Enum_AppMode
  app type Enum_AppMode: category=VALUE, sw-calibration-access=READ-WRITE, compu {1=LIN_0_SCHEDULE_TABLE_0_MODE (CompuScale), 2=LIN_0_SCHEDULE_TABLE_1_MODE (CompuScale_0), 3=LIN_1_SCHEDULE_TABLE_0_MODE (CompuScale_1), 4=LIN_1_SCHEDULE_TABLE_1_MODE (CompuScale_2), 16=SWC_REQUEST_SHUTDOWN (CompuScale_3)}
package /AppMode_Mapping
  data type mapping set AppMode_Mapping: data-type-map{application-data-type=Enum_AppMode, implementation-data-type=uint8}, mode-request-type-map{implementation-data-type=uint8, mode-group=MDG_App_Mode}
