AUTOSAR XML (schema 00047)
standard types defined: UInt16, Boolean, Float, UInt8, Double, UInt32, uint16, boolean, float32, uint8, float64, uint32
package /Components
  application sw component type ASW_COM
    behavior ASW_COM_IB: handle-termination-and-restart=NO-SUPPORT
      9 x timing event:
        TE_Can01_Below100ms: start-on-event=MainMsg_Can01_Below100ms, period=0.01
        TE_Can01_Above100ms: start-on-event=MainMsg_Can01_Above100ms, period=0.1
        TE_Can01_SpecialPeriod: start-on-event=MainMsg_Can01_SpecialPeriod, period=0.001
        TE_Can02_Below100ms: start-on-event=MainMsg_Can02_Below100ms, period=0.01
        TE_Can02_Above100ms: start-on-event=MainMsg_Can02_Above100ms, period=0.1
        TE_Can02_SpecialPeriod: start-on-event=MainMsg_Can02_SpecialPeriod, period=0.001
        TE_Can03_Below100ms: start-on-event=MainMsg_Can03_Below100ms, period=0.01
        TE_Can03_Above100ms: start-on-event=MainMsg_Can03_Above100ms, period=0.1
        TE_Can03_SpecialPeriod: start-on-event=MainMsg_Can03_SpecialPeriod, period=0.001
      10 x runnable:
        ASW_COM_Init
        MainMsg_Can01_Below100ms: symbol=MainMsg_Can01_Below100ms_Func
        MainMsg_Can01_Above100ms: symbol=MainMsg_Can01_Above100ms_Func
        MainMsg_Can01_SpecialPeriod: symbol=MainMsg_Can01_SpecialPeriod_Func
        MainMsg_Can02_Below100ms: symbol=MainMsg_Can02_Below100ms_Func
        MainMsg_Can02_Above100ms: symbol=MainMsg_Can02_Above100ms_Func
        MainMsg_Can02_SpecialPeriod: symbol=MainMsg_Can02_SpecialPeriod_Func
        MainMsg_Can03_Below100ms: symbol=MainMsg_Can03_Below100ms_Func
        MainMsg_Can03_Above100ms: symbol=MainMsg_Can03_Above100ms_Func
        MainMsg_Can03_SpecialPeriod: symbol=MainMsg_Can03_SpecialPeriod_Func
package /Components/SwcImplementations
  swc implementation ASW_COM_Impl: programming-language=C, sw-version=1.394.1, used-code-generator=Embedded Coder 7.6 (R2021a) 14-Nov-2020, vendor-id=0, behavior=ASW_COM_IB
    code-descriptors:
      code Code
        artifact-descriptors:
          short-label=ASW_COM_c, category=SWSRC
          short-label=BCM_peps_Fun_Cal_wrapper_c, category=SWSRC
          short-label=EMS1_Fun_Cal_wrapper_c, category=SWSRC
          short-label=EMS3_Fun_Cal_wrapper_c, category=SWSRC
          short-label=EMS5_Fun_Cal_wrapper_c, category=SWSRC
          short-label=EMS8_Fun_Cal_wrapper_c, category=SWSRC
          short-label=GCU{1..4}_Fun_Cal_wrapper_c, category=SWSRC
          short-label=GCU_Inner1_Fun_Cal_wrapper_c, category=SWSRC
          short-label=GCU_Inner2_Fun_Cal_wrapper_c, category=SWSRC
          short-label=IPB4_Fun_Cal_wrapper_c, category=SWSRC
          short-label=IPB5_Fun_Cal_wrapper_c, category=SWSRC
          short-label=IPB7_Fun_wrapper_c, category=SWSRC
          short-label=IVI_timeAndGPS_Fun_Cal_wrapper_c, category=SWSRC
          short-label=MCUF{1..4}_Fun_Cal_wrapper_c, category=SWSRC
          short-label=MCUF6_Fun_Cal_wrapper_c, category=SWSRC
          short-label=MCUF8_Fun_Cal_wrapper_c, category=SWSRC
          short-label=MCUF_Inner1_Fun_Cal_wrapper_c, category=SWSRC
          short-label=MCUF_Inner2_Fun_Cal_wrapper_c, category=SWSRC
          short-label=MCUF_SelfHeat1_Fun_Cal_wrapper_c, category=SWSRC
          short-label=MCUF_SelfHeat2_Fun_Cal_wrapper_c, category=SWSRC
          short-label=MCUF_TCU{1..3}_Fun_Cal_wrapper_c, category=SWSRC
          short-label=PDCM10_Fun_Cal_wrapper_c, category=SWSRC
          short-label=PDCM1_Fun_Cal_wrapper_c, category=SWSRC
          short-label=PDCM21_Fun_Cal_wrapper_c, category=SWSRC
          short-label=PDCM22_Fun_Cal_wrapper_c, category=SWSRC
          short-label=PDCM24_Fun_Cal_wrapper_c, category=SWSRC
          short-label=PDCM30_Fun_Cal_wrapper_c, category=SWSRC
          short-label=PDCM5_Fun_Cal_wrapper_c, category=SWSRC
          short-label=PDCM_ACU_EPS_Fun_Cal_wrapper_c, category=SWSRC
          short-label=PDCM_Body_IC_Fun_Cal_wrapper_c, category=SWSRC
          short-label=PDCM_GCU_Fun_Cal_wrapper_c, category=SWSRC
          short-label=PDCM_IC_ACU_Fun_Cal_wrapper_c, category=SWSRC
          short-label=PDCM_OBD_Fun_Cal_wrapper_c, category=SWSRC
          short-label=PDCM_SelfHeat_Fun_Cal_wrapper_c, category=SWSRC
          short-label=TBOX_VehicleMode_Fun_Cal_wrapper_c, category=SWSRC
          short-label=ASW_COM_h, category=SWHDR
          short-label=ASW_COM_private_h, category=SWHDR
          short-label=ASW_COM_types_h, category=SWHDR
          short-label=rtwtypes_h, category=SWHDR
    resource consumption RsrcCons_ASW_COM
package /DataTypes/SwAddrMethods
  sw addr method CODE: section-type=CODE
  sw addr method CONST: section-type=CONST
  sw addr method VAR: section-type=VAR
package /DataTypes/CompuMethods
  compu method TextTable: 0=FALSE, 1=TRUE
package /DataTypes/Units
  unit NoUnit: factor-si-to-unit=1.0, offset-si-to-unit=0.0
package /Timing
  swc timing ASWC_COM_timing: behavior=ASW_COM_IB
    timing-requirements:
      execution order constraint EOC
        ordered-elements:
          42 x eoc executable entity ref:
            COM_PDCM21_Rec10ms: successor=COM_PDCM22_Rec10ms
            COM_PDCM22_Rec10ms: successor=COM_PDCM24_Rec10ms
            COM_PDCM24_Rec10ms: successor=COM_EMS1_Rec10ms
            COM_EMS1_Rec10ms: successor=COM_MCUF1_Snd10ms
            COM_MCUF1_Snd10ms: successor=COM_PDCM_ACU_EPS_Rec10ms
            COM_PDCM_ACU_EPS_Rec10ms: successor=COM_GCU2_Snd10ms
            COM_GCU2_Snd10ms: successor=COM_EMS3_Rec10ms
            COM_EMS3_Rec10ms: successor=COM_PDCM_GCU_Rec10ms
            COM_PDCM_GCU_Rec10ms: successor=COM_PDCM10_Rec20ms
            COM_PDCM10_Rec20ms: successor=COM_PDCM30_Rec20ms
            COM_PDCM30_Rec20ms: successor=COM_IPB7_Rec20ms
            COM_IPB7_Rec20ms: successor=COM_PDCM_IC_ACU_Rec20ms
            COM_PDCM_IC_ACU_Rec20ms: successor=COM_MCUF3_Snd20ms
            COM_MCUF3_Snd20ms: successor=COM_MCUF2_Snd20ms
            COM_MCUF2_Snd20ms: successor=COM_GCU1_Snd20ms
            COM_GCU1_Snd20ms: successor=COM_GCU3_Snd20ms
            COM_GCU3_Snd20ms: successor=COM_MCUF_TCU1_Snd20ms
            COM_MCUF_TCU1_Snd20ms: successor=COM_MCUF_TCU2_Snd20ms
            COM_MCUF_TCU2_Snd20ms: successor=COM_IPB4_Rec20ms
            COM_IPB4_Rec20ms: successor=COM_IPB5_Rec20ms
            COM_IPB5_Rec20ms: successor=COM_PDCM_SelfHeat_Rec50ms
            COM_PDCM_SelfHeat_Rec50ms: successor=COM_IVI_timeAndGPS_Rec100ms
            COM_IVI_timeAndGPS_Rec100ms: successor=COM_EMS8_Rec100ms
            COM_EMS8_Rec100ms: successor=COM_PDCM_OBD_Rec100ms
            COM_PDCM_OBD_Rec100ms: successor=COM_BCM_peps_Rec100ms
            COM_BCM_peps_Rec100ms: successor=COM_PDCM_Body_IC_Rec100ms
            COM_PDCM_Body_IC_Rec100ms: successor=COM_EMS5_Rec100ms
            COM_EMS5_Rec100ms: successor=COM_PDCM5_Rec100ms
            COM_PDCM5_Rec100ms: successor=COM_PDCM1_Rec100ms
            COM_PDCM1_Rec100ms: successor=COM_MCUF6_Snd100ms
            COM_MCUF6_Snd100ms: successor=COM_MCUF4_Snd100ms
            COM_MCUF4_Snd100ms: successor=COM_MCUF_SelfHeat2_Snd100ms
            COM_MCUF_SelfHeat2_Snd100ms: successor=COM_MCUF_SelfHeat1_Snd100ms
            COM_MCUF_SelfHeat1_Snd100ms: successor=COM_GCU4_Snd100ms
            COM_GCU4_Snd100ms: successor=COM_MCUF_TCU3_Snd100ms
            COM_MCUF_TCU3_Snd100ms: successor=COM_MCUF_Inner1_Snd100ms
            COM_MCUF_Inner1_Snd100ms: successor=COM_MCUF_Inner2_Snd100ms
            COM_MCUF_Inner2_Snd100ms: successor=COM_GCU_Inner1_Snd100ms
            COM_GCU_Inner1_Snd100ms: successor=COM_GCU_Inner2_Snd100ms
            COM_GCU_Inner2_Snd100ms: successor=COM_MCUF8_Snd500ms
            COM_MCUF8_Snd500ms: successor=COM_TBOX_VehicleMode_Rec1000ms
            COM_TBOX_VehicleMode_Rec1000ms
