AUTOSAR XML (schema 00047)
package /IPC_FlatView/SwComponentTypes
  composition sw component type IPC_FlatView
    27 x component:
      CPT_ASW_BASE: type=ASW_BASE
      CPT_ASW_COM: type=ASW_COM
      CPT_ASW_CORE{0..2}: type=ASW_CORE{0..2}
      CPT_ASW_DCM: type=ASW_DCM
      CPT_ASW_DEM: type=ASW_DEM
      CPT_ASW_NM: type=ASW_NM
      CPT_ASW_NVM: type=ASW_NVM
      CPT_ASW_WDG: type=ASW_WDG
      CPT_ASW_XCP: type=ASW_XCP
      CPT_BswM: type=BswM
      CPT_CDD_CORE{0..2}: type=CDD_CORE{0..2}
      CPT_ComM: type=ComM
      CPT_Dcm: type=Dcm
      CPT_Dem: type=Dem
      CPT_Det: type=Det
      CPT_EcuM: type=EcuM
      CPT_NvM: type=NvM
      CPT_RSID: type=RSID
      CPT_WdgM: type=WdgM
      CPT_rba_DiagLib: type=rba_DiagLib
      CPT_SWC_DEM: type=SWC_DEM
      CPT_ASW_CORE3: type=ASW_CORE3
      CPT_CDD_CORE3: type=CDD_CORE3
    connect CPT_ASW_BASE.PPort_SwcModeRequest -> CPT_BswM.RP_BswMArbitration_BswMSwcModeRequest
    connect CPT_ASW_CORE0.PPort_SwcModeRequest -> CPT_BswM.RP_BswMArbitration_BswMSwcModeRequest
    connect CPT_ASW_CORE0.PPort_TransmitData2Core1 -> CPT_ASW_CORE1.RPort_ReceiverDataFromCore0
    connect CPT_ASW_CORE1.PPort_TransmitData2Core0 -> CPT_ASW_CORE0.RPort_ReceiveDatafromCore1
    connect CPT_ASW_DCM.VIT_04 -> CPT_Dcm.InfotypeServices_DcmDspVehInfoData_04
    connect CPT_ASW_DCM.VIT_06 -> CPT_Dcm.InfotypeServices_VIT_06_0
    connect CPT_ASW_DCM.VIT_0A -> CPT_Dcm.InfotypeServices_DcmDspVehInfoData_0A
    connect CPT_ASW_DEM.DataServices_CS_ExtendedDataRecord_Aged_counter -> CPT_Dem.DataServices_CS_ExtendedDataRecord_Aged_counter
    connect CPT_ASW_DEM.DataServices_CS_ExtendedDataRecord_Fault_pending_counter -> CPT_Dem.DataServices_CS_ExtendedDataRecord_Fault_pending_counter
    connect CPT_ASW_NM.PP_BswMArbitration_BswM_MRP_Network -> CPT_BswM.RP_BswMArbitration_BswM_MRP_SWC_Network
    connect CPT_ASW_NM.PP_BswMArbitration_BswM_MRP_NmState -> CPT_BswM.RP_BswMArbitration_BswM_MRP_SWC_Network
    connect CPT_CDD_CORE0.PPort_CPUUtilizationCore0 -> CPT_ASW_CORE0.RPort_CPUUtilizationCore0
    connect CPT_CDD_CORE0.PPort_Core0Server -> CPT_ASW_CORE0.RPort_ClientCallCore0
    connect CPT_CDD_CORE0.PPort_GetMaxUserStackUtilization -> CPT_ASW_CORE0.RPort_GetMaxUserStackUtilization
    connect CPT_CDD_CORE1.PPort_CPUUtilizationCore1 -> CPT_ASW_CORE1.RPort_CPUUtilizationCore1
    connect CPT_CDD_CORE1.PPort_GetMaxUserStackUtilization -> CPT_ASW_CORE1.RPort_GetMaxUserStackUtilization
    connect CPT_CDD_CORE2.PPort_CPUUtilizationCore2 -> CPT_ASW_CORE2.RPort_CPUUtilizationCore2
    connect CPT_CDD_CORE2.PPort_GetMaxUserStackUtilization -> CPT_ASW_CORE2.RPort_GetMaxUserStackUtilization
    connect CPT_ComM.UR_ComMUser_Can_Network_CanNodeNum_01 -> CPT_ASW_NM.RP_ComM_UserRequest_CAN0
    connect CPT_ComM.modeLimitation -> CPT_ASW_NM.RPort_EcuModeLimitation
    connect CPT_Dcm.DCMServices -> CPT_ASW_DCM.RPort_DCMServices
    connect CPT_Dem.IndStatus_MIL -> CPT_ASW_DEM.IndStatus_MIL
    connect CPT_Dem.OpCycle_DemOperationCycle_Ignition -> CPT_ASW_DEM.OpCycle_DemOperationCycle_Ignition
    connect CPT_Dem.OpCycle_DemOperationCycle_Power -> CPT_ASW_DEM.RPort_OpCycle_DemOperationCycle_Power
    connect CPT_RSID.RoutineServices_DcmDspRoutine_0203 -> CPT_Dcm.RoutineServices_DcmDspRoutine_0203
    connect CPT_WdgM.globalMode -> CPT_ASW_WDG.RPort_WdgM_GlobalMode
    connect CPT_WdgM.localSupervision_WdgMSupervisedEntity_Alive_Supervision_Entity1_WdgMCheckpoint_Alive_Supervision_Entity1 -> CPT_ASW_WDG.RPort_Alive_Supervision_Entity1
    connect CPT_WdgM.localSupervision_WdgMSupervisedEntity_Alive_Supervision_Entity1_WdgMCheckpoint_Alive_Supervision_Entity1 -> CPT_ASW_WDG.RPort_Deadline_Supervision_Entity1
    connect CPT_SWC_DEM.DataServices_PID_0C -> CPT_Dem.DataServices_PID_0C
    connect CPT_SWC_DEM.DataServices_PID_49 -> CPT_Dem.DataServices_PID_49
    connect CPT_SWC_DEM.DataServices_PID_05 -> CPT_Dem.DataServices_PID_05
    connect CPT_SWC_DEM.DataServices_PID_0D -> CPT_Dem.DataServices_PID_0D
    connect CPT_SWC_DEM.DataServices_PID_42 -> CPT_Dem.DataServices_PID_42
    connect CPT_SWC_DEM.DataServices_PID_04 -> CPT_Dem.DataServices_PID_04
    connect CPT_SWC_DEM.DataServices_PID_02 -> CPT_Dem.DataServices_PID_02
    connect CPT_ASW_DCM.DataServices_DcmDspPidData_41 -> CPT_Dcm.DataServices_DcmDspPidData_41
    connect CPT_ASW_DCM.DataServices_DcmDspPidData_05 -> CPT_Dcm.DataServices_DcmDspPidData_05
    connect CPT_ASW_DCM.DataServices_DcmDspPidData_0C -> CPT_Dcm.DataServices_DcmDspPidData_0C
    connect CPT_ASW_DCM.DataServices_DcmDspPidData_49 -> CPT_Dcm.DataServices_DcmDspPidData_49
    connect CPT_ASW_DCM.DataServices_DcmDspPidData_42 -> CPT_Dcm.DataServices_DcmDspPidData_42
    connect CPT_ASW_DCM.DataServices_DcmDspPidData_30 -> CPT_Dcm.DataServices_DcmDspPidData_30
    connect CPT_ASW_DCM.DataServices_DcmDspPidData_04 -> CPT_Dcm.DataServices_DcmDspPidData_04
    connect CPT_ASW_DCM.DataServices_DcmDspPidData_0D -> CPT_Dcm.DataServices_DcmDspPidData_0D
    connect CPT_ASW_DCM.DataServices_DcmDspPidData_21 -> CPT_Dcm.DataServices_DcmDspPidData_21
    connect CPT_NvM.NvM_NativeBlock_2 -> CPT_ASW_NVM.RPort_ASW_NVM_BlockNative_1024_1
    connect CPT_CDD_CORE3.PPort_CPUUtilizationCore3 -> CPT_ASW_CORE3.RPort_CPUUtilizationCore3
    connect CPT_CDD_CORE3.PPort_GetMaxUserStackUtilization -> CPT_ASW_CORE3.RPort_GetMaxUserStackUtilization
    connect CPT_ASW_DCM.DataServices_DcmDspPidData_31 -> CPT_Dcm.DataServices_DcmDspPidData_31
