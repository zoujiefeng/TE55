AUTOSAR XML (schema 00047)
package /OS
  module config Os
    OSDEFAULTAPPMODE (OsAppMode)
    OsRTATarget: OsRTATargetName=TriCoreHighTec, OsRTATargetVariant=TC38x
      SpECC (Param): Value=512,512
    OsOS:
      OsUseResScheduler = true
      OsSuppressVectorGen = false
      OsNumberOfCores = 4
      OsScalabilityClass = SC2
      OsStatus = STANDARD
      OsUseGetServiceId = false
      OsUseParameterAccess = false
      OsCyclesPerSecond = 200000000
      OsTicksPerSecond = 100000000
      OsDefaultInterrupt = DefaultInterruptHandler
      OsStackMonitoring = true
      OsHooks: OsStackFaultHook=true, OsErrorHook=true, OsPostTaskHook=false, OsPreTaskHook=false, OsProtectionHook=true, OsShutdownHook=true, OsStartupHook=true
      Param: Value=true
        meter_elapsed_time: VALUE=true
        meter_execution: VALUE=true
    Rte_TickCounter (OsCounter): OsSecondsPerTick=0.001, OsCounterAccessingApplication=OsApplication_Core0
    STM0SR1_ISR (OsIsr): OsIsrCategory=CATEGORY_2, OsIsrAddress=Interrupt_SRC_STM0SR1, OsIsrPriority=IPL_240
    3 x OsApplication, all with OsTrusted=true, OsTrustedApplicationDelayTimingViolationCall=false, OsTrustedApplicationWithProtection=false:
      OsApplication_Core0: OsAppTaskRef=Core0_OsTask_BSW_1ms, OsAppTaskRef=Core0_OsTask_BSW_10ms, OsAppTaskRef=Core0_OsTask_Background_1ms, OsAppTaskRef=Core0_OsTask_ASW_10ms, OsAppTaskRef=Core0_OsTask_ASW_100ms, OsAppTaskRef=Core0_ECU_StartupTask, OsAppTaskRef=Core0_BSW_OsTask_SwcRequest, OsAppTaskRef=Core0_OsTask_BSW_50ms, OsAppTaskRef=Core0_OsTask_BSW_100ms, OsAppEcucPartitionRef=EcucPartition_Core0, OsAppCounterRef=Rte_TickCounter, OsApplicationCoreRef=EcucCore0, OsAppScheduleTableRef=Rte_ScheduleTable, OsAppIsrRef=CAN0SR0_ISR, OsAppIsrRef=CAN0SR1_ISR, OsAppIsrRef=CAN0SR2_ISR, OsAppIsrRef=CAN0SR3_ISR, OsAppIsrRef=CAN0SR4_ISR, OsAppIsrRef=CAN0SR5_ISR, OsAppIsrRef=CAN0SR6_ISR, OsAppIsrRef=CAN0SR7_ISR, OsAppIsrRef=Millisecond, OsAppIsrRef=STM0SR1_ISR, OsAppIsrRef=ADC1SR0_ISR, OsAppIsrRef=ADC9SR0_ISR, OsAppIsrRef=ADC11SR0_ISR, OsAppIsrRef=CCU60SR2_ISR, OsAppIsrRef=ADC10SR0_ISR, OsAppTaskRef=Core0_OsTask_ASW_1ms, OsAppIsrRef=CAN0SR9_ISR, OsAppIsrRef=CAN1SR10_ISR, OsAppIsrRef=CAN0SR10_ISR, OsAppIsrRef=CAN0SR11_ISR, OsAppIsrRef=CAN0SR8_ISR, OsAppIsrRef=CAN1SR11_ISR, OsAppIsrRef=CAN1SR8_ISR, OsAppIsrRef=CAN1SR9_ISR
        OsApplicationHooks: OsAppErrorHook=true, OsAppShutdownHook=false, OsAppStartupHook=false
      OsApplication_Core1: OsAppTaskRef=Core1_OsTask_BSW_10ms, OsAppTaskRef=Core1_OsTask_ASW_10ms, OsAppEcucPartitionRef=EcucPartition_Core1, OsApplicationCoreRef=EcucCore1, OsAppTaskRef=Core1_OsTask_ASW_1ms, OsAppIsrRef=ADC0SR0_ISR, OsAppIsrRef=ADC2SR0_ISR, OsAppTaskRef=Core1_OsTask_ASW_100ms
        OsApplicationHooks: OsAppErrorHook=true, OsAppShutdownHook=false, OsAppStartupHook=false
      OsApplication_Core2: OsAppTaskRef=Core2_OsTask_BSW_10ms, OsAppTaskRef=Core2_OsTask_ASW_5ms, OsAppEcucPartitionRef=EcucPartition_Core2, OsApplicationCoreRef=EcucCore2, OsAppIsrRef=CCU61SR2_ISR, OsAppTaskRef=Core2_OsTask_ASW_1ms, OsAppIsrRef=ADC3SR0_ISR, OsAppTaskRef=Core2_OsTask_ASW_100ms, OsAppTaskRef=Core2_OsTask_ASW_10ms, OsAppIsrRef=ADC3SR1_ISR
        OsApplicationHooks: OsAppErrorHook=true, OsAppShutdownHook=false, OsAppStartupHook=false
    13 x OsTask, all with OsTaskActivation=1, OsTaskAccessingApplication=OsApplication_Core0:
      Core0_BSW_OsTask_SwcRequest: OsTaskStackAllocation=1024,1024, OsTaskPriority=15, OsTaskSchedule=FULL, OsTaskCanCallSchedule=false, OsTaskResourceRef=RTE_RESOURCE_OS_APP_OsApplication_Core0
      Core0_ECU_StartupTask: OsTaskPriority=60, OsTaskSchedule=FULL, OsTaskStackAllocation=2048,2048
        OsTaskAutostart: OsTaskAppModeRef=OSDEFAULTAPPMODE
      Core0_OsTask_ASW_100ms: OsTaskStackAllocation=2048,2048, OsTaskPriority=13, OsTaskSchedule=FULL, OsTaskResourceRef=RTE_RESOURCE_OS_APP_OsApplication_Core0
      Core0_OsTask_ASW_10ms: OsTaskStackAllocation=4096,4096, OsTaskPriority=20, OsTaskSchedule=FULL, OsTaskCanCallSchedule=false, OsTaskResourceRef=RTE_RESOURCE_OS_APP_OsApplication_Core0
      Core0_OsTask_Background_1ms: OsTaskPriority=2, OsTaskSchedule=NON, OsTaskStackAllocation=1024,1024
      Core0_OsTask_BSW_100ms: OsTaskPriority=18, OsTaskSchedule=FULL, OsTaskStackAllocation=1024,1024, OsTaskResourceRef=RTE_RESOURCE_OS_APP_OsApplication_Core0
      Core0_OsTask_BSW_10ms: OsTaskStackAllocation=1024,1024, OsTaskPriority=21, OsTaskSchedule=FULL, OsTaskResourceRef=RTE_RESOURCE_OS_APP_OsApplication_Core0
      Core0_OsTask_BSW_1ms: OsTaskStackAllocation=2048,2048, OsTaskPriority=23, OsTaskSchedule=FULL, OsTaskResourceRef=RTE_RESOURCE_OS_APP_OsApplication_Core0
      Core0_OsTask_BSW_50ms: OsTaskSchedule=FULL, OsTaskPriority=19, OsTaskStackAllocation=1024,1024, OsTaskResourceRef=RTE_RESOURCE_OS_APP_OsApplication_Core0
      Core1_OsTask_ASW_10ms: OsTaskStackAllocation=2048,2048, OsTaskPriority=14, OsTaskSchedule=FULL, OsTaskCanCallSchedule=false, OsTaskAccessingApplication=OsApplication_Core1, OsTaskResourceRef=RTE_RESOURCE_OS_APP_OsApplication_Core1
      Core1_OsTask_BSW_10ms: OsTaskStackAllocation=1024,1024, OsTaskPriority=16, OsTaskSchedule=FULL, OsTaskAccessingApplication=OsApplication_Core1, OsTaskResourceRef=RTE_RESOURCE_OS_APP_OsApplication_Core1
      Core2_OsTask_ASW_5ms: OsTaskStackAllocation=1024,1024, OsTaskPriority=8, OsTaskSchedule=FULL, OsTaskAccessingApplication=OsApplication_Core2, OsTaskResourceRef=RTE_RESOURCE_OS_APP_OsApplication_Core2
      Core2_OsTask_BSW_10ms: OsTaskStackAllocation=2048,2048, OsTaskPriority=10, OsTaskSchedule=FULL, OsTaskAccessingApplication=OsApplication_Core2, OsTaskResourceRef=RTE_RESOURCE_OS_APP_OsApplication_Core2
    9 x OsIsr, all with OsIsrCategory=CATEGORY_2:
      Millisecond: OsIsrAddress=Interrupt_SRC_STM0SR0, OsIsrPriority=IPL_241
      CAN0SR0_ISR: OsIsrAddress=Interrupt_SRC_CAN0INT0, OsIsrPriority=IPL_215
      CAN0SR1_ISR: OsIsrAddress=Interrupt_SRC_CAN0INT1, OsIsrPriority=IPL_222
      CAN0SR2_ISR: OsIsrAddress=Interrupt_SRC_CAN0INT2, OsIsrPriority=IPL_221
      CAN0SR3_ISR: OsIsrAddress=Interrupt_SRC_CAN0INT3, OsIsrPriority=IPL_220
      CAN0SR4_ISR: OsIsrAddress=Interrupt_SRC_CAN0INT4, OsIsrPriority=IPL_219
      CAN0SR5_ISR: OsIsrAddress=Interrupt_SRC_CAN0INT5, OsIsrPriority=IPL_218
      CAN0SR6_ISR: OsIsrAddress=Interrupt_SRC_CAN0INT6, OsIsrPriority=IPL_217
      CAN0SR7_ISR: OsIsrAddress=Interrupt_SRC_CAN0INT7, OsIsrPriority=IPL_216
    3 x OsResource, all with OsResourceProperty=STANDARD:
      RTE_RESOURCE_OS_APP_OsApplication_Core{0..2}: OsResourceAccessingApplication=OsApplication_Core{0..2}
    Rte_ScheduleTable (OsScheduleTable):
      OsSchTblAccessingApplication = OsApplication_Core{0..3}
      OsScheduleTableSync: OsScheduleTblSyncStrategy=EXPLICIT, OsScheduleTblExplicitPrecision=1
    21 x OsIsr:
      CAN0SR8_ISR: OsIsrCategory=CATEGORY_2, OsIsrAddress=Interrupt_SRC_CAN0INT8, OsIsrPriority=IPL_214
      CAN0SR9_ISR: OsIsrCategory=CATEGORY_2, OsIsrAddress=Interrupt_SRC_CAN0INT9, OsIsrPriority=IPL_213
      CAN0SR10_ISR: OsIsrCategory=CATEGORY_2, OsIsrAddress=Interrupt_SRC_CAN0INT10, OsIsrPriority=IPL_212
      CAN0SR11_ISR: OsIsrCategory=CATEGORY_2, OsIsrAddress=Interrupt_SRC_CAN0INT11, OsIsrPriority=IPL_211
      CAN1SR8_ISR: OsIsrCategory=CATEGORY_2, OsIsrAddress=Interrupt_SRC_CAN1INT8, OsIsrPriority=IPL_210
      CAN1SR9_ISR: OsIsrCategory=CATEGORY_2, OsIsrAddress=Interrupt_SRC_CAN1INT9, OsIsrPriority=IPL_209
      CAN1SR10_ISR: OsIsrCategory=CATEGORY_2, OsIsrAddress=Interrupt_SRC_CAN1INT10, OsIsrPriority=IPL_208
      CAN1SR11_ISR: OsIsrCategory=CATEGORY_2, OsIsrAddress=Interrupt_SRC_CAN1INT11, OsIsrPriority=IPL_207
      ADC0SR0_ISR: OsIsrCategory=CATEGORY_1, OsIsrAddress=Interrupt_SRC_VADCG0SR0, OsIsrPriority=IPL_250
      ADC1SR0_ISR: OsIsrCategory=CATEGORY_1, OsIsrAddress=Interrupt_SRC_VADCG1SR0, OsIsrPriority=IPL_253
      ADC2SR0_ISR: OsIsrCategory=CATEGORY_1, OsIsrAddress=Interrupt_SRC_VADCG2SR0, OsIsrPriority=IPL_251
      ADC3SR0_ISR: OsIsrCategory=CATEGORY_1, OsIsrAddress=Interrupt_SRC_VADCG3SR0, OsIsrPriority=IPL_252
      ADC3SR1_ISR: OsIsrCategory=CATEGORY_2, OsIsrAddress=Interrupt_SRC_VADCG3SR1, OsIsrPriority=IPL_234
      ADC4SR0_ISR: OsIsrCategory=CATEGORY_2, OsIsrPriority=IPL_229, OsIsrAddress=Interrupt_SRC_VADCG4SR0
      ADC8SR0_ISR: OsIsrCategory=CATEGORY_1, OsIsrAddress=Interrupt_SRC_VADCG8SR0, OsIsrPriority=IPL_247
      ADC8SR1_ISR: OsIsrCategory=CATEGORY_2, OsIsrAddress=Interrupt_SRC_VADCG8SR1, OsIsrPriority=IPL_233
      ADC9SR0_ISR: OsIsrCategory=CATEGORY_2, OsIsrAddress=Interrupt_SRC_VADCG9SR0, OsIsrPriority=IPL_232
      ADC10SR0_ISR: OsIsrCategory=CATEGORY_2, OsIsrAddress=Interrupt_SRC_VADCG10SR0, OsIsrPriority=IPL_231
      ADC11SR0_ISR: OsIsrCategory=CATEGORY_2, OsIsrAddress=Interrupt_SRC_VADCG11SR0, OsIsrPriority=IPL_230
      CCU60SR2_ISR: OsIsrCategory=CATEGORY_1, OsIsrAddress=Interrupt_SRC_CCU60SR2, OsIsrPriority=IPL_255
      CCU61SR2_ISR: OsIsrCategory=CATEGORY_1, OsIsrAddress=Interrupt_SRC_CCU61SR2, OsIsrPriority=IPL_254
    Core1_OsTask_ASW_1ms (OsTask):
      OsTaskCanCallSchedule = false
      OsTaskActivation = 1
      OsTaskPriority = 17
      OsTaskSchedule = FULL
      OsTaskStackAllocation = 1024,1024
      OsTaskResourceRef = RTE_RESOURCE_OS_APP_OsApplication_Core1
      OsTaskAccessingApplication = OsApplication_Core1
      OsTaskAccessingApplication = OsApplication_Core0
    Core2_OsTask_ASW_1ms (OsTask):
      OsTaskCanCallSchedule = false
      OsTaskActivation = 1
      OsTaskSchedule = FULL
      OsTaskStackAllocation = 2048,2048
      OsTaskPriority = 9
      OsTaskResourceRef = RTE_RESOURCE_OS_APP_OsApplication_Core2
      OsTaskAccessingApplication = OsApplication_Core2
      OsTaskAccessingApplication = OsApplication_Core0
    OsApplication_Core3 (OsApplication):
      OsTrusted = true
      OsTrustedApplicationDelayTimingViolationCall = false
      OsTrustedApplicationWithProtection = 0
      OsAppTaskRef = Core3_OsTask_ASW_1ms
      OsAppTaskRef = Core3_OsTask_ASW_5ms
      OsAppTaskRef = Core3_OsTask_BSW_10ms
      OsAppEcucPartitionRef = EcucPartition_Core3
      OsApplicationCoreRef = EcucCore3
      OsAppIsrRef = ADC8SR1_ISR
      OsAppIsrRef = ADC8SR0_ISR
      OsAppIsrRef = ADC4SR0_ISR
      OsAppIsrRef = GTMTIM2SR4_ISR
      OsAppIsrRef = GTMTIM3SR6_ISR
      OsApplicationHooks_0 (OsApplicationHooks): OsAppErrorHook=true, OsAppShutdownHook=false, OsAppStartupHook=false
    RTE_RESOURCE_OS_APP_OsApplication_Core3 (OsResource): OsResourceProperty=STANDARD, OsResourceAccessingApplication=OsApplication_Core3
    7 x OsTask, all with OsTaskCanCallSchedule=false, OsTaskSchedule=FULL, OsTaskActivation=1, OsTaskAccessingApplication=OsApplication_Core0:
      Core3_OsTask_BSW_10ms: OsTaskPriority=5, OsTaskStackAllocation=2048,2048, OsTaskAccessingApplication=OsApplication_Core3, OsTaskResourceRef=RTE_RESOURCE_OS_APP_OsApplication_Core3
      Core3_OsTask_ASW_5ms: OsTaskPriority=3, OsTaskStackAllocation=2048,2048, OsTaskAccessingApplication=OsApplication_Core3, OsTaskResourceRef=RTE_RESOURCE_OS_APP_OsApplication_Core3
      Core3_OsTask_ASW_1ms: OsTaskPriority=4, OsTaskStackAllocation=1024,1024, OsTaskAccessingApplication=OsApplication_Core3, OsTaskResourceRef=RTE_RESOURCE_OS_APP_OsApplication_Core3
      Core0_OsTask_ASW_1ms: OsTaskPriority=22, OsTaskStackAllocation=2048,2048, OsTaskResourceRef=RTE_RESOURCE_OS_APP_OsApplication_Core0
      Core2_OsTask_ASW_10ms: OsTaskPriority=7, OsTaskStackAllocation=2048,2048, OsTaskAccessingApplication=OsApplication_Core2, OsTaskResourceRef=RTE_RESOURCE_OS_APP_OsApplication_Core2
      Core2_OsTask_ASW_100ms: OsTaskPriority=6, OsTaskStackAllocation=2048,2048, OsTaskAccessingApplication=OsApplication_Core2, OsTaskResourceRef=RTE_RESOURCE_OS_APP_OsApplication_Core2
      Core1_OsTask_ASW_100ms: OsTaskPriority=12, OsTaskStackAllocation=1024,1024, OsTaskAccessingApplication=OsApplication_Core1, OsTaskResourceRef=RTE_RESOURCE_OS_APP_OsApplication_Core1
    GTMTIM2SR4_ISR (OsIsr): OsIsrCategory=CATEGORY_1, OsIsrAddress=Interrupt_SRC_GTMTIM24, OsIsrPriority=IPL_248
    GTMTIM3SR6_ISR (OsIsr): OsIsrCategory=CATEGORY_1, OsIsrAddress=Interrupt_SRC_GTMTIM36, OsIsrPriority=IPL_249
