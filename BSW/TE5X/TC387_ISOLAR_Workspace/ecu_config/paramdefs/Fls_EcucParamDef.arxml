AUTOSAR XML (schema 4-2-2)
package /AUTOSAR_Fls/EcucModuleDefs
  module definition Fls [0..*]: category=VENDOR_SPECIFIC_MODULE_DEFINITION, refined-module-def=Fls, variants pre-compile  # Memory: Flash Driver | Configuration of the Fls (internal or external flash driver) module.
    container FlsConfigSet  # Configuration data set | Container for runtime configuration parameters of the flash driver
      integer FlsAcErase [0..0]: 0..4294967295, set at pre-compile  # Address offset in RAM for erase code | Address offset in RAM to which the erase flash access code shall be loaded. Used as function pointer to access the erase flash access code.
      integer FlsAcWrite [0..0]: 0..4294967295, set at pre-compile  # Address offset in RAM for write code | Address offset in RAM to which the write flash access code shall be loaded. Used as function pointer to access the write flash access code.
      float FlsCallCycle [0..0]: 0..1, set at pre-compile  # Cycle time of main function | Cycle time of calls of the flash driver's main function (in seconds).
      enumeration FlsDefaultMode [0..1]: {MEMIF_MODE_FAST, MEMIF_MODE_SLOW}, set at pre-compile  # Default of FLS device mode | Default setting of the FLS device moder after initialization.
      function name FlsJobEndNotification [0..1]: multiplicity set at pre-compile, set at pre-compile  # Job End Notification | Function that is called after a job has been processed successfully. A maximum of 1 ConfigSet can be left empty (using the GetJobResult-API).
      function name FlsJobErrorNotification [0..1]: multiplicity set at pre-compile, set at pre-compile  # Job Error Notification | Function that is called after a job has been aborted with an error. A maximum of 1 ConfigSet can be left empty (using the GetJobResult-API).
      integer FlsMaxReadFastMode [0..1]: 0..4294967295, multiplicity set at pre-compile, set at pre-compile  # Read bytes in fast mode | The maximum number of bytes to read or compare in one cycle of the flash driver's job processing function in fast mode.
      integer FlsMaxReadNormalMode [0..1]: 0..4294967295, multiplicity set at pre-compile, set at pre-compile  # Read bytes in normal mode | The maximum number of bytes to read or compare in one cycle of the flash driver's job processing function in normal mode.
      integer FlsMaxWriteFastMode [0..1]: 0..4294967295, multiplicity set at pre-compile, set at pre-compile  # Write bytes in fast mode | The maximum number of bytes to write in one cycle of the flash driver's job processing function in fast mode.
      integer FlsMaxWriteNormalMode [0..1]: 0..4294967295, multiplicity set at pre-compile, set at pre-compile  # Write bytes in normal mode | The maximum number of bytes to write in one cycle of the flash driver's job processing function in normal mode.
      integer FlsProtection [0..0]: 0..4294967295, set at pre-compile  # Protection settings | Erase/write protection settings. Only relevant if supported by hardware.
      string FlsRbDeviceID [0..1]: multiplicity set at pre-compile, origin=RB:1.0.0:2011-09-09, set at pre-compile, max-length=32, min-length=1  # Device ID used (freely configurable) | Configuration of Fls Device ID is not supported anymore! Configuring this parameter will be ignored by the driver.
      enumeration FlsRbDeviceType: origin=RB:1.0.0:2011-09-09, set at pre-compile  # Device type | Flash device type (might be pushed by other components)
        DFLASH  # Generic Data Flash
        RBA_FLSIFX_DFLASH0  # Infineon Data Flash 0
        RBA_FLSIFX_DFLASH_UCB_HSM  # Infineon UCB Flash for HSM
        RBA_FLSIFX_PFLASH0  # Infineon Program Flash 0
        RBA_FLSIFX_PFLASH1  # Infineon Program Flash 1
        RBA_FLSIFX_DFLASH0_HSM  # Infineon HSM Data Flash 0
        RBA_FLSJDP_PFLASH0  # JDP Program Flash 0
        RBA_FLSJDP_PFLASH1  # JDP Program Flash 1
        RBA_FLSJDP_DFLASH0  # JDP Data Flash
        RBA_FLSJDP_DFLASH0_HSM  # JDP Data Flash HSM
        RBA_FLSJDP_PFLASH0_HSM  # JDP Program Flash HSM
        RBA_FLSJDP_UTEST  # JDP UTEST Flash (one-time-programmable)
        RBA_FLSSTELLAR_NVM_PFLASH  # Stellar NVM Program Flash
        RBA_FLSSTELLAR_DFLASH0  # Stellar Data Flash
        RBA_FLSSTELLAR_DFLASH0_HSM  # Stellar Data Flash HSM
        RBA_FLSSTELLAR_NVM_HSM  # Stellar NVM HSM Program Flash
        RBA_FLSSTELLAR_NVM_UTEST  # Stellar NVM UTEST (one-time-programmable)
        RBA_FLSSTELLAR_NVM_HSM_UTEST  # Stellar NVM HSM UT
        RBA_FLSSPC58XX_CHORUS_PFLASH0  # ST Chorus Program Flash 0
        RBA_FLSSPC58XX_CHORUS2M_REDUCEDPFLASH1  # ST Chorus 2M Reduced Program Flash to 1.5M
        RBA_FLSSPC58XX_CHORUS2M_REDUCEDPFLASH2  # ST Chorus 2M Reduced Program Flash to 1M
        RBA_FLSSPC58XX_CHORUS_PFLASH3M  # ST Chorus 4M Reduced Program Flash to 3M
        RBA_FLSSPC58XX_CHORUS_PFLASH_HSM  # ST Chorus HSM Program Flash
        RBA_FLSSPC58XX_CHORUS_DFLASH  # ST Chorus Data Flash
        RBA_FLSSPC58XX_CHORUS_DFLASH0_HSM  # ST Chorus HSM Data Flash
        RBA_FLSV850R1X_PFLASH0  # Renesas V850R1x Program Flash 0
        RBA_FLSV850R1X_PFLASH1  # Renesas V850R1x Program Flash 1
        RBA_FLSV850R1X_DFLASH  # Renesas V850R1x Data Flash
        RBA_FLSV850R1X_CRASHDATA  # Renesas V850R1x Crash Data Flash
        RBA_FLSRH850xx_PFLASH0  # Renesas RH850xx Program Flash 0
        RBA_FLSRH850xx_DFLASH0  # Renesas RH850xx Data Flash 0
        RBA_FLSRH850xx_CRASHDATA  # Renesas RH850xx Crash data
        RBA_FLSRH850xx_CFGAREA  # Renesas RH850F1KM_S4 Config Area
        RBA_FLSRH850xx_DFLASH_HSM  # Renesas RH850F1KM_S4 HSM Area
        RBA_FLSRH850P1XC_BMDATA  # Renesas RH850 Boot-Manager Data Flash
        RBA_FLSRH850P1XC_CRASHDATA  # Renesas RH850 Crash Data Flash
        RBA_FLSRH850P1XC_DFLASH0  # Renesas RH850 BANK-A Data Flash
        RBA_FLSRH850P1XC_DFLASH0_HSM  # Renesas RH850 BANK-B Data Flash for HSM
        RBA_FLSRH850P1XC_PFLASH0  # Renesas RH850 BANK-A Code Flash
        RBA_FLSRH850P1XC_PFLASH1  # Renesas RH850 BANK-B Code Flash
        RBA_FLSRH850P1XC_CFGAREA  # Renesas RH850 Config Area
        RBA_FLSPC_DFLASH  # Data flash emulation for PC-based testing
        RBA_FLSPC_PFLASH  # Prog flash emulation for PC-based testing
        RBA_FLSEXT2_DFLASH0  # FlsExt2 D-Flash 0
        RBA_FLSEXT2_DFLASH1  # FlsExt2 D-Flash 1
        RBA_FLSEXT2_HSMDFLASH0  # FlsExt2 D-Flash HSM 0
        RBA_FLSEXT1_DFLASH0  # FLSEXT1 D-FLASH 0
        RBA_FLSEXT1_DFLASH1  # FLSEXT1 D-FLASH 1
        RBA_FLSRH850U2A_DFLASH  # Renesas RH850U2A DFLASH
        RBA_FLSRH850U2A_PFLASH  # Renesas RH850U2A PFLASH
        RBA_FLSRH850U2A_CFGAREA  # Renesas RH850U2A CFG Area
        RBA_FLSRH850U2A_SWITCHAREA  # Renesas RH850U2A Switch Area
        RBA_FLSRH850U2A_TAGAREA  # Renesas RH850U2A TAG Area
        RBA_FLSRH850U2A_DFLASH_HSM  # Renesas RH850U2A HSM DFLASH Area
        RBA_FLSHYPERFLASH_DFLASH0  # FlsHyperFlash DFLASH 0
        RBA_FLSHYPERFLASH_DFLASH1  # FlsHyperFlash DFLASH 1
      enumeration FlsRbDeviceTypeForced [0..1]: origin=RB:1.0.0:2011-09-09, set at pre-compile  # Device type (forced) | Flash device type enforced. This should be used only in special situations to overwrite the settings of the FlsRbDevceType if other components push unprecise or wrong settings.
        DFLASH  # Generic Data Flash
        RBA_FLSIFX_DFLASH0  # Infineon Data Flash 0
        RBA_FLSIFX_DFLASH_UCB_HSM  # Infineon UCB Flash for HSM
        RBA_FLSIFX_PFLASH0  # Infineon Program Flash 0
        RBA_FLSIFX_PFLASH1  # Infineon Program Flash 1
        RBA_FLSIFX_DFLASH0_HSM  # Infineon HSM Data Flash 0
        RBA_FLSJDP_PFLASH0  # JDP Program Flash 0
        RBA_FLSJDP_PFLASH1  # JDP Program Flash 1
        RBA_FLSJDP_DFLASH0  # JDP Data Flash
        RBA_FLSJDP_DFLASH0_HSM  # JDP Data Flash HSM
        RBA_FLSJDP_PFLASH0_HSM  # JDP Program Flash HSM
        RBA_FLSJDP_UTEST  # JDP UTEST Flash (one-time-programmable)
        RBA_FLSSTELLAR_NVM_PFLASH  # Stellar NVM Program Flash
        RBA_FLSSTELLAR_DFLASH0  # Stellar Data Flash
        RBA_FLSSTELLAR_DFLASH0_HSM  # Stellar Data Flash HSM
        RBA_FLSSTELLAR_NVM_HSM  # Stellar NVM HSM Program Flash
        RBA_FLSSTELLAR_NVM_UTEST  # Stellar NVM UTEST (one-time-programmable)
        RBA_FLSSTELLAR_NVM_HSM_UTEST  # Stellar NVM HSM UT
        RBA_FLSSPC58XX_CHORUS_PFLASH0  # ST Chorus Program Flash 0
        RBA_FLSSPC58XX_CHORUS2M_REDUCEDPFLASH1  # ST Chorus 2M Reduced Program Flash to 1.5M
        RBA_FLSSPC58XX_CHORUS2M_REDUCEDPFLASH2  # ST Chorus 2M Reduced Program Flash to 1M
        RBA_FLSSPC58XX_CHORUS_PFLASH3M  # ST Chorus 4M Reduced Program Flash to 3M
        RBA_FLSSPC58XX_CHORUS_PFLASH_HSM  # ST Chorus HSM Program Flash
        RBA_FLSSPC58XX_CHORUS_DFLASH  # ST Chorus Data Flash
        RBA_FLSSPC58XX_CHORUS_DFLASH0_HSM  # ST Chorus HSM Data Flash
        RBA_FLSV850R1X_PFLASH0  # Renesas V850R1x Program Flash 0
        RBA_FLSV850R1X_PFLASH1  # Renesas V850R1x Program Flash 1
        RBA_FLSV850R1X_DFLASH  # Renesas V850R1x Data Flash
        RBA_FLSV850R1X_CRASHDATA  # Renesas V850R1x Crash Data Flash
        RBA_FLSRH850xx_PFLASH0  # Renesas RH850xx Program Flash 0
        RBA_FLSRH850xx_DFLASH0  # Renesas RH850xx Data Flash 0
        RBA_FLSRH850xx_CRASHDATA  # Renesas RH850xx Crash data
        RBA_FLSRH850xx_CFGAREA  # Renesas RH850F1KM_S4 Config Area
        RBA_FLSRH850xx_DFLASH_HSM  # Renesas RH850F1KM_S4 HSM Area
        RBA_FLSRH850P1XC_BMDATA  # Renesas RH850 Boot-Manager Data Flash
        RBA_FLSRH850P1XC_CRASHDATA  # Renesas RH850 Crash Data Flash
        RBA_FLSRH850P1XC_DFLASH0  # Renesas RH850 BANK-A Data Flash
        RBA_FLSRH850P1XC_DFLASH0_HSM  # Renesas RH850 BANK-B Data Flash for HSM
        RBA_FLSRH850P1XC_PFLASH0  # Renesas RH850 BANK-A Code Flash
        RBA_FLSRH850P1XC_PFLASH1  # Renesas RH850 BANK-B Code Flash
        RBA_FLSRH850P1XC_CFGAREA  # Renesas RH850 Config Area
        RBA_FLSPC_DFLASH  # Data flash emulation for PC-based testing
        RBA_FLSPC_PFLASH  # Prog flash emulation for PC-based testing
        RBA_FLSEXT2_DFLASH0  # FlsExt2 D-Flash 0
        RBA_FLSEXT2_DFLASH1  # FlsExt2 D-Flash 1
        RBA_FLSEXT2_HSMDFLASH0  # FlsExt2 D-Flash HSM 0
        RBA_FLSEXT1_DFLASH0  # FLSEXT1 D-FLASH 0
        RBA_FLSEXT1_DFLASH1  # FLSEXT1 D-FLASH 1
        RBA_FLSRH850U2A_DFLASH  # Renesas RH850U2A DFLASH
        RBA_FLSRH850U2A_PFLASH  # Renesas RH850U2A PFLASH
        RBA_FLSRH850U2A_CFGAREA  # Renesas RH850U2A CFG Area
        RBA_FLSRH850U2A_SWITCHAREA  # Renesas RH850U2A Switch Area
        RBA_FLSRH850U2A_TAGAREA  # Renesas RH850U2A TAG Area
        RBA_FLSRH850U2A_DFLASH_HSM  # Renesas RH850U2A HSM DFLASH Area
        RBA_FLSHYPERFLASH_DFLASH0  # FlsHyperFlash DFLASH 0
        RBA_FLSHYPERFLASH_DFLASH1  # FlsHyperFlash DFLASH 1
      container FlsDemEventParameterRefs [0..0]  # Container for the references to DemEventParameter elements which shall be invoked using the Dem_ReportErrorStatus API in case the corresponding error occurs. The EventId is taken from the referenced DemEventParameter's DemEventId value. The standardized e
        reference FLS_E_COMPARE_FAILED [0..0]: set at pre-compile, destination=DemEventParameter  # Failed compare event | Reference to the DemEventParameter which shall be issued when the error "Flash compare failed (HW)" has occurred.
        reference FLS_E_ERASE_FAILED [0..0]: set at pre-compile, destination=DemEventParameter  # Failed erase event | Reference to the DemEventParameter which shall be issued when the error "Flash erase failed (HW)" has occurred.
        reference FLS_E_READ_FAILED [0..0]: set at pre-compile, destination=DemEventParameter  # Failed read event | Reference to the DemEventParameter which shall be issued when the error "Flash read failed (HW)" has occurred.
        reference FLS_E_UNEXPECTED_FLASH_ID [0..0]: set at pre-compile, destination=DemEventParameter  # Failed Flash ID detection event | Reference to the DemEventParameter which shall be issued when the error "Unexptected Flash ID (HW)" has occurred.
        reference FLS_E_WRITE_FAILED [0..0]: set at pre-compile, destination=DemEventParameter  # Failed write event | Reference to the DemEventParameter which shall be issued when the error "Flash write failed (HW)" has occurred.
      container FlsExternalDriver [0..1]  # FlsExternalDriver (SPI) | This container is present for external Flash drivers only. Internal Flash drivers do not use the parameter listed in this container, hence its multiplicity is 0 for internal drivers.
        symbolic name reference FlsSpiReference [0..1]: multiplicity set at pre-compile, set at pre-compile, destination=SpiSequence  # Reference to Standard SPI sequence (required for external Flash drivers). Attention: ONLY 1 SpiReference allowed
      container FlsSectorList  # Sector list | List of flashable sectors and pages.
        container FlsSector [1..*]  # Sector descriptor | Configuration description of a flashable sector.
          integer FlsNumberOfSectors: 0..65535, set at pre-compile  # Number of identical sectors | Number of continuous sectors with identical values for FlsSectorSize and FlsPageSize. The parameter FlsSectorStartAddress denotes the start address of the first sector.
          integer FlsPageSize [0..1]: 0..32768, set at pre-compile  # Page size | Size of one page (for programming) (logical page size can be defined which has to be multiples of the physical page size)
          integer FlsSectorSize: 0..4294967295, set at pre-compile  # Sector size | Size of this sector (for erasing) (logical sector can be defined which has to be multiples of the physical sector)
          integer FlsSectorStartaddress: 0..4294967295, set at pre-compile  # Sector start address | Start address of the first sector.
    container FlsGeneral  # General Parameters | Container for general parameters of the flash driver. These parameters are always pre-compile.
      boolean FlsAcLoadOnJobStart [0..0]: set at pre-compile, default-value=false  # The flash driver shall load the flash access code to RAM whenever an erase or write job is started and unload (overwrite) it after that job has been finished or canceled. | true: Flash access code loaded on job start / unloaded on job end or error. false: Flash access code not loaded to / unloaded from RAM at all.
      integer FlsBaseAddress [0..1]: 0..4294967295, multiplicity set at pre-compile, set at pre-compile  # Base address | The flash memory start address for user. This parameter defines the lower boundary for read / write / erase and compare jobs. Not necessary to configure. Automatically considered by the Fls script according to machine type configured.
      boolean FlsBlankCheckApi: origin=RB:1.0.0:2011-09-09, set at pre-compile  # Activation of Fls_BlankCheck API | Pre-processor switch to enable / disable the API to check for the erase pattern within a certain address area.
      boolean FlsCancelApi: set at pre-compile  # Activation of FlsCancel API | Compile switch to enable and disable the Fls_Cancel function.
      boolean FlsCompareApi: set at pre-compile  # Activation of FlsCompare API | Compile switch to enable and disable the Fls_Compare function.
      boolean FlsDevErrorDetect: set at pre-compile  # Activation of Development Error Detection mode | Pre-processor switch to enable and disable development error detection.
      integer FlsDriverIndex [0..1]: 0..254, multiplicity set at pre-compile, set at pre-compile  # The configured "Memory: Fls-Driver" can be assigned to a dedicated Fls Device-instance by selecting the related FlsDriverIndex. This is only needed if several memories shall be addressed in parallel (e.g. internal memory and external memory connected via SPI). Please note that in that case you have to use dedicated "indexed" interfaces instead of the standard Fls-interfaces Please note: not all machine-types can be assigned to different Fls Device-instances. If you do not need this feature, please keep this entry "empty". For the AUTOSAR-Standard Fls-interfaces you have to select the FlsDriverIndex=0. Note: all users assigned to the same Fls Device-instance also have to use the same FlsDriverIndex entry. If FlsDriverIndex contains a value >0 then the user has to use interfaces containing the specified driver index (naming: Fls_6_<FlsDriverIndex>_Interface) to perform all tasks. Alternatively, specific Rb−extension interfaces are available which provide an indexed access (independent of this FlsDriverIndex, see FlsRbDriverId). If FlsDriverIndex contains a value >0 then it is necessary to have another "Memory: Fls-Driver" which is assigned to FlsDriverIndex=0. Please note that this setting is enabling the multi−instance handling.
      boolean FlsGetJobResultApi: set at pre-compile  # Activation of the Fls_GetJobResult function | Compile switch to enable and disable the Fls_GetJobResult function. Please note that only 1 user for each driver-instance is allowed to have this Api activated. All other users of the same driver−instance have to use Job−notification−callback functions or the specific Fls_Rb_GetJobResultAdr−interfaces.
      boolean FlsGetStatusApi: set at pre-compile, default-value=true  # Activation of the Fls_GetStatus function | Compile switch to enable and disable the Fls_GetStatus function.
      boolean FlsRbDeInitApi [0..1]: origin=RB:1.0.0:2019-09-16, set at pre-compile  # Activation of FlsRbDeInit API | Compile switch to enable and disable the Fls_Rb_DeInit function.
      boolean FlsRbDeactivateDeviceApi [0..1]: multiplicity set at pre-compile, origin=RB:1.0.0:2011-09-09, set at pre-compile, default-value=false  # Activation of Device Deactivation API | Deactivation of Device Id feature is not supported anymore. Configuration of FlsRbDeactivateDeviceApi will be ignored by the script of Fls.
      boolean FlsRbDeviceInfoApi [0..1]: multiplicity set at pre-compile, origin=RB:15.1.0:2020-03-26, set at pre-compile  # Activation of Device Information API | Pre-processor switch to enable and disable the Fls_Rb_GetDeviceInfo function
      string FlsRbDriverId [0..1]: multiplicity set at pre-compile, origin=RB:1.0.0:2019-03-05, set at pre-compile, max-length=32, min-length=1  # FlsInterfaceName (Nick name) | Optional "Nick name" of the "Memory Fls-driver" used for the API/Interface-name generation. In case a name is given here the related API header/source is generated providing a mapping to the FlsDriverIndex. API activation are then related to this generated API-files. The name of the API−interface is defined either by the FlsDriverIndex (Fls_6_<FlsDriverIndex>.c/h) or by a dedicated name (Fls<FlsRbDriverId>.c/.h). Note: for each Fls-Device-Driver-instance this parameter is mandatory and has to be unique. Note: for each Fls-User this parameter is optional (normally it is left empty)
      integer FlsRbEquadSpiConnect [0..1]: 0..4, multiplicity set at pre-compile, origin=RB:1.0.0:2011-09-09, set at pre-compile, default-value=0  # Fls QuadSPI Communication Channel (not for Standard Spi) | Quad spi channel number Do not use for Standard Spi connected devices
      boolean FlsRbExt1HWsuspendApi [0..1]: multiplicity set at pre-compile, origin=RB:1.0.0:2019-01-27, set at pre-compile, default-value=false  # Activation of Hardware Suspend API | Hardware Suspend/Resume Feature For External Flash. (Applicable only for Ext1 Devices) Suspend API has to be enabled before enabling this Feature
      boolean FlsRbGetModeApi [0..1]: multiplicity set at pre-compile, origin=RB:1.0.0:2019-03-21, set at pre-compile, default-value=true  # Activation of the Fls_Rb_GetMode function | Compile switch to enable and disable the Fls_Rb_GetModus function.
      integer FlsRbHclk [0..1]: multiplicity set at pre-compile, origin=RB:1.0.0:2011-09-09, set at pre-compile  # CPU clock frequency [MHz] (only for V850R1x and RH850xx devices). | CPU clock frequency [MHz] that is used by the Low level driver's library for intialization of the device CPU clock frequency [MHz] that is used by the LLD for intialization of the RH850P1xC, V850R1x and RH850xx libraries. HCLK frequency values supported by RH850P1xC: 120MHz ,160MHz , 240MHz
      integer FlsRbLibRamAddr [0..1]: multiplicity set at pre-compile, origin=RB:1.0.0:2011-09-09, set at pre-compile  # RAM address required to locate Library provided by vendor(only necessary for code flash users of V850R1x). | Address required for copying the FCL code to RAM from the code flash area (applicable for boot loader programming sequence) --> Only necessary for Code Flash users of Renesas V850R1x device.
      enumeration FlsRbMachineType [0..1]: multiplicity set at pre-compile, origin=RB:1.0.0:2011-09-09, set at pre-compile  # Machine type | Controller type to be configured (might be pushed from other components). If this parameter is not available then the Machine type is extracted from other users (Memory: Fls-driver) assigned to the same FlsDriverIndex or from the Mcu module (if present). (see documentation section "Device Type Configuration" for further details). Note: for a Fls-Device-Driver-Instance this entry is manadatory. Note: for a Fls-User this entry is not required (keep empty - only needed for one user per device-driver)
        FLS_RB_IFX_UC1_TC23X  # IFX TC23X/Dev1 Production
        MCU_RB_IFX_UC1_DEV2  # IFX Dev2 Production Device
        MCU_RB_IFX_UC1_DEV2_B  # IFX Dev2(B Silicon) Production Device
        MCU_RB_IFX_UC1_DEV3  # IFX Dev3 Production Device
        MCU_RB_IFX_UC1_DEV3_C  # IFX Dev3 (C Silicon)Production Device
        MCU_RB_IFX_UC1_DEV3_D  # IFX Dev3 (D Silicon)Production Device
        MCU_RB_IFX_UC1_DEV3_HSM  # IFX Dev3 (D Silicon) Production Device HSM
        MCU_RB_IFX_UC1_DEV4  # IFX Dev4 Production Device
        MCU_RB_IFX_UC1_DEV4_B  # IFX Dev4(B Silicon) Production Device
        MCU_RB_IFX_UC1_DEV4_HSM  # IFX Dev4 (B Silicon) Production Device HSM
        MCU_RB_IFX_ADAS_TC357TA_A  # IFX Dev M(TC357TA_A) 40nm Production Device
        MCU_RB_IFX_UC1_DEV{3..5}_40NM_A  # IFX Dev {3..5} 40nm(A Silicon) Production Device
        MCU_RB_IFX_UC1_DEV5_40NM_B  # IFX Dev 5 40nm(B Silicon) Production Device
        MCU_RB_IFX_UC1_DEV5_40NM_HSM  # IFX Dev 5 40nm HSM Production Device
        MCU_RB_IFX_ADAS_TC397QA_B  # IFX Dev 5 (TC397QA_B) Production Device
        FLS_RB_IFX_TC3EX_40NM_CMPL  # IFX Dev4 EVO(TC3EX) 40nm, Complementary Mode
        FLS_RB_IFX_TC3EX_40NM_SE  # IFX Dev4 EVO(TC3EX) 40nm, Single Ended Mode
        FLS_RB_IFX_TC35X_40NM_CMPL  # IFX Dev M(TC35X) 40nm, Complementary Mode
        FLS_RB_IFX_TC35X_40NM_SE  # IFX Dev M(TC35X) 40nm, Single Ended Mode
        FLS_RB_IFX_TC33X_40NM_CMPL  # IFX Dev S(TC33X) 40nm, Complementary Mode
        FLS_RB_IFX_TC33X_40NM_SE  # IFX Dev S(TC33X) 40nm, Single Ended Mode
        FLS_RB_IFX_TC38x_40NM_CMPL  # IFX Dev3(TC38x) 40nm, Complemtary Mode
        FLS_RB_IFX_TC38x_40NM_SE  # IFX Dev3(TC38x) 40nm, Single Ended Mode
        FLS_RB_IFX_TC38X_40NM_CMPL  # IFX Dev4(TC38X) 40nm, Complementary Mode
        FLS_RB_IFX_TC38X_40NM_SE  # IFX Dev4(TC38X) 40nm, Single Ended Mode
        FLS_RB_IFX_TC39X_40NM_CMPL  # IFX Dev5(TC39X) 40nm, Complementary Mode
        FLS_RB_IFX_TC39X_40NM_SE  # IFX Dev5(TC39X) 40nm, Single Ended Mode
        FLS_RB_IFX_40NM_SE_HSM  # IFX Aurix2 (TC3Ex,TC33x,TC35x,TC38x,TC38x,TC39x) 40nm, Single Ended HSM
        FLS_RB_IFX_40NM_CMPL_HSM  # IFX Aurix2 (TC3Ex,TC33x,TC35x,TC38x,TC38x,TC39x) 40nm, Complementary HSM
        MCU_RB_JDP_UC1_DEV1  # JDP Dev1 Production Device
        MCU_RB_JDP_UC1_DEV2_C2  # JDP Dev2 (Cut 2) Production Device
        MCU_RB_JDP_UC1_DEV3_C2  # JDP Dev3 (Cut 2) Production Device
        MCU_RB_JDP_UC1_DEV3_HSM  # JDP Dev3 (Cut 2) Production Device HSM
        MCU_RB_JDP_UC1_DEV4_C2  # JDP Dev4 (Cut 2) Production Device
        MCU_RB_JDP_UC1_DEV4_HSM  # JDP Dev4 (Cut 2) Production Device HSM
        MCU_RB_ST_UC1_DEV3_40NM_C3_HSM_  # ST Dev3 Plus HSM for JDP/Bernina
        MCU_RB_ST_UC1_DEV3_40NM_C3  # ST Dev3 Plus C3
        MCU_RB_ST_UC1_DEV3_40NM_C3_2  # ST Dev3 Plus Bernina
        FLS_RB_ST_STELLAR_16M_C1  # ST Centauri 16M
        FLS_RB_ST_STELLAR_16M_C1_HSM  # ST Centauri 16M With HSM
        MCU_RB_ST_CHORUS_1M_C1  # ST Chorus 1M C1
        MCU_RB_ST_CHORUS_2M_C1  # ST Chorus 2M C1
        MCU_RB_ST_CHORUS_4M_C1  # ST Chorus 4M C1
        MCU_RB_ST_CHORUS_4M_HSM  # ST Chorus 4M HSM
        FLS_RB_ST_CHORUS_6M  # ST Chorus 6M
        FLS_RB_ST_CHORUS_6M_HSM  # ST Chorus 6M HSM
        FLS_RB_ST_CHORUS_10M  # ST Chorus 10M
        FLS_RB_ST_CHORUS_10M_HSM  # ST Chorus 10M HSM
        MCU_RB_V850R1X_512K  # Renesas V850R1x with 512Kb Code Flash
        MCU_RB_V850R1X_512K_REDUCED  # Renesas V850R1x with 512Kb Code Flash reduced by Crash Data
        MCU_RB_V850R1X_1M  # Renesas V850R1x with 1Mb Code Flash
        MCU_RB_V850R1X_1M_REDUCED  # Renesas V850R1x with 1Mb Code Flash reduced by Crash Data
        FLS_RB_RH850_F1KM_S1  # Renesas RH850F1KM S1 variant
        FLS_RB_RH850_F1KM_S4  # Renesas RH850F1KM S4 variant
        MCU_RB_RH850_F1M_CF3M_DF64K  # Renesas RH850F1M variant
        MCU_RB_RH850_F1M_CF3M_DF62_2K_REDUCED  # Renesas RH850F1M variant with 2kB Crashdata
        MCU_RB_RH850_F1M_CF3M_DF60_4K_REDUCED  # Renesas RH850F1M variant with 4kB Crashdata
        FLS_RB_RH850P1M_1MB  # Renesas P1M variant 1MB
        MCU_RB_REN_RH850_P1LC_D1  # Renesas RH850/P1LC D1(eVR) LQFP100 (R7F701341EAFP)
        MCU_RB_REN_RH850_P1LC_D2  # Renesas RH850/P1LC D2(eVR) LQFP144 (R7F701337EAFP)
        MCU_RB_RH850P1XC_DEV3  # Renesas RH850P1x Dev3
        MCU_RB_RH850P1XC_DEV3_REDUCED  # Renesas RH850P1x Dev3 reduced by Crash Data
        MCU_RB_RH850P1XC_DEV3_6S  # Renesas RH850P1x Dev3 6 sectors
        MCU_RB_RH850P1XC_DEV3_REDUCED_6S  # Renesas RH850P1x Dev3 6 sectors reduced by Crash Data
        FLS_RB_RH850P1XC_DEV3_9K4S_24KC  # Renesas RH850P1x Dev3 4 sectors reduced by 24K Crash Data
        MCU_RB_RH850P1XC_DEV3_HSM  # Renesas RH850P1x Dev3 with HSM active
        MCU_RB_RH850P1XC_DEV4  # Renesas RH850P1x Dev4
        MCU_RB_RH850P1XC_DEV4_REDUCED  # Renesas RH850P1x Dev4 reduced by Crash Data
        MCU_RB_RH850P1XC_DEV4_HSM  # Renesas RH850P1x Dev4 with HSM active
        MCU_RB_RH850P1XC_DEV5  # Renesas RH850P1x Dev5
        MCU_RB_RH850P1XC_DEV5_REDUCED  # Renesas RH850P1x Dev5 reduced by Crash Data
        MCU_RB_RH850P1XC_DEV5_HSM  # Renesas RH850P1x Dev5 with HSM active
        FLS_RB_RH850U2A16  # Renesas RH850U2A16
        FLS_RB_RH850U2A16_HSM  # Renesas RH850U2A16 HSM
        FLS_RB_RCAR_S26XX512S  # RCAR with Cypress HyperFlash 64MB (S26XX512S)
        FLS_RB_ZYNQ_MT25QU02G  # Zynq ultrascale with Micron flash 256MB (MT25QU02G)
        FLS_RB_ZYNQ_S70FS01GS  # Zynq Ultrascale with Cypress Flash 128MB (S70FS01GS)
        FLS_RB_RCAR_S70FS01GS  # RCAR with Cypress 128MB(S70FS01GS)
        FLS_RB_RCAR_S70FS01GS_HSM_  # RCAR with Cypress 128MB(S70FS01GS with HSM)
        FLS_RB_ZYNQ_S25FS512S  # Zynq Ultrascale with Cypress Flash 64MB (S25FS512S)
        FLS_RB_ZYNQ_W25Q128JV  # Zynq Ultrascale with Winbond Flash 16MB (W25Q128JV)
        FLS_RB_ZYNQ_W25Q256JV  # Zynq Ultrascale with Winbond Flash 32MB (W25Q256JV)
        FLS_RB_RCAR_S25FS512  # RCAR with Cypress Flash 64 MB (S25FS512S)
        FLS_RB_RCAR_S25FS512_HSM_  # RCAR with Cypress Flash 64 MB (S25FS512S with HSM)
        FLS_RB_RCAR_W25Q64FW  # RCAR with Winbond Flash 8 MB (W25Q64FW)
        FLS_RB_RCAR_W25Q128FW  # RCAR with Winbond Flash 16 MB (W25Q128FW)
        RBA_FLS_TC39XX_64MB  # Standard SPI-connected Flash (auto-detected)
        RBA_FLS_EXT1_ECC_16MB  # Standard SPI-Connected Flash for ECC
        MCU_RB_PC  # PC-based simulation environment 6 sectors each 64kB and 8B pages
        MCU_RB_PC_16B  # PC-based simulation environment 6 sectors each 64kB and 16B pages
        MCU_RB_PC_4SEC_64KB  # PC-based simulation environment 4 sectors each 64kB and 8B pages
        MCU_RB_PC_4SEC_256KB  # PC-based simulation environment 4 sectors each 256kB
        MCU_RB_PC_6SEC_128KB  # PC-based simulation environment 6 sectors each 128kB and 8B pages
        MCU_RB_PC_8SEC_8KB  # PC-based simulation environment 8 sectors each 8kB and 8B pages
        MCU_RB_PC_8SEC_16KB  # PC-based simulation environment 8 sectors each 16kB and 8B pages
        MCU_RB_PC_8SEC_32KB  # PC-based simulation environment 8 sectors each 32kB and 8B pages
        MCU_RB_PC_8SEC_64KB  # PC-based simulation environment 8 sectors each 64kB and 8B pages
        RBA_FLS_PC_8SEC_64KB_16B  # PC-based simulation environment 8 sectors each 64kB and 16B pages
      enumeration FlsRbMachineTypeForced [0..1]: multiplicity set at pre-compile, origin=RB:1.0.0:2011-09-09, set at pre-compile  # Machine type (forced) | Controller type - selected with a higher priority than then FlsRbMachineType. Necessary to overwrite a pushed unprecise or wrong settings from other components. Note: normally this parameter is not necessary and shall left empty.
        FLS_RB_IFX_UC1_TC23X  # IFX TC23X/Dev1 Production
        MCU_RB_IFX_UC1_DEV2  # IFX Dev2 Production Device
        MCU_RB_IFX_UC1_DEV2_B  # IFX Dev2(B Silicon) Production Device
        MCU_RB_IFX_UC1_DEV3  # IFX Dev3 Production Device
        MCU_RB_IFX_UC1_DEV3_C  # IFX Dev3 (C Silicon)Production Device
        MCU_RB_IFX_UC1_DEV3_D  # IFX Dev3 (D Silicon)Production Device
        MCU_RB_IFX_UC1_DEV3_HSM  # IFX Dev3 (D Silicon) Production Device HSM
        MCU_RB_IFX_UC1_DEV4  # IFX Dev4 Production Device
        MCU_RB_IFX_UC1_DEV4_B  # IFX Dev4(B Silicon) Production Device
        MCU_RB_IFX_UC1_DEV4_HSM  # IFX Dev4 (B Silicon) Production Device HSM
        MCU_RB_IFX_ADAS_TC357TA_A  # IFX Dev M(TC357TA_A) 40nm Production Device
        MCU_RB_IFX_UC1_DEV{3..5}_40NM_A  # IFX Dev {3..5} 40nm(A Silicon) Production Device
        MCU_RB_IFX_UC1_DEV5_40NM_B  # IFX Dev 5 40nm(B Silicon) Production Device
        MCU_RB_IFX_UC1_DEV5_40NM_HSM  # IFX Dev 5 40nm HSM Production Device
        MCU_RB_IFX_ADAS_TC397QA_B  # IFX Dev 5 (TC397QA_B) Production Device
        FLS_RB_IFX_TC3EX_40NM_CMPL  # IFX Dev4 EVO(TC3EX) 40nm, Complementary Mode
        FLS_RB_IFX_TC3EX_40NM_SE  # IFX Dev4 EVO(TC3EX) 40nm, Single Ended Mode
        FLS_RB_IFX_TC35X_40NM_CMPL  # IFX Dev M(TC35X) 40nm, Complementary Mode
        FLS_RB_IFX_TC35X_40NM_SE  # IFX Dev M(TC35X) 40nm, Single Ended Mode
        FLS_RB_IFX_TC33X_40NM_CMPL  # IFX Dev S(TC33X) 40nm, Complementary Mode
        FLS_RB_IFX_TC33X_40NM_SE  # IFX Dev S(TC33X) 40nm, Single Ended Mode
        FLS_RB_IFX_TC38x_40NM_CMPL  # IFX Dev3(TC38x) 40nm, Complemtary Mode
        FLS_RB_IFX_TC38x_40NM_SE  # IFX Dev3(TC38x) 40nm, Single Ended Mode
        FLS_RB_IFX_TC38X_40NM_CMPL  # IFX Dev4(TC38X) 40nm, Complementary Mode
        FLS_RB_IFX_TC38X_40NM_SE  # IFX Dev4(TC38X) 40nm, Single Ended Mode
        FLS_RB_IFX_TC39X_40NM_CMPL  # IFX Dev5(TC39X) 40nm, Complementary Mode
        FLS_RB_IFX_TC39X_40NM_SE  # IFX Dev5(TC39X) 40nm, Single Ended Mode
        FLS_RB_IFX_40NM_SE_HSM  # IFX Aurix2 (TC3Ex,TC33x,TC35x,TC38x,TC38x,TC39x) 40nm, Single Ended HSM
        FLS_RB_IFX_40NM_CMPL_HSM  # IFX Aurix2 (TC3Ex,TC33x,TC35x,TC38x,TC38x,TC39x) 40nm, Complementary HSM
        MCU_RB_JDP_UC1_DEV1  # JDP Dev1 Production Device
        MCU_RB_JDP_UC1_DEV2_C2  # JDP Dev2 (Cut 2) Production Device
        MCU_RB_JDP_UC1_DEV3_C2  # JDP Dev3 (Cut 2) Production Device
        MCU_RB_JDP_UC1_DEV3_HSM  # JDP Dev3 (Cut 2) Production Device HSM
        MCU_RB_JDP_UC1_DEV4_C2  # JDP Dev4 (Cut 2) Production Device
        MCU_RB_JDP_UC1_DEV4_HSM  # JDP Dev4 (Cut 2) Production Device HSM
        MCU_RB_ST_UC1_DEV3_40NM_C3_HSM_  # ST Dev3 Plus HSM for JDP/Bernina
        MCU_RB_ST_UC1_DEV3_40NM_C3  # ST Dev3 Plus C3
        MCU_RB_ST_UC1_DEV3_40NM_C3_2  # ST Dev3 Plus Bernina
        FLS_RB_ST_STELLAR_16M_C1  # ST Centauri 16M
        FLS_RB_ST_STELLAR_16M_C1_HSM  # ST Centauri 16M With HSM
        MCU_RB_ST_CHORUS_1M_C1  # ST Chorus 1M C1
        MCU_RB_ST_CHORUS_2M_C1  # ST Chorus 2M C1
        MCU_RB_ST_CHORUS_4M_C1  # ST Chorus 4M C1
        MCU_RB_ST_CHORUS_4M_HSM  # ST Chorus 4M HSM
        FLS_RB_ST_CHORUS_6M  # ST Chorus 6M
        FLS_RB_ST_CHORUS_6M_HSM  # ST Chorus 6M HSM
        FLS_RB_ST_CHORUS_10M  # ST Chorus 10M
        FLS_RB_ST_CHORUS_10M_HSM  # ST Chorus 10M HSM
        MCU_RB_V850R1X_512K  # Renesas V850R1x with 512Kb Code Flash
        MCU_RB_V850R1X_512K_REDUCED  # Renesas V850R1x with 512Kb Code Flash reduced by Crash Data
        MCU_RB_V850R1X_1M  # Renesas V850R1x with 1Mb Code Flash
        MCU_RB_V850R1X_1M_REDUCED  # Renesas V850R1x with 1Mb Code Flash reduced by Crash Data
        FLS_RB_RH850_F1KM_S1  # Renesas RH850F1KM S1 variant
        FLS_RB_RH850_F1KM_S4  # Renesas RH850F1KM S4 variant
        MCU_RB_RH850_F1M_CF3M_DF64K  # Renesas RH850F1M variant
        MCU_RB_RH850_F1M_CF3M_DF62_2K_REDUCED  # Renesas RH850F1M variant with 2kB Crashdata
        MCU_RB_RH850_F1M_CF3M_DF60_4K_REDUCED  # Renesas RH850F1M variant with 4kB Crashdata
        FLS_RB_RH850P1M_1MB  # Renesas P1M variant 1MB
        MCU_RB_REN_RH850_P1LC_D1  # Renesas RH850/P1LC D1(eVR) LQFP100 (R7F701341EAFP)
        MCU_RB_REN_RH850_P1LC_D2  # Renesas RH850/P1LC D2(eVR) LQFP144 (R7F701337EAFP)
        MCU_RB_RH850P1XC_DEV3  # Renesas RH850P1x Dev3
        MCU_RB_RH850P1XC_DEV3_REDUCED  # Renesas RH850P1x Dev3 reduced by Crash Data
        MCU_RB_RH850P1XC_DEV3_6S  # Renesas RH850P1x Dev3 6 sectors
        MCU_RB_RH850P1XC_DEV3_REDUCED_6S  # Renesas RH850P1x Dev3 6 sectors reduced by Crash Data
        FLS_RB_RH850P1XC_DEV3_9K4S_24KC  # Renesas RH850P1x Dev3 4 sectors reduced by 24K Crash Data
        MCU_RB_RH850P1XC_DEV3_HSM  # Renesas RH850P1x Dev3 with HSM active
        MCU_RB_RH850P1XC_DEV4  # Renesas RH850P1x Dev4
        MCU_RB_RH850P1XC_DEV4_REDUCED  # Renesas RH850P1x Dev4 reduced by Crash Data
        MCU_RB_RH850P1XC_DEV4_HSM  # Renesas RH850P1x Dev4 with HSM active
        MCU_RB_RH850P1XC_DEV5  # Renesas RH850P1x Dev5
        MCU_RB_RH850P1XC_DEV5_REDUCED  # Renesas RH850P1x Dev5 reduced by Crash Data
        MCU_RB_RH850P1XC_DEV5_HSM  # Renesas RH850P1x Dev5 with HSM active
        FLS_RB_RH850U2A16  # Renesas RH850U2A16
        FLS_RB_RH850U2A16_HSM  # Renesas RH850U2A16 HSM
        FLS_RB_RCAR_S26XX512S  # RCAR with Cypress HyperFlash 64MB (S26XX512S)
        FLS_RB_ZYNQ_MT25QU02G  # Zynq ultrascale with Micron flash 256MB (MT25QU02G)
        FLS_RB_ZYNQ_S70FS01GS  # Zynq Ultrascale with Cypress Flash 128MB (S70FS01GS)
        FLS_RB_RCAR_S70FS01GS  # RCAR with Cypress 128MB(S70FS01GS)
        FLS_RB_RCAR_S70FS01GS_HSM_  # RCAR with Cypress 128MB(S70FS01GS with HSM)
        FLS_RB_ZYNQ_S25FS512S  # Zynq Ultrascale with Cypress Flash 64MB (S25FS512S)
        FLS_RB_ZYNQ_W25Q128JV  # Zynq Ultrascale with Winbond Flash 16MB (W25Q128JV)
        FLS_RB_ZYNQ_W25Q256JV  # Zynq Ultrascale with Winbond Flash 32MB (W25Q256JV)
        FLS_RB_RCAR_S25FS512  # RCAR with Cypress Flash 64 MB (S25FS512S)
        FLS_RB_RCAR_S25FS512_HSM_  # RCAR with Cypress Flash 64 MB (S25FS512S with HSM)
        FLS_RB_RCAR_W25Q64FW  # RCAR with Winbond Flash 8 MB (W25Q64FW)
        FLS_RB_RCAR_W25Q128FW  # RCAR with Winbond Flash 16 MB (W25Q128FW)
        RBA_FLS_TC39XX_64MB  # Standard SPI-connected Flash (auto-detected)
        RBA_FLS_EXT1_ECC_16MB  # Standard SPI-Connected Flash for ECC
        MCU_RB_PC  # PC-based simulation environment 6 sectors each 64kB and 8B pages
        MCU_RB_PC_16B  # PC-based simulation environment 6 sectors each 64kB and 16B pages
        MCU_RB_PC_4SEC_64KB  # PC-based simulation environment 4 sectors each 64kB and 8B pages
        MCU_RB_PC_4SEC_256KB  # PC-based simulation environment 4 sectors each 256kB
        MCU_RB_PC_6SEC_128KB  # PC-based simulation environment 6 sectors each 128kB and 8B pages
        MCU_RB_PC_8SEC_8KB  # PC-based simulation environment 8 sectors each 8kB and 8B pages
        MCU_RB_PC_8SEC_16KB  # PC-based simulation environment 8 sectors each 16kB and 8B pages
        MCU_RB_PC_8SEC_32KB  # PC-based simulation environment 8 sectors each 32kB and 8B pages
        MCU_RB_PC_8SEC_64KB  # PC-based simulation environment 8 sectors each 64kB and 8B pages
        RBA_FLS_PC_8SEC_64KB_16B  # PC-based simulation environment 8 sectors each 64kB and 16B pages
      boolean FlsRbP1xSupportFACI1 [0..1]: multiplicity set at pre-compile, origin=RB:1.0.0:2018-12-11, set at pre-compile  # Support of FACI1 for P1xC Device(only for RH850P1x devices). | Compiler Switch to Enable the Support of FACI1 for RH850P1xC device. Configure this parameter as True to access Bank B code Flash for device (D3, D4 and D5) of RH850P1xC.
      boolean FlsRbP1xSupportOlderDevice [0..1]: multiplicity set at pre-compile, origin=RB:1.0.0:2011-09-09, set at pre-compile  # Support P1x Dev5EDv1 device and P1x Dev4v1 device(only for RH850P1x devices). | Compile Switch to Enable the Support for P1x Dev5EDV1 device and P1x Dev4V1 Device (only necessary for RH850P1x devices).Configure this parameter as True while using P1x Dev5EDV1 and P1x Dev4V1 controllers.
      float FlsRbPageWriteTime [0..1]: 0.0001..0.01, multiplicity set at pre-compile, origin=RB:1.0.0:2019-08-20, set at pre-compile  # Timeout value (in s) for reference page write | Timeout value (in s) for one (1) reference page write operation. This parameter is needed to determine the volume dependent timeout part. This timeout duration is calculated as: FlsRbPageWriteTime * bytes-to-be-programmed / Ref-page-Size
      boolean FlsRbPowerModeApi [0..1]: multiplicity set at pre-compile, origin=RB:1.0.0:2018-10-19, set at pre-compile  # Activation of Fls_PowerMode API | Compile Switch to enable and disable the Deep Power Mode Function in External Flash.
      float FlsRbSectorEraseTime [0..1]: 0.01..10, multiplicity set at pre-compile, origin=RB:1.0.0:2019-08-20, set at pre-compile  # Timeout value (in s) for reference sector erase | Timeout value (in s) for one (1) reference sector erase operation. This parameter is needed to determine the volume dependent timeout part. This timeout duration is calculated as: FlsRbSectorEraseTime * bytes-in-Sectors / Ref-sector-size
      boolean FlsRbSetModeApi [0..1]: multiplicity set at pre-compile, origin=RB:1.0.0:2019-03-21, set at pre-compile  # Activation of the Fls_RbSetMode function | Compile switch to enable and disable the Fls_Rb_SetMode function. This is a replacement of Fls_SetMode also working if the Fls is busy.
      boolean FlsRbSuspendApi [0..1]: multiplicity set at pre-compile, origin=RB:1.0.0:2011-09-09, set at pre-compile  # Activation of the Suspend/Resume feature | Pre-processor switch to enable / disable the suspend/resume feature (only possible for certain devices).
      boolean FlsRbSyncErase [0..1]: multiplicity set at pre-compile, origin=RB:1.0.0:2018-11-13, set at pre-compile  # Activation of Sync Erase Function | This Function implements erase operation Synchronously
      boolean FlsRbSyncRead [0..1]: multiplicity set at pre-compile, origin=RB:1.0.0:2018-11-13, set at pre-compile  # Activation of Sync Read Function | This Function implements read ,blank check and compare operation Synchronously
      boolean FlsRbSyncWrite [0..1]: multiplicity set at pre-compile, origin=RB:1.0.0:2018-11-13, set at pre-compile  # Activation of Sync Write Function | Pre−processor switch to enable /disable Synchronous Mode for Write operation. Disabling this API will turn Write operation to Asynchronous Mode.
      float FlsRbTimeoutReqAcceptance [0..1]: 0..100, multiplicity set at pre-compile, origin=RB:1.0.0:2019-08-20, set at pre-compile  # Timeout value (in s) for request acceptance | Timeout duration (in seconds) to needed by the hardware / lower layer to accept the request placed by the flash driver. Note: This parameter might be influences by HSM/Host interaction
      float FlsRbTimeoutSupervisionOffset [0..1]: 0..100, multiplicity set at pre-compile, origin=RB:1.0.0:2019-08-14, set at pre-compile  # Timeout value offset (in s) for communication overhead | Duration (in seconds) needed for SPI/DMA etc. to process the accepted job. This configured timeing value will added to the volume depending flash processing time for the timeout supervision. Needed to consider the SPI channel load configured for the Flash device. Recommended: mandatory for external flashes if timeout supervision used.
      boolean FlsRbWriteSectorAlignedApi [0..1]: origin=RB:1.0.0:2019-11-29, set at pre-compile  # Activation of Fls_Rb_WriteSectorAligned | Pre-processor switch to enable / disable the API for writing sector aligned
      boolean FlsReadApi [0..1]: multiplicity set at pre-compile, origin=RB:1.0.0:2019-03-21, set at pre-compile, default-value=true  # Activation of FlsRead API | Compiler switch to enable and disable the Fls_Read function (only in exceptional cases)
      integer FlsSPIBufferSize [0..1]: 0..2048, multiplicity set at pre-compile, origin=RB:1.0.0:2018-10-31, set at pre-compile, default-value=261  # Fls SPI Buffer Size | Length of Transmission and reception buffer for SPI (shall be >=261)
      boolean FlsSetModeApi: multiplicity set at pre-compile, set at pre-compile, default-value=false  # Activation of the Fls_SetMode function | Compile switch to enable and disable the Fls_SetMode function. It is recommended to use the Fls_Rb_SetMode function instead as this is working also in BUSY-states. If you use Fls_SetMode the call is only accepted in IDLE state!
      boolean FlsTimeoutSupervisionEnabled [0..1]: multiplicity set at pre-compile, set at pre-compile  # Activation of Timeout Supervision | Compile switch to enable timeout supervision for the device. true: timeout supervision for read/erase/write/compare jobs enabled. false: timeout supervision for read/erase/write/compare jobs disabled.
      integer FlsTotalSize [0..1]: 0..4294967295, multiplicity set at pre-compile, set at pre-compile  # Amount of flash memory bytes | The total amount of flash memory in bytes (This parameter in conjunction with FLS_BASE_ADDRESS defines the upper boundary for read / write / erase and compare jobs). Not necessary to configure this tag anymore as the information of total size of configured sectors will be automatically computed and considered by the Fls script based on user configuration.
      boolean FlsUseInterrupts [0..1]: set at pre-compile, default-value=false  # Job processing triggered by hardware interrupt. | true: Job processing triggered by interrupt (hardware controlled). false: Job processing not triggered by interrupt (software controlled)
      boolean FlsVersionInfoApi: set at pre-compile, default-value=true  # Activation of FlsVersionInfo API | Pre-processor switch to enable / disable the API to read out the modules version information.
    container FlsPublishedInformation  # Additional published parameters not covered by CommonPublishedInformation container.
      integer FlsAcLocationErase [0..0]: 0..4294967295, set at published-information  # Position in RAM, to which the erase flash access code has to be loaded. | Only relevant if the erase flash access code is not position independent. If this information is not provided it is assumed that the erase flash access code is position independent and that therefore the RAM position can be freely configured.
      integer FlsAcLocationWrite [0..0]: 0..4294967295, set at published-information  # Position in RAM, to which the write flash access code has to be loaded. | Only relevant if the write flash access code is not position independent. If this information is not provided it is assumed that the write flash access code is position independent and that therefore the RAM position can be freely configured.
      integer FlsAcSizeErase [0..0]: 0..4294967295, set at published-information  # Number of bytes in RAM needed for the erase flash access code.
      integer FlsAcSizeWrite [0..0]: 0..4294967295, set at published-information  # Number of bytes in RAM needed for the write flash access code.
      float FlsEraseTime [0..0]: set at published-information  # Maximum time to erase one complete flash sector. (in seconds)
      integer FlsErasedValue [0..1]: 0..4294967295, multiplicity set at pre-compile, set at pre-compile  # Erase pattern | The contents of an erased flash memory cell.
      string FlsExpectedHwId [0..0]: set at published-information  # Unique identifier of the hardware device that is expected by this driver (the device for which this driver has been implemented). | Only relevant for external flash drivers.
      integer FlsSpecifiedEraseCycles [0..1]: 0..4294967295, multiplicity set at pre-compile, set at pre-compile  # Maximum erase cycles | Number of erase cycles specified for the flash device (usually given in the device data sheet). If the number of specified erase cycles depends on the operating environment (temperature, voltage, ...) during reprogramming of the flash device, the minimum number for which a data retention of atleast 15 years over the temperature range from -40°C .. +125°C can be guaranteed shall be given. Fls will ignore the configuration of this tag as it is not considered for any purpose, hence it is not necessary to configure this tag any more!
      float FlsWriteTime [0..0]: set at pre-compile  # Maximum page programming time | Maximum time to program one complete flash page. (in seconds)
