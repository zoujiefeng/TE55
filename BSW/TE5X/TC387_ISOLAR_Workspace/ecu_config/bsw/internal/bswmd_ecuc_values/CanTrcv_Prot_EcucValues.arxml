AUTOSAR XML (schema 4-2-2)
package /RB/UBK/Project/EcucModuleConfigurationValuess
  module config rba_ArxmlGen
    CanTrcv (rba_ArxmlGen_Comp):
      rba_ArxmlGen_CompCategory = BswModule
      rba_ArxmlGen_CompId = 70
      rba_ArxmlGen_CompIsConfigurable = true
      rba_ArxmlGen_CompIsStandalone = false
      rba_ArxmlGen_CompIsStandardized = true
      rba_ArxmlGen_CompLongName = Can Transceiver
      rba_ArxmlGen_CompVersionAr = 4.2.2
      CE_CanTrcv_Init (rba_ArxmlGen_ExecEntity): rba_ArxmlGen_ExecEntityCategory=Called, rba_ArxmlGen_ExecEntityImplEntryRef=CanTrcv_Init
      7 x rba_ArxmlGen_Memsection:
        CANTRCV_START_SEC_CONST_8: rba_ArxmlGen_MemsectionDatatype_08=true, rba_ArxmlGen_MemsectionDatatype_UNSPECIFIED=true, rba_ArxmlGen_MemsectionAddrMethodRef=CONST
        CANTRCV_START_SEC_CONFIG_DATA_UNSPECIFIED: rba_ArxmlGen_MemsectionDatatype_08=true, rba_ArxmlGen_MemsectionDatatype_16=true, rba_ArxmlGen_MemsectionDatatype_UNSPECIFIED=true, rba_ArxmlGen_MemsectionAddrMethodRef=CONFIG_DATA
        CANTRCV_START_SEC_CONFIG_DATA_POSTBUILD_HEADER: rba_ArxmlGen_MemsectionAddrMethodRef=CONFIG_DATA_POSTBUILD_HEADER
        CANTRCV_START_SEC_CONFIG_DATA_POSTBUILD_UNSPECIFIED: rba_ArxmlGen_MemsectionDatatype_UNSPECIFIED=true, rba_ArxmlGen_MemsectionAddrMethodRef=CONFIG_DATA_POSTBUILD
        CANTRCV_START_SEC_VAR_CLEARED: rba_ArxmlGen_MemsectionDatatype_08=true, rba_ArxmlGen_MemsectionDatatype_16=true, rba_ArxmlGen_MemsectionDatatype_32=true, rba_ArxmlGen_MemsectionDatatype_UNSPECIFIED=true, rba_ArxmlGen_MemsectionAddrMethodRef=VAR_CLEARED
        CANTRCV_START_SEC_VAR_INIT_BOOLEAN: rba_ArxmlGen_MemsectionDatatype_UNSPECIFIED=true, rba_ArxmlGen_MemsectionAddrMethodRef=VAR_INIT
        CANTRCV_START_SEC_CODE: rba_ArxmlGen_MemsectionAddrMethodRef=CODE
