AUTOSAR XML (schema 00047)
package /ETAS_Project/EcucModuleConfigurationValuess
  module config EcuM
    EcuMConfiguration_0 (EcuMConfiguration)
      EcuMCommonConfiguration: EcuMDefaultAppMode=OSDEFAULTAPPMODE
        EcuMDefaultShutdownTarget: EcuMDefaultState=EcuMStateOff, EcuMDefaultResetModeRef=ECUM_RESET_MCU
        5 x EcuMWakeupSource, all with EcuMValidationTimeout=0.0:
          ECUM_WKSOURCE_POWER: EcuMWakeupSourceId=0
          ECUM_WKSOURCE_RESET: EcuMWakeupSourceId=1
          ECUM_WKSOURCE_INTERNAL_RESET: EcuMWakeupSourceId=2
          ECUM_WKSOURCE_INTERNAL_WDG: EcuMWakeupSourceId=3
          ECUM_WKSOURCE_EXTERNAL_WDG: EcuMWakeupSourceId=4
        EcuMDriverInitListOne
          24 x EcuMDriverInitItem:
            Os_core0: EcuMModuleID=VectorTable_Core0, EcuMModuleParameter=VOID, EcuMModuleService=Init, EcuMRbDriverInitCoreId=0
            Os_core1: EcuMModuleID=VectorTable_Core1, EcuMModuleParameter=VOID, EcuMModuleService=Init, EcuMRbDriverInitCoreId=1
            ADC_Core1: EcuMModuleID=Adc, EcuMModuleParameter=POSTBUILD_PTR, EcuMModuleService=Init, EcuMRbDriverInitCoreId=1
            CddModuleInitCore1: EcuMModuleID=McuFunc, EcuMModuleParameter=VOID, EcuMModuleService=vidCddModuleInitCore1, EcuMRbDriverInitCoreId=1
            Os_core2: EcuMModuleID=VectorTable_Core2, EcuMModuleParameter=VOID, EcuMModuleService=Init, EcuMRbDriverInitCoreId=2
            ADC_Core2: EcuMModuleID=Adc, EcuMModuleParameter=POSTBUILD_PTR, EcuMModuleService=Init, EcuMRbDriverInitCoreId=2
            CddModuleInitCore2: EcuMModuleID=McuFunc, EcuMModuleService=vidCddModuleInitCore2, EcuMModuleParameter=VOID, EcuMRbDriverInitCoreId=2
            Os_core3: EcuMModuleID=VectorTable_Core3, EcuMModuleParameter=VOID, EcuMModuleService=Init, EcuMRbDriverInitCoreId=3
            ADC_Core3: EcuMModuleID=Adc, EcuMModuleParameter=POSTBUILD_PTR, EcuMModuleService=Init, EcuMRbDriverInitCoreId=3
            CddModuleInitCore3: EcuMModuleID=McuFunc, EcuMModuleService=vidCddModuleInitCore3, EcuMModuleParameter=VOID, EcuMRbDriverInitCoreId=3
            Det_StartupCore: EcuMModuleID=Det, EcuMModuleParameter=NULL_PTR, EcuMModuleService=Init
            Dem_PreInit_StartupCore: EcuMModuleID=Dem, EcuMModuleParameter=NULL_PTR, EcuMModuleService=PreInit
            Mcu_StartupCore: EcuMModuleID=Mcu, EcuMModuleParameter=POSTBUILD_PTR, EcuMModuleService=Init
            McuFunc_StartupCore: EcuMModuleID=McuFunc, EcuMModuleParameter=VOID, EcuMModuleService=InitializeClock
            Gpt_StartupCore: EcuMModuleID=Gpt, EcuMModuleParameter=POSTBUILD_PTR, EcuMModuleService=Init
            Port_StartupCore: EcuMModuleID=Port, EcuMModuleParameter=POSTBUILD_PTR, EcuMModuleService=Init
            Adc_StartupCore: EcuMModuleID=Adc, EcuMModuleParameter=POSTBUILD_PTR, EcuMModuleService=Init
            Pwm_StartupCore: EcuMModuleID=Pwm_17_GtmCcu6, EcuMModuleParameter=POSTBUILD_PTR, EcuMModuleService=Init
            Icu_StartupCore: EcuMModuleID=Icu_17_TimerIp, EcuMModuleService=Init, EcuMModuleParameter=POSTBUILD_PTR
            Fls_StartupCore: EcuMModuleID=Fls, EcuMModuleParameter=POSTBUILD_PTR, EcuMModuleService=Init
            Spi_StartupCore: EcuMModuleID=Spi, EcuMModuleParameter=POSTBUILD_PTR, EcuMModuleService=Init
            I2c_StartupCore: EcuMModuleID=I2c, EcuMModuleParameter=POSTBUILD_PTR, EcuMModuleService=Init
            Check_Wakeup_src_StartupCore: EcuMModuleID=EcuM_User, EcuMModuleParameter=VOID, EcuMModuleService=CheckWKSourceAll
            CddModuleInit_StartupCore: EcuMModuleID=McuFunc, EcuMModuleParameter=VOID, EcuMModuleService=vidCddModuleInitCore0
        ECUM_WKSOURCE_KL15 (EcuMWakeupSource): EcuMValidationTimeout=0.0
        ECUM_WKSOURCE_CANMSG (EcuMWakeupSource): EcuMValidationTimeout=0.0
      EcuMFlexConfiguration
        EcuMFlexUserConfig_0 (EcuMFlexUserConfig): EcuMFlexUser=0
        EcuMGoDownAllowedUsers: EcuMGoDownAllowedUserRef=EcuMFlexUserConfig_0
        3 x EcuMResetMode:
          ECUM_RESET_MCU: EcuMResetModeId=0
          ECUM_RESET_WDGM: EcuMResetModeId=1
          ECUM_RESET_IO: EcuMResetModeId=2
        3 x EcuMShutdownCause:
          ECUM_CAUSE_ECU_STATE: EcuMShutdownCauseId=1
          ECUM_CAUSE_WDGM: EcuMShutdownCauseId=2
          ECUM_CAUSE_DCM: EcuMShutdownCauseId=3
    EcuMGeneral: EcuMDevErrorDetect=1, EcuMIncludeDet=1, EcuMMainFunctionPeriod=0.01, EcuMVersionInfoApi=true
      EcuMRbIncludeHeaderList: EcuMRbModuleHeader=EcuM_PBDefine
