AUTOSAR XML (schema 00047)
package /ETAS_Project/EcucModuleConfigurationValuess
  module config EcuC
    EcucHardware
      4 x EcucCoreDefinition:
        EcucCore{0..3}: EcucCoreId={0..3}
    EcucPartitionCollection
      4 x EcucPartition, all with PartitionCanBeRestarted=false:
        EcucPartition_Core0: EcucPartitionBswModuleExecution=1, EcucPartitionSoftwareComponentInstanceRef=CPT_ASW_BASE, EcucPartitionSoftwareComponentInstanceRef=CPT_ASW_CORE0, EcucPartitionSoftwareComponentInstanceRef=CPT_ASW_DCM, EcucPartitionSoftwareComponentInstanceRef=CPT_ASW_DEM, EcucPartitionSoftwareComponentInstanceRef=CPT_ASW_NM, EcucPartitionSoftwareComponentInstanceRef=CPT_ASW_NVM, EcucPartitionSoftwareComponentInstanceRef=CPT_ASW_WDG, EcucPartitionSoftwareComponentInstanceRef=CPT_ASW_XCP, EcucPartitionSoftwareComponentInstanceRef=CPT_BswM, EcucPartitionSoftwareComponentInstanceRef=CPT_CDD_CORE0, EcucPartitionSoftwareComponentInstanceRef=CPT_ComM, EcucPartitionSoftwareComponentInstanceRef=CPT_Dcm, EcucPartitionSoftwareComponentInstanceRef=CPT_Dem, EcucPartitionSoftwareComponentInstanceRef=CPT_Det, EcucPartitionSoftwareComponentInstanceRef=CPT_EcuM, EcucPartitionSoftwareComponentInstanceRef=CPT_NvM, EcucPartitionSoftwareComponentInstanceRef=CPT_rba_DiagLib, EcucPartitionSoftwareComponentInstanceRef=CPT_WdgM, EcucPartitionSoftwareComponentInstanceRef=CPT_RSID, EcucPartitionSoftwareComponentInstanceRef=CPT_SWC_DEM
        EcucPartition_Core1: EcucPartitionBswModuleExecution=false, EcucPartitionSoftwareComponentInstanceRef=CPT_ASW_CORE1, EcucPartitionSoftwareComponentInstanceRef=CPT_CDD_CORE1, EcucPartitionSoftwareComponentInstanceRef=CPT_ASW_COM
        EcucPartition_Core2: EcucPartitionBswModuleExecution=false, EcucPartitionSoftwareComponentInstanceRef=CPT_ASW_CORE2, EcucPartitionSoftwareComponentInstanceRef=CPT_CDD_CORE2
        EcucPartition_Core3: EcucPartitionBswModuleExecution=false, EcucPartitionSoftwareComponentInstanceRef=CPT_ASW_CORE3, EcucPartitionSoftwareComponentInstanceRef=CPT_CDD_CORE3
