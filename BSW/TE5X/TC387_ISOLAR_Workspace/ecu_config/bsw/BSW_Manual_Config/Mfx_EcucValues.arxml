AUTOSAR XML (schema 4-2-2)
package /ETAS_Project/EcucModuleConfigurationValuess
  module config Mfx
    MfxGeneral_0 (MfxGeneral): MfxRbOptimizationMcuExtract=false, MfxRbOptimization=NO_OPTIMIZATION, Mfx_VersionInfoAPI=ON
    MfxRbMemoryLocations_0 (MfxRbMemoryLocations):
      mfxRbMemLocAbss16s16 = NORMAL
      mfxRbMemLocAbss16u16 = NORMAL
      mfxRbMemLocAbss32s16 = NORMAL
      mfxRbMemLocAbss32s32 = NORMAL
      mfxRbMemLocAbss32s8 = NORMAL
      mfxRbMemLocAbss32u16 = NORMAL
      mfxRbMemLocAbss32u32 = NORMAL
      mfxRbMemLocAbss32u8 = NORMAL
      mfxRbMemLocAbss8s8 = NORMAL
      mfxRbMemLocAbss8u8 = NORMAL
      mfxRbMemLocAbsDiffs16s16s16 = NORMAL
      mfxRbMemLocAbsDiffs16s16s8 = NORMAL
      mfxRbMemLocAbsDiffs16s16u16 = NORMAL
      mfxRbMemLocAbsDiffs16s16u8 = NORMAL
      mfxRbMemLocAbsDiffs32s32s16 = NORMAL
      mfxRbMemLocAbsDiffs32s32s32 = NORMAL
      mfxRbMemLocAbsDiffs32s32s8 = NORMAL
      mfxRbMemLocAbsDiffs32s32u16 = NORMAL
      mfxRbMemLocAbsDiffs32s32u32 = NORMAL
      mfxRbMemLocAbsDiffs32s32u8 = NORMAL
      mfxRbMemLocAbsDiffs8s8s8 = NORMAL
      mfxRbMemLocAbsDiffs8s8u8 = NORMAL
      mfxRbMemLocAbsDiffu16s16s16 = NORMAL
      mfxRbMemLocAbsDiffu16s16s8 = NORMAL
      mfxRbMemLocAbsDiffu16s16u16 = NORMAL
      mfxRbMemLocAbsDiffu16s16u8 = NORMAL
      mfxRbMemLocAbsDiffu16u16s16 = NORMAL
      mfxRbMemLocAbsDiffu16u16s8 = NORMAL
      mfxRbMemLocAbsDiffu16u16u16 = NORMAL
      mfxRbMemLocAbsDiffu16u16u8 = NORMAL
      mfxRbMemLocAbsdiffu32s32s16 = NORMAL
      mfxRbMemLocAbsdiffu32s32s32 = NORMAL
      mfxRbMemLocAbsdiffu32s32s8 = NORMAL
      mfxRbMemLocAbsDiffu32s32u16 = NORMAL
      mfxRbMemLocAbsDiffu32s32u32 = NORMAL
      mfxRbMemLocAbsDiffu32s32u8 = NORMAL
      mfxRbMemLocAbsdiffu32u32s16 = NORMAL
      mfxRbMemLocAbsdiffu32u32s32 = NORMAL
      mfxRbMemLocAbsdiffu32u32s8 = NORMAL
      mfxRbMemLocAbsDiffu32u32u16 = NORMAL
      mfxRbMemLocAbsDiffu32u32u32 = NORMAL
      mfxRbMemLocAbsDiffu32u32u8 = NORMAL
      mfxRbMemLocAbsDiffu8s8s8 = NORMAL
      mfxRbMemLocAbsDiffu8s8u8 = NORMAL
      mfxRbMemLocAbsDiffu8u8s8 = NORMAL
      mfxRbMemLocAbsDiffu8u8u8 = NORMAL
      mfxRbMemLocAbsDiffP2s16s16s16 = NORMAL
      mfxRbMemLocAbsDiffP2s16s16u16 = NORMAL
      mfxRbMemLocAbsDiffP2u16s16s16 = NORMAL
      mfxRbMemLocAbsDiffP2u16s16u16 = NORMAL
      mfxRbMemLocAbsDiffP2u16u16s16 = NORMAL
      mfxRbMemLocAbsDiffP2u16u16u16 = NORMAL
      mfxRbMemLocAbsP2s16s16 = NORMAL
      mfxRbMemLocAbsP2s16u16 = NORMAL
      mfxRbMemLocAbsP2s32s32 = NORMAL
      mfxRbMemLocAbsP2s32u32 = NORMAL
      mfxRbMemLocAdds16s16s16 = NORMAL
      mfxRbMemLocAdds16s16s8 = NORMAL
      mfxRbMemLocAdds16s16u16 = NORMAL
      mfxRbMemLocAdds16s16u8 = NORMAL
      mfxRbMemLocAdds32s32s16 = NORMAL
      mfxRbMemLocAdds32s32s32 = NORMAL
      mfxRbMemLocAdds32s32s8 = NORMAL
      mfxRbMemLocAdds32s32u16 = NORMAL
      mfxRbMemLocAdds32s32u32 = NORMAL
      mfxRbMemLocAdds32s32u8 = NORMAL
      mfxRbMemLocAdds8s8s8 = NORMAL
      mfxRbMemLocAdds8s8u8 = NORMAL
      mfxRbMemLocAddu16s16s16 = NORMAL
      mfxRbMemLocAddu16s16s8 = NORMAL
      mfxRbMemLocAddu16s16u16 = NORMAL
      mfxRbMemLocAddu16s16u8 = NORMAL
      mfxRbMemLocAddu16u16s16 = NORMAL
      mfxRbMemLocAddu16u16s8 = NORMAL
      mfxRbMemLocAddu16u16u16 = NORMAL
      mfxRbMemLocAddu16u16u8 = NORMAL
      mfxRbMemLocAddu32s32s16 = NORMAL
      mfxRbMemLocAddu32s32s32 = NORMAL
      mfxRbMemLocAddu32s32s8 = NORMAL
      mfxRbMemLocAddu32s32u16 = NORMAL
      mfxRbMemLocAddu32s32u32 = NORMAL
      mfxRbMemLocAddu32s32u8 = NORMAL
      mfxRbMemLocAddu32u32s16 = NORMAL
      mfxRbMemLocAddu32u32s32 = NORMAL
      mfxRbMemLocAddu32u32s8 = NORMAL
      mfxRbMemLocAddu32u32u16 = NORMAL
      mfxRbMemLocAddu32u32u32 = NORMAL
      mfxRbMemLocAddu32u32u8 = NORMAL
      mfxRbMemLocAddu8s8s8 = NORMAL
      mfxRbMemLocAddu8s8u8 = NORMAL
      mfxRbMemLocAddu8u8s8 = NORMAL
      mfxRbMemLocAddu8u8u8 = NORMAL
      mfxRbMemLocAddP2s16s16s16 = NORMAL
      mfxRbMemLocAddP2s16s16u16 = NORMAL
      mfxRbMemLocAddP2s32s32s32 = NORMAL
      mfxRbMemLocAddP2s32s32u32 = NORMAL
      mfxRbMemLocAddP2u16s16s16 = NORMAL
      mfxRbMemLocAddP2u16s16u16 = NORMAL
      mfxRbMemLocAddP2u16u16s16 = NORMAL
      mfxRbMemLocAddP2u16u16u16 = NORMAL
      mfxRbMemLocAddP2u32s32s32 = NORMAL
      mfxRbMemLocAddP2u32s32u32 = NORMAL
      mfxRbMemLocAddP2u32u32s32 = NORMAL
      mfxRbMemLocAddP2u32u32u32 = NORMAL
      mfxRbMemLocConvertP2s16s32 = NORMAL
      mfxRbMemLocConvertP2s16s8 = NORMAL
      mfxRbMemLocConvertP2s32s16 = NORMAL
      mfxRbMemLocConvertP2s8s16 = NORMAL
      mfxRbMemLocConvertP2u16u32 = NORMAL
      mfxRbMemLocConvertP2u16u8 = NORMAL
      mfxRbMemLocConvertP2u32u16 = NORMAL
      mfxRbMemLocConvertP2u8u16 = NORMAL
      mfxRbMemLocDivs16s16s16 = NORMAL
      mfxRbMemLocDivs16s16s8 = NORMAL
      mfxRbMemLocDivs16s16u16 = NORMAL
      mfxRbMemLocDivs16s16u8 = NORMAL
      mfxRbMemLocDivs16u16s16 = NORMAL
      mfxRbMemLocDivs16u16s8 = NORMAL
      mfxRbMemLocDivs16u16u16 = NORMAL
      mfxRbMemLocDivs16u16u8 = NORMAL
      mfxRbMemLocDivs32s16s16 = NORMAL
      mfxRbMemLocDivs32s32s16 = NORMAL
      mfxRbMemLocDivs32s32s32 = NORMAL
      mfxRbMemLocDivs32s32s8 = NORMAL
      mfxRbMemLocDivs32s32u16 = NORMAL
      mfxRbMemLocDivs32s32u32 = NORMAL
      mfxRbMemLocDivs32s32u8 = NORMAL
      mfxRbMemLocDivs32u16u16 = NORMAL
      mfxRbMemLocDivs32u32s16 = NORMAL
      mfxRbMemLocDivs32u32s32 = NORMAL
      mfxRbMemLocDivs32u32s8 = NORMAL
      mfxRbMemLocDivs32u32u16 = NORMAL
      mfxRbMemLocDivs32u32u32 = NORMAL
      mfxRbMemLocDivs32u32u8 = NORMAL
      mfxRbMemLocDivs8s8s8 = NORMAL
      mfxRbMemLocDivs8s8u8 = NORMAL
      mfxRbMemLocDivs8u8s8 = NORMAL
      mfxRbMemLocDivs8u8u8 = NORMAL
      mfxRbMemLocDivu16s16s16 = NORMAL
      mfxRbMemLocDivu16s16s8 = NORMAL
      mfxRbMemLocDivu16s16u16 = NORMAL
      mfxRbMemLocDivu16s16u8 = NORMAL
      mfxRbMemLocDivu16u16s16 = NORMAL
      mfxRbMemLocDivu16u16s8 = NORMAL
      mfxRbMemLocDivu16u16u16 = NORMAL
      mfxRbMemLocDivu16u16u8 = NORMAL
      mfxRbMemLocDivu32s32s16 = NORMAL
      mfxRbMemLocDivu32s32s32 = NORMAL
      mfxRbMemLocDivu32s32s8 = NORMAL
      mfxRbMemLocDivu32s32u16 = NORMAL
      mfxRbMemLocDivu32s32u32 = NORMAL
      mfxRbMemLocDivu32s32u8 = NORMAL
      mfxRbMemLocDivu32u16u16 = NORMAL
      mfxRbMemLocDivu32u16u32 = NORMAL
      mfxRbMemLocDivu32u32s16 = NORMAL
      mfxRbMemLocDivu32u32s32 = NORMAL
      mfxRbMemLocDivu32u32s8 = NORMAL
      mfxRbMemLocDivu32u32u16 = NORMAL
      mfxRbMemLocDivu32u32u32 = NORMAL
      mfxRbMemLocDivu32u32u8 = NORMAL
      mfxRbMemLocDivu8s8s8 = NORMAL
      mfxRbMemLocDivu8s8u8 = NORMAL
      mfxRbMemLocDivu8u8s8 = NORMAL
      mfxRbMemLocDivu8u8u8 = NORMAL
      mfxRbMemLocDivP2s16s16s16 = NORMAL
      mfxRbMemLocDivP2s16s16u16 = NORMAL
      mfxRbMemLocDivP2s16u16s16 = NORMAL
      mfxRbMemLocDivP2s16u16u16 = NORMAL
      mfxRbMemLocDivP2s32s32s32 = NORMAL
      mfxRbMemLocDivP2s32s32u32 = NORMAL
      mfxRbMemLocDivP2s32u32s32 = NORMAL
      mfxRbMemLocDivP2s32u32u32 = NORMAL
      mfxRbMemLocDivP2u16s16s16 = NORMAL
      mfxRbMemLocDivP2u16s16u16 = NORMAL
      mfxRbMemLocDivP2u16u16s16 = NORMAL
      mfxRbMemLocDivP2u16u16u16 = NORMAL
      mfxRbMemLocDivP2u32s32s32 = NORMAL
      mfxRbMemLocDivP2u32s32u32 = NORMAL
      mfxRbMemLocDivP2u32u32s32 = NORMAL
      mfxRbMemLocDivP2u32u32u32 = NORMAL
      mfxRbMemLocDivShLefts16s16u8s16 = NORMAL
      mfxRbMemLocDivShLefts16u16u8s16 = NORMAL
      mfxRbMemLocDivShLefts32s32u8s16 = NORMAL
      mfxRbMemLocDivShLefts32s32u8s32 = NORMAL
      mfxRbMemLocDivShLefts32s32u8s8 = NORMAL
      mfxRbMemLocDivShLefts32s32u8u16 = NORMAL
      mfxRbMemLocDivShLefts32s32u8u32 = NORMAL
      mfxRbMemLocDivShLefts32s32u8u8 = NORMAL
      mfxRbMemLocDivShLefts32u32u8s16 = NORMAL
      mfxRbMemLocDivShLefts32u32u8s32 = NORMAL
      mfxRbMemLocDivShLefts32u32u8s8 = NORMAL
      mfxRbMemLocDivShLefts32u32u8u16 = NORMAL
      mfxRbMemLocDivShLefts32u32u8u32 = NORMAL
      mfxRbMemLocDivShLefts32u32u8u8 = NORMAL
      mfxRbMemLocDivShLeftu16u16u8u16 = NORMAL
      mfxRbMemLocDivShLeftu16u16u8u8 = NORMAL
      mfxRbMemLocDivShLeftu32s32u8s16 = NORMAL
      mfxRbMemLocDivShLeftu32s32u8s32 = NORMAL
      mfxRbMemLocDivShLeftu32s32u8s8 = NORMAL
      mfxRbMemLocDivShLeftu32s32u8u16 = NORMAL
      mfxRbMemLocDivShLeftu32s32u8u32 = NORMAL
      mfxRbMemLocDivShLeftu32s32u8u8 = NORMAL
      mfxRbMemLocDivShLeftu32u32u8s16 = NORMAL
      mfxRbMemLocDivShLeftu32u32u8s32 = NORMAL
      mfxRbMemLocDivShLeftu32u32u8s8 = NORMAL
      mfxRbMemLocDivShLeftu32u32u8u16 = NORMAL
      mfxRbMemLocDivShLeftu32u32u8u32 = NORMAL
      mfxRbMemLocDivShLeftu32u32u8u8 = NORMAL
      mfxRbMemLocDivShLeftu8u8u8u8 = NORMAL
      mfxRbMemLocLimits16 = NORMAL
      mfxRbMemLocLimits32 = NORMAL
      mfxRbMemLocLimits8 = NORMAL
      mfxRbMemLocLimitu16 = NORMAL
      mfxRbMemLocLimitu32 = NORMAL
      mfxRbMemLocLimitu8 = NORMAL
      mfxRbMemLocMaxs16 = NORMAL
      mfxRbMemLocMaxs32 = NORMAL
      mfxRbMemLocMaxs8 = NORMAL
      mfxRbMemLocMaxu16 = NORMAL
      mfxRbMemLocMaxu32 = NORMAL
      mfxRbMemLocMaxu8 = NORMAL
      mfxRbMemLocMins16 = NORMAL
      mfxRbMemLocMins32 = NORMAL
      mfxRbMemLocMins8 = NORMAL
      mfxRbMemLocMinu16 = NORMAL
      mfxRbMemLocMinu32 = NORMAL
      mfxRbMemLocMinu8 = NORMAL
      mfxRbMemLocMinmaxs16 = NORMAL
      mfxRbMemLocMinmaxs32 = NORMAL
      mfxRbMemLocMinmaxs8 = NORMAL
      mfxRbMemLocMinmaxu16 = NORMAL
      mfxRbMemLocMinmaxu32 = NORMAL
      mfxRbMemLocMinmaxu8 = NORMAL
      mfxRbMemLocMods16 = NORMAL
      mfxRbMemLocMods32 = NORMAL
      mfxRbMemLocMods32s32s16 = NORMAL
      mfxRbMemLocMods32s32s8 = NORMAL
      mfxRbMemLocMods8 = NORMAL
      mfxRbMemLocModu16 = NORMAL
      mfxRbMemLocModu32 = NORMAL
      mfxRbMemLocModu32u32u16 = NORMAL
      mfxRbMemLocModu32u32u8 = NORMAL
      mfxRbMemLocModu8 = NORMAL
      mfxRbMemLocMuls16s16s16 = NORMAL
      mfxRbMemLocMuls16s16s32 = NORMAL
      mfxRbMemLocMuls16s16s8 = NORMAL
      mfxRbMemLocMuls16s16u16 = NORMAL
      mfxRbMemLocMuls16s16u8 = NORMAL
      mfxRbMemLocMuls16u16s16 = NORMAL
      mfxRbMemLocMuls16u16s32 = NORMAL
      mfxRbMemLocMuls16u16u16 = NORMAL
      mfxRbMemLocMuls32s32s16 = NORMAL
      mfxRbMemLocMuls32s32s32 = NORMAL
      mfxRbMemLocMuls32s32s8 = NORMAL
      mfxRbMemLocMuls32s32u16 = NORMAL
      mfxRbMemLocMuls32s32u32 = NORMAL
      mfxRbMemLocMuls32s32u8 = NORMAL
      mfxRbMemLocMuls32u16s32 = NORMAL
      mfxRbMemLocMuls8s8s8 = NORMAL
      mfxRbMemLocMuls8s8u8 = NORMAL
      mfxRbMemLocMuls8u8s8 = NORMAL
      mfxRbMemLocMuls8u8u8 = NORMAL
      mfxRbMemLocMulu16s16s16 = NORMAL
      mfxRbMemLocMulu16s16s32 = NORMAL
      mfxRbMemLocMulu16s16s8 = NORMAL
      mfxRbMemLocMulu16s16u16 = NORMAL
      mfxRbMemLocMulu16s16u8 = NORMAL
      mfxRbMemLocMulu16u16s16 = NORMAL
      mfxRbMemLocMulu16u16s8 = NORMAL
      mfxRbMemLocMulu16u16u16 = NORMAL
      mfxRbMemLocMulu16u16u32 = NORMAL
      mfxRbMemLocMulu16u16u8 = NORMAL
      mfxRbMemLocMulu32s32s16 = NORMAL
      mfxRbMemLocMulu32s32s32 = NORMAL
      mfxRbMemLocMulu32s32s8 = NORMAL
      mfxRbMemLocMulu32s32u16 = NORMAL
      mfxRbMemLocMulu32s32u32 = NORMAL
      mfxRbMemLocMulu32s32u8 = NORMAL
      mfxRbMemLocMulu32u16u32 = NORMAL
      mfxRbMemLocMulu32u32s16 = NORMAL
      mfxRbMemLocMulu32u32s32 = NORMAL
      mfxRbMemLocMulu32u32s8 = NORMAL
      mfxRbMemLocMulu32u32u16 = NORMAL
      mfxRbMemLocMulu32u32u32 = NORMAL
      mfxRbMemLocMulu32u32u8 = NORMAL
      mfxRbMemLocMulu8s8s8 = NORMAL
      mfxRbMemLocMulu8s8u8 = NORMAL
      mfxRbMemLocMulu8u8s8 = NORMAL
      mfxRbMemLocMulu8u8u8 = NORMAL
      mfxRbMemLocMulDivs16s16s16s16 = NORMAL
      mfxRbMemLocMulDivs16s16u16s16 = NORMAL
      mfxRbMemLocMulDivs16u16s16s16 = NORMAL
      mfxRbMemLocMulDivs16u16s16u16 = NORMAL
      mfxRbMemLocMulDivs16u16u16s16 = NORMAL
      mfxRbMemLocMulDivs16u16u16u16 = NORMAL
      mfxRbMemLocMulDivs32s32s16s16 = NORMAL
      mfxRbMemLocMulDivs32s32s32s16 = NORMAL
      mfxRbMemLocMulDivs32s32s32s32 = NORMAL
      mfxRbMemLocMulDivs32s32s32u16 = NORMAL
      mfxRbMemLocMulDivs32s32u32s32 = NORMAL
      mfxRbMemLocMulDivs32u32s32s32 = NORMAL
      mfxRbMemLocMulDivs32u32u32s32 = NORMAL
      mfxRbMemLocMulDivu16s16s16s16 = NORMAL
      mfxRbMemLocMulDivu16s16s16u16 = NORMAL
      mfxRbMemLocMulDivu16s16u16s16 = NORMAL
      mfxRbMemLocMulDivu16s16u16u16 = NORMAL
      mfxRbMemLocMulDivu16u16u16u16 = NORMAL
      mfxRbMemLocMulDivu32s32s32s32 = NORMAL
      mfxRbMemLocMulDivu32s32s32u32 = NORMAL
      mfxRbMemLocMulDivu32s32u32s32 = NORMAL
      mfxRbMemLocMulDivu32s32u32u32 = NORMAL
      mfxRbMemLocMulDivu32u32s32u32 = NORMAL
      mfxRbMemLocMulDivu32u32u16u16 = NORMAL
      mfxRbMemLocMulDivu32u32u32u16 = NORMAL
      mfxRbMemLocMulDivu32u32u32u32 = NORMAL
      mfxRbMemLocMulP2s16s16s16 = NORMAL
      mfxRbMemLocMulP2s16s16u16 = NORMAL
      mfxRbMemLocMulP2s32s32s32 = NORMAL
      mfxRbMemLocMulP2s32s32u32 = NORMAL
      mfxRbMemLocMulP2u16s16s16 = NORMAL
      mfxRbMemLocMulP2u16s16u16 = NORMAL
      mfxRbMemLocMulP2u16u16s16 = NORMAL
      mfxRbMemLocMulP2u16u16u16 = NORMAL
      mfxRbMemLocMulP2u32s32s32 = NORMAL
      mfxRbMemLocMulP2u32s32u32 = NORMAL
      mfxRbMemLocMulP2u32u32s32 = NORMAL
      mfxRbMemLocMulP2u32u32u32 = NORMAL
      mfxRbMemLocMulShRights16s16u8s16 = NORMAL
      mfxRbMemLocMulShRights16s16u8s8 = NORMAL
      mfxRbMemLocMulShRights16s16u8u16 = NORMAL
      mfxRbMemLocMulShRights16s16u8u8 = NORMAL
      mfxRbMemLocMulShRights32s32u8s16 = NORMAL
      mfxRbMemLocMulShRights32s32u8s32 = NORMAL
      mfxRbMemLocMulShRights32s32u8s8 = NORMAL
      mfxRbMemLocMulShRights32s32u8u16 = NORMAL
      mfxRbMemLocMulShRights32s32u8u32 = NORMAL
      mfxRbMemLocMulShRights32s32u8u8 = NORMAL
      mfxRbMemLocMulShRightu32s32u8s16 = NORMAL
      mfxRbMemLocMulShRightu32s32u8s32 = NORMAL
      mfxRbMemLocMulShRightu32s32u8s8 = NORMAL
      mfxRbMemLocMulShRightu32s32u8u16 = NORMAL
      mfxRbMemLocMulShRightu32s32u8u32 = NORMAL
      mfxRbMemLocMulShRightu32s32u8u8 = NORMAL
      mfxRbMemLocMulShRightu32u32u8s16 = NORMAL
      mfxRbMemLocMulShRightu32u32u8s32 = NORMAL
      mfxRbMemLocMulShRightu32u32u8s8 = NORMAL
      mfxRbMemLocMulShRightu32u32u8u16 = NORMAL
      mfxRbMemLocMulShRightu32u32u8u32 = NORMAL
      mfxRbMemLocMulShRightu32u32u8u8 = NORMAL
      mfxRbMemLocRDivs16s16s16 = NORMAL
      mfxRbMemLocRDivs16s16s8 = NORMAL
      mfxRbMemLocRDivs16s16u16 = NORMAL
      mfxRbMemLocRDivs16s16u8 = NORMAL
      mfxRbMemLocRDivs16u16s16 = NORMAL
      mfxRbMemLocRDivs16u16s8 = NORMAL
      mfxRbMemLocRDivs16u16u16 = NORMAL
      mfxRbMemLocRDivs16u16u8 = NORMAL
      mfxRbMemLocRDivs32s16s16 = NORMAL
      mfxRbMemLocRDivs32s32s16 = NORMAL
      mfxRbMemLocRDivs32s32s32 = NORMAL
      mfxRbMemLocRDivs32s32s8 = NORMAL
      mfxRbMemLocRDivs32s32u16 = NORMAL
      mfxRbMemLocRDivs32s32u32 = NORMAL
      mfxRbMemLocRDivs32s32u8 = NORMAL
      mfxRbMemLocRDivs32u16u16 = NORMAL
      mfxRbMemLocRDivs32u32s16 = NORMAL
      mfxRbMemLocRDivs32u32s32 = NORMAL
      mfxRbMemLocRDivs32u32s8 = NORMAL
      mfxRbMemLocRDivs32u32u16 = NORMAL
      mfxRbMemLocRDivs32u32u32 = NORMAL
      mfxRbMemLocRDivs32u32u8 = NORMAL
      mfxRbMemLocRDivs8s8s8 = NORMAL
      mfxRbMemLocRDivs8s8u8 = NORMAL
      mfxRbMemLocRDivs8u8s8 = NORMAL
      mfxRbMemLocRDivs8u8u8 = NORMAL
      mfxRbMemLocRDivu16s16s16 = NORMAL
      mfxRbMemLocRDivu16s16s8 = NORMAL
      mfxRbMemLocRDivu16s16u16 = NORMAL
      mfxRbMemLocRDivu16s16u8 = NORMAL
      mfxRbMemLocRDivu16u16s16 = NORMAL
      mfxRbMemLocRDivu16u16s8 = NORMAL
      mfxRbMemLocRDivu16u16u16 = NORMAL
      mfxRbMemLocRDivu16u16u8 = NORMAL
      mfxRbMemLocRDivu32s32s16 = NORMAL
      mfxRbMemLocRDivu32s32s32 = NORMAL
      mfxRbMemLocRDivu32s32s8 = NORMAL
      mfxRbMemLocRDivu32s32u16 = NORMAL
      mfxRbMemLocRDivu32s32u32 = NORMAL
      mfxRbMemLocRDivu32s32u8 = NORMAL
      mfxRbMemLocRDivu32u16u16 = NORMAL
      mfxRbMemLocRDivu32u16u32 = NORMAL
      mfxRbMemLocRDivu32u32s16 = NORMAL
      mfxRbMemLocRDivu32u32s32 = NORMAL
      mfxRbMemLocRDivu32u32s8 = NORMAL
      mfxRbMemLocRDivu32u32u16 = NORMAL
      mfxRbMemLocRDivu32u32u32 = NORMAL
      mfxRbMemLocRDivu32u32u8 = NORMAL
      mfxRbMemLocRDivu8s8s8 = NORMAL
      mfxRbMemLocRDivu8s8u8 = NORMAL
      mfxRbMemLocRDivu8u8s8 = NORMAL
      mfxRbMemLocRDivu8u8u8 = NORMAL
      mfxRbMemLocRMulDivs16s16s16s16 = NORMAL
      mfxRbMemLocRMulDivs16s16u16s16 = NORMAL
      mfxRbMemLocRMulDivs16u16s16s16 = NORMAL
      mfxRbMemLocRMulDivs16u16s16u16 = NORMAL
      mfxRbMemLocRMulDivs16u16u16s16 = NORMAL
      mfxRbMemLocRMulDivs16u16u16u16 = NORMAL
      mfxRbMemLocRMulDivs32s32s16s16 = NORMAL
      mfxRbMemLocRMulDivs32s32s32s16 = NORMAL
      mfxRbMemLocRMulDivs32s32s32s32 = NORMAL
      mfxRbMemLocRMulDivs32s32s32u16 = NORMAL
      mfxRbMemLocRMulDivs32s32u32s32 = NORMAL
      mfxRbMemLocRMulDivs32u32s32s32 = NORMAL
      mfxRbMemLocRMulDivs32u32u32s32 = NORMAL
      mfxRbMemLocRMulDivu16s16s16s16 = NORMAL
      mfxRbMemLocRMulDivu16s16s16u16 = NORMAL
      mfxRbMemLocRMulDivu16s16u16s16 = NORMAL
      mfxRbMemLocRMulDivu16s16u16u16 = NORMAL
      mfxRbMemLocRMulDivu16u16u16u16 = NORMAL
      mfxRbMemLocRMulDivu32s32s32s32 = NORMAL
      mfxRbMemLocRMulDivu32s32s32u32 = NORMAL
      mfxRbMemLocRMulDivu32s32u32s32 = NORMAL
      mfxRbMemLocRMulDivu32s32u32u32 = NORMAL
      mfxRbMemLocRMulDivu32u32s32u32 = NORMAL
      mfxRbMemLocRMulDivu32u32u16u16 = NORMAL
      mfxRbMemLocRMulDivu32u32u32u16 = NORMAL
      mfxRbMemLocRMulDivu32u32u32u32 = NORMAL
      mfxRbMemLocSubs16s16s16 = NORMAL
      mfxRbMemLocSubs16s16s8 = NORMAL
      mfxRbMemLocSubs16s16u16 = NORMAL
      mfxRbMemLocSubs16s16u8 = NORMAL
      mfxRbMemLocSubs16u16s16 = NORMAL
      mfxRbMemLocSubs16u16s8 = NORMAL
      mfxRbMemLocSubs16u16u16 = NORMAL
      mfxRbMemLocSubs16u16u8 = NORMAL
      mfxRbMemLocSubs32s32s16 = NORMAL
      mfxRbMemLocSubs32s32s32 = NORMAL
      mfxRbMemLocSubs32s32s8 = NORMAL
      mfxRbMemLocSubs32s32u16 = NORMAL
      mfxRbMemLocSubs32s32u32 = NORMAL
      mfxRbMemLocSubs32s32u8 = NORMAL
      mfxRbMemLocSubs32u32s16 = NORMAL
      mfxRbMemLocSubs32u32s32 = NORMAL
      mfxRbMemLocSubs32u32s8 = NORMAL
      mfxRbMemLocSubs32u32u16 = NORMAL
      mfxRbMemLocSubs32u32u32 = NORMAL
      mfxRbMemLocSubs32u32u8 = NORMAL
      mfxRbMemLocSubs8s8s8 = NORMAL
      mfxRbMemLocSubs8s8u8 = NORMAL
      mfxRbMemLocSubs8u8s8 = NORMAL
      mfxRbMemLocSubs8u8u8 = NORMAL
      mfxRbMemLocSubu16s16s16 = NORMAL
      mfxRbMemLocSubu16s16s8 = NORMAL
      mfxRbMemLocSubu16s16u16 = NORMAL
      mfxRbMemLocSubu16s16u8 = NORMAL
      mfxRbMemLocSubu16u16s16 = NORMAL
      mfxRbMemLocSubu16u16s8 = NORMAL
      mfxRbMemLocSubu16u16u16 = NORMAL
      mfxRbMemLocSubu16u16u8 = NORMAL
      mfxRbMemLocSubu32s32s16 = NORMAL
      mfxRbMemLocSubu32s32s32 = NORMAL
      mfxRbMemLocSubu32s32s8 = NORMAL
      mfxRbMemLocSubu32s32u16 = NORMAL
      mfxRbMemLocSubu32s32u32 = NORMAL
      mfxRbMemLocSubu32s32u8 = NORMAL
      mfxRbMemLocSubu32u32s16 = NORMAL
      mfxRbMemLocSubu32u32s32 = NORMAL
      mfxRbMemLocSubu32u32s8 = NORMAL
      mfxRbMemLocSubu32u32u16 = NORMAL
      mfxRbMemLocSubu32u32u32 = NORMAL
      mfxRbMemLocSubu32u32u8 = NORMAL
      mfxRbMemLocSubu8s8s8 = NORMAL
      mfxRbMemLocSubu8s8u8 = NORMAL
      mfxRbMemLocSubu8u8s8 = NORMAL
      mfxRbMemLocSubu8u8u8 = NORMAL
      mfxRbMemLocSubP2s16s16s16 = NORMAL
      mfxRbMemLocSubP2s16s16u16 = NORMAL
      mfxRbMemLocSubP2s16u16s16 = NORMAL
      mfxRbMemLocSubP2s16u16u16 = NORMAL
      mfxRbMemLocSubP2s32s32s32 = NORMAL
      mfxRbMemLocSubP2s32s32u32 = NORMAL
      mfxRbMemLocSubP2s32u32s32 = NORMAL
      mfxRbMemLocSubP2s32u32u32 = NORMAL
      mfxRbMemLocSubP2u16s16s16 = NORMAL
      mfxRbMemLocSubP2u16s16u16 = NORMAL
      mfxRbMemLocSubP2u16u16s16 = NORMAL
      mfxRbMemLocSubP2u16u16u16 = NORMAL
      mfxRbMemLocSubP2u32s32s32 = NORMAL
      mfxRbMemLocSubP2u32s32u32 = NORMAL
      mfxRbMemLocSubP2u32u32s32 = NORMAL
      mfxRbMemLocSubP2u32u32u32 = NORMAL
