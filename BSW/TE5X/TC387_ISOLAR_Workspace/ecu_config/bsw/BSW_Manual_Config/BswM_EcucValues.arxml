AUTOSAR XML (schema 00047)
package /ETAS_Project/EcucModuleConfigurationValuess
  module config BswM
    BswMGeneral:
      BswMCanSMEnabled = 1
      BswMComMEnabled = 1
      BswMDcmEnabled = true
      BswMDevErrorDetect = true
      BswMEcuMEnabled = true
      BswMEthSMEnabled = false
      BswMFrSMEnabled = false
      BswMGenericRequestEnabled = true
      BswMLinSMEnabled = false
      BswMLinTPEnabled = false
      BswMMainFunctionPeriod = 0.01
      BswMNvMEnabled = true
      BswMSchMEnabled = true
      BswMSdEnabled = false
      BswMVersionInfoApi = true
      BswMRbDebugEnable = false
      BswMRbIntrptQueueMaxSize = 5
      BswMEthIfEnabled = false
      BswMJ1939DcmEnabled = false
      BswMJ1939NmEnabled = false
      BswMNmEnabled = false
      BswMRbMaxNumOfRules = 22
      BswMRbComEnabled = true
      BswMUserIncludeFiles:
        BswMUserIncludeFile = Mcu.h
        BswMUserIncludeFile = Stubs.h
        BswMUserIncludeFile = Rte_Main.h
        BswMUserIncludeFile = CanSM_ComM.h
        BswMUserIncludeFile = CanIf.h
        BswMUserIncludeFile = Can.h
        BswMUserIncludeFile = Can_17_McmCan.h
        BswMUserIncludeFile = Fee.h
        BswMUserIncludeFile = CddCom.h
    BswMConfig
      BswMArbitration
        6 x BswMLogicalExpression:
          BswM_LE_StartupOne: BswMArgumentRef=BswM_MC_BswM_StartupOne
          BswM_LE_StartupTwo: BswMLogicalOperator=BSWM_AND, BswMArgumentRef=BswM_MC_BswM_StartupTwo, BswMArgumentRef=BswM_MC_BswModules_ReadAllComplete
          BswM_LE_Run: BswMArgumentRef=BswM_MC_BswM_Run
          BswM_LE_AppRequestShutdown: BswMArgumentRef=BswM_MC_BswM_AppRequestShutdown
          BswM_LE_PrepShutdown: BswMArgumentRef=BswM_MC_BswM_PrepShutdown
          BswM_LE_Shutdown: BswMLogicalOperator=BSWM_AND, BswMArgumentRef=BswM_MC_BswM_Shutdown, BswMArgumentRef=BswM_MC_BswModules_WriteAllComplete
        6 x BswMModeCondition, all with BswMConditionType=BSWM_EQUALS:
          BswM_MC_BswM_StartupOne: BswMConditionMode=BswM_MRP_BswM_MDG
            BswM_MC_Val (BswMConditionValue)
              BswMModeDeclaration: BswMModeValueRef=ECUM_STATE_STARTUP_ONE
          BswM_MC_BswM_StartupTwo: BswMConditionMode=BswM_MRP_BswM_MDG
            BswM_MC_Val (BswMConditionValue)
              BswMModeDeclaration: BswMModeValueRef=ECUM_STATE_STARTUP_TWO
          BswM_MC_BswM_Run: BswMConditionMode=BswM_MRP_BswM_MDG
            BswM_MC_Val (BswMConditionValue)
              BswMModeDeclaration: BswMModeValueRef=ECUM_STATE_RUN
          BswM_MC_BswM_AppRequestShutdown: BswMConditionMode=BswMArbitration/BswMSwcModeRequest
            BswM_MC_Val (BswMConditionValue)
              BswMModeDeclaration: BswMModeValueRef=SWC_REQUEST_SHUTDOWN
          BswM_MC_BswM_PrepShutdown: BswMConditionMode=BswM_MRP_BswM_MDG
            BswM_MC_Val (BswMConditionValue)
              BswMModeDeclaration: BswMModeValueRef=ECUM_STATE_PREP_SHUTDOWN
          BswM_MC_BswM_Shutdown: BswMConditionMode=BswM_MRP_BswM_MDG
            BswM_MC_Val (BswMConditionValue)
              BswMModeDeclaration: BswMModeValueRef=ECUM_STATE_SHUTDOWN
        BswM_MRP_BswM_MDG (BswMModeRequestPort): BswMRequestProcessing=BSWM_DEFERRED
          BswMModeRequestSource
            BswMBswModeNotification: BswMRbBswModeDeclarationGroup=/AUTOSAR_BswM/ModeDeclarationGroups/MDG_ECUM_STATE
        6 x BswMRule, all with BswMRuleInitState=BSWM_FALSE:
          BswM_AR_StartupOne: BswMRuleExpressionRef=BswM_LE_StartupOne, BswMRuleTrueActionList=BswM_AL_BswMSwitchStartupTwo
          BswM_AR_StartupTwo: BswMRuleExpressionRef=BswM_LE_StartupTwo, BswMRuleTrueActionList=BswM_AL_BswMSwitchRun
          BswM_AR_Run: BswMRuleExpressionRef=BswM_LE_Run, BswMRuleTrueActionList=BswM_AL_BswMSwitchAppRun
          BswM_AR_AppRequestShutdown: BswMRuleExpressionRef=BswM_LE_AppRequestShutdown, BswMRuleTrueActionList=BswM_AL_BswMSwitchPrepShutdown
          BswM_AR_Shutdown: BswMRuleExpressionRef=BswM_LE_PrepShutdown, BswMRuleTrueActionList=BswM_AL_BswMSwitchShutdown
          BswM_AR_Godown: BswMRuleExpressionRef=BswM_LE_Shutdown, BswMRuleTrueActionList=BswM_AL_BswMSwitchGoDown
        3 x BswMModeRequestPort:
          BswMSwcModeRequest: BswMRequestProcessing=BSWM_DEFERRED
            BswMModeRequestSource
              BswMSwcModeRequest: BswMRbModeRequestQueueSize=0, BswMSwcModeRequestVariableDataPrototypeRef=AppMode
              BswMSwcModeRequest: BswMRbModeRequestQueueSize=0
            BswMModeInitValue
          BswM_MRP_NvMReadAllComplete: BswMRequestProcessing=BSWM_IMMEDIATE
            BswMModeRequestSource_0 (BswMModeRequestSource)
              BswMNvMJobModeIndication: BswMNvmService=NvmReadAll
            BswMModeInitValue: BswMBswModeInitValue=NVM_REQ_PENDING
          BswM_MRP_NvMWriteAllComplete: BswMRequestProcessing=BSWM_IMMEDIATE
            BswMModeRequestSource_0 (BswMModeRequestSource)
              BswMNvMJobModeIndication: BswMNvmService=NvmWriteAll
            BswMModeInitValue: BswMBswModeInitValue=NVM_REQ_PENDING
        BswM_MC_BswModules_ReadAllComplete (BswMModeCondition): BswMConditionType=BSWM_EQUALS_NOT, BswMConditionMode=BswM_MRP_NvMReadAllComplete
          BswMConditionValue
            BswMBswMode: BswMBswRequestedMode=NVM_REQ_PENDING
        BswM_MC_BswModules_WriteAllComplete (BswMModeCondition): BswMConditionType=BSWM_EQUALS_NOT, BswMConditionMode=BswM_MRP_NvMWriteAllComplete
          BswMConditionValue
            BswMBswMode: BswMBswRequestedMode=NVM_REQ_PENDING
        BswM_MRP_DCM_ModeNotification_EcuReset (BswMModeRequestPort): BswMRequestProcessing=BSWM_DEFERRED
          BswMModeRequestSource_0 (BswMModeRequestSource)
            BswMBswModeNotification: BswMRbBswModeDeclarationGroup=/AUTOSAR_Dcm/ModeDeclarationGroups/DcmEcuReset
          BswMModeInitValue: BswMBswModeInitValue=RTE_MODE_DcmEcuReset_NONE
        3 x BswMModeCondition, all with BswMConditionType=BSWM_EQUALS, BswMConditionMode=BswM_MRP_DCM_ModeNotification_EcuReset:
          BswM_MC_DCM_EcuReset_HARD
            BswMConditionValue
              BswMModeDeclaration: BswMModeValueRef=HARD
          BswM_MC_DCM_EcuReset_KEYONOFF
            BswMConditionValue
              BswMModeDeclaration: BswMModeValueRef=KEYONOFF
          BswM_MC_DCM_EcuReset_SOFT
            BswMConditionValue
              BswMModeDeclaration: BswMModeValueRef=SOFT
        BswM_LE_DCM_EcuReset_SOFT (BswMLogicalExpression): BswMArgumentRef=BswM_MC_DCM_EcuReset_SOFT
        BswM_LE_DCM_EcuReset_HARD (BswMLogicalExpression): BswMLogicalOperator=BSWM_OR, BswMArgumentRef=BswM_MC_DCM_EcuReset_HARD, BswMArgumentRef=BswM_MC_DCM_EcuReset_KEYONOFF
        BswM_AR_DCM_EcuReset_SOFT (BswMRule): BswMRuleInitState=BSWM_FALSE, BswMRuleExpressionRef=BswM_LE_DCM_EcuReset_SOFT, BswMRuleTrueActionList=BswM_AL_DCM_EcuReset_SOFT
        BswM_AR_DCM_EcuReset_HARD (BswMRule): BswMRuleInitState=BSWM_FALSE, BswMRuleExpressionRef=BswM_LE_DCM_EcuReset_HARD, BswMRuleTrueActionList=BswM_AL_DCM_EcuReset_HARD
        6 x BswMLogicalExpression:
          BswM_LE_DCM_ENABLE_RX_TX_NORM: BswMArgumentRef=BswM_MC_DCM_ENABLE_RX_TX_NORM
          BswM_LE_DCM_DISABLE_RX_TX_NORM: BswMArgumentRef=BswM_MC_DCM_DISABLE_RX_TX_NORM
          BswM_LE_DCM_ENABLE_RX_TX_NORM_NM: BswMArgumentRef=BswM_MC_DCM_ENABLE_RX_TX_NORM_NM
          BswM_LE_DCM_DISABLE_RX_TX_NORM_NM: BswMArgumentRef=BswM_MC_DCM_DISABLE_RX_TX_NORM_NM
          BswM_LE_DCM_ENABLE_RX_DISABLE_TX_NORM: BswMArgumentRef=BswM_MC_DCM_ENABLE_RX_DISABLE_TX_NORM
          BswM_LE_DCM_DISABLE_RX_ENABLE_TX_NORM: BswMArgumentRef=BswM_MC_DCM_DISABLE_RX_ENABLE_TX_NORM
        6 x BswMModeCondition, all with BswMConditionType=BSWM_EQUALS, BswMConditionMode=BswM_MRP_DCM_ComModeRequest_CanNodeNum_01:
          BswM_MC_DCM_ENABLE_RX_TX_NORM
            BswMConditionValue
              BswMBswMode: BswMBswRequestedMode=DCM_ENABLE_RX_TX_NORM
          BswM_MC_DCM_DISABLE_RX_TX_NORM
            BswMConditionValue
              BswMBswMode: BswMBswRequestedMode=DCM_DISABLE_RX_TX_NORMAL
          BswM_MC_DCM_ENABLE_RX_TX_NORM_NM
            BswMConditionValue
              BswMBswMode: BswMBswRequestedMode=DCM_ENABLE_RX_TX_NORM_NM
          BswM_MC_DCM_DISABLE_RX_TX_NORM_NM
            BswMConditionValue
              BswMBswMode: BswMBswRequestedMode=DCM_DISABLE_RX_TX_NORM_NM
          BswM_MC_DCM_ENABLE_RX_DISABLE_TX_NORM
            BswMConditionValue
              BswMBswMode: BswMBswRequestedMode=DCM_ENABLE_RX_DISABLE_TX_NORM
          BswM_MC_DCM_DISABLE_RX_ENABLE_TX_NORM
            BswMConditionValue
              BswMBswMode: BswMBswRequestedMode=DCM_DISABLE_RX_ENABLE_TX_NORM
        BswM_MRP_DCM_ComModeRequest_CanNodeNum_01 (BswMModeRequestPort): BswMRequestProcessing=BSWM_IMMEDIATE
          BswMModeRequestSource_0 (BswMModeRequestSource)
            BswMDcmComModeRequest: BswMDcmComMChannelRef=Can_Network_CanNodeNum_01
        6 x BswMRule, all with BswMRuleInitState=BSWM_FALSE:
          BswM_AR_DCM_ENABLE_RX_TX_NORM: BswMRuleExpressionRef=BswM_LE_DCM_ENABLE_RX_TX_NORM, BswMRuleTrueActionList=BswM_AL_DCM_ENABLE_RX_TX_NORM
          BswM_AR_DCM_DISABLE_RX_TX_NORM: BswMRuleExpressionRef=BswM_LE_DCM_DISABLE_RX_TX_NORM, BswMRuleTrueActionList=BswM_AL_DCM_DISABLE_RX_TX_NORM
          BswM_AR_DCM_ENABLE_RX_DISABLE_TX_NORM: BswMRuleExpressionRef=BswM_LE_DCM_ENABLE_RX_DISABLE_TX_NORM, BswMRuleTrueActionList=BswM_AL_DCM_ENABLE_RX_DISABLE_TX_NORM
          BswM_AR_DCM_ENABLE_RX_TX_NORM_NM: BswMRuleExpressionRef=BswM_LE_DCM_ENABLE_RX_TX_NORM_NM, BswMRuleTrueActionList=BswM_AL_DCM_ENABLE_RX_TX_NORM_NM
          BswM_AR_DCM_DISABLE_RX_TX_NORM_NM: BswMRuleExpressionRef=BswM_LE_DCM_DISABLE_RX_TX_NORM_NM, BswMRuleTrueActionList=BswM_AL_DCM_DISABLE_RX_TX_NORM_NM
          BswM_AR_DCM_DISABLE_RX_ENABLE_TX_NORM: BswMRuleExpressionRef=BswM_LE_DCM_DISABLE_RX_ENABLE_TX_NORM, BswMRuleTrueActionList=BswM_AL_DCM_DISABLE_RX_ENABLE_TX_NORM
        BswM_MRP_ControllerStateAlreadyStarted_CanNodeNum_00 (BswMModeRequestPort): BswMRequestProcessing=BSWM_DEFERRED
          BswMModeRequestSource_0 (BswMModeRequestSource)
            BswMCanSMIndication: BswMCanSMChannelRef=Can_Network_CanNodeNum_00
        BswM_MRP_ControllerStateAlreadyStarted_CanNodeNum_01 (BswMModeRequestPort): BswMRequestProcessing=BSWM_DEFERRED
          BswMModeRequestSource
            BswMCanSMIndication: BswMCanSMChannelRef=Can_Network_CanNodeNum_01
        5 x BswMModeCondition, all with BswMConditionType=BSWM_EQUALS:
          BswM_MC_BswM_ControllerStateAlreadyStarted_CanNodeNum_00: BswMConditionMode=BswM_MRP_ControllerStateAlreadyStarted_CanNodeNum_00
            BswMConditionValue
              BswMBswMode: BswMBswRequestedMode=CANIF_CS_STARTED
          BswM_MC_BswM_ControllerStateAlreadyStarted_CanNodeNum_01: BswMConditionMode=BswM_MRP_ControllerStateAlreadyStarted_CanNodeNum_01
            BswMConditionValue
              BswMBswMode: BswMBswRequestedMode=CANIF_CS_STARTED
          BswM_MC_BswM_ControllerStateAlreadyStarted_CanNodeNum_02: BswMConditionMode=BswM_MRP_ControllerStateAlreadyStarted_CanNodeNum_02
            BswMConditionValue
              BswMBswMode: BswMBswRequestedMode=CANIF_CS_STARTED
          BswM_MC_BswM_ControllerStateAlreadyStarted_CanNodeNum_03: BswMConditionMode=BswM_MRP_ControllerStateAlreadyStarted_CanNodeNum_03
            BswMConditionValue
              BswMBswMode: BswMBswRequestedMode=CANIF_CS_STARTED
          BswM_MC_BswM_AppRun: BswMConditionMode=BswM_MRP_BswM_MDG
            BswMConditionValue
              BswMModeDeclaration: BswMModeValueRef=ECUM_STATE_APP_RUN
        Bsw_AR_AppRun (BswMRule): BswMRuleInitState=BSWM_FALSE, BswMRuleExpressionRef=BswM_LE_AppRun, BswMRuleTrueActionList=BswM_AL_BswMInAppRun
        BswM_AR_DCM_ENABLE_NM (BswMRule): BswMRuleInitState=BSWM_FALSE, BswMRuleExpressionRef=BswM_LE_DCM_ENABLE_NM, BswMRuleTrueActionList=BswM_AL_DCM_ENABLE_TX_RX_NM
        3 x BswMLogicalExpression:
          BswM_LE_DCM_ENABLE_NM: BswMArgumentRef=BswM_MC_DCM_ENABLE_NM
          BswM_LE_AppRun: BswMLogicalOperator=BSWM_AND, BswMArgumentRef=BswM_MC_BswM_ControllerStateAlreadyStarted_CanNodeNum_01, BswMArgumentRef=BswM_MC_BswM_AppRun, BswMArgumentRef=BswM_MC_BswM_ControllerStateAlreadyStarted_CanNodeNum_03, BswMArgumentRef=BswM_MC_BswM_ControllerStateAlreadyStarted_CanNodeNum_02
          BswM_LE_DCM_DISABLE_NM: BswMArgumentRef=BswM_MC_DCM_DISABLE_NM
        BswM_MC_DCM_ENABLE_NM (BswMModeCondition): BswMConditionType=BSWM_EQUALS, BswMConditionMode=BswM_MRP_DCM_ComModeRequest_CanNodeNum_01
          BswMConditionValue
            BswMBswMode: BswMBswRequestedMode=DCM_ENABLE_RX_TX_NM
        BswM_MC_DCM_DISABLE_NM (BswMModeCondition): BswMConditionType=BSWM_EQUALS, BswMConditionMode=BswM_MRP_DCM_ComModeRequest_CanNodeNum_01
          BswMConditionValue
            BswMBswMode: BswMBswRequestedMode=DCM_DISABLE_RX_TX_NM
        BswM_AR_DCM_DISABLE_NM (BswMRule): BswMRuleInitState=BSWM_FALSE, BswMRuleExpressionRef=BswM_LE_DCM_DISABLE_NM, BswMRuleTrueActionList=BswM_AL_DCM_DISABLE_TX_RX_NM
        3 x BswMModeRequestPort, all with BswMRequestProcessing=BSWM_DEFERRED:
          BswM_MRP_ControllerStateAlreadyStarted_CanNodeNum_02
            BswMModeRequestSource_0 (BswMModeRequestSource)
              BswMCanSMIndication: BswMCanSMChannelRef=Can_Network_CanNodeNum_02
          BswM_MRP_ControllerStateAlreadyStarted_CanNodeNum_03
            BswMModeRequestSource_0 (BswMModeRequestSource)
              BswMCanSMIndication: BswMCanSMChannelRef=Can_Network_CanNodeNum_03
          BswM_MRP_SWC_Network
            BswMModeRequestSource_0 (BswMModeRequestSource)
              BswMSwcModeRequest: BswMRbModeRequestQueueSize=0, BswMSwcModeRequestVariableDataPrototypeRef=uint8
              BswMSwcModeRequest: BswMRbModeRequestQueueSize=0
        BswM_MC_NetworkRequest (BswMModeCondition): BswMConditionType=BSWM_EQUALS, BswMConditionMode=BswM_MRP_SWC_Network
          BswMConditionValue
            BswMModeDeclaration: BswMModeValueRef=COMM_FULL_COMMUNICATION
        BswM_MC_NetworkRelease (BswMModeCondition): BswMConditionType=BSWM_EQUALS, BswMConditionMode=BswM_MRP_SWC_Network
          BswMConditionValue
            BswMModeDeclaration: BswMModeValueRef=COMM_NO_COMMUNICATION
        BswM_LE_NetworkRequest (BswMLogicalExpression): BswMArgumentRef=BswM_MC_NetworkRequest
        BswM_LE_NetworkRelease (BswMLogicalExpression): BswMArgumentRef=BswM_MC_NetworkRelease
        BswM_AR_NetworkRequest (BswMRule): BswMRuleInitState=BSWM_FALSE, BswMRuleExpressionRef=BswM_LE_NetworkRequest, BswMRuleTrueActionList=BswM_AL_NetworkRequest
        BswM_AR_NetworkRelease (BswMRule): BswMRuleInitState=BSWM_FALSE, BswMRuleExpressionRef=BswM_LE_NetworkRelease, BswMRuleTrueActionList=BswM_AL_NetworkRelease
        BswM_MRP_WKSOURCE_KL15 (BswMModeRequestPort): BswMRequestProcessing=BSWM_IMMEDIATE
          BswMModeRequestSource
            BswMEcuMWakeupSource: BswMEcuMWakeupSrcRef=ECUM_WKSOURCE_KL15
        BswM_MRP_WKSOURCE_CANMSG (BswMModeRequestPort): BswMRequestProcessing=BSWM_IMMEDIATE
          BswMModeRequestSource
            BswMEcuMWakeupSource: BswMEcuMWakeupSrcRef=ECUM_WKSOURCE_CANMSG
        BswM_MC_WKUP_KL15 (BswMModeCondition): BswMConditionType=BSWM_EQUALS, BswMConditionMode=BswM_MRP_WKSOURCE_KL15
          BswMConditionValue
            BswMBswMode: BswMBswRequestedMode=ECUM_WKSTATUS_VALIDATED
        BswM_MC_WKUP_CANMSG (BswMModeCondition): BswMConditionType=BSWM_EQUALS, BswMConditionMode=BswM_MRP_WKSOURCE_CANMSG
          BswMConditionValue
            BswMBswMode: BswMBswRequestedMode=ECUM_WKSTATUS_VALIDATED
        BswM_LE_Run_Wakeup_KL15 (BswMLogicalExpression): BswMLogicalOperator=BSWM_AND, BswMArgumentRef=BswM_MC_WKUP_KL15, BswMArgumentRef=BswM_MC_BswM_Run
        BswM_LE_Run_Wakeup_CanMsg (BswMLogicalExpression): BswMLogicalOperator=BSWM_AND, BswMArgumentRef=BswM_MC_BswM_Run, BswMArgumentRef=BswM_MC_WKUP_CANMSG
        BswM_AR_Run_KL15 (BswMRule): BswMRuleInitState=BSWM_FALSE, BswMRuleExpressionRef=BswM_LE_Run_Wakeup_KL15, BswMRuleTrueActionList=BswM_AL_BswMSwitchAppRun_WAKEUP
        BswM_AR_Run_CanMsg_WU (BswMRule): BswMRuleInitState=BSWM_FALSE, BswMRuleExpressionRef=BswM_LE_Run_Wakeup_CanMsg, BswMRuleTrueActionList=BswM_AL_BswMSwitchAppRun_WAKEUP
      BswMDataTypeMappingSets:
        BswMDataTypeMappingSetRef = ECUM_STATE_Mapping
        BswMDataTypeMappingSetRef = AppMode_Mapping
        BswMDataTypeMappingSetRef = ComMModeMapping
        BswMDataTypeMappingSetRef = DTS_DcmEcuReset
        BswMDataTypeMappingSetRef = DTS_DcmDiagnosticSessionControl
      BswMModeControl
        8 x BswMAction:
          BswM_AI_BswMSwitchStartupTwo
            BswMAvailableActions
              BswMSchMSwitch: BswMSchMSwitchedMode=ECUM_STATE_STARTUP_TWO
          BswM_AI_BswMSwitchRun
            BswMAvailableActions
              BswMSchMSwitch: BswMSchMSwitchedMode=ECUM_STATE_RUN
          BswM_AI_BswMSwitchAppRun
            BswMAvailableActions
              BswMSchMSwitch: BswMSchMSwitchedMode=ECUM_STATE_APP_RUN
          BswM_AI_BswMSwitchPrepShutdown
            BswMAvailableActions
              BswMSchMSwitch: BswMSchMSwitchedMode=ECUM_STATE_PREP_SHUTDOWN
          BswM_AI_BswMSwitchShutdown
            BswMAvailableActions
              BswMSchMSwitch: BswMSchMSwitchedMode=ECUM_STATE_SHUTDOWN
          BswM_AI_RteTimerStart
            BswMAvailableActions
              BswM_UserCallout (BswMUserCallout): BswMUserCalloutFunction=IC_RteTimerStart()
          BswM_AI_RteStop
            BswMAvailableActions
              BswMUserCallout: BswMUserCalloutFunction=Rte_Stop()
          BswM_AI_GoDown
            BswMAvailableActions
              BswMUserCallout: BswMUserCalloutFunction=EcuM_GoDown(0)
        6 x BswMActionList:
          BswM_AL_BswMSwitchStartupTwo: BswMActionListExecution=BSWM_CONDITION
            5 x BswMActionListItem:
              BswM_ALI_BswMStartupTwo: BswMAbortOnFail=false, BswMActionListItemIndex=0, BswMActionListItemRef=BswM_AI_BswMSwitchStartupTwo
              BswM_ALI_FeeInit: BswMAbortOnFail=0, BswMActionListItemIndex=1, BswMActionListItemRef=BswM_AI_FeeInit
              BswM_ALI_FeeRbEndInit: BswMAbortOnFail=0, BswMActionListItemIndex=2, BswMActionListItemRef=BswMAction_FeeRbEndInit
              BswM_ALI_NvMInit: BswMAbortOnFail=0, BswMActionListItemIndex=3, BswMActionListItemRef=BswM_AI_NvMInit
              BswM_ALI_NvMReadAll: BswMAbortOnFail=0, BswMActionListItemIndex=4, BswMActionListItemRef=BswM_AI_NvMReadAll
          BswM_AL_BswMSwitchRun: BswMActionListExecution=BSWM_TRIGGER
            18 x BswMActionListItem:
              BswM_ALI_CanInit: BswMAbortOnFail=0, BswMActionListItemIndex=1, BswMActionListItemRef=BswM_AI_CanInit
              BswM_ALI_CanIfInit: BswMAbortOnFail=0, BswMActionListItemIndex=2, BswMActionListItemRef=BswM_AI_CanIfInit
              BswM_ALI_CanSmInit: BswMAbortOnFail=0, BswMActionListItemIndex=3, BswMActionListItemRef=BswM_AI_CanSmInit
              BswM_ALI_PduRInit: BswMAbortOnFail=0, BswMActionListItemIndex=5, BswMActionListItemRef=BswM_AI_PduRInit
              BswM_ALI_ComInit: BswMAbortOnFail=0, BswMActionListItemIndex=6, BswMActionListItemRef=BswM_AI_ComInit
              BswM_ALI_ComMInit: BswMAbortOnFail=0, BswMActionListItemIndex=7, BswMActionListItemRef=BswM_AI_ComMInit
              BswM_ALI_BswMRun: BswMAbortOnFail=false, BswMActionListItemIndex=8, BswMActionListItemRef=BswM_AI_BswMSwitchRun
              BswM_ALI_DemInit: BswMAbortOnFail=false, BswMActionListItemIndex=9, BswMActionListItemRef=BswMAction_DemInit
              BswM_ALI_DcmInit: BswMAbortOnFail=0, BswMActionListItemIndex=10, BswMActionListItemRef=BswM_AI_Dcm_Init
              BswM_ALI_CanTpInit: BswMAbortOnFail=0, BswMActionListItemIndex=11, BswMActionListItemRef=BswM_AI_CanTp_Init
              BswM_ALI_WdgMInit: BswMAbortOnFail=false, BswMActionListItemIndex=12, BswMActionListItemRef=BswM_AI_WdgMInit
              BswM_ALI_XcpInit: BswMAbortOnFail=false, BswMActionListItemIndex=13, BswMActionListItemRef=BswM_AI_XcpInit
              BswM_ALI_CheckCondition: BswMAbortOnFail=0, BswMActionListItemIndex=14, BswMActionListItemRef=BswM_AI_CheckCondition
              BswM_ALI_RteTimerStart: BswMAbortOnFail=0, BswMActionListItemIndex=15, BswMActionListItemRef=BswM_AI_RteTimerStart
              BswM_ALI_Nm_Init: BswMAbortOnFail=0, BswMActionListItemIndex=16, BswMActionListItemRef=BswM_AI_Nm_Init
              BswM_ALI_CanNm_Init: BswMAbortOnFail=0, BswMActionListItemIndex=17, BswMActionListItemRef=BswM_AI_CanNm_Init
              BswM_ALI_CanTrcv_Init: BswMAbortOnFail=0, BswMActionListItemIndex=18, BswMActionListItemRef=BswM_AI_CanTrcv_Init
              BswM_ALI_ReloadCANID: BswMAbortOnFail=0, BswMActionListItemIndex=19, BswMActionListItemRef=BswMAction_ReloadCANID
          BswM_AL_BswMSwitchAppRun: BswMActionListExecution=BSWM_TRIGGER
            4 x BswMActionListItem:
              BswM_ALI_AllowComm_CanNodeNum_01: BswMAbortOnFail=0, BswMActionListItemIndex=0, BswMActionListItemRef=BswM_AI_ComMCommAllowed_CanNodeNum_01
              BswM_ALI_AllowComm_CanNodeNum_02: BswMAbortOnFail=0, BswMActionListItemIndex=1, BswMActionListItemRef=BswM_AI_ComMCommAllowed_CanNodeNum_02
              BswM_ALI_AllowComm_CanNodeNum_03: BswMAbortOnFail=0, BswMActionListItemIndex=2, BswMActionListItemRef=BswM_AI_ComMCommAllowed_CanNodeNum_03
              BswM_ALI_AllowComm_CanNodeNum_00: BswMAbortOnFail=false, BswMActionListItemIndex=3, BswMActionListItemRef=BswM_AI_ComMCommAllowed_CanNodeNum_00
          BswM_AL_BswMSwitchPrepShutdown: BswMActionListExecution=BSWM_TRIGGER
            10 x BswMActionListItem:
              BswM_ALI_BswMPrepShutdown: BswMAbortOnFail=false, BswMActionListItemIndex=0, BswMActionListItemRef=BswM_AI_BswMSwitchPrepShutdown
              BswM_ALI_ComMReqNoComm_CanNodeNum_01: BswMAbortOnFail=0, BswMActionListItemIndex=1, BswMActionListItemRef=BswM_AI_ComMReqNoComm_CanNodeNum_01
              BswM_ALI_ComMCommNotAllowed_CanNodeNum_01: BswMAbortOnFail=0, BswMActionListItemIndex=2, BswMActionListItemRef=BswM_AI_ComMCommNotAllowed_CanNodeNum_01
              BswM_ALI_ComMReqNoComm_CanNodeNum_02: BswMAbortOnFail=0, BswMActionListItemIndex=3, BswMActionListItemRef=BswM_AI_ComMReqNoComm_CanNodeNum_02
              BswM_ALI_ComMCommNotAllowed_CanNodeNum_02: BswMAbortOnFail=0, BswMActionListItemIndex=4, BswMActionListItemRef=BswM_AI_ComMCommNotAllowed_CanNodeNum_02
              BswM_ALI_ComMReqNoComm_CanNodeNum_03: BswMAbortOnFail=0, BswMActionListItemIndex=5, BswMActionListItemRef=BswM_AI_ComMReqNoComm_CanNodeNum_03
              BswM_ALI_ComMCommNotAllowed_CanNodeNum_03: BswMAbortOnFail=0, BswMActionListItemIndex=6, BswMActionListItemRef=BswM_AI_ComMCommNotAllowed_CanNodeNum_03
              BswM_ALI_StopPduGroup_All: BswMAbortOnFail=0, BswMActionListItemIndex=7, BswMActionListItemRef=BswM_AI_StopPduGroup_All
              BswM_ALI_ComMReqNoComm_CanNodeNum_00: BswMAbortOnFail=false, BswMActionListItemIndex=8, BswMActionListItemRef=BswM_AI_ComMReqNoComm_CanNodeNum_00
              BswM_ALI_ComMCommNotAllowed_CanNodeNum_00: BswMAbortOnFail=false, BswMActionListItemIndex=9, BswMActionListItemRef=BswM_AI_ComMCommNotAllowed_CanNodeNum_00
          BswM_AL_BswMSwitchShutdown: BswMActionListExecution=BSWM_TRIGGER
            4 x BswMActionListItem:
              BswM_ALI_RteStop: BswMAbortOnFail=false, BswMActionListItemIndex=1, BswMActionListItemRef=BswM_AI_RteStop
              BswM_ALI_WriteAll: BswMAbortOnFail=0, BswMActionListItemIndex=2, BswMActionListItemRef=BswM_AI_NvMWriteAll
              BswM_ALI_EcuM_SelectShutdownTarget_RESET_MCU: BswMAbortOnFail=0, BswMActionListItemIndex=3, BswMActionListItemRef=BswMAction_EcuM_SelectShutdownTarget_RESET_MCU
              BswM_ALI_BswMShutdown: BswMAbortOnFail=false, BswMActionListItemIndex=4, BswMActionListItemRef=BswM_AI_BswMSwitchShutdown
          BswM_AL_BswMSwitchGoDown: BswMActionListExecution=BSWM_TRIGGER
            BswM_ALI_GoDown (BswMActionListItem): BswMAbortOnFail=false, BswMActionListItemIndex=1, BswMActionListItemRef=BswM_AI_GoDown
            BswMActionListItem_EcuM_InfinitLoopMainFunc (BswMActionListItem): BswMAbortOnFail=0, BswMActionListItemIndex=2, BswMActionListItemRef=BswMAction_EcuM_LoopMainFunc
        31 x BswMAction:
          BswM_AI_ComMCommAllowed_CanNodeNum_00
            BswMAvailableActions_0 (BswMAvailableActions)
              BswMComMAllowCom: BswMComAllowed=true, BswMComMAllowChannelRef=Can_Network_CanNodeNum_00
          BswM_AI_ComMCommAllowed_CanNodeNum_01
            BswMAvailableActions
              BswMComMAllowCom: BswMComAllowed=1, BswMComMAllowChannelRef=Can_Network_CanNodeNum_01
          BswM_AI_ComMCommAllowed_CanNodeNum_02
            BswMAvailableActions_0 (BswMAvailableActions)
              BswMComMAllowCom: BswMComAllowed=true, BswMComMAllowChannelRef=Can_Network_CanNodeNum_02
          BswM_AI_ComMCommAllowed_CanNodeNum_03
            BswMAvailableActions_0 (BswMAvailableActions)
              BswMComMAllowCom: BswMComAllowed=true, BswMComMAllowChannelRef=Can_Network_CanNodeNum_03
          BswM_AI_ComMCommNotAllowed_CanNodeNum_00
            BswMAvailableActions_0 (BswMAvailableActions)
              BswMComMAllowCom: BswMComAllowed=false, BswMComMAllowChannelRef=Can_Network_CanNodeNum_00
          BswM_AI_ComMCommNotAllowed_CanNodeNum_01
            BswMAvailableActions
              BswMComMAllowCom: BswMComAllowed=0, BswMComMAllowChannelRef=Can_Network_CanNodeNum_01
          BswM_AI_ComMCommNotAllowed_CanNodeNum_02
            BswMAvailableActions_0 (BswMAvailableActions)
              BswMComMAllowCom: BswMComAllowed=false, BswMComMAllowChannelRef=Can_Network_CanNodeNum_02
          BswM_AI_ComMCommNotAllowed_CanNodeNum_03
            BswMAvailableActions_0 (BswMAvailableActions)
              BswMComMAllowCom: BswMComAllowed=false, BswMComMAllowChannelRef=Can_Network_CanNodeNum_03
          BswM_AI_ComMReqFullComm_CanNodeNum_00
            BswMAvailableActions_0 (BswMAvailableActions)
              BswMComMModeSwitch: BswMComMRequestedMode=BSWM_FULL_COM, BswMComMUserRef=ComMUser_Can_Network_CanNodeNum_00
          BswM_AI_ComMReqFullComm_CanNodeNum_01
            BswMAvailableActions
              BswMComMModeSwitch: BswMComMRequestedMode=BSWM_FULL_COM, BswMComMUserRef=ComMUser_Can_Network_CanNodeNum_01
          BswM_AI_ComMReqFullComm_CanNodeNum_02
            BswMAvailableActions_0 (BswMAvailableActions)
              BswMComMModeSwitch: BswMComMRequestedMode=BSWM_FULL_COM, BswMComMUserRef=ComMUser_Can_Network_CanNodeNum_02
          BswM_AI_ComMReqFullComm_CanNodeNum_03
            BswMAvailableActions_0 (BswMAvailableActions)
              BswMComMModeSwitch: BswMComMRequestedMode=BSWM_FULL_COM, BswMComMUserRef=ComMUser_Can_Network_CanNodeNum_03
          BswM_AI_ComMReqNoComm_CanNodeNum_00
            BswMAvailableActions_0 (BswMAvailableActions)
              BswMComMModeSwitch: BswMComMRequestedMode=BSWM_NO_COM, BswMComMUserRef=ComMUser_Can_Network_CanNodeNum_00
          BswM_AI_ComMReqNoComm_CanNodeNum_01
            BswMAvailableActions
              BswMComMModeSwitch: BswMComMRequestedMode=BSWM_NO_COM, BswMComMUserRef=ComMUser_Can_Network_CanNodeNum_01
          BswM_AI_ComMReqNoComm_CanNodeNum_02
            BswMAvailableActions_0 (BswMAvailableActions)
              BswMComMModeSwitch: BswMComMRequestedMode=BSWM_NO_COM, BswMComMUserRef=ComMUser_Can_Network_CanNodeNum_02
          BswM_AI_ComMReqNoComm_CanNodeNum_03
            BswMAvailableActions_0 (BswMAvailableActions)
              BswMComMModeSwitch: BswMComMRequestedMode=BSWM_NO_COM, BswMComMUserRef=ComMUser_Can_Network_CanNodeNum_03
          BswM_AI_StartPduGroup_All
            BswMAvailableActions
              BswMPduGroupSwitch:
                BswMPduGroupSwitchReinit = false
                BswMEnabledPduGroupRef = ComIPduGroup_CanNodeNum_01_Rx
                BswMEnabledPduGroupRef = ComIPduGroup_CanNodeNum_01_Tx
                BswMEnabledPduGroupRef = ComIPduGroup_CanNodeNum_02_Rx
                BswMEnabledPduGroupRef = ComIPduGroup_CanNodeNum_02_Tx
                BswMEnabledPduGroupRef = ComIPduGroup_CanNodeNum_03_Rx
                BswMEnabledPduGroupRef = ComIPduGroup_CanNodeNum_03_Tx
          BswM_AI_StopPduGroup_All
            BswMAvailableActions
              BswMPduGroupSwitch:
                BswMPduGroupSwitchReinit = false
                BswMDisabledPduGroupRef = ComIPduGroup_CanNodeNum_01_Rx
                BswMDisabledPduGroupRef = ComIPduGroup_CanNodeNum_01_Tx
                BswMDisabledPduGroupRef = ComIPduGroup_CanNodeNum_02_Rx
                BswMDisabledPduGroupRef = ComIPduGroup_CanNodeNum_02_Tx
                BswMDisabledPduGroupRef = ComIPduGroup_CanNodeNum_03_Rx
                BswMDisabledPduGroupRef = ComIPduGroup_CanNodeNum_03_Tx
          BswM_AI_CanIfInit
            BswMAvailableActions
              BswMUserCallout: BswMUserCalloutFunction=CanIf_Init(NULL_PTR)
          BswM_AI_CanInit
            BswMAvailableActions
              BswMUserCallout: BswMUserCalloutFunction=Can_17_McmCan_Init(&Can_17_McmCan_Config)
          BswM_AI_ComMInit
            BswMAvailableActions
              BswMUserCallout: BswMUserCalloutFunction=ComM_Init(NULL_PTR)
          BswM_AI_CanSmInit
            BswMAvailableActions
              BswMUserCallout: BswMUserCalloutFunction=CanSM_Init(NULL_PTR)
          BswM_AI_ComInit
            BswMAvailableActions
              BswMUserCallout: BswMUserCalloutFunction=Com_Init(NULL_PTR)
          BswM_AI_PduRInit
            BswMAvailableActions
              BswMUserCallout: BswMUserCalloutFunction=PduR_Init(&PduR_Config)
          BswM_AI_FeeInit
            BswMAvailableActions
              BswMUserCallout: BswMUserCalloutFunction=Fee_Init(NULL_PTR)
          BswM_AI_NvMWriteAll
            BswMAvailableActions_0 (BswMAvailableActions)
              BswMUserCallout: BswMUserCalloutFunction=IC_BswM_NvM_WriteAll()
          BswM_AI_NvMReadAll
            BswMAvailableActions_0 (BswMAvailableActions)
              BswMUserCallout: BswMUserCalloutFunction=IC_BswM_NvM_ReadAll()
          BswM_AI_NvMInit
            BswMAvailableActions_0 (BswMAvailableActions)
              BswMUserCallout: BswMUserCalloutFunction=NvM_Init()
          BswMAction_EcuM_LoopMainFunc
            BswMAvailableActions
              BswMUserCallout: BswMUserCalloutFunction=Loop_EcuM_MainFunc()
          BswM_AI_Dcm_Init
            BswMAvailableActions_0 (BswMAvailableActions)
              BswMUserCallout: BswMUserCalloutFunction=Dcm_Init(NULL_PTR)
          BswM_AI_CanTp_Init
            BswMAvailableActions_0 (BswMAvailableActions)
              BswMUserCallout: BswMUserCalloutFunction=CanTp_Init(NULL_PTR)
        BswM_AL_DCM_EcuReset_SOFT (BswMActionList): BswMActionListExecution=BSWM_TRIGGER
          BswM_ALI_EcuM_SelectShutdownTarget_RESET_MCU (BswMActionListItem): BswMAbortOnFail=false, BswMActionListItemIndex=0, BswMActionListItemRef=BswMAction_EcuM_SelectShutdownTarget_RESET_MCU
          BswM_ALI_GoDown (BswMActionListItem): BswMAbortOnFail=0, BswMActionListItemIndex=1, BswMActionListItemRef=BswM_AI_GoDown
        BswM_AL_DCM_EcuReset_HARD (BswMActionList): BswMActionListExecution=BSWM_TRIGGER
          5 x BswMActionListItem:
            BswMActionListItem_EcuM_SelectShutdownTarget_RESET_IO: BswMAbortOnFail=false, BswMActionListItemIndex=0, BswMActionListItemRef=BswMAction_EcuM_SelectShutdownTarget_RESET_IO
            BswMActionListItem_Dem_endOperation: BswMAbortOnFail=false, BswMActionListItemIndex=1, BswMActionListItemRef=BswMAction_Dem_EndOperation
            BswMActionListItem__DemShutdown: BswMAbortOnFail=0, BswMActionListItemIndex=2, BswMActionListItemRef=BswMAction_DemShutdown
            BswMActionListItem_Writeall: BswMAbortOnFail=0, BswMActionListItemIndex=3, BswMActionListItemRef=BswM_AI_NvMWriteAll
            BswMActionListItem_GoDown: BswMAbortOnFail=0, BswMActionListItemIndex=4, BswMActionListItemRef=BswM_AI_GoDown
        6 x BswMAction:
          BswMAction_EcuM_SelectShutdownTarget_RESET_MCU
            BswMAvailableActions_0 (BswMAvailableActions)
              BswMUserCallout: BswMUserCalloutFunction=EcuM_SelectShutdownTarget(ECUM_SHUTDOWN_TARGET_RESET,ECUM_RESET_MCU)
          BswMAction_EcuM_SelectShutdownTarget_RESET_IO
            BswMAvailableActions_0 (BswMAvailableActions)
              BswMUserCallout: BswMUserCalloutFunction=EcuM_SelectShutdownTarget(ECUM_SHUTDOWN_TARGET_RESET,ECUM_RESET_IO)
          BswMAction_EnableRxPduGroup
            BswMAvailableActions_0 (BswMAvailableActions)
              BswMPduGroupSwitch: BswMPduGroupSwitchReinit=false, BswMEnabledPduGroupRef=ComIPduGroup_CanNodeNum_01_Rx
          BswMAction_DisableRxPduGroup
            BswMAvailableActions_0 (BswMAvailableActions)
              BswMPduGroupSwitch: BswMPduGroupSwitchReinit=false, BswMDisabledPduGroupRef=ComIPduGroup_CanNodeNum_01_Rx
          BswMAction_EnableTxPduGroup
            BswMAvailableActions_0 (BswMAvailableActions)
              BswMPduGroupSwitch: BswMPduGroupSwitchReinit=false, BswMEnabledPduGroupRef=ComIPduGroup_CanNodeNum_01_Tx
          BswMAction_DisableTxPduGroup
            BswMAvailableActions_0 (BswMAvailableActions)
              BswMPduGroupSwitch: BswMPduGroupSwitchReinit=false, BswMDisabledPduGroupRef=ComIPduGroup_CanNodeNum_01_Tx
        6 x BswMActionList, all with BswMActionListExecution=BSWM_TRIGGER:
          BswM_AL_DCM_ENABLE_RX_TX_NORM
            BswMActionListItem_EnableRxPduGroup (BswMActionListItem): BswMAbortOnFail=false, BswMActionListItemIndex=0, BswMActionListItemRef=BswMAction_EnableRxPduGroup
            BswMActionListItem_EnableTxPduGroup (BswMActionListItem): BswMAbortOnFail=false, BswMActionListItemIndex=1, BswMActionListItemRef=BswMAction_EnableTxPduGroup
          BswM_AL_DCM_DISABLE_RX_TX_NORM
            BswMActionListItem_DisableRxPduGroup (BswMActionListItem): BswMAbortOnFail=false, BswMActionListItemIndex=0, BswMActionListItemRef=BswMAction_DisableRxPduGroup
            BswMActionListItem_DisableTxPduGroup (BswMActionListItem): BswMAbortOnFail=false, BswMActionListItemIndex=1, BswMActionListItemRef=BswMAction_DisableTxPduGroup
          BswM_AL_DCM_ENABLE_RX_TX_NORM_NM
            3 x BswMActionListItem, all with BswMAbortOnFail=false:
              BswMActionListItem_EnableRxPduGroup: BswMActionListItemIndex=0, BswMActionListItemRef=BswMAction_EnableRxPduGroup
              BswMActionListItem_EnableTxPduGroup: BswMActionListItemIndex=1, BswMActionListItemRef=BswMAction_EnableTxPduGroup
              BswMActionListItem_0: BswMActionListItemIndex=2, BswMActionListItemRef=BswMAction_NM_Start
          BswM_AL_DCM_DISABLE_RX_TX_NORM_NM
            3 x BswMActionListItem, all with BswMAbortOnFail=false:
              BswMActionListItem_DisableRxPduGroup: BswMActionListItemIndex=0, BswMActionListItemRef=BswMAction_DisableRxPduGroup
              BswMActionListItem_DisableTxPduGroup: BswMActionListItemIndex=1, BswMActionListItemRef=BswMAction_DisableTxPduGroup
              BswMActionListItem_0: BswMActionListItemIndex=2, BswMActionListItemRef=BswMAction_NM_Stop
          BswM_AL_DCM_ENABLE_RX_DISABLE_TX_NORM
            BswMActionListItem_EnableRxPduGroup (BswMActionListItem): BswMAbortOnFail=false, BswMActionListItemIndex=0, BswMActionListItemRef=BswMAction_EnableRxPduGroup
            BswMActionListItem_DisableTxPduGroup (BswMActionListItem): BswMAbortOnFail=false, BswMActionListItemIndex=1, BswMActionListItemRef=BswMAction_DisableTxPduGroup
          BswM_AL_DCM_DISABLE_RX_ENABLE_TX_NORM
            BswMActionListItem_DisableRxPduGroup (BswMActionListItem): BswMAbortOnFail=false, BswMActionListItemIndex=0, BswMActionListItemRef=BswMAction_DisableRxPduGroup
            BswMActionListItem_EnableTxPduGroup (BswMActionListItem): BswMAbortOnFail=false, BswMActionListItemIndex=1, BswMActionListItemRef=BswMAction_EnableTxPduGroup
        5 x BswMAction:
          BswMAction_DemInit
            BswMAvailableActions_0 (BswMAvailableActions)
              BswMUserCallout: BswMUserCalloutFunction=Dem_Init()
          BswMAction_DemShutdown
            BswMAvailableActions_0 (BswMAvailableActions)
              BswMUserCallout: BswMUserCalloutFunction=Dem_Shutdown()
          BswMAction_Dem_EndOperation
            BswMAvailableActions
              BswMUserCallout: BswMUserCalloutFunction=Dem_SetOperationCycleState(0,DEM_CYCLE_STATE_END)
          BswM_AI_WdgMInit
            BswMAvailableActions
              BswMUserCallout: BswMUserCalloutFunction=WdgM_Init(NULL_PTR)
          BswM_AI_XcpInit
            BswMAvailableActions_0 (BswMAvailableActions)
              BswMUserCallout: BswMUserCalloutFunction=Xcp_Init(NULL_PTR)
        BswM_AL_BswMInAppRun (BswMActionList): BswMActionListExecution=BSWM_TRIGGER
          BswM_ALI_StartPduGroup (BswMActionListItem): BswMAbortOnFail=0, BswMActionListItemIndex=0, BswMActionListItemRef=BswM_AI_StartPduGroup_All
        5 x BswMAction:
          BswM_AI_CheckCondition
            BswMAvailableActions_0 (BswMAvailableActions)
              BswMUserCallout: BswMUserCalloutFunction=CheckCondition()
          BswM_AI_CanNm_Init
            BswMAvailableActions_0 (BswMAvailableActions)
              BswMUserCallout: BswMUserCalloutFunction=CanNm_Init(NULL_PTR)
          BswM_AI_Nm_Init
            BswMAvailableActions_0 (BswMAvailableActions)
              BswMUserCallout: BswMUserCalloutFunction=Nm_Init(NULL_PTR)
          BswMAction_NM_Start
            BswMAvailableActions_0 (BswMAvailableActions)
              BswMNMControl: BswMNMAction=BSWM_NM_ENABLE, BswMComMNetworkHandleRef=Can_Network_CanNodeNum_01
          BswMAction_NM_Stop
            BswMAvailableActions_0 (BswMAvailableActions)
              BswMNMControl: BswMNMAction=BSWM_NM_DISABLE, BswMComMNetworkHandleRef=Can_Network_CanNodeNum_01
        4 x BswMActionList, all with BswMActionListExecution=BSWM_TRIGGER:
          BswM_AL_DCM_ENABLE_TX_RX_NM
            BswMActionListItem_0 (BswMActionListItem): BswMAbortOnFail=false, BswMActionListItemIndex=0, BswMActionListItemRef=BswMAction_NM_Start
          BswM_AL_DCM_DISABLE_TX_RX_NM
            BswMActionListItem_0 (BswMActionListItem): BswMAbortOnFail=false, BswMActionListItemIndex=0, BswMActionListItemRef=BswMAction_NM_Stop
          BswM_AL_NetworkRequest
            9 x BswMActionListItem:
              BswM_ALI_ComMReqFullComm_CanNodeNum_00: BswMAbortOnFail=0, BswMActionListItemIndex=0, BswMActionListItemRef=BswM_AI_ComMReqFullComm_CanNodeNum_00
              BswM_ALI_ComMReqFullComm_CanNodeNum_01: BswMAbortOnFail=false, BswMActionListItemIndex=1, BswMActionListItemRef=BswM_AI_ComMReqFullComm_CanNodeNum_01
              BswM_ALI_ComMReqFullComm_CanNodeNum_02: BswMAbortOnFail=0, BswMActionListItemIndex=2, BswMActionListItemRef=BswM_AI_ComMReqFullComm_CanNodeNum_02
              BswM_ALI_ComMReqFullComm_CanNodeNum_03: BswMAbortOnFail=0, BswMActionListItemIndex=3, BswMActionListItemRef=BswM_AI_ComMReqFullComm_CanNodeNum_03
              BswM_ALI_ComMCommAllowed_CanNodeNum_00: BswMAbortOnFail=0, BswMActionListItemIndex=4, BswMActionListItemRef=BswM_AI_ComMCommAllowed_CanNodeNum_00
              BswM_ALI_ComMCommAllowed_CanNodeNum_01: BswMAbortOnFail=0, BswMActionListItemIndex=5, BswMActionListItemRef=BswM_AI_ComMCommAllowed_CanNodeNum_01
              BswM_ALI_ComMCommAllowed_CanNodeNum_02: BswMAbortOnFail=0, BswMActionListItemIndex=6, BswMActionListItemRef=BswM_AI_ComMCommAllowed_CanNodeNum_02
              BswM_ALI_ComMCommAllowed_CanNodeNum_03: BswMAbortOnFail=0, BswMActionListItemIndex=7, BswMActionListItemRef=BswM_AI_ComMCommAllowed_CanNodeNum_03
              BswM_ALI_StartPduGroup_All: BswMAbortOnFail=0, BswMActionListItemIndex=8, BswMActionListItemRef=BswM_AI_StartPduGroup_All
          BswM_AL_NetworkRelease
            8 x BswMActionListItem:
              BswM_ALI_ComMReqNoComm_CanNodeNum_00: BswMAbortOnFail=0, BswMActionListItemIndex=0, BswMActionListItemRef=BswM_AI_ComMReqNoComm_CanNodeNum_00
              BswM_ALI_ComMReqNoComm_CanNodeNum_01: BswMAbortOnFail=false, BswMActionListItemIndex=1, BswMActionListItemRef=BswM_AI_ComMReqNoComm_CanNodeNum_01
              BswM_ALI_ComMReqNoComm_CanNodeNum_02: BswMAbortOnFail=0, BswMActionListItemIndex=2, BswMActionListItemRef=BswM_AI_ComMReqNoComm_CanNodeNum_02
              BswM_ALI_ComMReqNoComm_CanNodeNum_03: BswMAbortOnFail=0, BswMActionListItemIndex=3, BswMActionListItemRef=BswM_AI_ComMReqNoComm_CanNodeNum_03
              BswM_ALI_ComMCommNotAllowed_CanNodeNum_00: BswMAbortOnFail=0, BswMActionListItemIndex=4, BswMActionListItemRef=BswM_AI_ComMCommNotAllowed_CanNodeNum_00
              BswM_ALI_ComMCommNotAllowed_CanNodeNum_01: BswMAbortOnFail=0, BswMActionListItemIndex=5, BswMActionListItemRef=BswM_AI_ComMCommNotAllowed_CanNodeNum_01
              BswM_ALI_ComMCommNotAllowed_CanNodeNum_02: BswMAbortOnFail=0, BswMActionListItemIndex=6, BswMActionListItemRef=BswM_AI_ComMCommNotAllowed_CanNodeNum_02
              BswM_ALI_ComMCommNotAllowed_CanNodeNum_03: BswMAbortOnFail=0, BswMActionListItemIndex=7, BswMActionListItemRef=BswM_AI_ComMCommNotAllowed_CanNodeNum_03
        BswMAction_FeeRbEndInit (BswMAction)
          BswMAvailableActions
            BswMUserCallout: BswMUserCalloutFunction=Fee_Rb_EndInit()
        BswM_AL_BswMSwitchAppRun_WAKEUP (BswMActionList): BswMActionListExecution=BSWM_TRIGGER
          BswM_ALI_ComMReqFullComm_CanNodeNum_00 (BswMActionListItem): BswMAbortOnFail=false, BswMActionListItemIndex=1, BswMActionListItemRef=BswM_AI_ComMReqFullComm_CanNodeNum_00
          BswM_ALI_BswMAppRun (BswMActionListItem): BswMAbortOnFail=false, BswMActionListItemIndex=2, BswMActionListItemRef=BswM_AI_BswMSwitchAppRun
        3 x BswMAction:
          BswMAction_SwitchAppMode_Dummy
            BswMAvailableActions
              BswMSchMSwitch: BswMSchMSwitchedMode=SWC_REQUEST_SHUTDOWN
          BswM_AI_CanTrcv_Init
            BswMAvailableActions_0 (BswMAvailableActions)
              BswMUserCallout: BswMUserCalloutFunction=CanTrcv_Init(NULL_PTR)
          BswMAction_ReloadCANID
            BswMAvailableActions_0 (BswMAvailableActions)
              BswMUserCallout: BswMUserCalloutFunction=CddCom_vidReloadCANID()
