AUTOSAR XML (schema 00047)
package /Spi
  module config Spi: implementation-config-variant=VARIANT-POST-BUILD-SELECTABLE
    SpiDriver_0 (SpiDriver)
      CAN_Trcv_Tja1145 (SpiChannel): SpiChannelType=EB, SpiDataWidth=16, SpiDefaultData=0, SpiEbMaxLength=511, SpiTransferStart=MSB
      CanTrcv_0 (SpiExternalDevice):
        SpiAutoCalcBaudParams = 0
        SpiAutoCalcDelayParams = 0
        SpiCsPolarity = LOW
        SpiCsSelection = CS_VIA_PERIPHERAL_ENGINE
        SpiDataShiftEdge = LEADING
        SpiEnableCs = 1
        SpiParitySupport = Unused
        SpiQSpiParamA = 2
        SpiQSpiParamB = 1
        SpiQSpiParamC = 1
        SpiQSpiParamIPre = 1
        SpiQSpiParamIdle = 1
        SpiQSpiParamLPre = 0
        SpiQSpiParamLead = 1
        SpiQSpiParamQ = 1
        SpiQSpiParamTPre = 0
        SpiQSpiParamTq = 9
        SpiQSpiParamTrail = 1
        SpiShiftClockIdleLevel = LOW
        SpiHwUnit = CSIH0
      SpiJob_0 (SpiJob): SpiChannelBasedCS=Enabled, SpiJobEndNotification=NULL_PTR, SpiJobPriority=0, SpiDeviceAssignment=CanTrcv_0
        SpiChannelList_0 (SpiChannelList): SpiChannelIndex=0, SpiChannelAssignment=CAN_Trcv_Tja1145
      SpiSequence_0 (SpiSequence): SpiSeqEndNotification=NULL_PTR, SpiJobAssignment=SpiJob_0
    SpiGeneral: SpiChannelBuffersAllowed=1, SpiLevelDelivered=0
      SpiRbInterruptAddress_0 (SpiRbInterruptAddress)
      Spi_Csih_HwRegCfg_0 (Spi_Csih_HwRegCfg)
        8 x Spi_Csih_HwCfgReg:
          Spi_Csih_HwCfgReg_0
          Spi_Csih_HwCfgReg_{0..6}
