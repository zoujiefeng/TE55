AUTOSAR XML (schema 00047)
package /ETAS_Project/EcucModuleConfigurationValuess
  module config CanTp: implementation-config-variant=VARIANT-PRE-COMPILE
    CanTpConfig: CanTpMainFunctionPeriod=0.001
      CanTpChannel_UDS (CanTpChannel): CanTpChannelMode=CANTP_MODE_FULL_DUPLEX
        Diag_Functional_request_Can_Network_CANNODE_0_Phys_CanTp2PduR (CanTpRxNSdu):
          CanTpBs = 0
          CanTpNar = 0.07
          CanTpNbr = 0.02
          CanTpNcr = 1.0
          CanTpRxAddressingFormat = CANTP_STANDARD
          CanTpRxPaddingActivation = CANTP_ON
          CanTpRxTaType = CANTP_FUNCTIONAL
          CanTpSTmin = 0.02
          CanTpRxNSduId = 0
          CanTpRxNSduRef = DcmPdu_CanTp2PduR_CanNodeNum_01_FunRequest
          Diag_Functional_request_Can_Network_CANNODE_0_Phys_CanIf2CanTp (CanTpRxNPdu): CanTpRxNPduRef=DcmPdu_CanIf2CanTp_CanNodeNum_01_FunRequest
        Diag_Physical_request_Can_Network_CANNODE_0_Func_CanTp2PduR (CanTpRxNSdu):
          CanTpBs = 0
          CanTpNar = 0.07
          CanTpNbr = 0.025
          CanTpNcr = 1.0
          CanTpRxAddressingFormat = CANTP_STANDARD
          CanTpRxPaddingActivation = CANTP_ON
          CanTpRxTaType = CANTP_PHYSICAL
          CanTpSTmin = 0.02
          CanTpRxNSduRef = DcmPdu_CanTp2PduR_CanNodeNum_01_PhyRequest
          Diag_Physical_request_Can_Network_CANNODE_0_Phys_CanIf2CanTp (CanTpRxNPdu): CanTpRxNPduRef=DcmPdu_CanIf2CanTp_CanNodeNum_01_PhyRequest
          Diag_Physical_response_Can_Network_CANNODE_0_Phys_CanTp2CanIf (CanTpTxFcNPdu): CanTpTxFcNPduRef=DcmPdu_CanTp2CanIf_CanNodeNum_01_PhyResponse
        Diag_Physical_response_Can_Network_CANNODE_0_Phys_PduR2CanTp (CanTpTxNSdu):
          CanTpNas = 0.07
          CanTpNbs = 0.15
          CanTpNcs = 0.002
          CanTpTc = 1
          CanTpTxAddressingFormat = CANTP_STANDARD
          CanTpTxPaddingActivation = CANTP_ON
          CanTpTxTaType = CANTP_PHYSICAL
          CanTpTxNSduRef = DcmPdu_PduR2CanTp_CanNodeNum_01_PhyResponse
          Diag_Physical_response_Can_Network_CANNODE_0_Phys_CanTp2CanIf (CanTpTxNPdu): CanTpTxNPduRef=DcmPdu_CanTp2CanIf_CanNodeNum_01_PhyResponse
          Diag_Physical_request_Can_Network_CANNODE_0_Phys_CanIf2CanTp (CanTpRxFcNPdu): CanTpRxFcNPduRef=DcmPdu_CanIf2CanTp_CanNodeNum_01_PhyRequest
    CanTpGeneral:
      CanTpDynIdSupport = 0
      CanTpFlexibleDataRateSupport = 1
      CanTpGenericConnectionSupport = 0
      CanTpRbDynamicFlowControlSupport = 0
      CanTpRbLegacySharedFcEnabled = 0
      CanTpRbLiteSupport = 0
      CanTpRbStrictBsCrTimeoutCheck = 0
      CanTpRbStrictDlcCheck = true
      CanTpChangeParameterApi = 0
      CanTpDevErrorDetect = true
      CanTpPaddingByte = 255
      CanTpVersionInfoApi = true
      CanTpReadParameterApi = 0
      CanTpRbPageConfirmation = false
