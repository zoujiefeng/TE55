AUTOSAR XML (schema 00047)
package /ETAS_Project/EcucModuleConfigurationValuess
  module config WdgIf
    WdgIfDevice: WdgIfDeviceIndex=0, WdgIfDriverRef=WdgGeneral
    WdgIfGeneral: WdgIfDevErrorDetect=true, WdgIfVersionInfoApi=false
