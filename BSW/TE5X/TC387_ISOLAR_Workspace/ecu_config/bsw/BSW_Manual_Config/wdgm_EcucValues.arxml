AUTOSAR XML (schema 00047)
package /ETAS_Project/EcucModuleConfigurationValuess
  module config WdgM
    WdgMConfigSet: WdgMInitialMode=WdgMMode_SlowMode
      WdgMMode_SlowMode (WdgMMode): WdgMExpiredSupervisionCycleTol=0, WdgMModeId=1, WdgMSupervisionCycle=0.01
        Alive_Supervision_Entity1 (WdgMAliveSupervision):
          WdgMMaxMargin = 5
          WdgMMinMargin = 5
          WdgMExpectedAliveIndications = 9
          WdgMSupervisionReferenceCycle = 10
          WdgMAliveSupervisionCheckpointRef = WdgMCheckpoint_Alive_Supervision_Entity1
        WdgMLocalStatusParams_Alive_Supervision_Entity1 (WdgMLocalStatusParams): WdgMFailedAliveSupervisionRefCycleTol=0, WdgMLocalStatusSupervisedEntityRef=WdgMSupervisedEntity_Alive_Supervision_Entity1
        WdgMTrigger_SlowMode (WdgMTrigger): WdgMTriggerConditionValue=100, WdgMWatchDogMode=WDGIF_SLOW_MODE, WdgMTriggerWatchDogRef=WdgMWatchdog
        WdgMLocalStatusParams_Logic_Supervision_Emtity1 (WdgMLocalStatusParams): WdgMFailedAliveSupervisionRefCycleTol=0, WdgMLocalStatusSupervisedEntityRef=WdgMSupervisedEntity_Logic_Supervision_Entity1
        3 x WdgMAliveSupervision, all with WdgMExpectedAliveIndications=9, WdgMMaxMargin=5, WdgMMinMargin=5, WdgMSupervisionReferenceCycle=10:
          Alive_Supervision_CPU{1..3}: WdgMAliveSupervisionCheckpointRef=WdgMCheckpoint_Alive_Supervision_CPU{1..3}
        3 x WdgMLocalStatusParams, all with WdgMFailedAliveSupervisionRefCycleTol=0:
          WdgMLocalStatusParams_0: WdgMLocalStatusSupervisedEntityRef=WdgMSupervisedEntity_Alive_Supervision_CPU1
          WdgMLocalStatusParams_1: WdgMLocalStatusSupervisedEntityRef=WdgMSupervisedEntity_Alive_Supervision_CPU2
          WdgMLocalStatusParams_2: WdgMLocalStatusSupervisedEntityRef=WdgMSupervisedEntity_Alive_Supervision_CPU3
      WdgMMode_FastMode (WdgMMode): WdgMExpiredSupervisionCycleTol=0, WdgMModeId=0, WdgMSupervisionCycle=0.01
        Alive_Supervision_Entity1 (WdgMAliveSupervision):
          WdgMExpectedAliveIndications = 10
          WdgMMaxMargin = 2
          WdgMMinMargin = 0
          WdgMSupervisionReferenceCycle = 10
          WdgMAliveSupervisionCheckpointRef = WdgMCheckpoint_Alive_Supervision_Entity1
        WdgMLocalStatusParams_Alive_Supervision_Entity1 (WdgMLocalStatusParams): WdgMFailedAliveSupervisionRefCycleTol=2, WdgMLocalStatusSupervisedEntityRef=WdgMSupervisedEntity_Alive_Supervision_Entity1
        WdgMTrigger_FastMode (WdgMTrigger): WdgMTriggerConditionValue=40, WdgMWatchDogMode=WDGIF_FAST_MODE, WdgMTriggerWatchDogRef=WdgMWatchdog
    WdgMGeneral:
      WdgMDefensiveBehavior = false
      WdgMDemStoppedSupervisionReport = false
      WdgMDevErrorDetect = true
      WdgMImmediateReset = false
      WdgMOffModeEnabled = false
      WdgMRbDeadlineTimeOutDetect = true
      WdgMRbDeadlineTimerSelection = AUTOSAR_OS_TIMER
      WdgMRbDebugOptionEnable = false
      WdgMRbInterruptLockDisable = true
      WdgMVersionInfoApi = false
      WdgMRbRteDisabled = false
      WdgMSupervisedEntity_Alive_Supervision_Entity1 (WdgMSupervisedEntity)
        WdgMCheckpoint_Alive_Supervision_Entity1 (WdgMCheckpoint)
      WdgMWatchdog: WdgMWatchdogDeviceRef=WdgIfDevice
      4 x WdgMSupervisedEntity:
        WdgMSupervisedEntity_Alive_Supervision_CPU1
          WdgMCheckpoint_Alive_Supervision_CPU1 (WdgMCheckpoint)
        WdgMSupervisedEntity_Alive_Supervision_CPU2
          WdgMCheckpoint_Alive_Supervision_CPU2 (WdgMCheckpoint)
        WdgMSupervisedEntity_Alive_Supervision_CPU3
          WdgMCheckpoint_Alive_Supervision_CPU3 (WdgMCheckpoint)
        WdgMSupervisedEntity_Logic_Supervision_Entity1: WdgMInternalCheckpointFinalRef=WdgMCheckpoint_4, WdgMInternalCheckpointInitialRef=WdgMCheckpoint_0
          5 x WdgMCheckpoint:
            WdgMCheckpoint_{0..4}
          4 x WdgMInternalTransition:
            WdgMInternalTransition: WdgMInternalTransitionDestRef=WdgMCheckpoint_4, WdgMInternalTransitionSourceRef=WdgMCheckpoint_3
            WdgMInternalTransition_0: WdgMInternalTransitionDestRef=WdgMCheckpoint_3, WdgMInternalTransitionSourceRef=WdgMCheckpoint_2
            WdgMInternalTransition_1: WdgMInternalTransitionDestRef=WdgMCheckpoint_2, WdgMInternalTransitionSourceRef=WdgMCheckpoint_1
            WdgMInternalTransition_2: WdgMInternalTransitionDestRef=WdgMCheckpoint_1, WdgMInternalTransitionSourceRef=WdgMCheckpoint_0
