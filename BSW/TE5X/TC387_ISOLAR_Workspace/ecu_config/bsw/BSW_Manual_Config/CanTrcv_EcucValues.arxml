AUTOSAR XML (schema 00047)
package /ETAS_Project/EcucModuleConfigurationValuess
  module config CanTrcv: implementation-config-variant=VARIANT-PRE-COMPILE
    CanTrcvConfigSet_0 (CanTrcvConfigSet)
      CanTrcvChannel_0 (CanTrcvChannel):
        CanTrcvChannelUsed = 1
        CanTrcvControlsPowerSupply = false
        CanTrcvHwPnSupport = false
        CanTrcvInitState = CANTRCV_OP_MODE_SLEEP
        CanTrcvWakeupByBusUsed = false
        CanTrcvHardwareType = TJA1145
        CanTrcvChannelId = 0
        CanTrcvMaxBaudrate = 1000
        CanTrcvAccess_0 (CanTrcvAccess)
          CanTrcvSpiAccess
            CanTrcvSpiSequence: CanTrcvSpiAccessSynchronous=0, CanTrcvSpiSequenceName=SpiSequence_0
        CanTrcvTja1145Param:
          CanTrcvTja1145CBSE = false
          CanTrcvTja1145CFDC = 0
          CanTrcvTja1145CFE = false
          CanTrcvTja1145CMC = true
          CanTrcvTja1145Diag01ModeControl = true
          CanTrcvTja1145Diag03MainStatus = true
          CanTrcvTja1145Diag04SystemEventEnable = 0
          CanTrcvTja1145Diag06Memory0 = 0
          CanTrcvTja1145Diag07Memory1 = 0
          CanTrcvTja1145Diag08Memory2 = 0
          CanTrcvTja1145Diag09Memory3 = 0
          CanTrcvTja1145Diag0ALockControl = 0
          CanTrcvTja1145Diag20CANControl = false
          CanTrcvTja1145Diag22TransceiverStatus = true
          CanTrcvTja1145Diag23TransceiverEventEnable = true
          CanTrcvTja1145Diag26DataRate = 0
          CanTrcvTja1145Diag27Identifier0 = 0
          CanTrcvTja1145Diag28Identifier1 = 0
          CanTrcvTja1145Diag29Identifier2 = 0
          CanTrcvTja1145Diag2AIdentifier3 = 0
          CanTrcvTja1145Diag2BMask0 = 0
          CanTrcvTja1145Diag2CMask1 = 0
          CanTrcvTja1145Diag2DMask2 = 0
          CanTrcvTja1145Diag2EMask3 = 0
          CanTrcvTja1145Diag2FFrameControl = 0
          CanTrcvTja1145Diag4BWakePinStatus = 0
          CanTrcvTja1145Diag4CWakePinEnable = true
          CanTrcvTja1145Diag60EventCaptureStatus = 0
          CanTrcvTja1145Diag61SystemEventStatus = true
          CanTrcvTja1145Diag63TransceiverEventStatus = true
          CanTrcvTja1145Diag64WakePinEventStatus = 0
          CanTrcvTja1145Diag68DataMask0 = 0
          CanTrcvTja1145Diag69DataMask1 = 0
          CanTrcvTja1145Diag6ADataMask2 = 0
          CanTrcvTja1145Diag6BDataMask3 = 0
          CanTrcvTja1145Diag6CDataMask4 = 0
          CanTrcvTja1145Diag6DDataMask5 = 0
          CanTrcvTja1145Diag6EDataMask6 = 0
          CanTrcvTja1145Diag6FDataMask7 = 0
          CanTrcvTja1145Diag7EIdentification = 0
          CanTrcvTja1145OTWE = false
          CanTrcvTja1145SPIFE = 0
          CanTrcvTja1145WPFE = 0
          CanTrcvTja1145WPRE = true
    CanTrcvGeneral:
      CanTrcvAutosarVersion = AR4_0_3
      CanTrcvGetVersionInfo = 0
      CanTrcvRbIndicationBehaviour = CANTRCV_INDICATION_ASYNC
      CanTrcvUseAsr31Api = false
      CanTrcvDevErrorDetect = 1
      CanTrcvWakeUpSupport = CANTRCV_WAKEUP_BY_POLLING
      CanTrcvMainFunctionPeriod = 0.001
      CanTrcvClearWupReasonInSetWakeupMode = true
      CanTrcvIndex = 0
      CanTrcvMainFunctionDiagnosticsPeriod = 0.001
  module config CanIf: implementation-config-variant=VARIANT-PRE-COMPILE
    CanIfTrcvDrvCfg
      CanIfTrcvCfg_0 (CanIfTrcvCfg): CanIfTrcvWakeupSupport=false, CanIfTrcvId=0, CanIfTrcvCanTrcvRef=CanTrcvChannel_0
    CanIfDispatchCfg:
      CanIfDispatchUserCtrlBusOffUL = CDD
      CanIfDispatchUserCtrlBusOffName = CDD_CanSM_ControllerBusOff
      CanIfDispatchUserCtrlModeIndicationUL = CAN_SM
      CanIfDispatchUserTrcvModeIndicationName = CAN_SM
      CanIfDispatchUserTrcvModeIndicationUL = CAN_SM
