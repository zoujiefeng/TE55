AUTOSAR XML (schema 00047)
package /ETAS_Project/EcucModuleConfigurationValuess
  module config Dem: implementation-config-variant=VARIANT-PRE-COMPILE
    DemConfigSet
      DemDebounceCounterBasedClass_LostCom (DemDebounceCounterBasedClass):
        DemDebounceBehavior = DEM_DEBOUNCE_FREEZE
        DemDebounceCounterDecrementStepSize = 1
        DemDebounceCounterFailedThreshold = 2
        DemDebounceCounterIncrementStepSize = 1
        DemDebounceCounterPassedThreshold = -2
        DemDebounceCounterStorage = true
    DemGeneral:
      DemAgingRequieresTestedCycle = false
      DemAvailabilitySupport = DEM_EVENT_AVAILABILITY
      DemBswErrorBufferSize = 10
      DemClearDTCBehavior = DEM_CLRRESP_VOLATILE
      DemClearDTCLimitation = DEM_ONLY_CLEAR_ALL_DTCS
      DemDataElementDefaultEndianness = BIG_ENDIAN
      DemDebounceCounterBasedSupport = true
      DemDebounceTimeBasedSupport = false
      DemDevErrorDetect = true
      DemDtcStatusAvailabilityMask = 9
      DemEventCombinationSupport = DEM_EVCOMB_ONRETRIEVAL
      DemEventDisplacementStrategy = DEM_DISPLACEMENT_FULL
      DemEventMemoryEntryStorageTrigger = DEM_TRIGGER_ON_CONFIRMED
      DemGeneralInterfaceSupport = false
      DemMaxNumberEventEntryPermanent = 6
      DemMaxNumberPrestoredFF = 5
      DemOccurrenceCounterProcessing = DEM_PROCESS_OCCCTR_TF
      DemResetConfirmedBitOnOverflow = true
      DemStatusBitHandlingTestFailedSinceLastClear = DEM_STATUS_BIT_NORMAL
      DemStatusBitStorageTestFailed = true
      DemSuppressionSupport = DEM_NO_SUPPRESSION
      DemTaskTime = 0.001
      DemTriggerDcmReports = false
      DemTriggerDltReports = false
      DemTriggerFiMReports = false
      DemTriggerMonitorInitBeforeClearOk = false
      DemTypeOfDTCSupported = DEM_DTC_TRANSLATION_SAEJ1939_73
      DemTypeOfFreezeFrameRecordNumeration = DEM_FF_RECNUM_CONFIGURED
      DemVersionInfoApi = false
      DemEnvironmentDataCapture = DEM_CAPTURE_SYNCHRONOUS_TO_REPORTING
      DemMaxNumberEventEntryEventBuffer = 15
      DemOperationCycleStatusStorage = true
      DemOBDSupport = DEM_OBD_PRIMARY_ECU
      DemMILIndicatorRef = MIL_Indicator
      DemPrimaryMemory: DemMaxNumberEventEntryPrimary=15
      DemRbGeneral:
        DemRbAgingCounterType = COUNT_UP
        DemRbDebLimitRelevantForJumping = false
        DemRbDebounceTimeBasedTaskTime = 0.001
        DemRbDebugData = ON_32BIT
        DemRbDisturbanceMemoryCallbackOnDisturbance = false
        DemRbDisturbanceMemorySupported = false
        DemRbOccurrenceCounterType = AUTOSAR
        DemRbSupportEventCategory = false
        DemRbSupportFailureDependency = false
        DemRbSymbolicNamesAccordingAR402 = false
        DemRbEnableNvmBlockLengthChecks = true
        DemRbEnableDemNvmBlocksAutoConfiguration = true
        DemRbTriggerToStoreNvMSupported = true
        DemRbClearDtcClearsAllBits = true
        DemEventCategory_0 (DemRbEventCategory): DemRbEventCategoryId=254
        DemRbOptimization
      DemClient: DemClientFunctionality=DEM_CLIENT_USES_FULL_FUNCTIONALITY, DemClientUsesRte=false, DemRbClientPriority=1, DemEventMemorySetRef=DemEventMemorySet
      PowertrainDTCGroup (DemGroupOfDTC): DemGroupDTCs=851968
      DemExtendedDataClass_DTC_0x0D01_Event (DemExtendedDataClass): DemExtendedDataRecordClassRef=Record_ExtendedDataRecord
      Record_ExtendedDataRecord (DemExtendedDataRecordClass):
        DemExtendedDataRecordNumber = 1
        DemExtendedDataRecordTrigger = DEM_TRIGGER_ON_TEST_FAILED
        DemExtendedDataRecordUpdate = DEM_UPDATE_RECORD_NO
        DemDataElementClassRef = INTER_ExtendedDataRecord_Fault_occurrence_counter
        DemDataElementClassRef = CS_ExtendedDataRecord_Fault_pending_counter
        DemDataElementClassRef = CS_ExtendedDataRecord_Aged_counter
        DemDataElementClassRef = INTER_ExtendedDataRecord_Aging_counter
      DemExtendedDataClass_DTC_0x0D02_Event (DemExtendedDataClass): DemExtendedDataRecordClassRef=Record_ExtendedDataRecord
      4 x DemDataElementClass:
        INTER_ExtendedDataRecord_Fault_occurrence_counter
          DemInternalDataElementClass: DemDataElementDataSize=1, DemInternalDataElement=DEM_OCCCTR
        INTER_ExtendedDataRecord_Aging_counter
          DemInternalDataElementClass: DemDataElementDataSize=1, DemInternalDataElement=DEM_AGINGCTR_UPCNT
        CS_ExtendedDataRecord_Fault_pending_counter
          DemExternalCSDataElementClass_0 (DemExternalCSDataElementClass): DemDataElementDataSize=1, DemDataElementUsePort=true
        CS_ExtendedDataRecord_Aged_counter
          DemExternalCSDataElementClass_0 (DemExternalCSDataElementClass): DemDataElementDataSize=1, DemDataElementUsePort=true
      DemExtendedDataClass_DTC_0x0D07_Event (DemExtendedDataClass): DemExtendedDataRecordClassRef=Record_ExtendedDataRecord
      DemMirrorMemory: DemMaxNumberEventEntryMirror=1
      DemEventMemorySet
        DemPrimaryMemory_0 (DemPrimaryMemory)
      3 x DemOperationCycle:
        DemOperationCycle_Power: DemRbIsStartViaApiAllowed=0
        DemOperationCycle_Ignition
        WARM_UP
      DemGeneralOBD:
        DemRbOBDDtcCodesConfigurable = 1
        DemRbOBDFreezeFrameCapture = DEM_TRIGGER_CONFIRMEDDTC
        DemRbOBDFreezeFrameVisibility = DEM_OBDFF_CONFIRMED_DTCS
        DemRbOBDPermanentDTCVisibilityTiming = IMMEDIATELY
        DemRbOBDSupportBlockingPermanentDTC = 0
        DemRbOBDSupportObdVariantCoding = 0
        DemRbEnableApiSignalEndOfOBDIgnitionCycle = 0
        DemRbOBDEnableMilCounterCheck = 0
        DemOBDCentralizedPID21Handling = false
        DemOBDCentralizedPID31Handling = false
        DemOBDCompliancy = 1
        DemOBDDrivingCycleRef = DemOperationCycle_Ignition
        DemOBDPFCCycleRef = DEM_OPCYC_PFC
        DemOBDWarmUpCycleRef = DEM_OPCYC_WARMUP
        DemRbOBDIgnitionCycleRef = DemOperationCycle_Ignition
      DemExtendedDataClass_0 (DemExtendedDataClass): DemExtendedDataRecordClassRef=Record_ExtendedDataRecord
