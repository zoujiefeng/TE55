AUTOSAR XML (schema 00047)
package /ETAS_Project/EcucModuleConfigurationValuess
  module config Wdg
    WdgGeneral: WdgDevErrorDetect=true, WdgVersionInfoApi=false, WdgMaxTimeout=10.0
    WdgPublishedInformation_0 (WdgPublishedInformation)
    WdgSettingsConfig_0 (WdgSettingsConfig)
