AUTOSAR XML (schema 00047)
package /ETAS_Project/EcucModuleConfigurationValuess
  module config Xcp
    XcpConfig
      3 x XcpEventChannel, all with XcpEventChannelType=DAQ:
        Event_10ms_Raster: XcpEventChannelName=10msRStr, XcpEventChannelShortName=10ms, XcpEventChannelPriority=8, XcpEventChannelTimeCycle=1, XcpEventChannelTimeUnit=TIMESTAMP_UNIT_10MS
        Event_100ms_Raster: XcpEventChannelName=100msRStr, XcpEventChannelShortName=100ms, XcpEventChannelPriority=10, XcpEventChannelTimeCycle=1, XcpEventChannelTimeUnit=TIMESTAMP_UNIT_100MS
        Event_50ms_Raster: XcpEventChannelName=50msRStr, XcpEventChannelShortName=50ms, XcpEventChannelPriority=9, XcpEventChannelTimeCycle=5, XcpEventChannelTimeUnit=TIMESTAMP_UNIT_10MS
    XcpGeneral:
      XcpCalibrationCal = true
      XcpSynchronousDataAcquisitionDaq = true
      XcpBlockTransferUpload = true
      XcpBlockTransferDownload = true
      XcpSeedAndKey = true
      XcpCommandChecksum = true
      XcpUploadDownloadMemoryAccessByAppl = true
      XcpCommandReadDaq = true
      XcpCommandsGetDaqInfo = true
      XcpEventChannelScheduling = true
      XcpVersion = VERSION_1_2
      XcpProductLine = CSMOSAR
      XcpDaqMemoryLimit = 4096
      XcpDevErrorDetect = true
      XcpMainFunctionPeriod = 0.01
      XcpSeedAndKeyExternalFunction = XcpSeedNKey.dll
      XcpVersionInfoApi = false
      XcpPageSwitchingPag = true
      XcpTimestampUnit = TIMESTAMP_UNIT_1MS
      XcpTimestampTicks = 1
    XcpA2LFile: XcpTimeoutT1=2000, XcpTimeoutT2=2000, XcpTimeoutT7=2000
