AUTOSAR XML (schema 00047)
package /ETAS_Project/EcucModuleConfigurationValuess
  module config Dcm: implementation-config-variant=VARIANT-PRE-COMPILE
    DcmConfigSet
      DcmDsd: DcmDsdRequestManufacturerNotificationEnabled=false, DcmDsdRequestSupplierNotificationEnabled=false
        DcmDsdServiceTable_UDS (DcmDsdServiceTable): DcmDsdSidTabId=0
          13 x DcmDsdService, all with DcmDsdSidTabSessionLevelRef=DcmDspSession/ExtendedDiagnosticSession:
            DiagnosticSessionControl: DcmDsdSidTabFnc=Dcm_DcmDiagnosticSessionControl, DcmDsdSidTabServiceId=16, DcmDsdSidTabSubfuncAvail=true, DcmRbDsdSidTabSidInitFunction=Dcm_Dsp_DscIni, DcmDsdSidTabSessionLevelRef=DcmDspSession/DefaultSession, DcmDsdSidTabSessionLevelRef=DcmDspSession/ProgrammingSession
              3 x DcmDsdSubService, all with DcmDsdSubServiceSessionLevelRef=DcmDspSession/ProgrammingSession, DcmDsdSubServiceSessionLevelRef=DcmDspSession/ExtendedDiagnosticSession:
                DefaultSession: DcmDsdSubServiceId=1, DcmDsdSubServiceSessionLevelRef=DcmDspSession/DefaultSession
                ProgrammingSession: DcmDsdSubServiceId=2
                ExtendedDiagnosticSession: DcmDsdSubServiceId=3, DcmDsdSubServiceSessionLevelRef=DcmDspSession/DefaultSession
            SecurityAccess: DcmDsdSidTabFnc=Dcm_DcmSecurityAccess, DcmDsdSidTabServiceId=39, DcmDsdSidTabSubfuncAvail=true, DcmRbDsdSidTabSidInitFunction=Dcm_Dsp_SecaIni
              DcmDsdSubService_requestSeed_SEC_LEV_L1 (DcmDsdSubService): DcmDsdSubServiceId=1, DcmDsdSubServiceSessionLevelRef=DcmDspSession/ExtendedDiagnosticSession
              DcmDsdSubService_sendKey_SEC_LEV_L1 (DcmDsdSubService): DcmDsdSubServiceId=2, DcmDsdSubServiceSessionLevelRef=DcmDspSession/ExtendedDiagnosticSession
            TesterPresent: DcmDsdSidTabFnc=Dcm_DcmTesterPresent, DcmDsdSidTabServiceId=62, DcmDsdSidTabSubfuncAvail=true, DcmRbDsdSidTabSidInitFunction=NULL_PTR, DcmDsdSidTabSessionLevelRef=DcmDspSession/DefaultSession, DcmDsdSidTabSessionLevelRef=DcmDspSession/ProgrammingSession
              zeroSubFunction (DcmDsdSubService):
                DcmDsdSubServiceId = 0
                DcmDsdSubServiceSessionLevelRef = DcmDspSession/DefaultSession
                DcmDsdSubServiceSessionLevelRef = DcmDspSession/ExtendedDiagnosticSession
                DcmDsdSubServiceSessionLevelRef = DcmDspSession/ProgrammingSession
            ECUReset: DcmDsdSidTabFnc=Dcm_DcmEcuReset, DcmDsdSidTabServiceId=17, DcmDsdSidTabSubfuncAvail=true, DcmRbDsdSidTabSidInitFunction=Dcm_Dsp_EcuReset_Ini, DcmDsdSidTabSessionLevelRef=DcmDspSession/DefaultSession
              3 x DcmDsdSubService, all with DcmDsdSubServiceSessionLevelRef=DcmDspSession/DefaultSession, DcmDsdSubServiceSessionLevelRef=DcmDspSession/ExtendedDiagnosticSession:
                HARD: DcmDsdSubServiceId=1
                KEYONOFF: DcmDsdSubServiceId=2
                SOFT: DcmDsdSubServiceId=3
            CommunicationControl: DcmDsdSidTabFnc=Dcm_DcmCommunicationControl, DcmDsdSidTabServiceId=40, DcmDsdSidTabSubfuncAvail=true, DcmRbDsdSidTabSidInitFunction=NULL_PTR
              enableRxAndTx (DcmDsdSubService): DcmDsdSubServiceId=0, DcmDsdSubServiceSessionLevelRef=DcmDspSession/ExtendedDiagnosticSession
              disableRxAndTx (DcmDsdSubService): DcmDsdSubServiceId=3, DcmDsdSubServiceSessionLevelRef=DcmDspSession/ExtendedDiagnosticSession
            RoutineControl: DcmDsdSidTabFnc=Dcm_DcmRoutineControl, DcmDsdSidTabServiceId=49, DcmDsdSidTabSubfuncAvail=true, DcmRbDsdSidTabSidInitFunction=Dcm_Dsp_RC_Ini, DcmDsdSidTabSessionLevelRef=DcmDspSession/ProgrammingSession, DcmDsdSidTabSessionLevelRef=DcmDspSession/DefaultSession
            InputOutpuControlByIdentifier: DcmDsdSidTabFnc=Dcm_DcmInputOutputControlByIdentifier, DcmDsdSidTabServiceId=47, DcmRbDsdSidTabSidInitFunction=Dcm_Dsp_IOCBI_Ini, DcmDsdSidTabSubfuncAvail=false, DcmDsdSidTabSecurityLevelRef=DSP_SEC_LEV_L1
            ReadDataByIdentifier: DcmDsdSidTabFnc=Dcm_DcmReadDataByIdentifier, DcmDsdSidTabServiceId=34, DcmDsdSidTabSubfuncAvail=false, DcmRbDsdSidTabSidInitFunction=Dcm_Dsp_RdbiIni, DcmDsdSidTabSessionLevelRef=DcmDspSession/DefaultSession
            WriteDataByIdentifier: DcmDsdSidTabFnc=Dcm_DcmWriteDataByIdentifier, DcmDsdSidTabServiceId=46, DcmDsdSidTabSubfuncAvail=false, DcmRbDsdSidTabSidInitFunction=Dcm_Dcm_WDBIInit
            ReadDTCInformation: DcmDsdSidTabFnc=Dcm_DcmReadDTCInformation, DcmDsdSidTabServiceId=25, DcmDsdSidTabSubfuncAvail=true, DcmRbDsdSidTabSidInitFunction=Dcm_Dsp_ReadDTCInfo_Ini, DcmDsdSidTabSessionLevelRef=DcmDspSession/DefaultSession
              5 x DcmDsdSubService, all with DcmDsdSubServiceSessionLevelRef=DcmDspSession/DefaultSession, DcmDsdSubServiceSessionLevelRef=DcmDspSession/ExtendedDiagnosticSession:
                DcmDsdSubService_ReportNumberOfDTCByStatusMask: DcmDsdSubServiceId=1
                DcmDsdSubService_ReportDTCByStatusMask: DcmDsdSubServiceId=2
                DcmDsdSubService_ReportDTCSnapshotRecordByDTCNumber: DcmDsdSubServiceId=4
                DcmDsdSubService_ReportSupportedDTC: DcmDsdSubServiceId=10
                DcmDsdSubService_ReportDTCSnapshotIdentification: DcmDsdSubServiceId=3
            ClearDiagnosticInformation: DcmDsdSidTabFnc=Dcm_DcmClearDiagnosticInformation, DcmDsdSidTabServiceId=20, DcmDsdSidTabSubfuncAvail=false, DcmRbDsdSidTabSidInitFunction=NULL_PTR, DcmRbDsdSidTabUserModeRuleFnc=Dcm_DsmClearDiagnosticInformation, DcmDsdSidTabSessionLevelRef=DcmDspSession/DefaultSession
            ControlDTCSetting: DcmDsdSidTabFnc=Dcm_DcmControlDTCSetting, DcmDsdSidTabServiceId=133, DcmDsdSidTabSubfuncAvail=true, DcmRbDsdSidTabSidInitFunction=Dcm_Dsp_CDTCSIni
              On (DcmDsdSubService): DcmDsdSubServiceId=1, DcmDsdSubServiceSessionLevelRef=DcmDspSession/ExtendedDiagnosticSession
              Off (DcmDsdSubService): DcmDsdSubServiceId=2, DcmDsdSubServiceSessionLevelRef=DcmDspSession/ExtendedDiagnosticSession
            ReadMemoryByAddress: DcmDsdSidTabSubfuncAvail=false, DcmDsdSidTabServiceId=35
      DcmDsl
        DcmDslBuffer_UDS_Tx (DcmDslBuffer): DcmDslBufferSize=1024
        DcmDslBuffer_UDS_Rx (DcmDslBuffer): DcmDslBufferSize=1024
        DcmDslDiagResp: DcmDslDiagRespMaxNumRespPend=5
        DcmDslProtocol
          DcmDslProtocolRow_UDS (DcmDslProtocolRow):
            DcmDslProtocolID = DCM_UDS_ON_CAN
            DcmDslProtocolPriority = 1
            DcmSendRespPendOnTransToBoot = 0
            DcmTimStrP2ServerAdjust = 0.01
            DcmTimStrP2StarServerAdjust = 0.01
            DcmDslProtocolMaximumResponseSize = 20
            DcmDslProtocolRxBufferRef = DcmDslBuffer_UDS_Rx
            DcmDslProtocolSIDTable = DcmDsdServiceTable_UDS
            DcmDslProtocolTxBufferRef = DcmDslBuffer_UDS_Tx
            DcmDemClientRef = DemClient
            DcmDslConnection_CAN (DcmDslConnection)
              DcmDslMainConnection: DcmDslProtocolRxTesterSourceAddr=0, DcmDslProtocolComMChannelRef=Can_Network_CanNodeNum_01
                Diag_PhyRequest_CanNodeNum_01_PduR2Dcm (DcmDslProtocolRx): DcmDslProtocolRxAddrType=DCM_PHYSICAL_TYPE, DcmDslProtocolRxPduRef=DcmPdu_PduR2Dcm_CanNodeNum_01_PhyRequest
                Diag_FunRequest_CanNodeNum_01_PduR2Dcm (DcmDslProtocolRx): DcmDslProtocolRxAddrType=DCM_FUNCTIONAL_TYPE, DcmDslProtocolRxPduRef=DcmPdu_PduR2Dcm_CanNodeNum_01_FunRequest
                Diag_PhyResponse_CanNodeNum_01_Dcm2PduR (DcmDslProtocolTx): DcmDslTxConfirmationPduId=0, DcmDslProtocolTxPduRef=DcmPdu_Dcm2PduR_CanNodeNum_01_PhyResponse
      DcmDsp:
        DcmDspDataDefaultEndianness = BIG_ENDIAN
        DcmDspMaxDidToRead = 10
        DcmDspMaxPeriodicDidToRead = 1
        DcmRbDspSesSecUsedInProtocol = UDS
        DcmRbDspSequenceCheckRequestUploadDisabled = false
        DcmDspSecurity:
          DcmRbDspSecurityDelayTimerMonitor = REQUEST_SEED
          DcmRbDspSecurityNRCExceedNoOfAttempt = NumAttDelayAndNumAttLock
          DcmRbDspSecurityStoreSeed = false
          DcmDspSecurityMaxAttemptCounterReadoutTime = 0.1
          DSP_SEC_LEV_L1 (DcmDspSecurityRow):
            DcmDspSecurityAttemptCounterEnabled = true
            DcmDspSecurityDelayTime = 10.0
            DcmDspSecurityDelayTimeOnBoot = 0.0
            DcmDspSecurityKeySize = 4
            DcmDspSecurityLevel = 1
            DcmDspSecurityNumAttDelay = 3
            DcmDspSecuritySeedSize = 4
            DcmDspSecurityUsePort = USE_ASYNCH_FNC
            DcmRbDspSecurityNumAttLock = 0
            DcmDspSecurityGetSeedFnc = GetSeed_L1
            DcmDspSecurityCompareKeyFnc = CompareKey_L1
            DcmDspSecurityGetAttemptCounterFnc = Dcm_GetAttemptCounter_L1
            DcmDspSecuritySetAttemptCounterFnc = Dcm_SetAttemptCounter_L1
        DcmDspSession: DcmRbDspSessionParamRecordEnabled=true
          3 x DcmDspSessionRow, all with DcmDspSessionP2ServerMax=0.05, DcmDspSessionP2StarServerMax=5.0:
            DefaultSession: DcmDspSessionForBoot=DCM_NO_BOOT, DcmDspSessionLevel=1
            ProgrammingSession: DcmDspSessionForBoot=DCM_OEM_BOOT, DcmDspSessionLevel=2
            ExtendedDiagnosticSession: DcmDspSessionForBoot=DCM_NO_BOOT, DcmDspSessionLevel=3
        DcmDspComControl
          DcmDspComControlAllChannel: DcmDspAllComMChannelRef=Can_Network_CanNodeNum_01
          DcmDspComControlSubNode: DcmDspComControlSubNodeUsed=true, DcmDspComControlSubNodeId=1, DcmDspComControlSubNodeComMChannelRef=Can_Network_CanNodeNum_01
        DcmRbDspReadDTC: DcmRbDspReadDTCMaxNumDTCRead=5, DcmRbDspReadDTCMaxNumRecordRead=5
      DcmPageBufferCfg: DcmPagedBufferEnabled=true, DcmPagedBufferTimeout=0.01
    DcmGeneral: DcmDevErrorDetect=true, DcmRespondAllRequest=false, DcmTaskTime=0.001, DcmVersionInfoApi=true
      DcmRbGeneral:
        DcmRbApplCallRequiredOnReqReception = false
        DcmRbApplTxConfirmationRequiredAlways = false
        DcmRbConfirmForDSDGeneratedNegRes = false
        DcmRbDiagAdaptSupport = false
        DcmRbOSTimerUse = CyclicCount
        DcmRbRestoringEnabled = true
        DcmRbRTEsupport = true
        DcmRbSignalDefaultValue = 0
        DcmRbStoringEnabled = true
        DcmRbQueuingOfRequestEnabled = false
        DcmRbRTEsupportsPRportFunctionality = true
