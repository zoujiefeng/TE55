AUTOSAR XML (schema 00047)
package /ETAS_Project/EcucModuleConfigurationValuess
  module config Cdd
    CddComStackContribution
      CddComIfUpperLayerContribution
        CddComIfUpperLayerRxPdu_CCP_RX_CRO (CddComIfUpperLayerRxPdu): CddComIfPduRef=CcpPdu_CanIf2Cdd_CanNodeNum_00_Rx_Cro
        4 x CddComIfUpperLayerTxPdu:
          CddComIfUpperLayerTxPdu_CCP_TX_DTO_MCU: CddComIfPduRef=CcpPdu_Cdd2CanIf_CanNodeNum_00_Tx_Dto
          CddComIfUpperLayerTxPdu_CCP_TX_DAQ{0..2}_MCU: CddComIfPduRef=CcpPdu_Cdd2CanIf_CanNodeNum_00_Tx_Daq{0..2}
