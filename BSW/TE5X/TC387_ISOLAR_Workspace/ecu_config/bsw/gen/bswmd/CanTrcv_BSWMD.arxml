AUTOSAR XML (schema 4-2-2)
package /AUTOSAR_CanTrcv/BswModuleEntrys
  bsw module entry CanTrcv_MainFunction: is-reentrant=false, is-synchronous=true, call-type=SCHEDULED, execution-context=TASK, sw-service-impl-policy=STANDARD
  bsw module entry CanTrcv_Init: service-id=0x00, is-reentrant=false, is-synchronous=true, call-type=REGULAR, execution-context=UNSPECIFIED, sw-service-impl-policy=STANDARD  # Initialize the CanTrcv module.
    sw service arg CanTrcvConfigPtr: category=DATA_REFERENCE, direction=IN, sw-pointer-target-props={target-category=STRUCTURE, implementation-data-type=CanTrcv_ConfigType, sw-impl-policy=CONST}  # Pointer to a selected configuration structure
package /AUTOSAR_CanTrcv/ImplementationDataTypes
  impl type CanTrcv_ConfigType: category=STRUCTURE, type-emitter=HEADER_FILE  # This type shall contain at least all parameters that are post-build able
    element CanTrcv_ConfigData: category=DATA_REFERENCE, sw-pointer-target-props={target-category=VALUE, base-type=void, sw-impl-policy=CONST}
    element versionInfo: category=DATA_REFERENCE, sw-pointer-target-props={target-category=VALUE, base-type=uint16, sw-impl-policy=CONST}
