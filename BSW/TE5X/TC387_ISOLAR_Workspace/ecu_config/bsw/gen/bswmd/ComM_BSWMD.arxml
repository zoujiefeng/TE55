AUTOSAR XML (schema 4-0-3)
package /AUTOSAR_ComM/BswModuleEntrys
  5 x bsw module entry, all with is-reentrant=false, is-synchronous=true, sw-service-impl-policy=STANDARD:
    ComM_Init: call-type=REGULAR, execution-context=UNSPECIFIED
    ComM_MainFunction_Can_Network_CanNodeNum_{00..03}: call-type=SCHEDULED, execution-context=TASK
