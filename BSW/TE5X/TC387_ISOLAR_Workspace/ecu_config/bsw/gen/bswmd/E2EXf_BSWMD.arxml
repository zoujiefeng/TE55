AUTOSAR XML (schema 4-2-2)
package /AUTOSAR_E2EXf/BswImplementations
  bsw implementation E2EXf: programming-language=C, sw-version=7.0.0, used-code-generator=E2EXf.bamf, vendor-id=6, ar-release-version=4.2.2, behavior=BswInternalBehavior, vendor-specific-module-def=[E2EXf, Xfrm]
    code-descriptors:
      code CodeDescriptor: artifact-descriptors=autosar-engineering-object={short-label=ArEngObj, category=SWSRC}
    resource consumption E2EXf_ResourceConsumption
      5 x memory section, all with prefix=E2EXF:
        E2EXf_CONST_UNSPECIFIED: sw-addrmethod=CONST, symbol=CONST_UNSPECIFIED
        E2EXf_VAR_CLEARED_8: sw-addrmethod=VAR_CLEARED, symbol=VAR_CLEARED_8
        E2EXf_VAR_CLEARED_UNSPECIFIED: sw-addrmethod=VAR_CLEARED, symbol=VAR_CLEARED_UNSPECIFIED
        E2EXf_VAR_INIT_BOOLEAN: sw-addrmethod=VAR_INIT, symbol=VAR_INIT_BOOLEAN
        E2EXF_CODE: sw-addrmethod=CODE, symbol=CODE
      section name prefix E2EXF
package /AUTOSAR_E2EXf/BswModuleDescriptions
  bsw module description E2EXf: category=BSW_MODULE, module-id=176, provided-entrys=[E2EXf_GetVersionInfo, E2EXf_Init, E2EXf_DeInit]
    4 x bsw module dependency, all with category=MANDATORY:
      Dependency_StandardTypes: target-module-id=197
      Dependency_CompilerAbstraction: target-module-id=198
      Dependency_MemMap: target-module-id=195
      Dependency_E2E: target-module-id=207
    bsw internal behavior BswInternalBehavior
package /AUTOSAR_E2EXf/BswModuleEntrys
  bsw module entry E2EXf_Init: service-id=1, is-reentrant=true, is-synchronous=true, call-type=REGULAR, execution-context=UNSPECIFIED, sw-service-impl-policy=STANDARD  # Initializes the state of the E2E Transformer | Initializes the state of the E2E Transformer. The main part of it is the initialization of the E2E library state structures, which is done by calling all init-functions from E2E library.
    sw service arg config: category=DATA_REFERENCE, sw-pointer-target-props={target-category=VALUE, implementation-data-type=E2EXf_ConfigType, sw-impl-policy=CONST}  # Pointer to a selected configuration structure, in the post-build-selectable variant. NULL in link-time variant.
  bsw module entry E2EXf_DeInit: service-id=2, is-reentrant=true, is-synchronous=true, call-type=REGULAR, execution-context=UNSPECIFIED, sw-service-impl-policy=STANDARD  # Deinitializes the E2E transformer
  bsw module entry E2EXf_GetVersionInfo: service-id=20, is-reentrant=true, is-synchronous=true, call-type=REGULAR, execution-context=UNSPECIFIED, sw-service-impl-policy=STANDARD  # Returns the version information of this module. | The function E2EXf_GetVersionInfo shall store the version information of this module into the parameter VersionInfo. The version information includes: vendor ID module ID instance ID sw_major_version sw_minor_version sw_patch_version | Example: The following example shows the usage of the GetVersionInfo function: /*--------------------------------- E2EXf GetVersionInfo Example ------------------------*/ /*--------------------------------- Declaration of Variable ---------------------------*/ Std_VersionInfoType VersionInfo; /* Into VersionInfo the version information shall be saved */ /*--------------------------------- Call of the GetVersionInf Function ----------------*/ E2EXf_GetVersionInfo(&VersionInfo); /* Saving the version information in VersionInfo */
    sw service arg VersionInfoPtr: category=DATA_REFERENCE, sw-pointer-target-props={target-category=VALUE, implementation-data-type=Std_VersionInfoType}  # Pointer to where to store the version information of this module.
package /AUTOSAR_E2EXf/ImplementationDataTypes
  impl type E2EXf_ConfigType: category=STRUCTURE, type-emitter=HEADER_FILE  # Parent container for the configuration of E2E Transformer.
    element dummy: implementation-data-type=uint8  # Not used
