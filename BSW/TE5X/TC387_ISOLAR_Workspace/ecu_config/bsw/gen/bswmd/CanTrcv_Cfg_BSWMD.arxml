AUTOSAR XML (schema 4-2-2)
package /AUTOSAR_CanTrcv/BswImplementations
  bsw implementation CanTrcv: programming-language=C, sw-version=10.0.0, ar-release-version=4.2.2, behavior=BswInternalBehavior
    code-descriptors:
      code CodeDescriptor: artifact-descriptors=autosar-engineering-object={short-label=ArEngObj, category=SWSRC}
    resource consumption CanTrcv_ResourceConsumption
      13 x memory section:
        CANTRCV_CONST_8: alignment=8, prefix=CANTRCV, sw-addrmethod=CONST, symbol=CONST_8
        CANTRCV_CONST_UNSPECIFIED: alignment=UNSPECIFIED, prefix=CANTRCV, sw-addrmethod=CONST, symbol=CONST_UNSPECIFIED
        CANTRCV_CONFIG_DATA_8: alignment=8, prefix=CANTRCV, sw-addrmethod=CONFIG_DATA, symbol=CONFIG_DATA_8
        CANTRCV_CONFIG_DATA_16: alignment=16, prefix=CANTRCV, sw-addrmethod=CONFIG_DATA, symbol=CONFIG_DATA_16
        CANTRCV_CONFIG_DATA_UNSPECIFIED: alignment=UNSPECIFIED, prefix=CANTRCV, sw-addrmethod=CONFIG_DATA, symbol=CONFIG_DATA_UNSPECIFIED
        CANTRCV_CONFIG_DATA_POSTBUILD_UNSPECIFIED: alignment=UNSPECIFIED, prefix=CANTRCV, sw-addrmethod=CONFIG_DATA_POSTBUILD, symbol=CONFIG_DATA_POSTBUILD_UNSPECIFIED
        CANTRCV_VAR_CLEARED_8: alignment=8, prefix=CANTRCV, sw-addrmethod=VAR_CLEARED, symbol=VAR_CLEARED_8
        CANTRCV_VAR_CLEARED_16: alignment=16, prefix=CANTRCV, sw-addrmethod=VAR_CLEARED, symbol=VAR_CLEARED_16
        CANTRCV_VAR_CLEARED_32: alignment=32, prefix=CANTRCV, sw-addrmethod=VAR_CLEARED, symbol=VAR_CLEARED_32
        CANTRCV_VAR_CLEARED_UNSPECIFIED: alignment=UNSPECIFIED, prefix=CANTRCV, sw-addrmethod=VAR_CLEARED, symbol=VAR_CLEARED_UNSPECIFIED
        CANTRCV_VAR_INIT_UNSPECIFIED: alignment=UNSPECIFIED, prefix=CANTRCV, sw-addrmethod=VAR_INIT, symbol=VAR_INIT_UNSPECIFIED
        CanTrcv_CODE: prefix=CanTrcv, sw-addrmethod=CODE, symbol=CODE
        CANTRCV_CODE: prefix=CANTRCV, sw-addrmethod=CODE, symbol=CODE
      section name prefix CanTrcv
      section name prefix CANTRCV
package /AUTOSAR_CanTrcv/BswModuleDescriptions
  bsw module description CanTrcv
    bsw internal behavior BswInternalBehavior
      bsw called entity CE_CanTrcv_Init: implemented-entry=CanTrcv_Init
      bsw schedulable entity SE_MainFunction_CanTrcv: implemented-entry=CanTrcv_MainFunction
      bsw timing event EV_SE_MainFunction_CanTrcv: starts-on-event=SE_MainFunction_CanTrcv, period=0.001
package /AUTOSAR_CanTrcv/Units
  unit NoUnit: display-name=noUnit, factor-si-to-unit=1.0, offset-si-to-unit=0.0, physical-dimension=NoUnit  # No Unit
package /AUTOSAR_CanTrcv/PhysicalDimensions
  physical dimension NoUnit: length-exp=0
