AUTOSAR XML (schema 4-2-2)
package /AUTOSAR_Com/ApplicationDataTypes
  application array data type Com_SigBuf_au8: category=ARRAY, sw-calibration-access=READ-WRITE  # Application data type for Signals of type - uint8,sint8,boolean,uint8_n
    element Com_Subapp_u8: category=VALUE, type=Com_uint8, max-number-of-elements=960
  application array data type Com_applDataType_au8_Size8: category=ARRAY, sw-calibration-access=READ-WRITE  # Application data type for Ipdu buffer of Size8
    element Com_Subapp8: category=VALUE, type=Com_uint8, max-number-of-elements=8
  5 x app type, all with category=VALUE, sw-calibration-access=READ-WRITE, display-format=%5.0f:
    Com_IPduStatus_type: compu {0=INACTIVE, 1=ACTIVE} "Computation Method for ComIPdu Calibration Status", range phys 0..1  # unsigned char
    Com_uint8: compu-method=Identical, range phys 0..255  # unsigned char
    Com_uint16: compu-method=Identical, range phys 0..65535  # unsigned short
    Com_uint32: compu-method=Identical, range phys 0..4294967295  # unsigned int
    Com_uint64: compu-method=Identical, range phys 0..9.223372036854776E18  # unsigned long long
package /AUTOSAR_Com/BswImplementations
  bsw implementation Com: programming-language=C, sw-version=10.0.0, ar-release-version=4.2.2, behavior=BswInternalBehavior
    code-descriptors:
      code CodeDescriptor: artifact-descriptors=autosar-engineering-object={short-label=ArEngObj, category=SWSRC}
    resource consumption Com_ResourceConsumption
      10 x memory section:
        Com_CODE: prefix=Com, sw-addrmethod=CODE, symbol=CODE
        COM_CODE: prefix=COM, sw-addrmethod=CODE, symbol=CODE
        COM_CONST_UNSPECIFIED: alignment=UNSPECIFIED, prefix=COM, sw-addrmethod=CONST, symbol=CONST_UNSPECIFIED
        COM_CONFIG_DATA_32: alignment=32, prefix=COM, sw-addrmethod=CONFIG_DATA, symbol=CONFIG_DATA_32
        COM_CONFIG_DATA_UNSPECIFIED: alignment=UNSPECIFIED, prefix=COM, sw-addrmethod=CONFIG_DATA, symbol=CONFIG_DATA_UNSPECIFIED
        COM_VAR_CLEARED_8: alignment=8, prefix=COM, sw-addrmethod=VAR_CLEARED, symbol=VAR_CLEARED_8
        COM_VAR_CLEARED_16: alignment=16, prefix=COM, sw-addrmethod=VAR_CLEARED, symbol=VAR_CLEARED_16
        COM_VAR_CLEARED_32: alignment=32, prefix=COM, sw-addrmethod=VAR_CLEARED, symbol=VAR_CLEARED_32
        COM_VAR_CLEARED_64: alignment=64, prefix=COM, sw-addrmethod=VAR_CLEARED, symbol=VAR_CLEARED_64
        COM_VAR_CLEARED_UNSPECIFIED: alignment=UNSPECIFIED, prefix=COM, sw-addrmethod=VAR_CLEARED, symbol=VAR_CLEARED_UNSPECIFIED
      section name prefix Com
      section name prefix COM
package /AUTOSAR_Com/BswModuleDescriptions
  bsw module description Com
    bsw internal behavior BswInternalBehavior: data-type-mapping=DataTypeMappingSet
      static-memorys:
        261 x data, all with category=ARRAY, sw-addr-method=INTERNAL_VAR_CLEARED, sw-calibration-access=READ-ONLY, display-format=%5.0f:
          Com_SigType_au8: type=Com_SigBuf_au8  # Measurement variable for Signals of type - uint8,sint8,boolean,uint8_n. To refer Individual element in the Buffer array, Fetch Buffer Index from Com_PBcfg.c for each signal.
          Com_dCom_IPdu_CanNodeNum_01_TxBasic_{01..20}Byte: type=Com_applDataType_au8_Size8  # Tx Ipdu buffer of IPdu -Com_IPdu_CanNodeNum_01_TxBasic_{01..20}- as a Measurement parameter
          Com_dCom_IPdu_CanNodeNum_01_Tx_{01..25}Byte: type=Com_applDataType_au8_Size8  # Tx Ipdu buffer of IPdu -Com_IPdu_CanNodeNum_01_Tx_{01..25}- as a Measurement parameter
          Com_dCom_IPdu_CanNodeNum_01_Tx_25_00Byte: type=Com_applDataType_au8_Size8  # Tx Ipdu buffer of IPdu -Com_IPdu_CanNodeNum_01_Tx_25_00- as a Measurement parameter
          Com_dCom_IPdu_CanNodeNum_01_Tx_25_01Byte: type=Com_applDataType_au8_Size8  # Tx Ipdu buffer of IPdu -Com_IPdu_CanNodeNum_01_Tx_25_01- as a Measurement parameter
          Com_dCom_IPdu_CanNodeNum_01_Tx_26Byte: type=Com_applDataType_au8_Size8  # Tx Ipdu buffer of IPdu -Com_IPdu_CanNodeNum_01_Tx_26- as a Measurement parameter
          Com_dCom_IPdu_CanNodeNum_02_TxBasic_{01..20}Byte: type=Com_applDataType_au8_Size8  # Tx Ipdu buffer of IPdu -Com_IPdu_CanNodeNum_02_TxBasic_{01..20}- as a Measurement parameter
          Com_dCom_IPdu_CanNodeNum_02_Tx_{01..26}Byte: type=Com_applDataType_au8_Size8  # Tx Ipdu buffer of IPdu -Com_IPdu_CanNodeNum_02_Tx_{01..26}- as a Measurement parameter
          Com_dCom_IPdu_CanNodeNum_03_TxBasic_{01..20}Byte: type=Com_applDataType_au8_Size8  # Tx Ipdu buffer of IPdu -Com_IPdu_CanNodeNum_03_TxBasic_{01..20}- as a Measurement parameter
          Com_dCom_IPdu_CanNodeNum_03_Tx_{01..26}Byte: type=Com_applDataType_au8_Size8  # Tx Ipdu buffer of IPdu -Com_IPdu_CanNodeNum_03_Tx_{01..26}- as a Measurement parameter
          Com_dCom_IPdu_CanNodeNum_01_Rx_{01..40}Byte: type=Com_applDataType_au8_Size8  # Rx Local Ipdu buffer of IPdu -Com_IPdu_CanNodeNum_01_Rx_{01..40}- as a Measurement parameter
          Com_dCom_IPdu_CanNodeNum_02_Rx_{01..40}Byte: type=Com_applDataType_au8_Size8  # Rx Local Ipdu buffer of IPdu -Com_IPdu_CanNodeNum_02_Rx_{01..40}- as a Measurement parameter
          Com_dCom_IPdu_CanNodeNum_03_Rx_{01..40}Byte: type=Com_applDataType_au8_Size8  # Rx Local Ipdu buffer of IPdu -Com_IPdu_CanNodeNum_03_Rx_{01..40}- as a Measurement parameter
      bsw called entity CE_Init: implemented-entry=Com_Init
      bsw schedulable entity SE_MainFunctionRx: implemented-entry=Com_MainFunctionRx
      bsw schedulable entity SE_MainFunctionTx: implemented-entry=Com_MainFunctionTx
      bsw timing event EV_SE_MainFunctionRx: starts-on-event=SE_MainFunctionRx, period=0.001
      bsw timing event EV_SE_MainFunctionTx: starts-on-event=SE_MainFunctionTx, period=0.001
package /AUTOSAR_Com/DataTypeMappingSets
  data type mapping set DataTypeMappingSet
    data-type-maps:
      application-data-type=Com_SigBuf_au8, implementation-data-type=Com_SigBuf_au8_impl
      application-data-type=Com_applDataType_au8_Size8, implementation-data-type=Com_implDataType_au8_Size8
      application-data-type=Com_IPduStatus_type, implementation-data-type=Com_impl_b
      application-data-type=Com_uint8, implementation-data-type=Com_impl_u8
      application-data-type=Com_uint16, implementation-data-type=Com_impl_u16
      application-data-type=Com_uint32, implementation-data-type=Com_impl_u32
      application-data-type=Com_uint64, implementation-data-type=Com_impl_u64
package /AUTOSAR_Com/ImplementationDataTypes
  7 x impl type:
    Com_SigBuf_au8_impl: category=ARRAY  # Implementation data type for Signals of type - uint8,sint8,boolean,uint8_n
      element Com_Subimpl_u8: array-size=960, array-size-semantics=FIXED-SIZE, implementation-data-type=Com_impl_u8
    Com_implDataType_au8_Size8: category=ARRAY  # Implementation data type for Ipdu buffer of Size8
      element Com_Subimpl8: array-size=8, array-size-semantics=FIXED-SIZE, implementation-data-type=Com_impl_u8
    Com_impl_b: implementation-data-type=boolean  # unsigned char
    Com_impl_u8: implementation-data-type=uint8  # unsigned char
    Com_impl_u16: implementation-data-type=uint16  # unsigned short
    Com_impl_u32: implementation-data-type=uint32  # unsigned long
    Com_impl_u64: implementation-data-type=uint64  # unsigned long long
package /AUTOSAR_Com/Units
  unit NoUnit: display-name=noUnit, factor-si-to-unit=1.0, offset-si-to-unit=0.0, physical-dimension=NoUnit  # No Unit
package /AUTOSAR_Com/PhysicalDimensions
  physical dimension NoUnit: length-exp=0
