AUTOSAR XML (schema 4-2-2)
package /AUTOSAR_CanNm/BswImplementations
  bsw implementation CanNm: programming-language=C, sw-version=3.4.0, ar-release-version=4.2.2, behavior=BswInternalBehavior
    code-descriptors:
      code CodeDescriptor: artifact-descriptors=autosar-engineering-object={short-label=ArEngObj, category=SWSRC}
    resource consumption CanNm_ResourceConsumption
      8 x memory section:
        CANNM_VAR_CLEARED_8: alignment=8, prefix=CANNM, sw-addrmethod=VAR_CLEARED, symbol=VAR_CLEARED_8
        CANNM_VAR_CLEARED_UNSPECIFIED: alignment=UNSPECIFIED, prefix=CANNM, sw-addrmethod=VAR_CLEARED, symbol=VAR_CLEARED_UNSPECIFIED
        CanNm_CODE: prefix=CanNm, sw-addrmethod=CODE, symbol=CODE
        CANNM_CODE: prefix=CANNM, sw-addrmethod=CODE, symbol=CODE
        CANNM_CONFIG_DATA_POSTBUILD_8: alignment=8, prefix=CANNM, sw-addrmethod=CONFIG_DATA_POSTBUILD, symbol=CONFIG_DATA_POSTBUILD_8
        CANNM_CONFIG_DATA_POSTBUILD_UNSPECIFIED: alignment=UNSPECIFIED, prefix=CANNM, sw-addrmethod=CONFIG_DATA_POSTBUILD, symbol=CONFIG_DATA_POSTBUILD_UNSPECIFIED
        CANNM_CONST_8: alignment=8, prefix=CANNM, sw-addrmethod=CONST, symbol=CONST_8
        CANNM_CONST_UNSPECIFIED: alignment=UNSPECIFIED, prefix=CANNM, sw-addrmethod=CONST, symbol=CONST_UNSPECIFIED
      section name prefix CanNm
      section name prefix CANNM
package /AUTOSAR_CanNm/BswModuleDescriptions
  bsw module description CanNm: category=BSW_MODULE, module-id=31  # CanNetworkManagement
    bsw internal behavior BswInternalBehavior
      bsw called entity CE_Init: implemented-entry=CanNm_Init
      bsw schedulable entity SE_MainFunction: implemented-entry=CanNm_MainFunction
      bsw timing event EV_SE_MainFunction: starts-on-event=SE_MainFunction, period=0.001
package /AUTOSAR_CanNm/Units
  unit NoUnit: display-name=noUnit, factor-si-to-unit=1.0, offset-si-to-unit=0.0, physical-dimension=NoUnit  # No Unit
package /AUTOSAR_CanNm/PhysicalDimensions
  physical dimension NoUnit: length-exp=0
