AUTOSAR XML (schema 4-2-2)
package /AUTOSAR_ComM/TimingExtensions
  bsw module timing ComM_BswModuleTiming: behavior=BswInternalBehavior
    timing-requirements:
      execution order constraint EOC_EcuM_Init: execution-order-constraint-type=ORDINARY-EOC, is-event=false, permit-multiple-references-to-ee=false
        ordered-elements:
          eoc executable entity ref EOCEERef_CE_ComM_Init: bsw-module-instance=ComM, executable=CE_Init
      execution order constraint EOC_T_xxms: execution-order-constraint-type=ORDINARY-EOC, is-event=true
        ordered-elements:
          4 x eoc event ref, all with bsw-module-instance=ComM:
            EOCEventRef_ComM_0: event=EV_SE_MainFunction_Can_Network_CanNodeNum_00, successor=EOCEventRef_ComM_1
            EOCEventRef_ComM_1: event=EV_SE_MainFunction_Can_Network_CanNodeNum_01, successor=EOCEventRef_ComM_2
            EOCEventRef_ComM_2: event=EV_SE_MainFunction_Can_Network_CanNodeNum_02, successor=EOCEventRef_ComM_3
            EOCEventRef_ComM_3: event=EV_SE_MainFunction_Can_Network_CanNodeNum_03
