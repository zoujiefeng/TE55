[part 3 of 12: package /AUTOSAR_Dem/SwComponentTypes]
AUTOSAR XML (schema 4-2-2)
package /AUTOSAR_Dem/SwComponentTypes  (continued)
  service sw component type Dem  (continued)
    2013 x provide port:  (continued)
      EvtInfo_DemEventParameter_ECU2_DTC71: provided-interface=DiagnosticInfo
        provided-com-specs:
          operation=DiagnosticInfo/GetEventStatus, queue-length=1
          operation=DiagnosticInfo/GetEventFailed, queue-length=1
          operation=DiagnosticInfo/GetEventTested, queue-length=1
          operation=DiagnosticInfo/GetDTCOfEvent, queue-length=1
          operation=DiagnosticInfo/GetDebouncingOfEvent, queue-length=1
          operation=DiagnosticInfo/GetFaultDetectionCounter, queue-length=1
          operation=DiagnosticInfo/GetEventExtendedDataRecord, queue-length=1
          operation=DiagnosticInfo/GetEventExtendedDataRecordEx, queue-length=1
          operation=DiagnosticInfo/GetEventFreezeFrameData, queue-length=1
          operation=DiagnosticInfo/GetEventFreezeFrameDataEx, queue-length=1
      EvtInfo_DemEventParameter_ECU2_DTC72: provided-interface=DiagnosticInfo
        provided-com-specs:
          operation=DiagnosticInfo/GetEventStatus, queue-length=1
          operation=DiagnosticInfo/GetEventFailed, queue-length=1
          operation=DiagnosticInfo/GetEventTested, queue-length=1
          operation=DiagnosticInfo/GetDTCOfEvent, queue-length=1
          operation=DiagnosticInfo/GetDebouncingOfEvent, queue-length=1
          operation=DiagnosticInfo/GetFaultDetectionCounter, queue-length=1
          operation=DiagnosticInfo/GetEventExtendedDataRecord, queue-length=1
          operation=DiagnosticInfo/GetEventExtendedDataRecordEx, queue-length=1
          operation=DiagnosticInfo/GetEventFreezeFrameData, queue-length=1
          operation=DiagnosticInfo/GetEventFreezeFrameDataEx, queue-length=1
      EvtInfo_DemEventParameter_ECU2_DTC73: provided-interface=DiagnosticInfo
        provided-com-specs:
          operation=DiagnosticInfo/GetEventStatus, queue-length=1
          operation=DiagnosticInfo/GetEventFailed, queue-length=1
          operation=DiagnosticInfo/GetEventTested, queue-length=1
          operation=DiagnosticInfo/GetDTCOfEvent, queue-length=1
          operation=DiagnosticInfo/GetDebouncingOfEvent, queue-length=1
          operation=DiagnosticInfo/GetFaultDetectionCounter, queue-length=1
          operation=DiagnosticInfo/GetEventExtendedDataRecord, queue-length=1
          operation=DiagnosticInfo/GetEventExtendedDataRecordEx, queue-length=1
          operation=DiagnosticInfo/GetEventFreezeFrameData, queue-length=1
          operation=DiagnosticInfo/GetEventFreezeFrameDataEx, queue-length=1
      EvtInfo_DemEventParameter_ECU2_DTC74: provided-interface=DiagnosticInfo
        provided-com-specs:
          operation=DiagnosticInfo/GetEventStatus, queue-length=1
          operation=DiagnosticInfo/GetEventFailed, queue-length=1
          operation=DiagnosticInfo/GetEventTested, queue-length=1
          operation=DiagnosticInfo/GetDTCOfEvent, queue-length=1
          operation=DiagnosticInfo/GetDebouncingOfEvent, queue-length=1
          operation=DiagnosticInfo/GetFaultDetectionCounter, queue-length=1
          operation=DiagnosticInfo/GetEventExtendedDataRecord, queue-length=1
          operation=DiagnosticInfo/GetEventExtendedDataRecordEx, queue-length=1
          operation=DiagnosticInfo/GetEventFreezeFrameData, queue-length=1
          operation=DiagnosticInfo/GetEventFreezeFrameDataEx, queue-length=1
      EvtInfo_DemEventParameter_ECU2_DTC75: provided-interface=DiagnosticInfo
        provided-com-specs:
          operation=DiagnosticInfo/GetEventStatus, queue-length=1
          operation=DiagnosticInfo/GetEventFailed, queue-length=1
          operation=DiagnosticInfo/GetEventTested, queue-length=1
          operation=DiagnosticInfo/GetDTCOfEvent, queue-length=1
          operation=DiagnosticInfo/GetDebouncingOfEvent, queue-length=1
          operation=DiagnosticInfo/GetFaultDetectionCounter, queue-length=1
          operation=DiagnosticInfo/GetEventExtendedDataRecord, queue-length=1
          operation=DiagnosticInfo/GetEventExtendedDataRecordEx, queue-length=1
          operation=DiagnosticInfo/GetEventFreezeFrameData, queue-length=1
          operation=DiagnosticInfo/GetEventFreezeFrameDataEx, queue-length=1
      EvtInfo_DemEventParameter_ECU2_DTC76: provided-interface=DiagnosticInfo
        provided-com-specs:
          operation=DiagnosticInfo/GetEventStatus, queue-length=1
          operation=DiagnosticInfo/GetEventFailed, queue-length=1
          operation=DiagnosticInfo/GetEventTested, queue-length=1
          operation=DiagnosticInfo/GetDTCOfEvent, queue-length=1
          operation=DiagnosticInfo/GetDebouncingOfEvent, queue-length=1
          operation=DiagnosticInfo/GetFaultDetectionCounter, queue-length=1
          operation=DiagnosticInfo/GetEventExtendedDataRecord, queue-length=1
          operation=DiagnosticInfo/GetEventExtendedDataRecordEx, queue-length=1
          operation=DiagnosticInfo/GetEventFreezeFrameData, queue-length=1
          operation=DiagnosticInfo/GetEventFreezeFrameDataEx, queue-length=1
      EvtInfo_DemEventParameter_ECU2_DTC77: provided-interface=DiagnosticInfo
        provided-com-specs:
          operation=DiagnosticInfo/GetEventStatus, queue-length=1
          operation=DiagnosticInfo/GetEventFailed, queue-length=1
          operation=DiagnosticInfo/GetEventTested, queue-length=1
          operation=DiagnosticInfo/GetDTCOfEvent, queue-length=1
          operation=DiagnosticInfo/GetDebouncingOfEvent, queue-length=1
          operation=DiagnosticInfo/GetFaultDetectionCounter, queue-length=1
          operation=DiagnosticInfo/GetEventExtendedDataRecord, queue-length=1
          operation=DiagnosticInfo/GetEventExtendedDataRecordEx, queue-length=1
          operation=DiagnosticInfo/GetEventFreezeFrameData, queue-length=1
          operation=DiagnosticInfo/GetEventFreezeFrameDataEx, queue-length=1
      EvtInfo_DemEventParameter_ECU2_DTC78: provided-interface=DiagnosticInfo
        provided-com-specs:
          operation=DiagnosticInfo/GetEventStatus, queue-length=1
          operation=DiagnosticInfo/GetEventFailed, queue-length=1
          operation=DiagnosticInfo/GetEventTested, queue-length=1
          operation=DiagnosticInfo/GetDTCOfEvent, queue-length=1
          operation=DiagnosticInfo/GetDebouncingOfEvent, queue-length=1
          operation=DiagnosticInfo/GetFaultDetectionCounter, queue-length=1
          operation=DiagnosticInfo/GetEventExtendedDataRecord, queue-length=1
          operation=DiagnosticInfo/GetEventExtendedDataRecordEx, queue-length=1
          operation=DiagnosticInfo/GetEventFreezeFrameData, queue-length=1
          operation=DiagnosticInfo/GetEventFreezeFrameDataEx, queue-length=1
      EvtInfo_DemEventParameter_ECU2_DTC79: provided-interface=DiagnosticInfo
        provided-com-specs:
          operation=DiagnosticInfo/GetEventStatus, queue-length=1
          operation=DiagnosticInfo/GetEventFailed, queue-length=1
          operation=DiagnosticInfo/GetEventTested, queue-length=1
          operation=DiagnosticInfo/GetDTCOfEvent, queue-length=1
          operation=DiagnosticInfo/GetDebouncingOfEvent, queue-length=1
          operation=DiagnosticInfo/GetFaultDetectionCounter, queue-length=1
          operation=DiagnosticInfo/GetEventExtendedDataRecord, queue-length=1
          operation=DiagnosticInfo/GetEventExtendedDataRecordEx, queue-length=1
          operation=DiagnosticInfo/GetEventFreezeFrameData, queue-length=1
          operation=DiagnosticInfo/GetEventFreezeFrameDataEx, queue-length=1
      EvtInfo_DemEventParameter_ECU2_DTC80: provided-interface=DiagnosticInfo
        provided-com-specs:
          operation=DiagnosticInfo/GetEventStatus, queue-length=1
          operation=DiagnosticInfo/GetEventFailed, queue-length=1
          operation=DiagnosticInfo/GetEventTested, queue-length=1
          operation=DiagnosticInfo/GetDTCOfEvent, queue-length=1
          operation=DiagnosticInfo/GetDebouncingOfEvent, queue-length=1
          operation=DiagnosticInfo/GetFaultDetectionCounter, queue-length=1
          operation=DiagnosticInfo/GetEventExtendedDataRecord, queue-length=1
          operation=DiagnosticInfo/GetEventExtendedDataRecordEx, queue-length=1
          operation=DiagnosticInfo/GetEventFreezeFrameData, queue-length=1
          operation=DiagnosticInfo/GetEventFreezeFrameDataEx, queue-length=1
      EvtInfo_DemEventParameter_ECU2_DTC81: provided-interface=DiagnosticInfo
        provided-com-specs:
          operation=DiagnosticInfo/GetEventStatus, queue-length=1
          operation=DiagnosticInfo/GetEventFailed, queue-length=1
          operation=DiagnosticInfo/GetEventTested, queue-length=1
          operation=DiagnosticInfo/GetDTCOfEvent, queue-length=1
          operation=DiagnosticInfo/GetDebouncingOfEvent, queue-length=1
          operation=DiagnosticInfo/GetFaultDetectionCounter, queue-length=1
          operation=DiagnosticInfo/GetEventExtendedDataRecord, queue-length=1
          operation=DiagnosticInfo/GetEventExtendedDataRecordEx, queue-length=1
          operation=DiagnosticInfo/GetEventFreezeFrameData, queue-length=1
          operation=DiagnosticInfo/GetEventFreezeFrameDataEx, queue-length=1
      EvtInfo_DemEventParameter_ECU2_DTC82: provided-interface=DiagnosticInfo
        provided-com-specs:
          operation=DiagnosticInfo/GetEventStatus, queue-length=1
          operation=DiagnosticInfo/GetEventFailed, queue-length=1
          operation=DiagnosticInfo/GetEventTested, queue-length=1
          operation=DiagnosticInfo/GetDTCOfEvent, queue-length=1
          operation=DiagnosticInfo/GetDebouncingOfEvent, queue-length=1
          operation=DiagnosticInfo/GetFaultDetectionCounter, queue-length=1
          operation=DiagnosticInfo/GetEventExtendedDataRecord, queue-length=1
          operation=DiagnosticInfo/GetEventExtendedDataRecordEx, queue-length=1
          operation=DiagnosticInfo/GetEventFreezeFrameData, queue-length=1
          operation=DiagnosticInfo/GetEventFreezeFrameDataEx, queue-length=1
      EvtInfo_DemEventParameter_ECU2_DTC83: provided-interface=DiagnosticInfo
        provided-com-specs:
          operation=DiagnosticInfo/GetEventStatus, queue-length=1
          operation=DiagnosticInfo/GetEventFailed, queue-length=1
          operation=DiagnosticInfo/GetEventTested, queue-length=1
          operation=DiagnosticInfo/GetDTCOfEvent, queue-length=1
          operation=DiagnosticInfo/GetDebouncingOfEvent, queue-length=1
          operation=DiagnosticInfo/GetFaultDetectionCounter, queue-length=1
          operation=DiagnosticInfo/GetEventExtendedDataRecord, queue-length=1
          operation=DiagnosticInfo/GetEventExtendedDataRecordEx, queue-length=1
          operation=DiagnosticInfo/GetEventFreezeFrameData, queue-length=1
          operation=DiagnosticInfo/GetEventFreezeFrameDataEx, queue-length=1
      EvtInfo_DemEventParameter_ECU2_DTC84: provided-interface=DiagnosticInfo
        provided-com-specs:
          operation=DiagnosticInfo/GetEventStatus, queue-length=1
          operation=DiagnosticInfo/GetEventFailed, queue-length=1
          operation=DiagnosticInfo/GetEventTested, queue-length=1
          operation=DiagnosticInfo/GetDTCOfEvent, queue-length=1
          operation=DiagnosticInfo/GetDebouncingOfEvent, queue-length=1
          operation=DiagnosticInfo/GetFaultDetectionCounter, queue-length=1
          operation=DiagnosticInfo/GetEventExtendedDataRecord, queue-length=1
          operation=DiagnosticInfo/GetEventExtendedDataRecordEx, queue-length=1
          operation=DiagnosticInfo/GetEventFreezeFrameData, queue-length=1
          operation=DiagnosticInfo/GetEventFreezeFrameDataEx, queue-length=1
      EvtInfo_DemEventParameter_ECU2_DTC85: provided-interface=DiagnosticInfo
        provided-com-specs:
          operation=DiagnosticInfo/GetEventStatus, queue-length=1
          operation=DiagnosticInfo/GetEventFailed, queue-length=1
          operation=DiagnosticInfo/GetEventTested, queue-length=1
          operation=DiagnosticInfo/GetDTCOfEvent, queue-length=1
          operation=DiagnosticInfo/GetDebouncingOfEvent, queue-length=1
          operation=DiagnosticInfo/GetFaultDetectionCounter, queue-length=1
          operation=DiagnosticInfo/GetEventExtendedDataRecord, queue-length=1
          operation=DiagnosticInfo/GetEventExtendedDataRecordEx, queue-length=1
          operation=DiagnosticInfo/GetEventFreezeFrameData, queue-length=1
          operation=DiagnosticInfo/GetEventFreezeFrameDataEx, queue-length=1
      EvtInfo_DemEventParameter_ECU2_DTC86: provided-interface=DiagnosticInfo
        provided-com-specs:
          operation=DiagnosticInfo/GetEventStatus, queue-length=1
          operation=DiagnosticInfo/GetEventFailed, queue-length=1
          operation=DiagnosticInfo/GetEventTested, queue-length=1
          operation=DiagnosticInfo/GetDTCOfEvent, queue-length=1
          operation=DiagnosticInfo/GetDebouncingOfEvent, queue-length=1
          operation=DiagnosticInfo/GetFaultDetectionCounter, queue-length=1
          operation=DiagnosticInfo/GetEventExtendedDataRecord, queue-length=1
          operation=DiagnosticInfo/GetEventExtendedDataRecordEx, queue-length=1
          operation=DiagnosticInfo/GetEventFreezeFrameData, queue-length=1
          operation=DiagnosticInfo/GetEventFreezeFrameDataEx, queue-length=1
      EvtInfo_DemEventParameter_ECU2_DTC87: provided-interface=DiagnosticInfo
        provided-com-specs:
          operation=DiagnosticInfo/GetEventStatus, queue-length=1
          operation=DiagnosticInfo/GetEventFailed, queue-length=1
          operation=DiagnosticInfo/GetEventTested, queue-length=1
          operation=DiagnosticInfo/GetDTCOfEvent, queue-length=1
          operation=DiagnosticInfo/GetDebouncingOfEvent, queue-length=1
          operation=DiagnosticInfo/GetFaultDetectionCounter, queue-length=1
          operation=DiagnosticInfo/GetEventExtendedDataRecord, queue-length=1
          operation=DiagnosticInfo/GetEventExtendedDataRecordEx, queue-length=1
          operation=DiagnosticInfo/GetEventFreezeFrameData, queue-length=1
          operation=DiagnosticInfo/GetEventFreezeFrameDataEx, queue-length=1
      EvtInfo_DemEventParameter_ECU2_DTC88: provided-interface=DiagnosticInfo
        provided-com-specs:
          operation=DiagnosticInfo/GetEventStatus, queue-length=1
          operation=DiagnosticInfo/GetEventFailed, queue-length=1
          operation=DiagnosticInfo/GetEventTested, queue-length=1
          operation=DiagnosticInfo/GetDTCOfEvent, queue-length=1
          operation=DiagnosticInfo/GetDebouncingOfEvent, queue-length=1
          operation=DiagnosticInfo/GetFaultDetectionCounter, queue-length=1
          operation=DiagnosticInfo/GetEventExtendedDataRecord, queue-length=1
          operation=DiagnosticInfo/GetEventExtendedDataRecordEx, queue-length=1
          operation=DiagnosticInfo/GetEventFreezeFrameData, queue-length=1
          operation=DiagnosticInfo/GetEventFreezeFrameDataEx, queue-length=1
      EvtInfo_DemEventParameter_ECU2_DTC89: provided-interface=DiagnosticInfo
        provided-com-specs:
          operation=DiagnosticInfo/GetEventStatus, queue-length=1
          operation=DiagnosticInfo/GetEventFailed, queue-length=1
          operation=DiagnosticInfo/GetEventTested, queue-length=1
          operation=DiagnosticInfo/GetDTCOfEvent, queue-length=1
          operation=DiagnosticInfo/GetDebouncingOfEvent, queue-length=1
          operation=DiagnosticInfo/GetFaultDetectionCounter, queue-length=1
          operation=DiagnosticInfo/GetEventExtendedDataRecord, queue-length=1
          operation=DiagnosticInfo/GetEventExtendedDataRecordEx, queue-length=1
          operation=DiagnosticInfo/GetEventFreezeFrameData, queue-length=1
          operation=DiagnosticInfo/GetEventFreezeFrameDataEx, queue-length=1
      EvtInfo_DemEventParameter_ECU2_DTC90: provided-interface=DiagnosticInfo
        provided-com-specs:
          operation=DiagnosticInfo/GetEventStatus, queue-length=1
          operation=DiagnosticInfo/GetEventFailed, queue-length=1
          operation=DiagnosticInfo/GetEventTested, queue-length=1
          operation=DiagnosticInfo/GetDTCOfEvent, queue-length=1
          operation=DiagnosticInfo/GetDebouncingOfEvent, queue-length=1
          operation=DiagnosticInfo/GetFaultDetectionCounter, queue-length=1
          operation=DiagnosticInfo/GetEventExtendedDataRecord, queue-length=1
          operation=DiagnosticInfo/GetEventExtendedDataRecordEx, queue-length=1
          operation=DiagnosticInfo/GetEventFreezeFrameData, queue-length=1
          operation=DiagnosticInfo/GetEventFreezeFrameDataEx, queue-length=1
      EvtInfo_DemEventParameter_ECU2_DTC91: provided-interface=DiagnosticInfo
        provided-com-specs:
          operation=DiagnosticInfo/GetEventStatus, queue-length=1
          operation=DiagnosticInfo/GetEventFailed, queue-length=1
          operation=DiagnosticInfo/GetEventTested, queue-length=1
          operation=DiagnosticInfo/GetDTCOfEvent, queue-length=1
          operation=DiagnosticInfo/GetDebouncingOfEvent, queue-length=1
          operation=DiagnosticInfo/GetFaultDetectionCounter, queue-length=1
          operation=DiagnosticInfo/GetEventExtendedDataRecord, queue-length=1
          operation=DiagnosticInfo/GetEventExtendedDataRecordEx, queue-length=1
          operation=DiagnosticInfo/GetEventFreezeFrameData, queue-length=1
          operation=DiagnosticInfo/GetEventFreezeFrameDataEx, queue-length=1
      EvtInfo_DemEventParameter_ECU2_DTC92: provided-interface=DiagnosticInfo
        provided-com-specs:
          operation=DiagnosticInfo/GetEventStatus, queue-length=1
          operation=DiagnosticInfo/GetEventFailed, queue-length=1
          operation=DiagnosticInfo/GetEventTested, queue-length=1
          operation=DiagnosticInfo/GetDTCOfEvent, queue-length=1
          operation=DiagnosticInfo/GetDebouncingOfEvent, queue-length=1
          operation=DiagnosticInfo/GetFaultDetectionCounter, queue-length=1
          operation=DiagnosticInfo/GetEventExtendedDataRecord, queue-length=1
          operation=DiagnosticInfo/GetEventExtendedDataRecordEx, queue-length=1
          operation=DiagnosticInfo/GetEventFreezeFrameData, queue-length=1
          operation=DiagnosticInfo/GetEventFreezeFrameDataEx, queue-length=1
      EvtInfo_DemEventParameter_ECU2_DTC93: provided-interface=DiagnosticInfo
        provided-com-specs:
          operation=DiagnosticInfo/GetEventStatus, queue-length=1
          operation=DiagnosticInfo/GetEventFailed, queue-length=1
          operation=DiagnosticInfo/GetEventTested, queue-length=1
          operation=DiagnosticInfo/GetDTCOfEvent, queue-length=1
          operation=DiagnosticInfo/GetDebouncingOfEvent, queue-length=1
          operation=DiagnosticInfo/GetFaultDetectionCounter, queue-length=1
          operation=DiagnosticInfo/GetEventExtendedDataRecord, queue-length=1
          operation=DiagnosticInfo/GetEventExtendedDataRecordEx, queue-length=1
          operation=DiagnosticInfo/GetEventFreezeFrameData, queue-length=1
          operation=DiagnosticInfo/GetEventFreezeFrameDataEx, queue-length=1
      EvtInfo_DemEventParameter_ECU2_DTC94: provided-interface=DiagnosticInfo
        provided-com-specs:
          operation=DiagnosticInfo/GetEventStatus, queue-length=1
          operation=DiagnosticInfo/GetEventFailed, queue-length=1
          operation=DiagnosticInfo/GetEventTested, queue-length=1
          operation=DiagnosticInfo/GetDTCOfEvent, queue-length=1
          operation=DiagnosticInfo/GetDebouncingOfEvent, queue-length=1
          operation=DiagnosticInfo/GetFaultDetectionCounter, queue-length=1
          operation=DiagnosticInfo/GetEventExtendedDataRecord, queue-length=1
          operation=DiagnosticInfo/GetEventExtendedDataRecordEx, queue-length=1
          operation=DiagnosticInfo/GetEventFreezeFrameData, queue-length=1
          operation=DiagnosticInfo/GetEventFreezeFrameDataEx, queue-length=1
      EvtInfo_DemEventParameter_ECU2_DTC95: provided-interface=DiagnosticInfo
        provided-com-specs:
          operation=DiagnosticInfo/GetEventStatus, queue-length=1
          operation=DiagnosticInfo/GetEventFailed, queue-length=1
          operation=DiagnosticInfo/GetEventTested, queue-length=1
          operation=DiagnosticInfo/GetDTCOfEvent, queue-length=1
          operation=DiagnosticInfo/GetDebouncingOfEvent, queue-length=1
          operation=DiagnosticInfo/GetFaultDetectionCounter, queue-length=1
          operation=DiagnosticInfo/GetEventExtendedDataRecord, queue-length=1
          operation=DiagnosticInfo/GetEventExtendedDataRecordEx, queue-length=1
          operation=DiagnosticInfo/GetEventFreezeFrameData, queue-length=1
          operation=DiagnosticInfo/GetEventFreezeFrameDataEx, queue-length=1
      EvtInfo_DemEventParameter_ECU2_DTC96: provided-interface=DiagnosticInfo
        provided-com-specs:
          operation=DiagnosticInfo/GetEventStatus, queue-length=1
          operation=DiagnosticInfo/GetEventFailed, queue-length=1
          operation=DiagnosticInfo/GetEventTested, queue-length=1
          operation=DiagnosticInfo/GetDTCOfEvent, queue-length=1
          operation=DiagnosticInfo/GetDebouncingOfEvent, queue-length=1
          operation=DiagnosticInfo/GetFaultDetectionCounter, queue-length=1
          operation=DiagnosticInfo/GetEventExtendedDataRecord, queue-length=1
          operation=DiagnosticInfo/GetEventExtendedDataRecordEx, queue-length=1
          operation=DiagnosticInfo/GetEventFreezeFrameData, queue-length=1
          operation=DiagnosticInfo/GetEventFreezeFrameDataEx, queue-length=1
      EvtInfo_DemEventParameter_ECU2_DTC97: provided-interface=DiagnosticInfo
        provided-com-specs:
          operation=DiagnosticInfo/GetEventStatus, queue-length=1
          operation=DiagnosticInfo/GetEventFailed, queue-length=1
          operation=DiagnosticInfo/GetEventTested, queue-length=1
          operation=DiagnosticInfo/GetDTCOfEvent, queue-length=1
          operation=DiagnosticInfo/GetDebouncingOfEvent, queue-length=1
          operation=DiagnosticInfo/GetFaultDetectionCounter, queue-length=1
          operation=DiagnosticInfo/GetEventExtendedDataRecord, queue-length=1
          operation=DiagnosticInfo/GetEventExtendedDataRecordEx, queue-length=1
          operation=DiagnosticInfo/GetEventFreezeFrameData, queue-length=1
          operation=DiagnosticInfo/GetEventFreezeFrameDataEx, queue-length=1
      EvtInfo_DemEventParameter_ECU2_DTC98: provided-interface=DiagnosticInfo
        provided-com-specs:
          operation=DiagnosticInfo/GetEventStatus, queue-length=1
          operation=DiagnosticInfo/GetEventFailed, queue-length=1
          operation=DiagnosticInfo/GetEventTested, queue-length=1
          operation=DiagnosticInfo/GetDTCOfEvent, queue-length=1
          operation=DiagnosticInfo/GetDebouncingOfEvent, queue-length=1
          operation=DiagnosticInfo/GetFaultDetectionCounter, queue-length=1
          operation=DiagnosticInfo/GetEventExtendedDataRecord, queue-length=1
          operation=DiagnosticInfo/GetEventExtendedDataRecordEx, queue-length=1
          operation=DiagnosticInfo/GetEventFreezeFrameData, queue-length=1
          operation=DiagnosticInfo/GetEventFreezeFrameDataEx, queue-length=1
      EvtInfo_DemEventParameter_ECU2_DTC99: provided-interface=DiagnosticInfo
        provided-com-specs:
          operation=DiagnosticInfo/GetEventStatus, queue-length=1
          operation=DiagnosticInfo/GetEventFailed, queue-length=1
          operation=DiagnosticInfo/GetEventTested, queue-length=1
          operation=DiagnosticInfo/GetDTCOfEvent, queue-length=1
          operation=DiagnosticInfo/GetDebouncingOfEvent, queue-length=1
          operation=DiagnosticInfo/GetFaultDetectionCounter, queue-length=1
          operation=DiagnosticInfo/GetEventExtendedDataRecord, queue-length=1
          operation=DiagnosticInfo/GetEventExtendedDataRecordEx, queue-length=1
          operation=DiagnosticInfo/GetEventFreezeFrameData, queue-length=1
          operation=DiagnosticInfo/GetEventFreezeFrameDataEx, queue-length=1
      EvtInfo_DemEventParameter_ECU3_DTC00: provided-interface=DiagnosticInfo
        provided-com-specs:
          operation=DiagnosticInfo/GetEventStatus, queue-length=1
          operation=DiagnosticInfo/GetEventFailed, queue-length=1
          operation=DiagnosticInfo/GetEventTested, queue-length=1
          operation=DiagnosticInfo/GetDTCOfEvent, queue-length=1
          operation=DiagnosticInfo/GetDebouncingOfEvent, queue-length=1
          operation=DiagnosticInfo/GetFaultDetectionCounter, queue-length=1
          operation=DiagnosticInfo/GetEventExtendedDataRecord, queue-length=1
          operation=DiagnosticInfo/GetEventExtendedDataRecordEx, queue-length=1
          operation=DiagnosticInfo/GetEventFreezeFrameData, queue-length=1
          operation=DiagnosticInfo/GetEventFreezeFrameDataEx, queue-length=1
      EvtInfo_DemEventParameter_ECU3_DTC01: provided-interface=DiagnosticInfo
        provided-com-specs:
          operation=DiagnosticInfo/GetEventStatus, queue-length=1
          operation=DiagnosticInfo/GetEventFailed, queue-length=1
          operation=DiagnosticInfo/GetEventTested, queue-length=1
          operation=DiagnosticInfo/GetDTCOfEvent, queue-length=1
          operation=DiagnosticInfo/GetDebouncingOfEvent, queue-length=1
          operation=DiagnosticInfo/GetFaultDetectionCounter, queue-length=1
          operation=DiagnosticInfo/GetEventExtendedDataRecord, queue-length=1
          operation=DiagnosticInfo/GetEventExtendedDataRecordEx, queue-length=1
          operation=DiagnosticInfo/GetEventFreezeFrameData, queue-length=1
          operation=DiagnosticInfo/GetEventFreezeFrameDataEx, queue-length=1
      EvtInfo_DemEventParameter_ECU3_DTC02: provided-interface=DiagnosticInfo
        provided-com-specs:
          operation=DiagnosticInfo/GetEventStatus, queue-length=1
          operation=DiagnosticInfo/GetEventFailed, queue-length=1
          operation=DiagnosticInfo/GetEventTested, queue-length=1
          operation=DiagnosticInfo/GetDTCOfEvent, queue-length=1
          operation=DiagnosticInfo/GetDebouncingOfEvent, queue-length=1
          operation=DiagnosticInfo/GetFaultDetectionCounter, queue-length=1
          operation=DiagnosticInfo/GetEventExtendedDataRecord, queue-length=1
          operation=DiagnosticInfo/GetEventExtendedDataRecordEx, queue-length=1
          operation=DiagnosticInfo/GetEventFreezeFrameData, queue-length=1
          operation=DiagnosticInfo/GetEventFreezeFrameDataEx, queue-length=1
      EvtInfo_DemEventParameter_ECU3_DTC03: provided-interface=DiagnosticInfo
        provided-com-specs:
          operation=DiagnosticInfo/GetEventStatus, queue-length=1
          operation=DiagnosticInfo/GetEventFailed, queue-length=1
          operation=DiagnosticInfo/GetEventTested, queue-length=1
          operation=DiagnosticInfo/GetDTCOfEvent, queue-length=1
          operation=DiagnosticInfo/GetDebouncingOfEvent, queue-length=1
          operation=DiagnosticInfo/GetFaultDetectionCounter, queue-length=1
          operation=DiagnosticInfo/GetEventExtendedDataRecord, queue-length=1
          operation=DiagnosticInfo/GetEventExtendedDataRecordEx, queue-length=1
          operation=DiagnosticInfo/GetEventFreezeFrameData, queue-length=1
          operation=DiagnosticInfo/GetEventFreezeFrameDataEx, queue-length=1
      EvtInfo_DemEventParameter_ECU3_DTC04: provided-interface=DiagnosticInfo
        provided-com-specs:
          operation=DiagnosticInfo/GetEventStatus, queue-length=1
          operation=DiagnosticInfo/GetEventFailed, queue-length=1
          operation=DiagnosticInfo/GetEventTested, queue-length=1
          operation=DiagnosticInfo/GetDTCOfEvent, queue-length=1
          operation=DiagnosticInfo/GetDebouncingOfEvent, queue-length=1
          operation=DiagnosticInfo/GetFaultDetectionCounter, queue-length=1
          operation=DiagnosticInfo/GetEventExtendedDataRecord, queue-length=1
          operation=DiagnosticInfo/GetEventExtendedDataRecordEx, queue-length=1
          operation=DiagnosticInfo/GetEventFreezeFrameData, queue-length=1
          operation=DiagnosticInfo/GetEventFreezeFrameDataEx, queue-length=1
      EvtInfo_DemEventParameter_ECU3_DTC05: provided-interface=DiagnosticInfo
        provided-com-specs:
          operation=DiagnosticInfo/GetEventStatus, queue-length=1
          operation=DiagnosticInfo/GetEventFailed, queue-length=1
          operation=DiagnosticInfo/GetEventTested, queue-length=1
          operation=DiagnosticInfo/GetDTCOfEvent, queue-length=1
          operation=DiagnosticInfo/GetDebouncingOfEvent, queue-length=1
          operation=DiagnosticInfo/GetFaultDetectionCounter, queue-length=1
          operation=DiagnosticInfo/GetEventExtendedDataRecord, queue-length=1
          operation=DiagnosticInfo/GetEventExtendedDataRecordEx, queue-length=1
          operation=DiagnosticInfo/GetEventFreezeFrameData, queue-length=1
          operation=DiagnosticInfo/GetEventFreezeFrameDataEx, queue-length=1
      EvtInfo_DemEventParameter_ECU3_DTC06: provided-interface=DiagnosticInfo
        provided-com-specs:
          operation=DiagnosticInfo/GetEventStatus, queue-length=1
          operation=DiagnosticInfo/GetEventFailed, queue-length=1
          operation=DiagnosticInfo/GetEventTested, queue-length=1
          operation=DiagnosticInfo/GetDTCOfEvent, queue-length=1
          operation=DiagnosticInfo/GetDebouncingOfEvent, queue-length=1
          operation=DiagnosticInfo/GetFaultDetectionCounter, queue-length=1
          operation=DiagnosticInfo/GetEventExtendedDataRecord, queue-length=1
          operation=DiagnosticInfo/GetEventExtendedDataRecordEx, queue-length=1
          operation=DiagnosticInfo/GetEventFreezeFrameData, queue-length=1
          operation=DiagnosticInfo/GetEventFreezeFrameDataEx, queue-length=1
      EvtInfo_DemEventParameter_ECU3_DTC07: provided-interface=DiagnosticInfo
        provided-com-specs:
          operation=DiagnosticInfo/GetEventStatus, queue-length=1
          operation=DiagnosticInfo/GetEventFailed, queue-length=1
          operation=DiagnosticInfo/GetEventTested, queue-length=1
          operation=DiagnosticInfo/GetDTCOfEvent, queue-length=1
          operation=DiagnosticInfo/GetDebouncingOfEvent, queue-length=1
          operation=DiagnosticInfo/GetFaultDetectionCounter, queue-length=1
          operation=DiagnosticInfo/GetEventExtendedDataRecord, queue-length=1
          operation=DiagnosticInfo/GetEventExtendedDataRecordEx, queue-length=1
          operation=DiagnosticInfo/GetEventFreezeFrameData, queue-length=1
          operation=DiagnosticInfo/GetEventFreezeFrameDataEx, queue-length=1
      EvtInfo_DemEventParameter_ECU3_DTC08: provided-interface=DiagnosticInfo
        provided-com-specs:
          operation=DiagnosticInfo/GetEventStatus, queue-length=1
          operation=DiagnosticInfo/GetEventFailed, queue-length=1
          operation=DiagnosticInfo/GetEventTested, queue-length=1
          operation=DiagnosticInfo/GetDTCOfEvent, queue-length=1
          operation=DiagnosticInfo/GetDebouncingOfEvent, queue-length=1
          operation=DiagnosticInfo/GetFaultDetectionCounter, queue-length=1
          operation=DiagnosticInfo/GetEventExtendedDataRecord, queue-length=1
          operation=DiagnosticInfo/GetEventExtendedDataRecordEx, queue-length=1
          operation=DiagnosticInfo/GetEventFreezeFrameData, queue-length=1
          operation=DiagnosticInfo/GetEventFreezeFrameDataEx, queue-length=1
      EvtInfo_DemEventParameter_ECU3_DTC09: provided-interface=DiagnosticInfo
        provided-com-specs:
          operation=DiagnosticInfo/GetEventStatus, queue-length=1
          operation=DiagnosticInfo/GetEventFailed, queue-length=1
          operation=DiagnosticInfo/GetEventTested, queue-length=1
          operation=DiagnosticInfo/GetDTCOfEvent, queue-length=1
          operation=DiagnosticInfo/GetDebouncingOfEvent, queue-length=1
          operation=DiagnosticInfo/GetFaultDetectionCounter, queue-length=1
          operation=DiagnosticInfo/GetEventExtendedDataRecord, queue-length=1
          operation=DiagnosticInfo/GetEventExtendedDataRecordEx, queue-length=1
          operation=DiagnosticInfo/GetEventFreezeFrameData, queue-length=1
          operation=DiagnosticInfo/GetEventFreezeFrameDataEx, queue-length=1
      EvtInfo_DemEventParameter_ECU3_DTC10: provided-interface=DiagnosticInfo
        provided-com-specs:
          operation=DiagnosticInfo/GetEventStatus, queue-length=1
          operation=DiagnosticInfo/GetEventFailed, queue-length=1
          operation=DiagnosticInfo/GetEventTested, queue-length=1
          operation=DiagnosticInfo/GetDTCOfEvent, queue-length=1
          operation=DiagnosticInfo/GetDebouncingOfEvent, queue-length=1
          operation=DiagnosticInfo/GetFaultDetectionCounter, queue-length=1
          operation=DiagnosticInfo/GetEventExtendedDataRecord, queue-length=1
          operation=DiagnosticInfo/GetEventExtendedDataRecordEx, queue-length=1
          operation=DiagnosticInfo/GetEventFreezeFrameData, queue-length=1
          operation=DiagnosticInfo/GetEventFreezeFrameDataEx, queue-length=1
      EvtInfo_DemEventParameter_ECU3_DTC11: provided-interface=DiagnosticInfo
        provided-com-specs:
          operation=DiagnosticInfo/GetEventStatus, queue-length=1
          operation=DiagnosticInfo/GetEventFailed, queue-length=1
          operation=DiagnosticInfo/GetEventTested, queue-length=1
          operation=DiagnosticInfo/GetDTCOfEvent, queue-length=1
          operation=DiagnosticInfo/GetDebouncingOfEvent, queue-length=1
          operation=DiagnosticInfo/GetFaultDetectionCounter, queue-length=1
          operation=DiagnosticInfo/GetEventExtendedDataRecord, queue-length=1
          operation=DiagnosticInfo/GetEventExtendedDataRecordEx, queue-length=1
          operation=DiagnosticInfo/GetEventFreezeFrameData, queue-length=1
          operation=DiagnosticInfo/GetEventFreezeFrameDataEx, queue-length=1
      EvtInfo_DemEventParameter_ECU3_DTC12: provided-interface=DiagnosticInfo
        provided-com-specs:
          operation=DiagnosticInfo/GetEventStatus, queue-length=1
          operation=DiagnosticInfo/GetEventFailed, queue-length=1
          operation=DiagnosticInfo/GetEventTested, queue-length=1
          operation=DiagnosticInfo/GetDTCOfEvent, queue-length=1
          operation=DiagnosticInfo/GetDebouncingOfEvent, queue-length=1
          operation=DiagnosticInfo/GetFaultDetectionCounter, queue-length=1
          operation=DiagnosticInfo/GetEventExtendedDataRecord, queue-length=1
          operation=DiagnosticInfo/GetEventExtendedDataRecordEx, queue-length=1
          operation=DiagnosticInfo/GetEventFreezeFrameData, queue-length=1
          operation=DiagnosticInfo/GetEventFreezeFrameDataEx, queue-length=1
      EvtInfo_DemEventParameter_ECU3_DTC13: provided-interface=DiagnosticInfo
        provided-com-specs:
          operation=DiagnosticInfo/GetEventStatus, queue-length=1
          operation=DiagnosticInfo/GetEventFailed, queue-length=1
          operation=DiagnosticInfo/GetEventTested, queue-length=1
          operation=DiagnosticInfo/GetDTCOfEvent, queue-length=1
          operation=DiagnosticInfo/GetDebouncingOfEvent, queue-length=1
          operation=DiagnosticInfo/GetFaultDetectionCounter, queue-length=1
          operation=DiagnosticInfo/GetEventExtendedDataRecord, queue-length=1
          operation=DiagnosticInfo/GetEventExtendedDataRecordEx, queue-length=1
          operation=DiagnosticInfo/GetEventFreezeFrameData, queue-length=1
          operation=DiagnosticInfo/GetEventFreezeFrameDataEx, queue-length=1
      EvtInfo_DemEventParameter_ECU3_DTC14: provided-interface=DiagnosticInfo
        provided-com-specs:
          operation=DiagnosticInfo/GetEventStatus, queue-length=1
          operation=DiagnosticInfo/GetEventFailed, queue-length=1
          operation=DiagnosticInfo/GetEventTested, queue-length=1
          operation=DiagnosticInfo/GetDTCOfEvent, queue-length=1
          operation=DiagnosticInfo/GetDebouncingOfEvent, queue-length=1
          operation=DiagnosticInfo/GetFaultDetectionCounter, queue-length=1
          operation=DiagnosticInfo/GetEventExtendedDataRecord, queue-length=1
          operation=DiagnosticInfo/GetEventExtendedDataRecordEx, queue-length=1
          operation=DiagnosticInfo/GetEventFreezeFrameData, queue-length=1
          operation=DiagnosticInfo/GetEventFreezeFrameDataEx, queue-length=1
      EvtInfo_DemEventParameter_ECU3_DTC15: provided-interface=DiagnosticInfo
        provided-com-specs:
          operation=DiagnosticInfo/GetEventStatus, queue-length=1
          operation=DiagnosticInfo/GetEventFailed, queue-length=1
          operation=DiagnosticInfo/GetEventTested, queue-length=1
          operation=DiagnosticInfo/GetDTCOfEvent, queue-length=1
          operation=DiagnosticInfo/GetDebouncingOfEvent, queue-length=1
          operation=DiagnosticInfo/GetFaultDetectionCounter, queue-length=1
          operation=DiagnosticInfo/GetEventExtendedDataRecord, queue-length=1
          operation=DiagnosticInfo/GetEventExtendedDataRecordEx, queue-length=1
          operation=DiagnosticInfo/GetEventFreezeFrameData, queue-length=1
          operation=DiagnosticInfo/GetEventFreezeFrameDataEx, queue-length=1
      EvtInfo_DemEventParameter_ECU3_DTC16: provided-interface=DiagnosticInfo
        provided-com-specs:
          operation=DiagnosticInfo/GetEventStatus, queue-length=1
          operation=DiagnosticInfo/GetEventFailed, queue-length=1
          operation=DiagnosticInfo/GetEventTested, queue-length=1
          operation=DiagnosticInfo/GetDTCOfEvent, queue-length=1
          operation=DiagnosticInfo/GetDebouncingOfEvent, queue-length=1
          operation=DiagnosticInfo/GetFaultDetectionCounter, queue-length=1
          operation=DiagnosticInfo/GetEventExtendedDataRecord, queue-length=1
          operation=DiagnosticInfo/GetEventExtendedDataRecordEx, queue-length=1
          operation=DiagnosticInfo/GetEventFreezeFrameData, queue-length=1
          operation=DiagnosticInfo/GetEventFreezeFrameDataEx, queue-length=1
      EvtInfo_DemEventParameter_ECU3_DTC17: provided-interface=DiagnosticInfo
        provided-com-specs:
          operation=DiagnosticInfo/GetEventStatus, queue-length=1
          operation=DiagnosticInfo/GetEventFailed, queue-length=1
          operation=DiagnosticInfo/GetEventTested, queue-length=1
          operation=DiagnosticInfo/GetDTCOfEvent, queue-length=1
          operation=DiagnosticInfo/GetDebouncingOfEvent, queue-length=1
          operation=DiagnosticInfo/GetFaultDetectionCounter, queue-length=1
          operation=DiagnosticInfo/GetEventExtendedDataRecord, queue-length=1
          operation=DiagnosticInfo/GetEventExtendedDataRecordEx, queue-length=1
          operation=DiagnosticInfo/GetEventFreezeFrameData, queue-length=1
          operation=DiagnosticInfo/GetEventFreezeFrameDataEx, queue-length=1
      EvtInfo_DemEventParameter_ECU3_DTC18: provided-interface=DiagnosticInfo
        provided-com-specs:
          operation=DiagnosticInfo/GetEventStatus, queue-length=1
          operation=DiagnosticInfo/GetEventFailed, queue-length=1
          operation=DiagnosticInfo/GetEventTested, queue-length=1
          operation=DiagnosticInfo/GetDTCOfEvent, queue-length=1
          operation=DiagnosticInfo/GetDebouncingOfEvent, queue-length=1
          operation=DiagnosticInfo/GetFaultDetectionCounter, queue-length=1
          operation=DiagnosticInfo/GetEventExtendedDataRecord, queue-length=1
          operation=DiagnosticInfo/GetEventExtendedDataRecordEx, queue-length=1
          operation=DiagnosticInfo/GetEventFreezeFrameData, queue-length=1
          operation=DiagnosticInfo/GetEventFreezeFrameDataEx, queue-length=1
      EvtInfo_DemEventParameter_ECU3_DTC19: provided-interface=DiagnosticInfo
        provided-com-specs:
          operation=DiagnosticInfo/GetEventStatus, queue-length=1
          operation=DiagnosticInfo/GetEventFailed, queue-length=1
          operation=DiagnosticInfo/GetEventTested, queue-length=1
          operation=DiagnosticInfo/GetDTCOfEvent, queue-length=1
          operation=DiagnosticInfo/GetDebouncingOfEvent, queue-length=1
          operation=DiagnosticInfo/GetFaultDetectionCounter, queue-length=1
          operation=DiagnosticInfo/GetEventExtendedDataRecord, queue-length=1
          operation=DiagnosticInfo/GetEventExtendedDataRecordEx, queue-length=1
          operation=DiagnosticInfo/GetEventFreezeFrameData, queue-length=1
          operation=DiagnosticInfo/GetEventFreezeFrameDataEx, queue-length=1
      EvtInfo_DemEventParameter_ECU3_DTC20: provided-interface=DiagnosticInfo
        provided-com-specs:
          operation=DiagnosticInfo/GetEventStatus, queue-length=1
          operation=DiagnosticInfo/GetEventFailed, queue-length=1
          operation=DiagnosticInfo/GetEventTested, queue-length=1
          operation=DiagnosticInfo/GetDTCOfEvent, queue-length=1
          operation=DiagnosticInfo/GetDebouncingOfEvent, queue-length=1
          operation=DiagnosticInfo/GetFaultDetectionCounter, queue-length=1
          operation=DiagnosticInfo/GetEventExtendedDataRecord, queue-length=1
          operation=DiagnosticInfo/GetEventExtendedDataRecordEx, queue-length=1
          operation=DiagnosticInfo/GetEventFreezeFrameData, queue-length=1
          operation=DiagnosticInfo/GetEventFreezeFrameDataEx, queue-length=1
      EvtInfo_DemEventParameter_ECU3_DTC21: provided-interface=DiagnosticInfo
        provided-com-specs:
          operation=DiagnosticInfo/GetEventStatus, queue-length=1
          operation=DiagnosticInfo/GetEventFailed, queue-length=1
          operation=DiagnosticInfo/GetEventTested, queue-length=1
          operation=DiagnosticInfo/GetDTCOfEvent, queue-length=1
          operation=DiagnosticInfo/GetDebouncingOfEvent, queue-length=1
          operation=DiagnosticInfo/GetFaultDetectionCounter, queue-length=1
          operation=DiagnosticInfo/GetEventExtendedDataRecord, queue-length=1
          operation=DiagnosticInfo/GetEventExtendedDataRecordEx, queue-length=1
          operation=DiagnosticInfo/GetEventFreezeFrameData, queue-length=1
          operation=DiagnosticInfo/GetEventFreezeFrameDataEx, queue-length=1
      EvtInfo_DemEventParameter_ECU3_DTC22: provided-interface=DiagnosticInfo
        provided-com-specs:
          operation=DiagnosticInfo/GetEventStatus, queue-length=1
          operation=DiagnosticInfo/GetEventFailed, queue-length=1
          operation=DiagnosticInfo/GetEventTested, queue-length=1
          operation=DiagnosticInfo/GetDTCOfEvent, queue-length=1
          operation=DiagnosticInfo/GetDebouncingOfEvent, queue-length=1
          operation=DiagnosticInfo/GetFaultDetectionCounter, queue-length=1
          operation=DiagnosticInfo/GetEventExtendedDataRecord, queue-length=1
          operation=DiagnosticInfo/GetEventExtendedDataRecordEx, queue-length=1
          operation=DiagnosticInfo/GetEventFreezeFrameData, queue-length=1
          operation=DiagnosticInfo/GetEventFreezeFrameDataEx, queue-length=1
      EvtInfo_DemEventParameter_ECU3_DTC23: provided-interface=DiagnosticInfo
        provided-com-specs:
          operation=DiagnosticInfo/GetEventStatus, queue-length=1
          operation=DiagnosticInfo/GetEventFailed, queue-length=1
          operation=DiagnosticInfo/GetEventTested, queue-length=1
          operation=DiagnosticInfo/GetDTCOfEvent, queue-length=1
          operation=DiagnosticInfo/GetDebouncingOfEvent, queue-length=1
          operation=DiagnosticInfo/GetFaultDetectionCounter, queue-length=1
          operation=DiagnosticInfo/GetEventExtendedDataRecord, queue-length=1
          operation=DiagnosticInfo/GetEventExtendedDataRecordEx, queue-length=1
          operation=DiagnosticInfo/GetEventFreezeFrameData, queue-length=1
          operation=DiagnosticInfo/GetEventFreezeFrameDataEx, queue-length=1
      EvtInfo_DemEventParameter_ECU3_DTC24: provided-interface=DiagnosticInfo
        provided-com-specs:
          operation=DiagnosticInfo/GetEventStatus, queue-length=1
          operation=DiagnosticInfo/GetEventFailed, queue-length=1
          operation=DiagnosticInfo/GetEventTested, queue-length=1
          operation=DiagnosticInfo/GetDTCOfEvent, queue-length=1
          operation=DiagnosticInfo/GetDebouncingOfEvent, queue-length=1
          operation=DiagnosticInfo/GetFaultDetectionCounter, queue-length=1
          operation=DiagnosticInfo/GetEventExtendedDataRecord, queue-length=1
          operation=DiagnosticInfo/GetEventExtendedDataRecordEx, queue-length=1
          operation=DiagnosticInfo/GetEventFreezeFrameData, queue-length=1
          operation=DiagnosticInfo/GetEventFreezeFrameDataEx, queue-length=1
      EvtInfo_DemEventParameter_ECU3_DTC25: provided-interface=DiagnosticInfo
        provided-com-specs:
          operation=DiagnosticInfo/GetEventStatus, queue-length=1
          operation=DiagnosticInfo/GetEventFailed, queue-length=1
          operation=DiagnosticInfo/GetEventTested, queue-length=1
          operation=DiagnosticInfo/GetDTCOfEvent, queue-length=1
          operation=DiagnosticInfo/GetDebouncingOfEvent, queue-length=1
          operation=DiagnosticInfo/GetFaultDetectionCounter, queue-length=1
          operation=DiagnosticInfo/GetEventExtendedDataRecord, queue-length=1
          operation=DiagnosticInfo/GetEventExtendedDataRecordEx, queue-length=1
          operation=DiagnosticInfo/GetEventFreezeFrameData, queue-length=1
          operation=DiagnosticInfo/GetEventFreezeFrameDataEx, queue-length=1
      EvtInfo_DemEventParameter_ECU3_DTC26: provided-interface=DiagnosticInfo
        provided-com-specs:
          operation=DiagnosticInfo/GetEventStatus, queue-length=1
          operation=DiagnosticInfo/GetEventFailed, queue-length=1
          operation=DiagnosticInfo/GetEventTested, queue-length=1
          operation=DiagnosticInfo/GetDTCOfEvent, queue-length=1
          operation=DiagnosticInfo/GetDebouncingOfEvent, queue-length=1
          operation=DiagnosticInfo/GetFaultDetectionCounter, queue-length=1
          operation=DiagnosticInfo/GetEventExtendedDataRecord, queue-length=1
          operation=DiagnosticInfo/GetEventExtendedDataRecordEx, queue-length=1
          operation=DiagnosticInfo/GetEventFreezeFrameData, queue-length=1
          operation=DiagnosticInfo/GetEventFreezeFrameDataEx, queue-length=1
      EvtInfo_DemEventParameter_ECU3_DTC27: provided-interface=DiagnosticInfo
        provided-com-specs:
          operation=DiagnosticInfo/GetEventStatus, queue-length=1
          operation=DiagnosticInfo/GetEventFailed, queue-length=1
          operation=DiagnosticInfo/GetEventTested, queue-length=1
          operation=DiagnosticInfo/GetDTCOfEvent, queue-length=1
          operation=DiagnosticInfo/GetDebouncingOfEvent, queue-length=1
          operation=DiagnosticInfo/GetFaultDetectionCounter, queue-length=1
          operation=DiagnosticInfo/GetEventExtendedDataRecord, queue-length=1
          operation=DiagnosticInfo/GetEventExtendedDataRecordEx, queue-length=1
          operation=DiagnosticInfo/GetEventFreezeFrameData, queue-length=1
          operation=DiagnosticInfo/GetEventFreezeFrameDataEx, queue-length=1
      EvtInfo_DemEventParameter_ECU3_DTC28: provided-interface=DiagnosticInfo
        provided-com-specs:
          operation=DiagnosticInfo/GetEventStatus, queue-length=1
          operation=DiagnosticInfo/GetEventFailed, queue-length=1
          operation=DiagnosticInfo/GetEventTested, queue-length=1
          operation=DiagnosticInfo/GetDTCOfEvent, queue-length=1
          operation=DiagnosticInfo/GetDebouncingOfEvent, queue-length=1
          operation=DiagnosticInfo/GetFaultDetectionCounter, queue-length=1
          operation=DiagnosticInfo/GetEventExtendedDataRecord, queue-length=1
          operation=DiagnosticInfo/GetEventExtendedDataRecordEx, queue-length=1
          operation=DiagnosticInfo/GetEventFreezeFrameData, queue-length=1
          operation=DiagnosticInfo/GetEventFreezeFrameDataEx, queue-length=1
      EvtInfo_DemEventParameter_ECU3_DTC29: provided-interface=DiagnosticInfo
        provided-com-specs:
          operation=DiagnosticInfo/GetEventStatus, queue-length=1
          operation=DiagnosticInfo/GetEventFailed, queue-length=1
          operation=DiagnosticInfo/GetEventTested, queue-length=1
          operation=DiagnosticInfo/GetDTCOfEvent, queue-length=1
          operation=DiagnosticInfo/GetDebouncingOfEvent, queue-length=1
          operation=DiagnosticInfo/GetFaultDetectionCounter, queue-length=1
          operation=DiagnosticInfo/GetEventExtendedDataRecord, queue-length=1
          operation=DiagnosticInfo/GetEventExtendedDataRecordEx, queue-length=1
          operation=DiagnosticInfo/GetEventFreezeFrameData, queue-length=1
          operation=DiagnosticInfo/GetEventFreezeFrameDataEx, queue-length=1
      EvtInfo_DemEventParameter_ECU3_DTC30: provided-interface=DiagnosticInfo
        provided-com-specs:
          operation=DiagnosticInfo/GetEventStatus, queue-length=1
          operation=DiagnosticInfo/GetEventFailed, queue-length=1
          operation=DiagnosticInfo/GetEventTested, queue-length=1
          operation=DiagnosticInfo/GetDTCOfEvent, queue-length=1
          operation=DiagnosticInfo/GetDebouncingOfEvent, queue-length=1
          operation=DiagnosticInfo/GetFaultDetectionCounter, queue-length=1
          operation=DiagnosticInfo/GetEventExtendedDataRecord, queue-length=1
          operation=DiagnosticInfo/GetEventExtendedDataRecordEx, queue-length=1
          operation=DiagnosticInfo/GetEventFreezeFrameData, queue-length=1
          operation=DiagnosticInfo/GetEventFreezeFrameDataEx, queue-length=1
      EvtInfo_DemEventParameter_ECU3_DTC31: provided-interface=DiagnosticInfo
        provided-com-specs:
          operation=DiagnosticInfo/GetEventStatus, queue-length=1
          operation=DiagnosticInfo/GetEventFailed, queue-length=1
          operation=DiagnosticInfo/GetEventTested, queue-length=1
          operation=DiagnosticInfo/GetDTCOfEvent, queue-length=1
          operation=DiagnosticInfo/GetDebouncingOfEvent, queue-length=1
          operation=DiagnosticInfo/GetFaultDetectionCounter, queue-length=1
          operation=DiagnosticInfo/GetEventExtendedDataRecord, queue-length=1
          operation=DiagnosticInfo/GetEventExtendedDataRecordEx, queue-length=1
          operation=DiagnosticInfo/GetEventFreezeFrameData, queue-length=1
          operation=DiagnosticInfo/GetEventFreezeFrameDataEx, queue-length=1
      EvtInfo_DemEventParameter_ECU3_DTC32: provided-interface=DiagnosticInfo
        provided-com-specs:
          operation=DiagnosticInfo/GetEventStatus, queue-length=1
          operation=DiagnosticInfo/GetEventFailed, queue-length=1
          operation=DiagnosticInfo/GetEventTested, queue-length=1
          operation=DiagnosticInfo/GetDTCOfEvent, queue-length=1
          operation=DiagnosticInfo/GetDebouncingOfEvent, queue-length=1
          operation=DiagnosticInfo/GetFaultDetectionCounter, queue-length=1
          operation=DiagnosticInfo/GetEventExtendedDataRecord, queue-length=1
          operation=DiagnosticInfo/GetEventExtendedDataRecordEx, queue-length=1
          operation=DiagnosticInfo/GetEventFreezeFrameData, queue-length=1
          operation=DiagnosticInfo/GetEventFreezeFrameDataEx, queue-length=1
      EvtInfo_DemEventParameter_ECU3_DTC33: provided-interface=DiagnosticInfo
        provided-com-specs:
          operation=DiagnosticInfo/GetEventStatus, queue-length=1
          operation=DiagnosticInfo/GetEventFailed, queue-length=1
          operation=DiagnosticInfo/GetEventTested, queue-length=1
          operation=DiagnosticInfo/GetDTCOfEvent, queue-length=1
          operation=DiagnosticInfo/GetDebouncingOfEvent, queue-length=1
          operation=DiagnosticInfo/GetFaultDetectionCounter, queue-length=1
          operation=DiagnosticInfo/GetEventExtendedDataRecord, queue-length=1
          operation=DiagnosticInfo/GetEventExtendedDataRecordEx, queue-length=1
          operation=DiagnosticInfo/GetEventFreezeFrameData, queue-length=1
          operation=DiagnosticInfo/GetEventFreezeFrameDataEx, queue-length=1
      EvtInfo_DemEventParameter_ECU3_DTC34: provided-interface=DiagnosticInfo
        provided-com-specs:
          operation=DiagnosticInfo/GetEventStatus, queue-length=1
          operation=DiagnosticInfo/GetEventFailed, queue-length=1
          operation=DiagnosticInfo/GetEventTested, queue-length=1
          operation=DiagnosticInfo/GetDTCOfEvent, queue-length=1
          operation=DiagnosticInfo/GetDebouncingOfEvent, queue-length=1
          operation=DiagnosticInfo/GetFaultDetectionCounter, queue-length=1
          operation=DiagnosticInfo/GetEventExtendedDataRecord, queue-length=1
          operation=DiagnosticInfo/GetEventExtendedDataRecordEx, queue-length=1
          operation=DiagnosticInfo/GetEventFreezeFrameData, queue-length=1
          operation=DiagnosticInfo/GetEventFreezeFrameDataEx, queue-length=1
      EvtInfo_DemEventParameter_ECU3_DTC35: provided-interface=DiagnosticInfo
        provided-com-specs:
          operation=DiagnosticInfo/GetEventStatus, queue-length=1
          operation=DiagnosticInfo/GetEventFailed, queue-length=1
          operation=DiagnosticInfo/GetEventTested, queue-length=1
          operation=DiagnosticInfo/GetDTCOfEvent, queue-length=1
          operation=DiagnosticInfo/GetDebouncingOfEvent, queue-length=1
          operation=DiagnosticInfo/GetFaultDetectionCounter, queue-length=1
          operation=DiagnosticInfo/GetEventExtendedDataRecord, queue-length=1
          operation=DiagnosticInfo/GetEventExtendedDataRecordEx, queue-length=1
          operation=DiagnosticInfo/GetEventFreezeFrameData, queue-length=1
          operation=DiagnosticInfo/GetEventFreezeFrameDataEx, queue-length=1
      EvtInfo_DemEventParameter_ECU3_DTC36: provided-interface=DiagnosticInfo
        provided-com-specs:
          operation=DiagnosticInfo/GetEventStatus, queue-length=1
          operation=DiagnosticInfo/GetEventFailed, queue-length=1
          operation=DiagnosticInfo/GetEventTested, queue-length=1
          operation=DiagnosticInfo/GetDTCOfEvent, queue-length=1
          operation=DiagnosticInfo/GetDebouncingOfEvent, queue-length=1
          operation=DiagnosticInfo/GetFaultDetectionCounter, queue-length=1
          operation=DiagnosticInfo/GetEventExtendedDataRecord, queue-length=1
          operation=DiagnosticInfo/GetEventExtendedDataRecordEx, queue-length=1
          operation=DiagnosticInfo/GetEventFreezeFrameData, queue-length=1
          operation=DiagnosticInfo/GetEventFreezeFrameDataEx, queue-length=1
      EvtInfo_DemEventParameter_ECU3_DTC37: provided-interface=DiagnosticInfo
        provided-com-specs:
          operation=DiagnosticInfo/GetEventStatus, queue-length=1
          operation=DiagnosticInfo/GetEventFailed, queue-length=1
          operation=DiagnosticInfo/GetEventTested, queue-length=1
          operation=DiagnosticInfo/GetDTCOfEvent, queue-length=1
          operation=DiagnosticInfo/GetDebouncingOfEvent, queue-length=1
          operation=DiagnosticInfo/GetFaultDetectionCounter, queue-length=1
          operation=DiagnosticInfo/GetEventExtendedDataRecord, queue-length=1
          operation=DiagnosticInfo/GetEventExtendedDataRecordEx, queue-length=1
          operation=DiagnosticInfo/GetEventFreezeFrameData, queue-length=1
          operation=DiagnosticInfo/GetEventFreezeFrameDataEx, queue-length=1
      EvtInfo_DemEventParameter_ECU3_DTC38: provided-interface=DiagnosticInfo
        provided-com-specs:
          operation=DiagnosticInfo/GetEventStatus, queue-length=1
          operation=DiagnosticInfo/GetEventFailed, queue-length=1
          operation=DiagnosticInfo/GetEventTested, queue-length=1
          operation=DiagnosticInfo/GetDTCOfEvent, queue-length=1
          operation=DiagnosticInfo/GetDebouncingOfEvent, queue-length=1
          operation=DiagnosticInfo/GetFaultDetectionCounter, queue-length=1
          operation=DiagnosticInfo/GetEventExtendedDataRecord, queue-length=1
          operation=DiagnosticInfo/GetEventExtendedDataRecordEx, queue-length=1
          operation=DiagnosticInfo/GetEventFreezeFrameData, queue-length=1
          operation=DiagnosticInfo/GetEventFreezeFrameDataEx, queue-length=1
      EvtInfo_DemEventParameter_ECU3_DTC39: provided-interface=DiagnosticInfo
        provided-com-specs:
          operation=DiagnosticInfo/GetEventStatus, queue-length=1
          operation=DiagnosticInfo/GetEventFailed, queue-length=1
          operation=DiagnosticInfo/GetEventTested, queue-length=1
          operation=DiagnosticInfo/GetDTCOfEvent, queue-length=1
          operation=DiagnosticInfo/GetDebouncingOfEvent, queue-length=1
          operation=DiagnosticInfo/GetFaultDetectionCounter, queue-length=1
          operation=DiagnosticInfo/GetEventExtendedDataRecord, queue-length=1
          operation=DiagnosticInfo/GetEventExtendedDataRecordEx, queue-length=1
          operation=DiagnosticInfo/GetEventFreezeFrameData, queue-length=1
          operation=DiagnosticInfo/GetEventFreezeFrameDataEx, queue-length=1
      EvtInfo_DemEventParameter_ECU3_DTC40: provided-interface=DiagnosticInfo
        provided-com-specs:
          operation=DiagnosticInfo/GetEventStatus, queue-length=1
          operation=DiagnosticInfo/GetEventFailed, queue-length=1
          operation=DiagnosticInfo/GetEventTested, queue-length=1
          operation=DiagnosticInfo/GetDTCOfEvent, queue-length=1
          operation=DiagnosticInfo/GetDebouncingOfEvent, queue-length=1
          operation=DiagnosticInfo/GetFaultDetectionCounter, queue-length=1
          operation=DiagnosticInfo/GetEventExtendedDataRecord, queue-length=1
          operation=DiagnosticInfo/GetEventExtendedDataRecordEx, queue-length=1
          operation=DiagnosticInfo/GetEventFreezeFrameData, queue-length=1
          operation=DiagnosticInfo/GetEventFreezeFrameDataEx, queue-length=1
      EvtInfo_DemEventParameter_ECU3_DTC41: provided-interface=DiagnosticInfo
        provided-com-specs:
          operation=DiagnosticInfo/GetEventStatus, queue-length=1
          operation=DiagnosticInfo/GetEventFailed, queue-length=1
          operation=DiagnosticInfo/GetEventTested, queue-length=1
          operation=DiagnosticInfo/GetDTCOfEvent, queue-length=1
          operation=DiagnosticInfo/GetDebouncingOfEvent, queue-length=1
          operation=DiagnosticInfo/GetFaultDetectionCounter, queue-length=1
          operation=DiagnosticInfo/GetEventExtendedDataRecord, queue-length=1
          operation=DiagnosticInfo/GetEventExtendedDataRecordEx, queue-length=1
          operation=DiagnosticInfo/GetEventFreezeFrameData, queue-length=1
          operation=DiagnosticInfo/GetEventFreezeFrameDataEx, queue-length=1
      EvtInfo_DemEventParameter_ECU3_DTC42: provided-interface=DiagnosticInfo
        provided-com-specs:
          operation=DiagnosticInfo/GetEventStatus, queue-length=1
          operation=DiagnosticInfo/GetEventFailed, queue-length=1
          operation=DiagnosticInfo/GetEventTested, queue-length=1
          operation=DiagnosticInfo/GetDTCOfEvent, queue-length=1
          operation=DiagnosticInfo/GetDebouncingOfEvent, queue-length=1
          operation=DiagnosticInfo/GetFaultDetectionCounter, queue-length=1
          operation=DiagnosticInfo/GetEventExtendedDataRecord, queue-length=1
          operation=DiagnosticInfo/GetEventExtendedDataRecordEx, queue-length=1
          operation=DiagnosticInfo/GetEventFreezeFrameData, queue-length=1
          operation=DiagnosticInfo/GetEventFreezeFrameDataEx, queue-length=1
      EvtInfo_DemEventParameter_ECU3_DTC43: provided-interface=DiagnosticInfo
        provided-com-specs:
          operation=DiagnosticInfo/GetEventStatus, queue-length=1
          operation=DiagnosticInfo/GetEventFailed, queue-length=1
          operation=DiagnosticInfo/GetEventTested, queue-length=1
          operation=DiagnosticInfo/GetDTCOfEvent, queue-length=1
          operation=DiagnosticInfo/GetDebouncingOfEvent, queue-length=1
          operation=DiagnosticInfo/GetFaultDetectionCounter, queue-length=1
          operation=DiagnosticInfo/GetEventExtendedDataRecord, queue-length=1
          operation=DiagnosticInfo/GetEventExtendedDataRecordEx, queue-length=1
          operation=DiagnosticInfo/GetEventFreezeFrameData, queue-length=1
          operation=DiagnosticInfo/GetEventFreezeFrameDataEx, queue-length=1
      EvtInfo_DemEventParameter_ECU3_DTC44: provided-interface=DiagnosticInfo
        provided-com-specs:
          operation=DiagnosticInfo/GetEventStatus, queue-length=1
          operation=DiagnosticInfo/GetEventFailed, queue-length=1
          operation=DiagnosticInfo/GetEventTested, queue-length=1
          operation=DiagnosticInfo/GetDTCOfEvent, queue-length=1
          operation=DiagnosticInfo/GetDebouncingOfEvent, queue-length=1
          operation=DiagnosticInfo/GetFaultDetectionCounter, queue-length=1
          operation=DiagnosticInfo/GetEventExtendedDataRecord, queue-length=1
          operation=DiagnosticInfo/GetEventExtendedDataRecordEx, queue-length=1
          operation=DiagnosticInfo/GetEventFreezeFrameData, queue-length=1
          operation=DiagnosticInfo/GetEventFreezeFrameDataEx, queue-length=1
      EvtInfo_DemEventParameter_ECU3_DTC45: provided-interface=DiagnosticInfo
        provided-com-specs:
          operation=DiagnosticInfo/GetEventStatus, queue-length=1
          operation=DiagnosticInfo/GetEventFailed, queue-length=1
          operation=DiagnosticInfo/GetEventTested, queue-length=1
          operation=DiagnosticInfo/GetDTCOfEvent, queue-length=1
          operation=DiagnosticInfo/GetDebouncingOfEvent, queue-length=1
          operation=DiagnosticInfo/GetFaultDetectionCounter, queue-length=1
          operation=DiagnosticInfo/GetEventExtendedDataRecord, queue-length=1
          operation=DiagnosticInfo/GetEventExtendedDataRecordEx, queue-length=1
          operation=DiagnosticInfo/GetEventFreezeFrameData, queue-length=1
          operation=DiagnosticInfo/GetEventFreezeFrameDataEx, queue-length=1
      EvtInfo_DemEventParameter_ECU3_DTC46: provided-interface=DiagnosticInfo
        provided-com-specs:
          operation=DiagnosticInfo/GetEventStatus, queue-length=1
          operation=DiagnosticInfo/GetEventFailed, queue-length=1
          operation=DiagnosticInfo/GetEventTested, queue-length=1
          operation=DiagnosticInfo/GetDTCOfEvent, queue-length=1
          operation=DiagnosticInfo/GetDebouncingOfEvent, queue-length=1
          operation=DiagnosticInfo/GetFaultDetectionCounter, queue-length=1
          operation=DiagnosticInfo/GetEventExtendedDataRecord, queue-length=1
          operation=DiagnosticInfo/GetEventExtendedDataRecordEx, queue-length=1
          operation=DiagnosticInfo/GetEventFreezeFrameData, queue-length=1
          operation=DiagnosticInfo/GetEventFreezeFrameDataEx, queue-length=1
      EvtInfo_DemEventParameter_ECU3_DTC47: provided-interface=DiagnosticInfo
        provided-com-specs:
          operation=DiagnosticInfo/GetEventStatus, queue-length=1
          operation=DiagnosticInfo/GetEventFailed, queue-length=1
          operation=DiagnosticInfo/GetEventTested, queue-length=1
          operation=DiagnosticInfo/GetDTCOfEvent, queue-length=1
          operation=DiagnosticInfo/GetDebouncingOfEvent, queue-length=1
          operation=DiagnosticInfo/GetFaultDetectionCounter, queue-length=1
          operation=DiagnosticInfo/GetEventExtendedDataRecord, queue-length=1
          operation=DiagnosticInfo/GetEventExtendedDataRecordEx, queue-length=1
          operation=DiagnosticInfo/GetEventFreezeFrameData, queue-length=1
          operation=DiagnosticInfo/GetEventFreezeFrameDataEx, queue-length=1
      EvtInfo_DemEventParameter_ECU3_DTC48: provided-interface=DiagnosticInfo
        provided-com-specs:
          operation=DiagnosticInfo/GetEventStatus, queue-length=1
          operation=DiagnosticInfo/GetEventFailed, queue-length=1
          operation=DiagnosticInfo/GetEventTested, queue-length=1
          operation=DiagnosticInfo/GetDTCOfEvent, queue-length=1
          operation=DiagnosticInfo/GetDebouncingOfEvent, queue-length=1
          operation=DiagnosticInfo/GetFaultDetectionCounter, queue-length=1
          operation=DiagnosticInfo/GetEventExtendedDataRecord, queue-length=1
          operation=DiagnosticInfo/GetEventExtendedDataRecordEx, queue-length=1
          operation=DiagnosticInfo/GetEventFreezeFrameData, queue-length=1
          operation=DiagnosticInfo/GetEventFreezeFrameDataEx, queue-length=1
      EvtInfo_DemEventParameter_ECU3_DTC49: provided-interface=DiagnosticInfo
        provided-com-specs:
          operation=DiagnosticInfo/GetEventStatus, queue-length=1
          operation=DiagnosticInfo/GetEventFailed, queue-length=1
          operation=DiagnosticInfo/GetEventTested, queue-length=1
          operation=DiagnosticInfo/GetDTCOfEvent, queue-length=1
          operation=DiagnosticInfo/GetDebouncingOfEvent, queue-length=1
          operation=DiagnosticInfo/GetFaultDetectionCounter, queue-length=1
          operation=DiagnosticInfo/GetEventExtendedDataRecord, queue-length=1
          operation=DiagnosticInfo/GetEventExtendedDataRecordEx, queue-length=1
          operation=DiagnosticInfo/GetEventFreezeFrameData, queue-length=1
          operation=DiagnosticInfo/GetEventFreezeFrameDataEx, queue-length=1
      EvtInfo_DemEventParameter_ECU3_DTC50: provided-interface=DiagnosticInfo
        provided-com-specs:
          operation=DiagnosticInfo/GetEventStatus, queue-length=1
          operation=DiagnosticInfo/GetEventFailed, queue-length=1
          operation=DiagnosticInfo/GetEventTested, queue-length=1
          operation=DiagnosticInfo/GetDTCOfEvent, queue-length=1
          operation=DiagnosticInfo/GetDebouncingOfEvent, queue-length=1
          operation=DiagnosticInfo/GetFaultDetectionCounter, queue-length=1
          operation=DiagnosticInfo/GetEventExtendedDataRecord, queue-length=1
          operation=DiagnosticInfo/GetEventExtendedDataRecordEx, queue-length=1
          operation=DiagnosticInfo/GetEventFreezeFrameData, queue-length=1
          operation=DiagnosticInfo/GetEventFreezeFrameDataEx, queue-length=1
      EvtInfo_DemEventParameter_ECU3_DTC51: provided-interface=DiagnosticInfo
        provided-com-specs:
          operation=DiagnosticInfo/GetEventStatus, queue-length=1
          operation=DiagnosticInfo/GetEventFailed, queue-length=1
          operation=DiagnosticInfo/GetEventTested, queue-length=1
          operation=DiagnosticInfo/GetDTCOfEvent, queue-length=1
          operation=DiagnosticInfo/GetDebouncingOfEvent, queue-length=1
          operation=DiagnosticInfo/GetFaultDetectionCounter, queue-length=1
          operation=DiagnosticInfo/GetEventExtendedDataRecord, queue-length=1
          operation=DiagnosticInfo/GetEventExtendedDataRecordEx, queue-length=1
          operation=DiagnosticInfo/GetEventFreezeFrameData, queue-length=1
          operation=DiagnosticInfo/GetEventFreezeFrameDataEx, queue-length=1
      EvtInfo_DemEventParameter_ECU3_DTC52: provided-interface=DiagnosticInfo
        provided-com-specs:
          operation=DiagnosticInfo/GetEventStatus, queue-length=1
          operation=DiagnosticInfo/GetEventFailed, queue-length=1
          operation=DiagnosticInfo/GetEventTested, queue-length=1
          operation=DiagnosticInfo/GetDTCOfEvent, queue-length=1
          operation=DiagnosticInfo/GetDebouncingOfEvent, queue-length=1
          operation=DiagnosticInfo/GetFaultDetectionCounter, queue-length=1
          operation=DiagnosticInfo/GetEventExtendedDataRecord, queue-length=1
          operation=DiagnosticInfo/GetEventExtendedDataRecordEx, queue-length=1
          operation=DiagnosticInfo/GetEventFreezeFrameData, queue-length=1
          operation=DiagnosticInfo/GetEventFreezeFrameDataEx, queue-length=1
      EvtInfo_DemEventParameter_ECU3_DTC53: provided-interface=DiagnosticInfo
        provided-com-specs:
          operation=DiagnosticInfo/GetEventStatus, queue-length=1
          operation=DiagnosticInfo/GetEventFailed, queue-length=1
          operation=DiagnosticInfo/GetEventTested, queue-length=1
          operation=DiagnosticInfo/GetDTCOfEvent, queue-length=1
          operation=DiagnosticInfo/GetDebouncingOfEvent, queue-length=1
          operation=DiagnosticInfo/GetFaultDetectionCounter, queue-length=1
          operation=DiagnosticInfo/GetEventExtendedDataRecord, queue-length=1
          operation=DiagnosticInfo/GetEventExtendedDataRecordEx, queue-length=1
          operation=DiagnosticInfo/GetEventFreezeFrameData, queue-length=1
          operation=DiagnosticInfo/GetEventFreezeFrameDataEx, queue-length=1
      EvtInfo_DemEventParameter_ECU3_DTC54: provided-interface=DiagnosticInfo
        provided-com-specs:
          operation=DiagnosticInfo/GetEventStatus, queue-length=1
          operation=DiagnosticInfo/GetEventFailed, queue-length=1
          operation=DiagnosticInfo/GetEventTested, queue-length=1
          operation=DiagnosticInfo/GetDTCOfEvent, queue-length=1
          operation=DiagnosticInfo/GetDebouncingOfEvent, queue-length=1
          operation=DiagnosticInfo/GetFaultDetectionCounter, queue-length=1
          operation=DiagnosticInfo/GetEventExtendedDataRecord, queue-length=1
          operation=DiagnosticInfo/GetEventExtendedDataRecordEx, queue-length=1
          operation=DiagnosticInfo/GetEventFreezeFrameData, queue-length=1
          operation=DiagnosticInfo/GetEventFreezeFrameDataEx, queue-length=1
      EvtInfo_DemEventParameter_ECU3_DTC55: provided-interface=DiagnosticInfo
        provided-com-specs:
          operation=DiagnosticInfo/GetEventStatus, queue-length=1
          operation=DiagnosticInfo/GetEventFailed, queue-length=1
          operation=DiagnosticInfo/GetEventTested, queue-length=1
          operation=DiagnosticInfo/GetDTCOfEvent, queue-length=1
          operation=DiagnosticInfo/GetDebouncingOfEvent, queue-length=1
          operation=DiagnosticInfo/GetFaultDetectionCounter, queue-length=1
          operation=DiagnosticInfo/GetEventExtendedDataRecord, queue-length=1
          operation=DiagnosticInfo/GetEventExtendedDataRecordEx, queue-length=1
          operation=DiagnosticInfo/GetEventFreezeFrameData, queue-length=1
          operation=DiagnosticInfo/GetEventFreezeFrameDataEx, queue-length=1
      EvtInfo_DemEventParameter_ECU3_DTC56: provided-interface=DiagnosticInfo
        provided-com-specs:
          operation=DiagnosticInfo/GetEventStatus, queue-length=1
          operation=DiagnosticInfo/GetEventFailed, queue-length=1
          operation=DiagnosticInfo/GetEventTested, queue-length=1
          operation=DiagnosticInfo/GetDTCOfEvent, queue-length=1
          operation=DiagnosticInfo/GetDebouncingOfEvent, queue-length=1
          operation=DiagnosticInfo/GetFaultDetectionCounter, queue-length=1
          operation=DiagnosticInfo/GetEventExtendedDataRecord, queue-length=1
          operation=DiagnosticInfo/GetEventExtendedDataRecordEx, queue-length=1
          operation=DiagnosticInfo/GetEventFreezeFrameData, queue-length=1
          operation=DiagnosticInfo/GetEventFreezeFrameDataEx, queue-length=1
      EvtInfo_DemEventParameter_ECU3_DTC57: provided-interface=DiagnosticInfo
        provided-com-specs:
          operation=DiagnosticInfo/GetEventStatus, queue-length=1
          operation=DiagnosticInfo/GetEventFailed, queue-length=1
          operation=DiagnosticInfo/GetEventTested, queue-length=1
          operation=DiagnosticInfo/GetDTCOfEvent, queue-length=1
          operation=DiagnosticInfo/GetDebouncingOfEvent, queue-length=1
          operation=DiagnosticInfo/GetFaultDetectionCounter, queue-length=1
          operation=DiagnosticInfo/GetEventExtendedDataRecord, queue-length=1
          operation=DiagnosticInfo/GetEventExtendedDataRecordEx, queue-length=1
          operation=DiagnosticInfo/GetEventFreezeFrameData, queue-length=1
          operation=DiagnosticInfo/GetEventFreezeFrameDataEx, queue-length=1
      EvtInfo_DemEventParameter_ECU3_DTC58: provided-interface=DiagnosticInfo
        provided-com-specs:
          operation=DiagnosticInfo/GetEventStatus, queue-length=1
          operation=DiagnosticInfo/GetEventFailed, queue-length=1
          operation=DiagnosticInfo/GetEventTested, queue-length=1
          operation=DiagnosticInfo/GetDTCOfEvent, queue-length=1
          operation=DiagnosticInfo/GetDebouncingOfEvent, queue-length=1
          operation=DiagnosticInfo/GetFaultDetectionCounter, queue-length=1
          operation=DiagnosticInfo/GetEventExtendedDataRecord, queue-length=1
          operation=DiagnosticInfo/GetEventExtendedDataRecordEx, queue-length=1
          operation=DiagnosticInfo/GetEventFreezeFrameData, queue-length=1
          operation=DiagnosticInfo/GetEventFreezeFrameDataEx, queue-length=1
      EvtInfo_DemEventParameter_ECU3_DTC59: provided-interface=DiagnosticInfo
        provided-com-specs:
          operation=DiagnosticInfo/GetEventStatus, queue-length=1
          operation=DiagnosticInfo/GetEventFailed, queue-length=1
          operation=DiagnosticInfo/GetEventTested, queue-length=1
          operation=DiagnosticInfo/GetDTCOfEvent, queue-length=1
          operation=DiagnosticInfo/GetDebouncingOfEvent, queue-length=1
          operation=DiagnosticInfo/GetFaultDetectionCounter, queue-length=1
          operation=DiagnosticInfo/GetEventExtendedDataRecord, queue-length=1
          operation=DiagnosticInfo/GetEventExtendedDataRecordEx, queue-length=1
          operation=DiagnosticInfo/GetEventFreezeFrameData, queue-length=1
          operation=DiagnosticInfo/GetEventFreezeFrameDataEx, queue-length=1
      EvtInfo_DemEventParameter_ECU3_DTC60: provided-interface=DiagnosticInfo
        provided-com-specs:
          operation=DiagnosticInfo/GetEventStatus, queue-length=1
          operation=DiagnosticInfo/GetEventFailed, queue-length=1
          operation=DiagnosticInfo/GetEventTested, queue-length=1
          operation=DiagnosticInfo/GetDTCOfEvent, queue-length=1
          operation=DiagnosticInfo/GetDebouncingOfEvent, queue-length=1
          operation=DiagnosticInfo/GetFaultDetectionCounter, queue-length=1
          operation=DiagnosticInfo/GetEventExtendedDataRecord, queue-length=1
          operation=DiagnosticInfo/GetEventExtendedDataRecordEx, queue-length=1
          operation=DiagnosticInfo/GetEventFreezeFrameData, queue-length=1
          operation=DiagnosticInfo/GetEventFreezeFrameDataEx, queue-length=1
      EvtInfo_DemEventParameter_ECU3_DTC61: provided-interface=DiagnosticInfo
        provided-com-specs:
          operation=DiagnosticInfo/GetEventStatus, queue-length=1
          operation=DiagnosticInfo/GetEventFailed, queue-length=1
          operation=DiagnosticInfo/GetEventTested, queue-length=1
          operation=DiagnosticInfo/GetDTCOfEvent, queue-length=1
          operation=DiagnosticInfo/GetDebouncingOfEvent, queue-length=1
          operation=DiagnosticInfo/GetFaultDetectionCounter, queue-length=1
          operation=DiagnosticInfo/GetEventExtendedDataRecord, queue-length=1
          operation=DiagnosticInfo/GetEventExtendedDataRecordEx, queue-length=1
          operation=DiagnosticInfo/GetEventFreezeFrameData, queue-length=1
          operation=DiagnosticInfo/GetEventFreezeFrameDataEx, queue-length=1
      EvtInfo_DemEventParameter_ECU3_DTC62: provided-interface=DiagnosticInfo
        provided-com-specs:
          operation=DiagnosticInfo/GetEventStatus, queue-length=1
          operation=DiagnosticInfo/GetEventFailed, queue-length=1
          operation=DiagnosticInfo/GetEventTested, queue-length=1
          operation=DiagnosticInfo/GetDTCOfEvent, queue-length=1
          operation=DiagnosticInfo/GetDebouncingOfEvent, queue-length=1
          operation=DiagnosticInfo/GetFaultDetectionCounter, queue-length=1
          operation=DiagnosticInfo/GetEventExtendedDataRecord, queue-length=1
          operation=DiagnosticInfo/GetEventExtendedDataRecordEx, queue-length=1
          operation=DiagnosticInfo/GetEventFreezeFrameData, queue-length=1
          operation=DiagnosticInfo/GetEventFreezeFrameDataEx, queue-length=1
      EvtInfo_DemEventParameter_ECU3_DTC63: provided-interface=DiagnosticInfo
        provided-com-specs:
          operation=DiagnosticInfo/GetEventStatus, queue-length=1
          operation=DiagnosticInfo/GetEventFailed, queue-length=1
          operation=DiagnosticInfo/GetEventTested, queue-length=1
          operation=DiagnosticInfo/GetDTCOfEvent, queue-length=1
          operation=DiagnosticInfo/GetDebouncingOfEvent, queue-length=1
          operation=DiagnosticInfo/GetFaultDetectionCounter, queue-length=1
          operation=DiagnosticInfo/GetEventExtendedDataRecord, queue-length=1
          operation=DiagnosticInfo/GetEventExtendedDataRecordEx, queue-length=1
          operation=DiagnosticInfo/GetEventFreezeFrameData, queue-length=1
          operation=DiagnosticInfo/GetEventFreezeFrameDataEx, queue-length=1
      EvtInfo_DemEventParameter_ECU3_DTC64: provided-interface=DiagnosticInfo
        provided-com-specs:
          operation=DiagnosticInfo/GetEventStatus, queue-length=1
          operation=DiagnosticInfo/GetEventFailed, queue-length=1
          operation=DiagnosticInfo/GetEventTested, queue-length=1
          operation=DiagnosticInfo/GetDTCOfEvent, queue-length=1
          operation=DiagnosticInfo/GetDebouncingOfEvent, queue-length=1
          operation=DiagnosticInfo/GetFaultDetectionCounter, queue-length=1
          operation=DiagnosticInfo/GetEventExtendedDataRecord, queue-length=1
          operation=DiagnosticInfo/GetEventExtendedDataRecordEx, queue-length=1
          operation=DiagnosticInfo/GetEventFreezeFrameData, queue-length=1
          operation=DiagnosticInfo/GetEventFreezeFrameDataEx, queue-length=1
      EvtInfo_DemEventParameter_ECU3_DTC65: provided-interface=DiagnosticInfo
        provided-com-specs:
          operation=DiagnosticInfo/GetEventStatus, queue-length=1
          operation=DiagnosticInfo/GetEventFailed, queue-length=1
          operation=DiagnosticInfo/GetEventTested, queue-length=1
          operation=DiagnosticInfo/GetDTCOfEvent, queue-length=1
          operation=DiagnosticInfo/GetDebouncingOfEvent, queue-length=1
          operation=DiagnosticInfo/GetFaultDetectionCounter, queue-length=1
          operation=DiagnosticInfo/GetEventExtendedDataRecord, queue-length=1
          operation=DiagnosticInfo/GetEventExtendedDataRecordEx, queue-length=1
          operation=DiagnosticInfo/GetEventFreezeFrameData, queue-length=1
          operation=DiagnosticInfo/GetEventFreezeFrameDataEx, queue-length=1
      EvtInfo_DemEventParameter_ECU3_DTC66: provided-interface=DiagnosticInfo
        provided-com-specs:
          operation=DiagnosticInfo/GetEventStatus, queue-length=1
          operation=DiagnosticInfo/GetEventFailed, queue-length=1
          operation=DiagnosticInfo/GetEventTested, queue-length=1
          operation=DiagnosticInfo/GetDTCOfEvent, queue-length=1
          operation=DiagnosticInfo/GetDebouncingOfEvent, queue-length=1
          operation=DiagnosticInfo/GetFaultDetectionCounter, queue-length=1
          operation=DiagnosticInfo/GetEventExtendedDataRecord, queue-length=1
          operation=DiagnosticInfo/GetEventExtendedDataRecordEx, queue-length=1
          operation=DiagnosticInfo/GetEventFreezeFrameData, queue-length=1
          operation=DiagnosticInfo/GetEventFreezeFrameDataEx, queue-length=1
      EvtInfo_DemEventParameter_ECU3_DTC67: provided-interface=DiagnosticInfo
        provided-com-specs:
          operation=DiagnosticInfo/GetEventStatus, queue-length=1
          operation=DiagnosticInfo/GetEventFailed, queue-length=1
          operation=DiagnosticInfo/GetEventTested, queue-length=1
          operation=DiagnosticInfo/GetDTCOfEvent, queue-length=1
          operation=DiagnosticInfo/GetDebouncingOfEvent, queue-length=1
          operation=DiagnosticInfo/GetFaultDetectionCounter, queue-length=1
          operation=DiagnosticInfo/GetEventExtendedDataRecord, queue-length=1
          operation=DiagnosticInfo/GetEventExtendedDataRecordEx, queue-length=1
          operation=DiagnosticInfo/GetEventFreezeFrameData, queue-length=1
          operation=DiagnosticInfo/GetEventFreezeFrameDataEx, queue-length=1
      EvtInfo_DemEventParameter_ECU3_DTC68: provided-interface=DiagnosticInfo
        provided-com-specs:
          operation=DiagnosticInfo/GetEventStatus, queue-length=1
          operation=DiagnosticInfo/GetEventFailed, queue-length=1
          operation=DiagnosticInfo/GetEventTested, queue-length=1
          operation=DiagnosticInfo/GetDTCOfEvent, queue-length=1
          operation=DiagnosticInfo/GetDebouncingOfEvent, queue-length=1
          operation=DiagnosticInfo/GetFaultDetectionCounter, queue-length=1
          operation=DiagnosticInfo/GetEventExtendedDataRecord, queue-length=1
          operation=DiagnosticInfo/GetEventExtendedDataRecordEx, queue-length=1
          operation=DiagnosticInfo/GetEventFreezeFrameData, queue-length=1
          operation=DiagnosticInfo/GetEventFreezeFrameDataEx, queue-length=1
      EvtInfo_DemEventParameter_ECU3_DTC69: provided-interface=DiagnosticInfo
        provided-com-specs:
          operation=DiagnosticInfo/GetEventStatus, queue-length=1
          operation=DiagnosticInfo/GetEventFailed, queue-length=1
          operation=DiagnosticInfo/GetEventTested, queue-length=1
          operation=DiagnosticInfo/GetDTCOfEvent, queue-length=1
          operation=DiagnosticInfo/GetDebouncingOfEvent, queue-length=1
          operation=DiagnosticInfo/GetFaultDetectionCounter, queue-length=1
          operation=DiagnosticInfo/GetEventExtendedDataRecord, queue-length=1
          operation=DiagnosticInfo/GetEventExtendedDataRecordEx, queue-length=1
          operation=DiagnosticInfo/GetEventFreezeFrameData, queue-length=1
          operation=DiagnosticInfo/GetEventFreezeFrameDataEx, queue-length=1
      EvtInfo_DemEventParameter_ECU3_DTC70: provided-interface=DiagnosticInfo
        provided-com-specs:
          operation=DiagnosticInfo/GetEventStatus, queue-length=1
          operation=DiagnosticInfo/GetEventFailed, queue-length=1
          operation=DiagnosticInfo/GetEventTested, queue-length=1
          operation=DiagnosticInfo/GetDTCOfEvent, queue-length=1
          operation=DiagnosticInfo/GetDebouncingOfEvent, queue-length=1
          operation=DiagnosticInfo/GetFaultDetectionCounter, queue-length=1
          operation=DiagnosticInfo/GetEventExtendedDataRecord, queue-length=1
          operation=DiagnosticInfo/GetEventExtendedDataRecordEx, queue-length=1
          operation=DiagnosticInfo/GetEventFreezeFrameData, queue-length=1
          operation=DiagnosticInfo/GetEventFreezeFrameDataEx, queue-length=1
      EvtInfo_DemEventParameter_ECU3_DTC71: provided-interface=DiagnosticInfo
        provided-com-specs:
          operation=DiagnosticInfo/GetEventStatus, queue-length=1
          operation=DiagnosticInfo/GetEventFailed, queue-length=1
          operation=DiagnosticInfo/GetEventTested, queue-length=1
          operation=DiagnosticInfo/GetDTCOfEvent, queue-length=1
          operation=DiagnosticInfo/GetDebouncingOfEvent, queue-length=1
          operation=DiagnosticInfo/GetFaultDetectionCounter, queue-length=1
          operation=DiagnosticInfo/GetEventExtendedDataRecord, queue-length=1
          operation=DiagnosticInfo/GetEventExtendedDataRecordEx, queue-length=1
          operation=DiagnosticInfo/GetEventFreezeFrameData, queue-length=1
          operation=DiagnosticInfo/GetEventFreezeFrameDataEx, queue-length=1
      EvtInfo_DemEventParameter_ECU3_DTC72: provided-interface=DiagnosticInfo
        provided-com-specs:
          operation=DiagnosticInfo/GetEventStatus, queue-length=1
          operation=DiagnosticInfo/GetEventFailed, queue-length=1
          operation=DiagnosticInfo/GetEventTested, queue-length=1
          operation=DiagnosticInfo/GetDTCOfEvent, queue-length=1
          operation=DiagnosticInfo/GetDebouncingOfEvent, queue-length=1
          operation=DiagnosticInfo/GetFaultDetectionCounter, queue-length=1
          operation=DiagnosticInfo/GetEventExtendedDataRecord, queue-length=1
          operation=DiagnosticInfo/GetEventExtendedDataRecordEx, queue-length=1
          operation=DiagnosticInfo/GetEventFreezeFrameData, queue-length=1
          operation=DiagnosticInfo/GetEventFreezeFrameDataEx, queue-length=1
      EvtInfo_DemEventParameter_ECU3_DTC73: provided-interface=DiagnosticInfo
        provided-com-specs:
          operation=DiagnosticInfo/GetEventStatus, queue-length=1
          operation=DiagnosticInfo/GetEventFailed, queue-length=1
          operation=DiagnosticInfo/GetEventTested, queue-length=1
          operation=DiagnosticInfo/GetDTCOfEvent, queue-length=1
          operation=DiagnosticInfo/GetDebouncingOfEvent, queue-length=1
          operation=DiagnosticInfo/GetFaultDetectionCounter, queue-length=1
          operation=DiagnosticInfo/GetEventExtendedDataRecord, queue-length=1
          operation=DiagnosticInfo/GetEventExtendedDataRecordEx, queue-length=1
          operation=DiagnosticInfo/GetEventFreezeFrameData, queue-length=1
          operation=DiagnosticInfo/GetEventFreezeFrameDataEx, queue-length=1
      EvtInfo_DemEventParameter_ECU3_DTC74: provided-interface=DiagnosticInfo
        provided-com-specs:
          operation=DiagnosticInfo/GetEventStatus, queue-length=1
          operation=DiagnosticInfo/GetEventFailed, queue-length=1
          operation=DiagnosticInfo/GetEventTested, queue-length=1
          operation=DiagnosticInfo/GetDTCOfEvent, queue-length=1
          operation=DiagnosticInfo/GetDebouncingOfEvent, queue-length=1
          operation=DiagnosticInfo/GetFaultDetectionCounter, queue-length=1
          operation=DiagnosticInfo/GetEventExtendedDataRecord, queue-length=1
          operation=DiagnosticInfo/GetEventExtendedDataRecordEx, queue-length=1
          operation=DiagnosticInfo/GetEventFreezeFrameData, queue-length=1
          operation=DiagnosticInfo/GetEventFreezeFrameDataEx, queue-length=1
      EvtInfo_DemEventParameter_ECU3_DTC75: provided-interface=DiagnosticInfo
        provided-com-specs:
          operation=DiagnosticInfo/GetEventStatus, queue-length=1
          operation=DiagnosticInfo/GetEventFailed, queue-length=1
          operation=DiagnosticInfo/GetEventTested, queue-length=1
          operation=DiagnosticInfo/GetDTCOfEvent, queue-length=1
          operation=DiagnosticInfo/GetDebouncingOfEvent, queue-length=1
          operation=DiagnosticInfo/GetFaultDetectionCounter, queue-length=1
          operation=DiagnosticInfo/GetEventExtendedDataRecord, queue-length=1
          operation=DiagnosticInfo/GetEventExtendedDataRecordEx, queue-length=1
          operation=DiagnosticInfo/GetEventFreezeFrameData, queue-length=1
          operation=DiagnosticInfo/GetEventFreezeFrameDataEx, queue-length=1
      EvtInfo_DemEventParameter_ECU3_DTC76: provided-interface=DiagnosticInfo
        provided-com-specs:
          operation=DiagnosticInfo/GetEventStatus, queue-length=1
          operation=DiagnosticInfo/GetEventFailed, queue-length=1
          operation=DiagnosticInfo/GetEventTested, queue-length=1
          operation=DiagnosticInfo/GetDTCOfEvent, queue-length=1
          operation=DiagnosticInfo/GetDebouncingOfEvent, queue-length=1
          operation=DiagnosticInfo/GetFaultDetectionCounter, queue-length=1
          operation=DiagnosticInfo/GetEventExtendedDataRecord, queue-length=1
          operation=DiagnosticInfo/GetEventExtendedDataRecordEx, queue-length=1
          operation=DiagnosticInfo/GetEventFreezeFrameData, queue-length=1
          operation=DiagnosticInfo/GetEventFreezeFrameDataEx, queue-length=1
      EvtInfo_DemEventParameter_ECU3_DTC77: provided-interface=DiagnosticInfo
        provided-com-specs:
          operation=DiagnosticInfo/GetEventStatus, queue-length=1
          operation=DiagnosticInfo/GetEventFailed, queue-length=1
          operation=DiagnosticInfo/GetEventTested, queue-length=1
          operation=DiagnosticInfo/GetDTCOfEvent, queue-length=1
          operation=DiagnosticInfo/GetDebouncingOfEvent, queue-length=1
          operation=DiagnosticInfo/GetFaultDetectionCounter, queue-length=1
          operation=DiagnosticInfo/GetEventExtendedDataRecord, queue-length=1
          operation=DiagnosticInfo/GetEventExtendedDataRecordEx, queue-length=1
          operation=DiagnosticInfo/GetEventFreezeFrameData, queue-length=1
          operation=DiagnosticInfo/GetEventFreezeFrameDataEx, queue-length=1
      EvtInfo_DemEventParameter_ECU3_DTC78: provided-interface=DiagnosticInfo
        provided-com-specs:
          operation=DiagnosticInfo/GetEventStatus, queue-length=1
          operation=DiagnosticInfo/GetEventFailed, queue-length=1
          operation=DiagnosticInfo/GetEventTested, queue-length=1
          operation=DiagnosticInfo/GetDTCOfEvent, queue-length=1
          operation=DiagnosticInfo/GetDebouncingOfEvent, queue-length=1
          operation=DiagnosticInfo/GetFaultDetectionCounter, queue-length=1
          operation=DiagnosticInfo/GetEventExtendedDataRecord, queue-length=1
          operation=DiagnosticInfo/GetEventExtendedDataRecordEx, queue-length=1
          operation=DiagnosticInfo/GetEventFreezeFrameData, queue-length=1
          operation=DiagnosticInfo/GetEventFreezeFrameDataEx, queue-length=1
      EvtInfo_DemEventParameter_ECU3_DTC79: provided-interface=DiagnosticInfo
        provided-com-specs:
          operation=DiagnosticInfo/GetEventStatus, queue-length=1
          operation=DiagnosticInfo/GetEventFailed, queue-length=1
          operation=DiagnosticInfo/GetEventTested, queue-length=1
          operation=DiagnosticInfo/GetDTCOfEvent, queue-length=1
          operation=DiagnosticInfo/GetDebouncingOfEvent, queue-length=1
          operation=DiagnosticInfo/GetFaultDetectionCounter, queue-length=1
          operation=DiagnosticInfo/GetEventExtendedDataRecord, queue-length=1
          operation=DiagnosticInfo/GetEventExtendedDataRecordEx, queue-length=1
          operation=DiagnosticInfo/GetEventFreezeFrameData, queue-length=1
          operation=DiagnosticInfo/GetEventFreezeFrameDataEx, queue-length=1
      EvtInfo_DemEventParameter_ECU3_DTC80: provided-interface=DiagnosticInfo
        provided-com-specs:
          operation=DiagnosticInfo/GetEventStatus, queue-length=1
          operation=DiagnosticInfo/GetEventFailed, queue-length=1
          operation=DiagnosticInfo/GetEventTested, queue-length=1
          operation=DiagnosticInfo/GetDTCOfEvent, queue-length=1
          operation=DiagnosticInfo/GetDebouncingOfEvent, queue-length=1
          operation=DiagnosticInfo/GetFaultDetectionCounter, queue-length=1
          operation=DiagnosticInfo/GetEventExtendedDataRecord, queue-length=1
          operation=DiagnosticInfo/GetEventExtendedDataRecordEx, queue-length=1
          operation=DiagnosticInfo/GetEventFreezeFrameData, queue-length=1
          operation=DiagnosticInfo/GetEventFreezeFrameDataEx, queue-length=1
      EvtInfo_DemEventParameter_ECU3_DTC81: provided-interface=DiagnosticInfo
        provided-com-specs:
          operation=DiagnosticInfo/GetEventStatus, queue-length=1
          operation=DiagnosticInfo/GetEventFailed, queue-length=1
          operation=DiagnosticInfo/GetEventTested, queue-length=1
          operation=DiagnosticInfo/GetDTCOfEvent, queue-length=1
          operation=DiagnosticInfo/GetDebouncingOfEvent, queue-length=1
          operation=DiagnosticInfo/GetFaultDetectionCounter, queue-length=1
          operation=DiagnosticInfo/GetEventExtendedDataRecord, queue-length=1
          operation=DiagnosticInfo/GetEventExtendedDataRecordEx, queue-length=1
          operation=DiagnosticInfo/GetEventFreezeFrameData, queue-length=1
          operation=DiagnosticInfo/GetEventFreezeFrameDataEx, queue-length=1
      EvtInfo_DemEventParameter_ECU3_DTC82: provided-interface=DiagnosticInfo
        provided-com-specs:
          operation=DiagnosticInfo/GetEventStatus, queue-length=1
          operation=DiagnosticInfo/GetEventFailed, queue-length=1
          operation=DiagnosticInfo/GetEventTested, queue-length=1
          operation=DiagnosticInfo/GetDTCOfEvent, queue-length=1
          operation=DiagnosticInfo/GetDebouncingOfEvent, queue-length=1
          operation=DiagnosticInfo/GetFaultDetectionCounter, queue-length=1
          operation=DiagnosticInfo/GetEventExtendedDataRecord, queue-length=1
          operation=DiagnosticInfo/GetEventExtendedDataRecordEx, queue-length=1
          operation=DiagnosticInfo/GetEventFreezeFrameData, queue-length=1
          operation=DiagnosticInfo/GetEventFreezeFrameDataEx, queue-length=1
      EvtInfo_DemEventParameter_ECU3_DTC83: provided-interface=DiagnosticInfo
        provided-com-specs:
          operation=DiagnosticInfo/GetEventStatus, queue-length=1
          operation=DiagnosticInfo/GetEventFailed, queue-length=1
          operation=DiagnosticInfo/GetEventTested, queue-length=1
          operation=DiagnosticInfo/GetDTCOfEvent, queue-length=1
          operation=DiagnosticInfo/GetDebouncingOfEvent, queue-length=1
          operation=DiagnosticInfo/GetFaultDetectionCounter, queue-length=1
          operation=DiagnosticInfo/GetEventExtendedDataRecord, queue-length=1
          operation=DiagnosticInfo/GetEventExtendedDataRecordEx, queue-length=1
          operation=DiagnosticInfo/GetEventFreezeFrameData, queue-length=1
          operation=DiagnosticInfo/GetEventFreezeFrameDataEx, queue-length=1
      EvtInfo_DemEventParameter_ECU3_DTC84: provided-interface=DiagnosticInfo
        provided-com-specs:
          operation=DiagnosticInfo/GetEventStatus, queue-length=1
          operation=DiagnosticInfo/GetEventFailed, queue-length=1
          operation=DiagnosticInfo/GetEventTested, queue-length=1
          operation=DiagnosticInfo/GetDTCOfEvent, queue-length=1
          operation=DiagnosticInfo/GetDebouncingOfEvent, queue-length=1
          operation=DiagnosticInfo/GetFaultDetectionCounter, queue-length=1
          operation=DiagnosticInfo/GetEventExtendedDataRecord, queue-length=1
          operation=DiagnosticInfo/GetEventExtendedDataRecordEx, queue-length=1
          operation=DiagnosticInfo/GetEventFreezeFrameData, queue-length=1
          operation=DiagnosticInfo/GetEventFreezeFrameDataEx, queue-length=1
      EvtInfo_DemEventParameter_ECU3_DTC85: provided-interface=DiagnosticInfo
        provided-com-specs:
          operation=DiagnosticInfo/GetEventStatus, queue-length=1
          operation=DiagnosticInfo/GetEventFailed, queue-length=1
          operation=DiagnosticInfo/GetEventTested, queue-length=1
          operation=DiagnosticInfo/GetDTCOfEvent, queue-length=1
          operation=DiagnosticInfo/GetDebouncingOfEvent, queue-length=1
          operation=DiagnosticInfo/GetFaultDetectionCounter, queue-length=1
          operation=DiagnosticInfo/GetEventExtendedDataRecord, queue-length=1
          operation=DiagnosticInfo/GetEventExtendedDataRecordEx, queue-length=1
          operation=DiagnosticInfo/GetEventFreezeFrameData, queue-length=1
          operation=DiagnosticInfo/GetEventFreezeFrameDataEx, queue-length=1
      EvtInfo_DemEventParameter_ECU3_DTC86: provided-interface=DiagnosticInfo
        provided-com-specs:
          operation=DiagnosticInfo/GetEventStatus, queue-length=1
          operation=DiagnosticInfo/GetEventFailed, queue-length=1
          operation=DiagnosticInfo/GetEventTested, queue-length=1
          operation=DiagnosticInfo/GetDTCOfEvent, queue-length=1
          operation=DiagnosticInfo/GetDebouncingOfEvent, queue-length=1
          operation=DiagnosticInfo/GetFaultDetectionCounter, queue-length=1
          operation=DiagnosticInfo/GetEventExtendedDataRecord, queue-length=1
          operation=DiagnosticInfo/GetEventExtendedDataRecordEx, queue-length=1
          operation=DiagnosticInfo/GetEventFreezeFrameData, queue-length=1
          operation=DiagnosticInfo/GetEventFreezeFrameDataEx, queue-length=1
      EvtInfo_DemEventParameter_ECU3_DTC87: provided-interface=DiagnosticInfo
        provided-com-specs:
          operation=DiagnosticInfo/GetEventStatus, queue-length=1
          operation=DiagnosticInfo/GetEventFailed, queue-length=1
          operation=DiagnosticInfo/GetEventTested, queue-length=1
          operation=DiagnosticInfo/GetDTCOfEvent, queue-length=1
          operation=DiagnosticInfo/GetDebouncingOfEvent, queue-length=1
          operation=DiagnosticInfo/GetFaultDetectionCounter, queue-length=1
          operation=DiagnosticInfo/GetEventExtendedDataRecord, queue-length=1
          operation=DiagnosticInfo/GetEventExtendedDataRecordEx, queue-length=1
          operation=DiagnosticInfo/GetEventFreezeFrameData, queue-length=1
          operation=DiagnosticInfo/GetEventFreezeFrameDataEx, queue-length=1
      EvtInfo_DemEventParameter_ECU3_DTC88: provided-interface=DiagnosticInfo
        provided-com-specs:
          operation=DiagnosticInfo/GetEventStatus, queue-length=1
          operation=DiagnosticInfo/GetEventFailed, queue-length=1
          operation=DiagnosticInfo/GetEventTested, queue-length=1
          operation=DiagnosticInfo/GetDTCOfEvent, queue-length=1
          operation=DiagnosticInfo/GetDebouncingOfEvent, queue-length=1
          operation=DiagnosticInfo/GetFaultDetectionCounter, queue-length=1
          operation=DiagnosticInfo/GetEventExtendedDataRecord, queue-length=1
          operation=DiagnosticInfo/GetEventExtendedDataRecordEx, queue-length=1
          operation=DiagnosticInfo/GetEventFreezeFrameData, queue-length=1
          operation=DiagnosticInfo/GetEventFreezeFrameDataEx, queue-length=1
      EvtInfo_DemEventParameter_ECU3_DTC89: provided-interface=DiagnosticInfo
        provided-com-specs:
          operation=DiagnosticInfo/GetEventStatus, queue-length=1
          operation=DiagnosticInfo/GetEventFailed, queue-length=1
          operation=DiagnosticInfo/GetEventTested, queue-length=1
          operation=DiagnosticInfo/GetDTCOfEvent, queue-length=1
          operation=DiagnosticInfo/GetDebouncingOfEvent, queue-length=1
          operation=DiagnosticInfo/GetFaultDetectionCounter, queue-length=1
          operation=DiagnosticInfo/GetEventExtendedDataRecord, queue-length=1
          operation=DiagnosticInfo/GetEventExtendedDataRecordEx, queue-length=1
          operation=DiagnosticInfo/GetEventFreezeFrameData, queue-length=1
          operation=DiagnosticInfo/GetEventFreezeFrameDataEx, queue-length=1
      EvtInfo_DemEventParameter_ECU3_DTC90: provided-interface=DiagnosticInfo
        provided-com-specs:
          operation=DiagnosticInfo/GetEventStatus, queue-length=1
          operation=DiagnosticInfo/GetEventFailed, queue-length=1
          operation=DiagnosticInfo/GetEventTested, queue-length=1
          operation=DiagnosticInfo/GetDTCOfEvent, queue-length=1
          operation=DiagnosticInfo/GetDebouncingOfEvent, queue-length=1
          operation=DiagnosticInfo/GetFaultDetectionCounter, queue-length=1
          operation=DiagnosticInfo/GetEventExtendedDataRecord, queue-length=1
          operation=DiagnosticInfo/GetEventExtendedDataRecordEx, queue-length=1
          operation=DiagnosticInfo/GetEventFreezeFrameData, queue-length=1
          operation=DiagnosticInfo/GetEventFreezeFrameDataEx, queue-length=1
      EvtInfo_DemEventParameter_ECU3_DTC91: provided-interface=DiagnosticInfo
        provided-com-specs:
          operation=DiagnosticInfo/GetEventStatus, queue-length=1
          operation=DiagnosticInfo/GetEventFailed, queue-length=1
          operation=DiagnosticInfo/GetEventTested, queue-length=1
          operation=DiagnosticInfo/GetDTCOfEvent, queue-length=1
          operation=DiagnosticInfo/GetDebouncingOfEvent, queue-length=1
          operation=DiagnosticInfo/GetFaultDetectionCounter, queue-length=1
          operation=DiagnosticInfo/GetEventExtendedDataRecord, queue-length=1
          operation=DiagnosticInfo/GetEventExtendedDataRecordEx, queue-length=1
          operation=DiagnosticInfo/GetEventFreezeFrameData, queue-length=1
          operation=DiagnosticInfo/GetEventFreezeFrameDataEx, queue-length=1
      EvtInfo_DemEventParameter_ECU3_DTC92: provided-interface=DiagnosticInfo
        provided-com-specs:
          operation=DiagnosticInfo/GetEventStatus, queue-length=1
          operation=DiagnosticInfo/GetEventFailed, queue-length=1
          operation=DiagnosticInfo/GetEventTested, queue-length=1
          operation=DiagnosticInfo/GetDTCOfEvent, queue-length=1
          operation=DiagnosticInfo/GetDebouncingOfEvent, queue-length=1
          operation=DiagnosticInfo/GetFaultDetectionCounter, queue-length=1
          operation=DiagnosticInfo/GetEventExtendedDataRecord, queue-length=1
          operation=DiagnosticInfo/GetEventExtendedDataRecordEx, queue-length=1
          operation=DiagnosticInfo/GetEventFreezeFrameData, queue-length=1
          operation=DiagnosticInfo/GetEventFreezeFrameDataEx, queue-length=1
      EvtInfo_DemEventParameter_ECU3_DTC93: provided-interface=DiagnosticInfo
        provided-com-specs:
          operation=DiagnosticInfo/GetEventStatus, queue-length=1
          operation=DiagnosticInfo/GetEventFailed, queue-length=1
          operation=DiagnosticInfo/GetEventTested, queue-length=1
          operation=DiagnosticInfo/GetDTCOfEvent, queue-length=1
          operation=DiagnosticInfo/GetDebouncingOfEvent, queue-length=1
          operation=DiagnosticInfo/GetFaultDetectionCounter, queue-length=1
          operation=DiagnosticInfo/GetEventExtendedDataRecord, queue-length=1
          operation=DiagnosticInfo/GetEventExtendedDataRecordEx, queue-length=1
          operation=DiagnosticInfo/GetEventFreezeFrameData, queue-length=1
          operation=DiagnosticInfo/GetEventFreezeFrameDataEx, queue-length=1
      EvtInfo_DemEventParameter_ECU3_DTC94: provided-interface=DiagnosticInfo
        provided-com-specs:
          operation=DiagnosticInfo/GetEventStatus, queue-length=1
          operation=DiagnosticInfo/GetEventFailed, queue-length=1
          operation=DiagnosticInfo/GetEventTested, queue-length=1
          operation=DiagnosticInfo/GetDTCOfEvent, queue-length=1
          operation=DiagnosticInfo/GetDebouncingOfEvent, queue-length=1
          operation=DiagnosticInfo/GetFaultDetectionCounter, queue-length=1
          operation=DiagnosticInfo/GetEventExtendedDataRecord, queue-length=1
          operation=DiagnosticInfo/GetEventExtendedDataRecordEx, queue-length=1
          operation=DiagnosticInfo/GetEventFreezeFrameData, queue-length=1
          operation=DiagnosticInfo/GetEventFreezeFrameDataEx, queue-length=1
      EvtInfo_DemEventParameter_ECU3_DTC95: provided-interface=DiagnosticInfo
        provided-com-specs:
          operation=DiagnosticInfo/GetEventStatus, queue-length=1
          operation=DiagnosticInfo/GetEventFailed, queue-length=1
          operation=DiagnosticInfo/GetEventTested, queue-length=1
          operation=DiagnosticInfo/GetDTCOfEvent, queue-length=1
          operation=DiagnosticInfo/GetDebouncingOfEvent, queue-length=1
          operation=DiagnosticInfo/GetFaultDetectionCounter, queue-length=1
          operation=DiagnosticInfo/GetEventExtendedDataRecord, queue-length=1
          operation=DiagnosticInfo/GetEventExtendedDataRecordEx, queue-length=1
          operation=DiagnosticInfo/GetEventFreezeFrameData, queue-length=1
          operation=DiagnosticInfo/GetEventFreezeFrameDataEx, queue-length=1
      EvtInfo_DemEventParameter_ECU3_DTC96: provided-interface=DiagnosticInfo
        provided-com-specs:
          operation=DiagnosticInfo/GetEventStatus, queue-length=1
          operation=DiagnosticInfo/GetEventFailed, queue-length=1
          operation=DiagnosticInfo/GetEventTested, queue-length=1
          operation=DiagnosticInfo/GetDTCOfEvent, queue-length=1
          operation=DiagnosticInfo/GetDebouncingOfEvent, queue-length=1
          operation=DiagnosticInfo/GetFaultDetectionCounter, queue-length=1
          operation=DiagnosticInfo/GetEventExtendedDataRecord, queue-length=1
          operation=DiagnosticInfo/GetEventExtendedDataRecordEx, queue-length=1
          operation=DiagnosticInfo/GetEventFreezeFrameData, queue-length=1
          operation=DiagnosticInfo/GetEventFreezeFrameDataEx, queue-length=1
      EvtInfo_DemEventParameter_ECU3_DTC97: provided-interface=DiagnosticInfo
        provided-com-specs:
          operation=DiagnosticInfo/GetEventStatus, queue-length=1
          operation=DiagnosticInfo/GetEventFailed, queue-length=1
          operation=DiagnosticInfo/GetEventTested, queue-length=1
          operation=DiagnosticInfo/GetDTCOfEvent, queue-length=1
          operation=DiagnosticInfo/GetDebouncingOfEvent, queue-length=1
          operation=DiagnosticInfo/GetFaultDetectionCounter, queue-length=1
          operation=DiagnosticInfo/GetEventExtendedDataRecord, queue-length=1
          operation=DiagnosticInfo/GetEventExtendedDataRecordEx, queue-length=1
          operation=DiagnosticInfo/GetEventFreezeFrameData, queue-length=1
          operation=DiagnosticInfo/GetEventFreezeFrameDataEx, queue-length=1
      EvtInfo_DemEventParameter_ECU3_DTC98: provided-interface=DiagnosticInfo
        provided-com-specs:
          operation=DiagnosticInfo/GetEventStatus, queue-length=1
          operation=DiagnosticInfo/GetEventFailed, queue-length=1
          operation=DiagnosticInfo/GetEventTested, queue-length=1
          operation=DiagnosticInfo/GetDTCOfEvent, queue-length=1
          operation=DiagnosticInfo/GetDebouncingOfEvent, queue-length=1
          operation=DiagnosticInfo/GetFaultDetectionCounter, queue-length=1
          operation=DiagnosticInfo/GetEventExtendedDataRecord, queue-length=1
          operation=DiagnosticInfo/GetEventExtendedDataRecordEx, queue-length=1
          operation=DiagnosticInfo/GetEventFreezeFrameData, queue-length=1
          operation=DiagnosticInfo/GetEventFreezeFrameDataEx, queue-length=1
      EvtInfo_DemEventParameter_ECU3_DTC99: provided-interface=DiagnosticInfo
        provided-com-specs:
          operation=DiagnosticInfo/GetEventStatus, queue-length=1
          operation=DiagnosticInfo/GetEventFailed, queue-length=1
          operation=DiagnosticInfo/GetEventTested, queue-length=1
          operation=DiagnosticInfo/GetDTCOfEvent, queue-length=1
          operation=DiagnosticInfo/GetDebouncingOfEvent, queue-length=1
          operation=DiagnosticInfo/GetFaultDetectionCounter, queue-length=1
          operation=DiagnosticInfo/GetEventExtendedDataRecord, queue-length=1
          operation=DiagnosticInfo/GetEventExtendedDataRecordEx, queue-length=1
          operation=DiagnosticInfo/GetEventFreezeFrameData, queue-length=1
          operation=DiagnosticInfo/GetEventFreezeFrameDataEx, queue-length=1
      EvtInfo_DemEventParameter_ECU4_DTC00: provided-interface=DiagnosticInfo
        provided-com-specs:
          operation=DiagnosticInfo/GetEventStatus, queue-length=1
          operation=DiagnosticInfo/GetEventFailed, queue-length=1
          operation=DiagnosticInfo/GetEventTested, queue-length=1
          operation=DiagnosticInfo/GetDTCOfEvent, queue-length=1
          operation=DiagnosticInfo/GetDebouncingOfEvent, queue-length=1
          operation=DiagnosticInfo/GetFaultDetectionCounter, queue-length=1
          operation=DiagnosticInfo/GetEventExtendedDataRecord, queue-length=1
          operation=DiagnosticInfo/GetEventExtendedDataRecordEx, queue-length=1
          operation=DiagnosticInfo/GetEventFreezeFrameData, queue-length=1
          operation=DiagnosticInfo/GetEventFreezeFrameDataEx, queue-length=1
      EvtInfo_DemEventParameter_ECU4_DTC01: provided-interface=DiagnosticInfo
        provided-com-specs:
          operation=DiagnosticInfo/GetEventStatus, queue-length=1
          operation=DiagnosticInfo/GetEventFailed, queue-length=1
          operation=DiagnosticInfo/GetEventTested, queue-length=1
          operation=DiagnosticInfo/GetDTCOfEvent, queue-length=1
          operation=DiagnosticInfo/GetDebouncingOfEvent, queue-length=1
          operation=DiagnosticInfo/GetFaultDetectionCounter, queue-length=1
          operation=DiagnosticInfo/GetEventExtendedDataRecord, queue-length=1
          operation=DiagnosticInfo/GetEventExtendedDataRecordEx, queue-length=1
          operation=DiagnosticInfo/GetEventFreezeFrameData, queue-length=1
          operation=DiagnosticInfo/GetEventFreezeFrameDataEx, queue-length=1
      EvtInfo_DemEventParameter_ECU4_DTC02: provided-interface=DiagnosticInfo
        provided-com-specs:
          operation=DiagnosticInfo/GetEventStatus, queue-length=1
          operation=DiagnosticInfo/GetEventFailed, queue-length=1
          operation=DiagnosticInfo/GetEventTested, queue-length=1
          operation=DiagnosticInfo/GetDTCOfEvent, queue-length=1
          operation=DiagnosticInfo/GetDebouncingOfEvent, queue-length=1
          operation=DiagnosticInfo/GetFaultDetectionCounter, queue-length=1
          operation=DiagnosticInfo/GetEventExtendedDataRecord, queue-length=1
          operation=DiagnosticInfo/GetEventExtendedDataRecordEx, queue-length=1
          operation=DiagnosticInfo/GetEventFreezeFrameData, queue-length=1
          operation=DiagnosticInfo/GetEventFreezeFrameDataEx, queue-length=1
      EvtInfo_DemEventParameter_ECU4_DTC03: provided-interface=DiagnosticInfo
        provided-com-specs:
          operation=DiagnosticInfo/GetEventStatus, queue-length=1
          operation=DiagnosticInfo/GetEventFailed, queue-length=1
          operation=DiagnosticInfo/GetEventTested, queue-length=1
          operation=DiagnosticInfo/GetDTCOfEvent, queue-length=1
          operation=DiagnosticInfo/GetDebouncingOfEvent, queue-length=1
          operation=DiagnosticInfo/GetFaultDetectionCounter, queue-length=1
          operation=DiagnosticInfo/GetEventExtendedDataRecord, queue-length=1
          operation=DiagnosticInfo/GetEventExtendedDataRecordEx, queue-length=1
          operation=DiagnosticInfo/GetEventFreezeFrameData, queue-length=1
          operation=DiagnosticInfo/GetEventFreezeFrameDataEx, queue-length=1
      EvtInfo_DemEventParameter_ECU4_DTC04: provided-interface=DiagnosticInfo
        provided-com-specs:
          operation=DiagnosticInfo/GetEventStatus, queue-length=1
          operation=DiagnosticInfo/GetEventFailed, queue-length=1
          operation=DiagnosticInfo/GetEventTested, queue-length=1
          operation=DiagnosticInfo/GetDTCOfEvent, queue-length=1
          operation=DiagnosticInfo/GetDebouncingOfEvent, queue-length=1
          operation=DiagnosticInfo/GetFaultDetectionCounter, queue-length=1
          operation=DiagnosticInfo/GetEventExtendedDataRecord, queue-length=1
          operation=DiagnosticInfo/GetEventExtendedDataRecordEx, queue-length=1
          operation=DiagnosticInfo/GetEventFreezeFrameData, queue-length=1
          operation=DiagnosticInfo/GetEventFreezeFrameDataEx, queue-length=1
      EvtInfo_DemEventParameter_ECU4_DTC05: provided-interface=DiagnosticInfo
        provided-com-specs:
          operation=DiagnosticInfo/GetEventStatus, queue-length=1
          operation=DiagnosticInfo/GetEventFailed, queue-length=1
          operation=DiagnosticInfo/GetEventTested, queue-length=1
          operation=DiagnosticInfo/GetDTCOfEvent, queue-length=1
          operation=DiagnosticInfo/GetDebouncingOfEvent, queue-length=1
          operation=DiagnosticInfo/GetFaultDetectionCounter, queue-length=1
          operation=DiagnosticInfo/GetEventExtendedDataRecord, queue-length=1
          operation=DiagnosticInfo/GetEventExtendedDataRecordEx, queue-length=1
          operation=DiagnosticInfo/GetEventFreezeFrameData, queue-length=1
          operation=DiagnosticInfo/GetEventFreezeFrameDataEx, queue-length=1
      EvtInfo_DemEventParameter_ECU4_DTC06: provided-interface=DiagnosticInfo
        provided-com-specs:
          operation=DiagnosticInfo/GetEventStatus, queue-length=1
          operation=DiagnosticInfo/GetEventFailed, queue-length=1
          operation=DiagnosticInfo/GetEventTested, queue-length=1
          operation=DiagnosticInfo/GetDTCOfEvent, queue-length=1
          operation=DiagnosticInfo/GetDebouncingOfEvent, queue-length=1
          operation=DiagnosticInfo/GetFaultDetectionCounter, queue-length=1
          operation=DiagnosticInfo/GetEventExtendedDataRecord, queue-length=1
          operation=DiagnosticInfo/GetEventExtendedDataRecordEx, queue-length=1
          operation=DiagnosticInfo/GetEventFreezeFrameData, queue-length=1
          operation=DiagnosticInfo/GetEventFreezeFrameDataEx, queue-length=1
      EvtInfo_DemEventParameter_ECU4_DTC07: provided-interface=DiagnosticInfo
        provided-com-specs:
          operation=DiagnosticInfo/GetEventStatus, queue-length=1
          operation=DiagnosticInfo/GetEventFailed, queue-length=1
          operation=DiagnosticInfo/GetEventTested, queue-length=1
          operation=DiagnosticInfo/GetDTCOfEvent, queue-length=1
          operation=DiagnosticInfo/GetDebouncingOfEvent, queue-length=1
          operation=DiagnosticInfo/GetFaultDetectionCounter, queue-length=1
          operation=DiagnosticInfo/GetEventExtendedDataRecord, queue-length=1
          operation=DiagnosticInfo/GetEventExtendedDataRecordEx, queue-length=1
          operation=DiagnosticInfo/GetEventFreezeFrameData, queue-length=1
          operation=DiagnosticInfo/GetEventFreezeFrameDataEx, queue-length=1
      EvtInfo_DemEventParameter_ECU4_DTC08: provided-interface=DiagnosticInfo
        provided-com-specs:
          operation=DiagnosticInfo/GetEventStatus, queue-length=1
          operation=DiagnosticInfo/GetEventFailed, queue-length=1
          operation=DiagnosticInfo/GetEventTested, queue-length=1
          operation=DiagnosticInfo/GetDTCOfEvent, queue-length=1
          operation=DiagnosticInfo/GetDebouncingOfEvent, queue-length=1
          operation=DiagnosticInfo/GetFaultDetectionCounter, queue-length=1
          operation=DiagnosticInfo/GetEventExtendedDataRecord, queue-length=1
          operation=DiagnosticInfo/GetEventExtendedDataRecordEx, queue-length=1
          operation=DiagnosticInfo/GetEventFreezeFrameData, queue-length=1
          operation=DiagnosticInfo/GetEventFreezeFrameDataEx, queue-length=1
      EvtInfo_DemEventParameter_ECU4_DTC09: provided-interface=DiagnosticInfo
        provided-com-specs:
          operation=DiagnosticInfo/GetEventStatus, queue-length=1
          operation=DiagnosticInfo/GetEventFailed, queue-length=1
          operation=DiagnosticInfo/GetEventTested, queue-length=1
          operation=DiagnosticInfo/GetDTCOfEvent, queue-length=1
          operation=DiagnosticInfo/GetDebouncingOfEvent, queue-length=1
          operation=DiagnosticInfo/GetFaultDetectionCounter, queue-length=1
          operation=DiagnosticInfo/GetEventExtendedDataRecord, queue-length=1
          operation=DiagnosticInfo/GetEventExtendedDataRecordEx, queue-length=1
          operation=DiagnosticInfo/GetEventFreezeFrameData, queue-length=1
          operation=DiagnosticInfo/GetEventFreezeFrameDataEx, queue-length=1
      EvtInfo_DemEventParameter_ECU4_DTC10: provided-interface=DiagnosticInfo
        provided-com-specs:
          operation=DiagnosticInfo/GetEventStatus, queue-length=1
          operation=DiagnosticInfo/GetEventFailed, queue-length=1
          operation=DiagnosticInfo/GetEventTested, queue-length=1
          operation=DiagnosticInfo/GetDTCOfEvent, queue-length=1
          operation=DiagnosticInfo/GetDebouncingOfEvent, queue-length=1
          operation=DiagnosticInfo/GetFaultDetectionCounter, queue-length=1
          operation=DiagnosticInfo/GetEventExtendedDataRecord, queue-length=1
          operation=DiagnosticInfo/GetEventExtendedDataRecordEx, queue-length=1
          operation=DiagnosticInfo/GetEventFreezeFrameData, queue-length=1
          operation=DiagnosticInfo/GetEventFreezeFrameDataEx, queue-length=1
      EvtInfo_DemEventParameter_ECU4_DTC11: provided-interface=DiagnosticInfo
        provided-com-specs:
          operation=DiagnosticInfo/GetEventStatus, queue-length=1
          operation=DiagnosticInfo/GetEventFailed, queue-length=1
          operation=DiagnosticInfo/GetEventTested, queue-length=1
          operation=DiagnosticInfo/GetDTCOfEvent, queue-length=1
          operation=DiagnosticInfo/GetDebouncingOfEvent, queue-length=1
          operation=DiagnosticInfo/GetFaultDetectionCounter, queue-length=1
          operation=DiagnosticInfo/GetEventExtendedDataRecord, queue-length=1
          operation=DiagnosticInfo/GetEventExtendedDataRecordEx, queue-length=1
          operation=DiagnosticInfo/GetEventFreezeFrameData, queue-length=1
          operation=DiagnosticInfo/GetEventFreezeFrameDataEx, queue-length=1
      EvtInfo_DemEventParameter_ECU4_DTC12: provided-interface=DiagnosticInfo
        provided-com-specs:
          operation=DiagnosticInfo/GetEventStatus, queue-length=1
          operation=DiagnosticInfo/GetEventFailed, queue-length=1
          operation=DiagnosticInfo/GetEventTested, queue-length=1
          operation=DiagnosticInfo/GetDTCOfEvent, queue-length=1
          operation=DiagnosticInfo/GetDebouncingOfEvent, queue-length=1
          operation=DiagnosticInfo/GetFaultDetectionCounter, queue-length=1
          operation=DiagnosticInfo/GetEventExtendedDataRecord, queue-length=1
          operation=DiagnosticInfo/GetEventExtendedDataRecordEx, queue-length=1
          operation=DiagnosticInfo/GetEventFreezeFrameData, queue-length=1
          operation=DiagnosticInfo/GetEventFreezeFrameDataEx, queue-length=1
      EvtInfo_DemEventParameter_ECU4_DTC13: provided-interface=DiagnosticInfo
        provided-com-specs:
          operation=DiagnosticInfo/GetEventStatus, queue-length=1
          operation=DiagnosticInfo/GetEventFailed, queue-length=1
          operation=DiagnosticInfo/GetEventTested, queue-length=1
          operation=DiagnosticInfo/GetDTCOfEvent, queue-length=1
          operation=DiagnosticInfo/GetDebouncingOfEvent, queue-length=1
          operation=DiagnosticInfo/GetFaultDetectionCounter, queue-length=1
          operation=DiagnosticInfo/GetEventExtendedDataRecord, queue-length=1
          operation=DiagnosticInfo/GetEventExtendedDataRecordEx, queue-length=1
          operation=DiagnosticInfo/GetEventFreezeFrameData, queue-length=1
          operation=DiagnosticInfo/GetEventFreezeFrameDataEx, queue-length=1
      EvtInfo_DemEventParameter_ECU4_DTC14: provided-interface=DiagnosticInfo
        provided-com-specs:
          operation=DiagnosticInfo/GetEventStatus, queue-length=1
          operation=DiagnosticInfo/GetEventFailed, queue-length=1
          operation=DiagnosticInfo/GetEventTested, queue-length=1
          operation=DiagnosticInfo/GetDTCOfEvent, queue-length=1
          operation=DiagnosticInfo/GetDebouncingOfEvent, queue-length=1
          operation=DiagnosticInfo/GetFaultDetectionCounter, queue-length=1
          operation=DiagnosticInfo/GetEventExtendedDataRecord, queue-length=1
          operation=DiagnosticInfo/GetEventExtendedDataRecordEx, queue-length=1
          operation=DiagnosticInfo/GetEventFreezeFrameData, queue-length=1
          operation=DiagnosticInfo/GetEventFreezeFrameDataEx, queue-length=1
      EvtInfo_DemEventParameter_ECU4_DTC15: provided-interface=DiagnosticInfo
        provided-com-specs:
          operation=DiagnosticInfo/GetEventStatus, queue-length=1
          operation=DiagnosticInfo/GetEventFailed, queue-length=1
          operation=DiagnosticInfo/GetEventTested, queue-length=1
          operation=DiagnosticInfo/GetDTCOfEvent, queue-length=1
          operation=DiagnosticInfo/GetDebouncingOfEvent, queue-length=1
          operation=DiagnosticInfo/GetFaultDetectionCounter, queue-length=1
          operation=DiagnosticInfo/GetEventExtendedDataRecord, queue-length=1
          operation=DiagnosticInfo/GetEventExtendedDataRecordEx, queue-length=1
          operation=DiagnosticInfo/GetEventFreezeFrameData, queue-length=1
          operation=DiagnosticInfo/GetEventFreezeFrameDataEx, queue-length=1
      EvtInfo_DemEventParameter_ECU4_DTC16: provided-interface=DiagnosticInfo
        provided-com-specs:
          operation=DiagnosticInfo/GetEventStatus, queue-length=1
          operation=DiagnosticInfo/GetEventFailed, queue-length=1
          operation=DiagnosticInfo/GetEventTested, queue-length=1
          operation=DiagnosticInfo/GetDTCOfEvent, queue-length=1
          operation=DiagnosticInfo/GetDebouncingOfEvent, queue-length=1
          operation=DiagnosticInfo/GetFaultDetectionCounter, queue-length=1
          operation=DiagnosticInfo/GetEventExtendedDataRecord, queue-length=1
          operation=DiagnosticInfo/GetEventExtendedDataRecordEx, queue-length=1
          operation=DiagnosticInfo/GetEventFreezeFrameData, queue-length=1
          operation=DiagnosticInfo/GetEventFreezeFrameDataEx, queue-length=1
      EvtInfo_DemEventParameter_ECU4_DTC17: provided-interface=DiagnosticInfo
        provided-com-specs:
          operation=DiagnosticInfo/GetEventStatus, queue-length=1
          operation=DiagnosticInfo/GetEventFailed, queue-length=1
          operation=DiagnosticInfo/GetEventTested, queue-length=1
          operation=DiagnosticInfo/GetDTCOfEvent, queue-length=1
          operation=DiagnosticInfo/GetDebouncingOfEvent, queue-length=1
          operation=DiagnosticInfo/GetFaultDetectionCounter, queue-length=1
          operation=DiagnosticInfo/GetEventExtendedDataRecord, queue-length=1
          operation=DiagnosticInfo/GetEventExtendedDataRecordEx, queue-length=1
          operation=DiagnosticInfo/GetEventFreezeFrameData, queue-length=1
          operation=DiagnosticInfo/GetEventFreezeFrameDataEx, queue-length=1
      EvtInfo_DemEventParameter_ECU4_DTC18: provided-interface=DiagnosticInfo
        provided-com-specs:
          operation=DiagnosticInfo/GetEventStatus, queue-length=1
          operation=DiagnosticInfo/GetEventFailed, queue-length=1
          operation=DiagnosticInfo/GetEventTested, queue-length=1
          operation=DiagnosticInfo/GetDTCOfEvent, queue-length=1
          operation=DiagnosticInfo/GetDebouncingOfEvent, queue-length=1
          operation=DiagnosticInfo/GetFaultDetectionCounter, queue-length=1
          operation=DiagnosticInfo/GetEventExtendedDataRecord, queue-length=1
          operation=DiagnosticInfo/GetEventExtendedDataRecordEx, queue-length=1
          operation=DiagnosticInfo/GetEventFreezeFrameData, queue-length=1
          operation=DiagnosticInfo/GetEventFreezeFrameDataEx, queue-length=1
      EvtInfo_DemEventParameter_ECU4_DTC19: provided-interface=DiagnosticInfo
        provided-com-specs:
          operation=DiagnosticInfo/GetEventStatus, queue-length=1
          operation=DiagnosticInfo/GetEventFailed, queue-length=1
          operation=DiagnosticInfo/GetEventTested, queue-length=1
          operation=DiagnosticInfo/GetDTCOfEvent, queue-length=1
          operation=DiagnosticInfo/GetDebouncingOfEvent, queue-length=1
          operation=DiagnosticInfo/GetFaultDetectionCounter, queue-length=1
          operation=DiagnosticInfo/GetEventExtendedDataRecord, queue-length=1
          operation=DiagnosticInfo/GetEventExtendedDataRecordEx, queue-length=1
          operation=DiagnosticInfo/GetEventFreezeFrameData, queue-length=1
          operation=DiagnosticInfo/GetEventFreezeFrameDataEx, queue-length=1
      EvtInfo_DemEventParameter_ECU4_DTC20: provided-interface=DiagnosticInfo
        provided-com-specs:
          operation=DiagnosticInfo/GetEventStatus, queue-length=1
          operation=DiagnosticInfo/GetEventFailed, queue-length=1
          operation=DiagnosticInfo/GetEventTested, queue-length=1
          operation=DiagnosticInfo/GetDTCOfEvent, queue-length=1
          operation=DiagnosticInfo/GetDebouncingOfEvent, queue-length=1
          operation=DiagnosticInfo/GetFaultDetectionCounter, queue-length=1
          operation=DiagnosticInfo/GetEventExtendedDataRecord, queue-length=1
          operation=DiagnosticInfo/GetEventExtendedDataRecordEx, queue-length=1
          operation=DiagnosticInfo/GetEventFreezeFrameData, queue-length=1
          operation=DiagnosticInfo/GetEventFreezeFrameDataEx, queue-length=1
      EvtInfo_DemEventParameter_ECU4_DTC21: provided-interface=DiagnosticInfo
        provided-com-specs:
          operation=DiagnosticInfo/GetEventStatus, queue-length=1
          operation=DiagnosticInfo/GetEventFailed, queue-length=1
          operation=DiagnosticInfo/GetEventTested, queue-length=1
          operation=DiagnosticInfo/GetDTCOfEvent, queue-length=1
          operation=DiagnosticInfo/GetDebouncingOfEvent, queue-length=1
          operation=DiagnosticInfo/GetFaultDetectionCounter, queue-length=1
          operation=DiagnosticInfo/GetEventExtendedDataRecord, queue-length=1
          operation=DiagnosticInfo/GetEventExtendedDataRecordEx, queue-length=1
          operation=DiagnosticInfo/GetEventFreezeFrameData, queue-length=1
          operation=DiagnosticInfo/GetEventFreezeFrameDataEx, queue-length=1
      EvtInfo_DemEventParameter_ECU4_DTC22: provided-interface=DiagnosticInfo
        provided-com-specs:
          operation=DiagnosticInfo/GetEventStatus, queue-length=1
          operation=DiagnosticInfo/GetEventFailed, queue-length=1
          operation=DiagnosticInfo/GetEventTested, queue-length=1
          operation=DiagnosticInfo/GetDTCOfEvent, queue-length=1
          operation=DiagnosticInfo/GetDebouncingOfEvent, queue-length=1
          operation=DiagnosticInfo/GetFaultDetectionCounter, queue-length=1
          operation=DiagnosticInfo/GetEventExtendedDataRecord, queue-length=1
          operation=DiagnosticInfo/GetEventExtendedDataRecordEx, queue-length=1
          operation=DiagnosticInfo/GetEventFreezeFrameData, queue-length=1
          operation=DiagnosticInfo/GetEventFreezeFrameDataEx, queue-length=1
      EvtInfo_DemEventParameter_ECU4_DTC23: provided-interface=DiagnosticInfo
        provided-com-specs:
          operation=DiagnosticInfo/GetEventStatus, queue-length=1
          operation=DiagnosticInfo/GetEventFailed, queue-length=1
          operation=DiagnosticInfo/GetEventTested, queue-length=1
          operation=DiagnosticInfo/GetDTCOfEvent, queue-length=1
          operation=DiagnosticInfo/GetDebouncingOfEvent, queue-length=1
          operation=DiagnosticInfo/GetFaultDetectionCounter, queue-length=1
          operation=DiagnosticInfo/GetEventExtendedDataRecord, queue-length=1
          operation=DiagnosticInfo/GetEventExtendedDataRecordEx, queue-length=1
          operation=DiagnosticInfo/GetEventFreezeFrameData, queue-length=1
          operation=DiagnosticInfo/GetEventFreezeFrameDataEx, queue-length=1
      EvtInfo_DemEventParameter_ECU4_DTC24: provided-interface=DiagnosticInfo
        provided-com-specs:
          operation=DiagnosticInfo/GetEventStatus, queue-length=1
          operation=DiagnosticInfo/GetEventFailed, queue-length=1
          operation=DiagnosticInfo/GetEventTested, queue-length=1
          operation=DiagnosticInfo/GetDTCOfEvent, queue-length=1
          operation=DiagnosticInfo/GetDebouncingOfEvent, queue-length=1
          operation=DiagnosticInfo/GetFaultDetectionCounter, queue-length=1
          operation=DiagnosticInfo/GetEventExtendedDataRecord, queue-length=1
          operation=DiagnosticInfo/GetEventExtendedDataRecordEx, queue-length=1
          operation=DiagnosticInfo/GetEventFreezeFrameData, queue-length=1
          operation=DiagnosticInfo/GetEventFreezeFrameDataEx, queue-length=1
      EvtInfo_DemEventParameter_ECU4_DTC25: provided-interface=DiagnosticInfo
        provided-com-specs:
          operation=DiagnosticInfo/GetEventStatus, queue-length=1
          operation=DiagnosticInfo/GetEventFailed, queue-length=1
          operation=DiagnosticInfo/GetEventTested, queue-length=1
          operation=DiagnosticInfo/GetDTCOfEvent, queue-length=1
          operation=DiagnosticInfo/GetDebouncingOfEvent, queue-length=1
          operation=DiagnosticInfo/GetFaultDetectionCounter, queue-length=1
          operation=DiagnosticInfo/GetEventExtendedDataRecord, queue-length=1
          operation=DiagnosticInfo/GetEventExtendedDataRecordEx, queue-length=1
          operation=DiagnosticInfo/GetEventFreezeFrameData, queue-length=1
          operation=DiagnosticInfo/GetEventFreezeFrameDataEx, queue-length=1
      EvtInfo_DemEventParameter_ECU4_DTC26: provided-interface=DiagnosticInfo
        provided-com-specs:
          operation=DiagnosticInfo/GetEventStatus, queue-length=1
          operation=DiagnosticInfo/GetEventFailed, queue-length=1
          operation=DiagnosticInfo/GetEventTested, queue-length=1
          operation=DiagnosticInfo/GetDTCOfEvent, queue-length=1
          operation=DiagnosticInfo/GetDebouncingOfEvent, queue-length=1
          operation=DiagnosticInfo/GetFaultDetectionCounter, queue-length=1
          operation=DiagnosticInfo/GetEventExtendedDataRecord, queue-length=1
          operation=DiagnosticInfo/GetEventExtendedDataRecordEx, queue-length=1
          operation=DiagnosticInfo/GetEventFreezeFrameData, queue-length=1
          operation=DiagnosticInfo/GetEventFreezeFrameDataEx, queue-length=1
      EvtInfo_DemEventParameter_ECU4_DTC27: provided-interface=DiagnosticInfo
        provided-com-specs:
          operation=DiagnosticInfo/GetEventStatus, queue-length=1
          operation=DiagnosticInfo/GetEventFailed, queue-length=1
          operation=DiagnosticInfo/GetEventTested, queue-length=1
          operation=DiagnosticInfo/GetDTCOfEvent, queue-length=1
          operation=DiagnosticInfo/GetDebouncingOfEvent, queue-length=1
          operation=DiagnosticInfo/GetFaultDetectionCounter, queue-length=1
          operation=DiagnosticInfo/GetEventExtendedDataRecord, queue-length=1
          operation=DiagnosticInfo/GetEventExtendedDataRecordEx, queue-length=1
          operation=DiagnosticInfo/GetEventFreezeFrameData, queue-length=1
          operation=DiagnosticInfo/GetEventFreezeFrameDataEx, queue-length=1
      EvtInfo_DemEventParameter_ECU4_DTC28: provided-interface=DiagnosticInfo
        provided-com-specs:
          operation=DiagnosticInfo/GetEventStatus, queue-length=1
          operation=DiagnosticInfo/GetEventFailed, queue-length=1
          operation=DiagnosticInfo/GetEventTested, queue-length=1
          operation=DiagnosticInfo/GetDTCOfEvent, queue-length=1
          operation=DiagnosticInfo/GetDebouncingOfEvent, queue-length=1
          operation=DiagnosticInfo/GetFaultDetectionCounter, queue-length=1
          operation=DiagnosticInfo/GetEventExtendedDataRecord, queue-length=1
          operation=DiagnosticInfo/GetEventExtendedDataRecordEx, queue-length=1
          operation=DiagnosticInfo/GetEventFreezeFrameData, queue-length=1
          operation=DiagnosticInfo/GetEventFreezeFrameDataEx, queue-length=1
      EvtInfo_DemEventParameter_ECU4_DTC29: provided-interface=DiagnosticInfo
        provided-com-specs:
          operation=DiagnosticInfo/GetEventStatus, queue-length=1
          operation=DiagnosticInfo/GetEventFailed, queue-length=1
          operation=DiagnosticInfo/GetEventTested, queue-length=1
          operation=DiagnosticInfo/GetDTCOfEvent, queue-length=1
          operation=DiagnosticInfo/GetDebouncingOfEvent, queue-length=1
          operation=DiagnosticInfo/GetFaultDetectionCounter, queue-length=1
          operation=DiagnosticInfo/GetEventExtendedDataRecord, queue-length=1
          operation=DiagnosticInfo/GetEventExtendedDataRecordEx, queue-length=1
          operation=DiagnosticInfo/GetEventFreezeFrameData, queue-length=1
          operation=DiagnosticInfo/GetEventFreezeFrameDataEx, queue-length=1
      EvtInfo_DemEventParameter_ECU4_DTC30: provided-interface=DiagnosticInfo
        provided-com-specs:
          operation=DiagnosticInfo/GetEventStatus, queue-length=1
          operation=DiagnosticInfo/GetEventFailed, queue-length=1
          operation=DiagnosticInfo/GetEventTested, queue-length=1
          operation=DiagnosticInfo/GetDTCOfEvent, queue-length=1
          operation=DiagnosticInfo/GetDebouncingOfEvent, queue-length=1
          operation=DiagnosticInfo/GetFaultDetectionCounter, queue-length=1
          operation=DiagnosticInfo/GetEventExtendedDataRecord, queue-length=1
          operation=DiagnosticInfo/GetEventExtendedDataRecordEx, queue-length=1
          operation=DiagnosticInfo/GetEventFreezeFrameData, queue-length=1
          operation=DiagnosticInfo/GetEventFreezeFrameDataEx, queue-length=1
      EvtInfo_DemEventParameter_ECU4_DTC31: provided-interface=DiagnosticInfo
        provided-com-specs:
          operation=DiagnosticInfo/GetEventStatus, queue-length=1
          operation=DiagnosticInfo/GetEventFailed, queue-length=1
          operation=DiagnosticInfo/GetEventTested, queue-length=1
          operation=DiagnosticInfo/GetDTCOfEvent, queue-length=1
          operation=DiagnosticInfo/GetDebouncingOfEvent, queue-length=1
          operation=DiagnosticInfo/GetFaultDetectionCounter, queue-length=1
          operation=DiagnosticInfo/GetEventExtendedDataRecord, queue-length=1
          operation=DiagnosticInfo/GetEventExtendedDataRecordEx, queue-length=1
          operation=DiagnosticInfo/GetEventFreezeFrameData, queue-length=1
          operation=DiagnosticInfo/GetEventFreezeFrameDataEx, queue-length=1
      EvtInfo_DemEventParameter_ECU4_DTC32: provided-interface=DiagnosticInfo
        provided-com-specs:
          operation=DiagnosticInfo/GetEventStatus, queue-length=1
          operation=DiagnosticInfo/GetEventFailed, queue-length=1
          operation=DiagnosticInfo/GetEventTested, queue-length=1
          operation=DiagnosticInfo/GetDTCOfEvent, queue-length=1
          operation=DiagnosticInfo/GetDebouncingOfEvent, queue-length=1
          operation=DiagnosticInfo/GetFaultDetectionCounter, queue-length=1
          operation=DiagnosticInfo/GetEventExtendedDataRecord, queue-length=1
          operation=DiagnosticInfo/GetEventExtendedDataRecordEx, queue-length=1
          operation=DiagnosticInfo/GetEventFreezeFrameData, queue-length=1
          operation=DiagnosticInfo/GetEventFreezeFrameDataEx, queue-length=1
      EvtInfo_DemEventParameter_ECU4_DTC33: provided-interface=DiagnosticInfo
        provided-com-specs:
          operation=DiagnosticInfo/GetEventStatus, queue-length=1
          operation=DiagnosticInfo/GetEventFailed, queue-length=1
          operation=DiagnosticInfo/GetEventTested, queue-length=1
          operation=DiagnosticInfo/GetDTCOfEvent, queue-length=1
          operation=DiagnosticInfo/GetDebouncingOfEvent, queue-length=1
          operation=DiagnosticInfo/GetFaultDetectionCounter, queue-length=1
          operation=DiagnosticInfo/GetEventExtendedDataRecord, queue-length=1
          operation=DiagnosticInfo/GetEventExtendedDataRecordEx, queue-length=1
          operation=DiagnosticInfo/GetEventFreezeFrameData, queue-length=1
          operation=DiagnosticInfo/GetEventFreezeFrameDataEx, queue-length=1
      EvtInfo_DemEventParameter_ECU4_DTC34: provided-interface=DiagnosticInfo
        provided-com-specs:
          operation=DiagnosticInfo/GetEventStatus, queue-length=1
          operation=DiagnosticInfo/GetEventFailed, queue-length=1
          operation=DiagnosticInfo/GetEventTested, queue-length=1
          operation=DiagnosticInfo/GetDTCOfEvent, queue-length=1
          operation=DiagnosticInfo/GetDebouncingOfEvent, queue-length=1
          operation=DiagnosticInfo/GetFaultDetectionCounter, queue-length=1
          operation=DiagnosticInfo/GetEventExtendedDataRecord, queue-length=1
          operation=DiagnosticInfo/GetEventExtendedDataRecordEx, queue-length=1
          operation=DiagnosticInfo/GetEventFreezeFrameData, queue-length=1
          operation=DiagnosticInfo/GetEventFreezeFrameDataEx, queue-length=1
      EvtInfo_DemEventParameter_ECU4_DTC35: provided-interface=DiagnosticInfo
        provided-com-specs:
          operation=DiagnosticInfo/GetEventStatus, queue-length=1
          operation=DiagnosticInfo/GetEventFailed, queue-length=1
          operation=DiagnosticInfo/GetEventTested, queue-length=1
          operation=DiagnosticInfo/GetDTCOfEvent, queue-length=1
          operation=DiagnosticInfo/GetDebouncingOfEvent, queue-length=1
          operation=DiagnosticInfo/GetFaultDetectionCounter, queue-length=1
          operation=DiagnosticInfo/GetEventExtendedDataRecord, queue-length=1
          operation=DiagnosticInfo/GetEventExtendedDataRecordEx, queue-length=1
          operation=DiagnosticInfo/GetEventFreezeFrameData, queue-length=1
          operation=DiagnosticInfo/GetEventFreezeFrameDataEx, queue-length=1
      EvtInfo_DemEventParameter_ECU4_DTC36: provided-interface=DiagnosticInfo
        provided-com-specs:
          operation=DiagnosticInfo/GetEventStatus, queue-length=1
          operation=DiagnosticInfo/GetEventFailed, queue-length=1
          operation=DiagnosticInfo/GetEventTested, queue-length=1
          operation=DiagnosticInfo/GetDTCOfEvent, queue-length=1
          operation=DiagnosticInfo/GetDebouncingOfEvent, queue-length=1
          operation=DiagnosticInfo/GetFaultDetectionCounter, queue-length=1
          operation=DiagnosticInfo/GetEventExtendedDataRecord, queue-length=1
          operation=DiagnosticInfo/GetEventExtendedDataRecordEx, queue-length=1
          operation=DiagnosticInfo/GetEventFreezeFrameData, queue-length=1
          operation=DiagnosticInfo/GetEventFreezeFrameDataEx, queue-length=1
      EvtInfo_DemEventParameter_ECU4_DTC37: provided-interface=DiagnosticInfo
        provided-com-specs:
          operation=DiagnosticInfo/GetEventStatus, queue-length=1
          operation=DiagnosticInfo/GetEventFailed, queue-length=1
          operation=DiagnosticInfo/GetEventTested, queue-length=1
          operation=DiagnosticInfo/GetDTCOfEvent, queue-length=1
          operation=DiagnosticInfo/GetDebouncingOfEvent, queue-length=1
          operation=DiagnosticInfo/GetFaultDetectionCounter, queue-length=1
          operation=DiagnosticInfo/GetEventExtendedDataRecord, queue-length=1
          operation=DiagnosticInfo/GetEventExtendedDataRecordEx, queue-length=1
          operation=DiagnosticInfo/GetEventFreezeFrameData, queue-length=1
          operation=DiagnosticInfo/GetEventFreezeFrameDataEx, queue-length=1
      EvtInfo_DemEventParameter_ECU4_DTC38: provided-interface=DiagnosticInfo
        provided-com-specs:
          operation=DiagnosticInfo/GetEventStatus, queue-length=1
          operation=DiagnosticInfo/GetEventFailed, queue-length=1
          operation=DiagnosticInfo/GetEventTested, queue-length=1
          operation=DiagnosticInfo/GetDTCOfEvent, queue-length=1
          operation=DiagnosticInfo/GetDebouncingOfEvent, queue-length=1
          operation=DiagnosticInfo/GetFaultDetectionCounter, queue-length=1
          operation=DiagnosticInfo/GetEventExtendedDataRecord, queue-length=1
          operation=DiagnosticInfo/GetEventExtendedDataRecordEx, queue-length=1
          operation=DiagnosticInfo/GetEventFreezeFrameData, queue-length=1
          operation=DiagnosticInfo/GetEventFreezeFrameDataEx, queue-length=1
      EvtInfo_DemEventParameter_ECU4_DTC39: provided-interface=DiagnosticInfo
        provided-com-specs:
          operation=DiagnosticInfo/GetEventStatus, queue-length=1
          operation=DiagnosticInfo/GetEventFailed, queue-length=1
          operation=DiagnosticInfo/GetEventTested, queue-length=1
          operation=DiagnosticInfo/GetDTCOfEvent, queue-length=1
          operation=DiagnosticInfo/GetDebouncingOfEvent, queue-length=1
          operation=DiagnosticInfo/GetFaultDetectionCounter, queue-length=1
          operation=DiagnosticInfo/GetEventExtendedDataRecord, queue-length=1
          operation=DiagnosticInfo/GetEventExtendedDataRecordEx, queue-length=1
          operation=DiagnosticInfo/GetEventFreezeFrameData, queue-length=1
          operation=DiagnosticInfo/GetEventFreezeFrameDataEx, queue-length=1
      EvtInfo_DemEventParameter_ECU4_DTC40: provided-interface=DiagnosticInfo
        provided-com-specs:
          operation=DiagnosticInfo/GetEventStatus, queue-length=1
          operation=DiagnosticInfo/GetEventFailed, queue-length=1
          operation=DiagnosticInfo/GetEventTested, queue-length=1
          operation=DiagnosticInfo/GetDTCOfEvent, queue-length=1
          operation=DiagnosticInfo/GetDebouncingOfEvent, queue-length=1
          operation=DiagnosticInfo/GetFaultDetectionCounter, queue-length=1
          operation=DiagnosticInfo/GetEventExtendedDataRecord, queue-length=1
          operation=DiagnosticInfo/GetEventExtendedDataRecordEx, queue-length=1
          operation=DiagnosticInfo/GetEventFreezeFrameData, queue-length=1
          operation=DiagnosticInfo/GetEventFreezeFrameDataEx, queue-length=1
      EvtInfo_DemEventParameter_ECU4_DTC41: provided-interface=DiagnosticInfo
        provided-com-specs:
          operation=DiagnosticInfo/GetEventStatus, queue-length=1
          operation=DiagnosticInfo/GetEventFailed, queue-length=1
          operation=DiagnosticInfo/GetEventTested, queue-length=1
          operation=DiagnosticInfo/GetDTCOfEvent, queue-length=1
          operation=DiagnosticInfo/GetDebouncingOfEvent, queue-length=1
          operation=DiagnosticInfo/GetFaultDetectionCounter, queue-length=1
          operation=DiagnosticInfo/GetEventExtendedDataRecord, queue-length=1
          operation=DiagnosticInfo/GetEventExtendedDataRecordEx, queue-length=1
          operation=DiagnosticInfo/GetEventFreezeFrameData, queue-length=1
          operation=DiagnosticInfo/GetEventFreezeFrameDataEx, queue-length=1
      EvtInfo_DemEventParameter_ECU4_DTC42: provided-interface=DiagnosticInfo
        provided-com-specs:
          operation=DiagnosticInfo/GetEventStatus, queue-length=1
          operation=DiagnosticInfo/GetEventFailed, queue-length=1
          operation=DiagnosticInfo/GetEventTested, queue-length=1
          operation=DiagnosticInfo/GetDTCOfEvent, queue-length=1
          operation=DiagnosticInfo/GetDebouncingOfEvent, queue-length=1
          operation=DiagnosticInfo/GetFaultDetectionCounter, queue-length=1
          operation=DiagnosticInfo/GetEventExtendedDataRecord, queue-length=1
          operation=DiagnosticInfo/GetEventExtendedDataRecordEx, queue-length=1
          operation=DiagnosticInfo/GetEventFreezeFrameData, queue-length=1
          operation=DiagnosticInfo/GetEventFreezeFrameDataEx, queue-length=1
      EvtInfo_DemEventParameter_ECU4_DTC43: provided-interface=DiagnosticInfo
        provided-com-specs:
          operation=DiagnosticInfo/GetEventStatus, queue-length=1
          operation=DiagnosticInfo/GetEventFailed, queue-length=1
          operation=DiagnosticInfo/GetEventTested, queue-length=1
          operation=DiagnosticInfo/GetDTCOfEvent, queue-length=1
          operation=DiagnosticInfo/GetDebouncingOfEvent, queue-length=1
          operation=DiagnosticInfo/GetFaultDetectionCounter, queue-length=1
          operation=DiagnosticInfo/GetEventExtendedDataRecord, queue-length=1
          operation=DiagnosticInfo/GetEventExtendedDataRecordEx, queue-length=1
          operation=DiagnosticInfo/GetEventFreezeFrameData, queue-length=1
          operation=DiagnosticInfo/GetEventFreezeFrameDataEx, queue-length=1
      EvtInfo_DemEventParameter_ECU4_DTC44: provided-interface=DiagnosticInfo
        provided-com-specs:
          operation=DiagnosticInfo/GetEventStatus, queue-length=1
          operation=DiagnosticInfo/GetEventFailed, queue-length=1
          operation=DiagnosticInfo/GetEventTested, queue-length=1
          operation=DiagnosticInfo/GetDTCOfEvent, queue-length=1
          operation=DiagnosticInfo/GetDebouncingOfEvent, queue-length=1
          operation=DiagnosticInfo/GetFaultDetectionCounter, queue-length=1
          operation=DiagnosticInfo/GetEventExtendedDataRecord, queue-length=1
          operation=DiagnosticInfo/GetEventExtendedDataRecordEx, queue-length=1
          operation=DiagnosticInfo/GetEventFreezeFrameData, queue-length=1
          operation=DiagnosticInfo/GetEventFreezeFrameDataEx, queue-length=1
      EvtInfo_DemEventParameter_ECU4_DTC45: provided-interface=DiagnosticInfo
        provided-com-specs:
          operation=DiagnosticInfo/GetEventStatus, queue-length=1
          operation=DiagnosticInfo/GetEventFailed, queue-length=1
          operation=DiagnosticInfo/GetEventTested, queue-length=1
          operation=DiagnosticInfo/GetDTCOfEvent, queue-length=1
          operation=DiagnosticInfo/GetDebouncingOfEvent, queue-length=1
          operation=DiagnosticInfo/GetFaultDetectionCounter, queue-length=1
          operation=DiagnosticInfo/GetEventExtendedDataRecord, queue-length=1
          operation=DiagnosticInfo/GetEventExtendedDataRecordEx, queue-length=1
          operation=DiagnosticInfo/GetEventFreezeFrameData, queue-length=1
          operation=DiagnosticInfo/GetEventFreezeFrameDataEx, queue-length=1
      EvtInfo_DemEventParameter_ECU4_DTC46: provided-interface=DiagnosticInfo
        provided-com-specs:
          operation=DiagnosticInfo/GetEventStatus, queue-length=1
          operation=DiagnosticInfo/GetEventFailed, queue-length=1
          operation=DiagnosticInfo/GetEventTested, queue-length=1
          operation=DiagnosticInfo/GetDTCOfEvent, queue-length=1
          operation=DiagnosticInfo/GetDebouncingOfEvent, queue-length=1
          operation=DiagnosticInfo/GetFaultDetectionCounter, queue-length=1
          operation=DiagnosticInfo/GetEventExtendedDataRecord, queue-length=1
          operation=DiagnosticInfo/GetEventExtendedDataRecordEx, queue-length=1
          operation=DiagnosticInfo/GetEventFreezeFrameData, queue-length=1
          operation=DiagnosticInfo/GetEventFreezeFrameDataEx, queue-length=1
      EvtInfo_DemEventParameter_ECU4_DTC47: provided-interface=DiagnosticInfo
        provided-com-specs:
          operation=DiagnosticInfo/GetEventStatus, queue-length=1
          operation=DiagnosticInfo/GetEventFailed, queue-length=1
          operation=DiagnosticInfo/GetEventTested, queue-length=1
          operation=DiagnosticInfo/GetDTCOfEvent, queue-length=1
          operation=DiagnosticInfo/GetDebouncingOfEvent, queue-length=1
          operation=DiagnosticInfo/GetFaultDetectionCounter, queue-length=1
          operation=DiagnosticInfo/GetEventExtendedDataRecord, queue-length=1
          operation=DiagnosticInfo/GetEventExtendedDataRecordEx, queue-length=1
          operation=DiagnosticInfo/GetEventFreezeFrameData, queue-length=1
          operation=DiagnosticInfo/GetEventFreezeFrameDataEx, queue-length=1
      EvtInfo_DemEventParameter_ECU4_DTC48: provided-interface=DiagnosticInfo
        provided-com-specs:
          operation=DiagnosticInfo/GetEventStatus, queue-length=1
          operation=DiagnosticInfo/GetEventFailed, queue-length=1
          operation=DiagnosticInfo/GetEventTested, queue-length=1
          operation=DiagnosticInfo/GetDTCOfEvent, queue-length=1
          operation=DiagnosticInfo/GetDebouncingOfEvent, queue-length=1
          operation=DiagnosticInfo/GetFaultDetectionCounter, queue-length=1
          operation=DiagnosticInfo/GetEventExtendedDataRecord, queue-length=1
          operation=DiagnosticInfo/GetEventExtendedDataRecordEx, queue-length=1
          operation=DiagnosticInfo/GetEventFreezeFrameData, queue-length=1
          operation=DiagnosticInfo/GetEventFreezeFrameDataEx, queue-length=1
      EvtInfo_DemEventParameter_ECU4_DTC49: provided-interface=DiagnosticInfo
        provided-com-specs:
          operation=DiagnosticInfo/GetEventStatus, queue-length=1
          operation=DiagnosticInfo/GetEventFailed, queue-length=1
          operation=DiagnosticInfo/GetEventTested, queue-length=1
          operation=DiagnosticInfo/GetDTCOfEvent, queue-length=1
          operation=DiagnosticInfo/GetDebouncingOfEvent, queue-length=1
          operation=DiagnosticInfo/GetFaultDetectionCounter, queue-length=1
          operation=DiagnosticInfo/GetEventExtendedDataRecord, queue-length=1
          operation=DiagnosticInfo/GetEventExtendedDataRecordEx, queue-length=1
          operation=DiagnosticInfo/GetEventFreezeFrameData, queue-length=1
          operation=DiagnosticInfo/GetEventFreezeFrameDataEx, queue-length=1
      EvtInfo_DemEventParameter_ECU4_DTC50: provided-interface=DiagnosticInfo
        provided-com-specs:
          operation=DiagnosticInfo/GetEventStatus, queue-length=1
          operation=DiagnosticInfo/GetEventFailed, queue-length=1
          operation=DiagnosticInfo/GetEventTested, queue-length=1
          operation=DiagnosticInfo/GetDTCOfEvent, queue-length=1
          operation=DiagnosticInfo/GetDebouncingOfEvent, queue-length=1
          operation=DiagnosticInfo/GetFaultDetectionCounter, queue-length=1
          operation=DiagnosticInfo/GetEventExtendedDataRecord, queue-length=1
          operation=DiagnosticInfo/GetEventExtendedDataRecordEx, queue-length=1
          operation=DiagnosticInfo/GetEventFreezeFrameData, queue-length=1
          operation=DiagnosticInfo/GetEventFreezeFrameDataEx, queue-length=1
      EvtInfo_DemEventParameter_ECU4_DTC51: provided-interface=DiagnosticInfo
        provided-com-specs:
          operation=DiagnosticInfo/GetEventStatus, queue-length=1
          operation=DiagnosticInfo/GetEventFailed, queue-length=1
          operation=DiagnosticInfo/GetEventTested, queue-length=1
          operation=DiagnosticInfo/GetDTCOfEvent, queue-length=1
          operation=DiagnosticInfo/GetDebouncingOfEvent, queue-length=1
          operation=DiagnosticInfo/GetFaultDetectionCounter, queue-length=1
          operation=DiagnosticInfo/GetEventExtendedDataRecord, queue-length=1
          operation=DiagnosticInfo/GetEventExtendedDataRecordEx, queue-length=1
          operation=DiagnosticInfo/GetEventFreezeFrameData, queue-length=1
          operation=DiagnosticInfo/GetEventFreezeFrameDataEx, queue-length=1
      EvtInfo_DemEventParameter_ECU4_DTC52: provided-interface=DiagnosticInfo
        provided-com-specs:
          operation=DiagnosticInfo/GetEventStatus, queue-length=1
          operation=DiagnosticInfo/GetEventFailed, queue-length=1
          operation=DiagnosticInfo/GetEventTested, queue-length=1
          operation=DiagnosticInfo/GetDTCOfEvent, queue-length=1
          operation=DiagnosticInfo/GetDebouncingOfEvent, queue-length=1
          operation=DiagnosticInfo/GetFaultDetectionCounter, queue-length=1
          operation=DiagnosticInfo/GetEventExtendedDataRecord, queue-length=1
          operation=DiagnosticInfo/GetEventExtendedDataRecordEx, queue-length=1
          operation=DiagnosticInfo/GetEventFreezeFrameData, queue-length=1
          operation=DiagnosticInfo/GetEventFreezeFrameDataEx, queue-length=1
      EvtInfo_DemEventParameter_ECU4_DTC53: provided-interface=DiagnosticInfo
        provided-com-specs:
          operation=DiagnosticInfo/GetEventStatus, queue-length=1
          operation=DiagnosticInfo/GetEventFailed, queue-length=1
          operation=DiagnosticInfo/GetEventTested, queue-length=1
          operation=DiagnosticInfo/GetDTCOfEvent, queue-length=1
          operation=DiagnosticInfo/GetDebouncingOfEvent, queue-length=1
          operation=DiagnosticInfo/GetFaultDetectionCounter, queue-length=1
          operation=DiagnosticInfo/GetEventExtendedDataRecord, queue-length=1
          operation=DiagnosticInfo/GetEventExtendedDataRecordEx, queue-length=1
          operation=DiagnosticInfo/GetEventFreezeFrameData, queue-length=1
          operation=DiagnosticInfo/GetEventFreezeFrameDataEx, queue-length=1
      EvtInfo_DemEventParameter_ECU4_DTC54: provided-interface=DiagnosticInfo
        provided-com-specs:
          operation=DiagnosticInfo/GetEventStatus, queue-length=1
          operation=DiagnosticInfo/GetEventFailed, queue-length=1
          operation=DiagnosticInfo/GetEventTested, queue-length=1
          operation=DiagnosticInfo/GetDTCOfEvent, queue-length=1
          operation=DiagnosticInfo/GetDebouncingOfEvent, queue-length=1
          operation=DiagnosticInfo/GetFaultDetectionCounter, queue-length=1
          operation=DiagnosticInfo/GetEventExtendedDataRecord, queue-length=1
          operation=DiagnosticInfo/GetEventExtendedDataRecordEx, queue-length=1
          operation=DiagnosticInfo/GetEventFreezeFrameData, queue-length=1
          operation=DiagnosticInfo/GetEventFreezeFrameDataEx, queue-length=1
      EvtInfo_DemEventParameter_ECU4_DTC55: provided-interface=DiagnosticInfo
        provided-com-specs:
          operation=DiagnosticInfo/GetEventStatus, queue-length=1
          operation=DiagnosticInfo/GetEventFailed, queue-length=1
          operation=DiagnosticInfo/GetEventTested, queue-length=1
          operation=DiagnosticInfo/GetDTCOfEvent, queue-length=1
          operation=DiagnosticInfo/GetDebouncingOfEvent, queue-length=1
          operation=DiagnosticInfo/GetFaultDetectionCounter, queue-length=1
          operation=DiagnosticInfo/GetEventExtendedDataRecord, queue-length=1
          operation=DiagnosticInfo/GetEventExtendedDataRecordEx, queue-length=1
          operation=DiagnosticInfo/GetEventFreezeFrameData, queue-length=1
          operation=DiagnosticInfo/GetEventFreezeFrameDataEx, queue-length=1
      EvtInfo_DemEventParameter_ECU4_DTC56: provided-interface=DiagnosticInfo
        provided-com-specs:
          operation=DiagnosticInfo/GetEventStatus, queue-length=1
          operation=DiagnosticInfo/GetEventFailed, queue-length=1
          operation=DiagnosticInfo/GetEventTested, queue-length=1
          operation=DiagnosticInfo/GetDTCOfEvent, queue-length=1
          operation=DiagnosticInfo/GetDebouncingOfEvent, queue-length=1
          operation=DiagnosticInfo/GetFaultDetectionCounter, queue-length=1
          operation=DiagnosticInfo/GetEventExtendedDataRecord, queue-length=1
          operation=DiagnosticInfo/GetEventExtendedDataRecordEx, queue-length=1
          operation=DiagnosticInfo/GetEventFreezeFrameData, queue-length=1
          operation=DiagnosticInfo/GetEventFreezeFrameDataEx, queue-length=1
      EvtInfo_DemEventParameter_ECU4_DTC57: provided-interface=DiagnosticInfo
        provided-com-specs:
          operation=DiagnosticInfo/GetEventStatus, queue-length=1
          operation=DiagnosticInfo/GetEventFailed, queue-length=1
          operation=DiagnosticInfo/GetEventTested, queue-length=1
          operation=DiagnosticInfo/GetDTCOfEvent, queue-length=1
          operation=DiagnosticInfo/GetDebouncingOfEvent, queue-length=1
          operation=DiagnosticInfo/GetFaultDetectionCounter, queue-length=1
          operation=DiagnosticInfo/GetEventExtendedDataRecord, queue-length=1
          operation=DiagnosticInfo/GetEventExtendedDataRecordEx, queue-length=1
          operation=DiagnosticInfo/GetEventFreezeFrameData, queue-length=1
          operation=DiagnosticInfo/GetEventFreezeFrameDataEx, queue-length=1
      EvtInfo_DemEventParameter_ECU4_DTC58: provided-interface=DiagnosticInfo
        provided-com-specs:
          operation=DiagnosticInfo/GetEventStatus, queue-length=1
          operation=DiagnosticInfo/GetEventFailed, queue-length=1
          operation=DiagnosticInfo/GetEventTested, queue-length=1
          operation=DiagnosticInfo/GetDTCOfEvent, queue-length=1
          operation=DiagnosticInfo/GetDebouncingOfEvent, queue-length=1
          operation=DiagnosticInfo/GetFaultDetectionCounter, queue-length=1
          operation=DiagnosticInfo/GetEventExtendedDataRecord, queue-length=1
          operation=DiagnosticInfo/GetEventExtendedDataRecordEx, queue-length=1
          operation=DiagnosticInfo/GetEventFreezeFrameData, queue-length=1
          operation=DiagnosticInfo/GetEventFreezeFrameDataEx, queue-length=1
      EvtInfo_DemEventParameter_ECU4_DTC59: provided-interface=DiagnosticInfo
        provided-com-specs:
          operation=DiagnosticInfo/GetEventStatus, queue-length=1
          operation=DiagnosticInfo/GetEventFailed, queue-length=1
          operation=DiagnosticInfo/GetEventTested, queue-length=1
          operation=DiagnosticInfo/GetDTCOfEvent, queue-length=1
          operation=DiagnosticInfo/GetDebouncingOfEvent, queue-length=1
          operation=DiagnosticInfo/GetFaultDetectionCounter, queue-length=1
          operation=DiagnosticInfo/GetEventExtendedDataRecord, queue-length=1
          operation=DiagnosticInfo/GetEventExtendedDataRecordEx, queue-length=1
          operation=DiagnosticInfo/GetEventFreezeFrameData, queue-length=1
          operation=DiagnosticInfo/GetEventFreezeFrameDataEx, queue-length=1
      EvtInfo_DemEventParameter_ECU4_DTC60: provided-interface=DiagnosticInfo
        provided-com-specs:
          operation=DiagnosticInfo/GetEventStatus, queue-length=1
          operation=DiagnosticInfo/GetEventFailed, queue-length=1
          operation=DiagnosticInfo/GetEventTested, queue-length=1
          operation=DiagnosticInfo/GetDTCOfEvent, queue-length=1
          operation=DiagnosticInfo/GetDebouncingOfEvent, queue-length=1
          operation=DiagnosticInfo/GetFaultDetectionCounter, queue-length=1
          operation=DiagnosticInfo/GetEventExtendedDataRecord, queue-length=1
          operation=DiagnosticInfo/GetEventExtendedDataRecordEx, queue-length=1
          operation=DiagnosticInfo/GetEventFreezeFrameData, queue-length=1
          operation=DiagnosticInfo/GetEventFreezeFrameDataEx, queue-length=1
      EvtInfo_DemEventParameter_ECU4_DTC61: provided-interface=DiagnosticInfo
        provided-com-specs:
          operation=DiagnosticInfo/GetEventStatus, queue-length=1
          operation=DiagnosticInfo/GetEventFailed, queue-length=1
          operation=DiagnosticInfo/GetEventTested, queue-length=1
          operation=DiagnosticInfo/GetDTCOfEvent, queue-length=1
          operation=DiagnosticInfo/GetDebouncingOfEvent, queue-length=1
          operation=DiagnosticInfo/GetFaultDetectionCounter, queue-length=1
          operation=DiagnosticInfo/GetEventExtendedDataRecord, queue-length=1
          operation=DiagnosticInfo/GetEventExtendedDataRecordEx, queue-length=1
          operation=DiagnosticInfo/GetEventFreezeFrameData, queue-length=1
          operation=DiagnosticInfo/GetEventFreezeFrameDataEx, queue-length=1
      EvtInfo_DemEventParameter_ECU4_DTC62: provided-interface=DiagnosticInfo
        provided-com-specs:
          operation=DiagnosticInfo/GetEventStatus, queue-length=1
          operation=DiagnosticInfo/GetEventFailed, queue-length=1
          operation=DiagnosticInfo/GetEventTested, queue-length=1
          operation=DiagnosticInfo/GetDTCOfEvent, queue-length=1
          operation=DiagnosticInfo/GetDebouncingOfEvent, queue-length=1
          operation=DiagnosticInfo/GetFaultDetectionCounter, queue-length=1
          operation=DiagnosticInfo/GetEventExtendedDataRecord, queue-length=1
          operation=DiagnosticInfo/GetEventExtendedDataRecordEx, queue-length=1
          operation=DiagnosticInfo/GetEventFreezeFrameData, queue-length=1
          operation=DiagnosticInfo/GetEventFreezeFrameDataEx, queue-length=1
      EvtInfo_DemEventParameter_ECU4_DTC63: provided-interface=DiagnosticInfo
        provided-com-specs:
          operation=DiagnosticInfo/GetEventStatus, queue-length=1
          operation=DiagnosticInfo/GetEventFailed, queue-length=1
          operation=DiagnosticInfo/GetEventTested, queue-length=1
          operation=DiagnosticInfo/GetDTCOfEvent, queue-length=1
          operation=DiagnosticInfo/GetDebouncingOfEvent, queue-length=1
          operation=DiagnosticInfo/GetFaultDetectionCounter, queue-length=1
          operation=DiagnosticInfo/GetEventExtendedDataRecord, queue-length=1
          operation=DiagnosticInfo/GetEventExtendedDataRecordEx, queue-length=1
          operation=DiagnosticInfo/GetEventFreezeFrameData, queue-length=1
          operation=DiagnosticInfo/GetEventFreezeFrameDataEx, queue-length=1
      EvtInfo_DemEventParameter_ECU4_DTC64: provided-interface=DiagnosticInfo
        provided-com-specs:
          operation=DiagnosticInfo/GetEventStatus, queue-length=1
          operation=DiagnosticInfo/GetEventFailed, queue-length=1
          operation=DiagnosticInfo/GetEventTested, queue-length=1
          operation=DiagnosticInfo/GetDTCOfEvent, queue-length=1
          operation=DiagnosticInfo/GetDebouncingOfEvent, queue-length=1
          operation=DiagnosticInfo/GetFaultDetectionCounter, queue-length=1
          operation=DiagnosticInfo/GetEventExtendedDataRecord, queue-length=1
          operation=DiagnosticInfo/GetEventExtendedDataRecordEx, queue-length=1
          operation=DiagnosticInfo/GetEventFreezeFrameData, queue-length=1
          operation=DiagnosticInfo/GetEventFreezeFrameDataEx, queue-length=1
      EvtInfo_DemEventParameter_ECU4_DTC65: provided-interface=DiagnosticInfo
        provided-com-specs:
          operation=DiagnosticInfo/GetEventStatus, queue-length=1
          operation=DiagnosticInfo/GetEventFailed, queue-length=1
          operation=DiagnosticInfo/GetEventTested, queue-length=1
          operation=DiagnosticInfo/GetDTCOfEvent, queue-length=1
          operation=DiagnosticInfo/GetDebouncingOfEvent, queue-length=1
          operation=DiagnosticInfo/GetFaultDetectionCounter, queue-length=1
          operation=DiagnosticInfo/GetEventExtendedDataRecord, queue-length=1
          operation=DiagnosticInfo/GetEventExtendedDataRecordEx, queue-length=1
          operation=DiagnosticInfo/GetEventFreezeFrameData, queue-length=1
          operation=DiagnosticInfo/GetEventFreezeFrameDataEx, queue-length=1
      EvtInfo_DemEventParameter_ECU4_DTC66: provided-interface=DiagnosticInfo
        provided-com-specs:
          operation=DiagnosticInfo/GetEventStatus, queue-length=1
          operation=DiagnosticInfo/GetEventFailed, queue-length=1
          operation=DiagnosticInfo/GetEventTested, queue-length=1
          operation=DiagnosticInfo/GetDTCOfEvent, queue-length=1
          operation=DiagnosticInfo/GetDebouncingOfEvent, queue-length=1
          operation=DiagnosticInfo/GetFaultDetectionCounter, queue-length=1
          operation=DiagnosticInfo/GetEventExtendedDataRecord, queue-length=1
          operation=DiagnosticInfo/GetEventExtendedDataRecordEx, queue-length=1
          operation=DiagnosticInfo/GetEventFreezeFrameData, queue-length=1
          operation=DiagnosticInfo/GetEventFreezeFrameDataEx, queue-length=1
      EvtInfo_DemEventParameter_ECU4_DTC67: provided-interface=DiagnosticInfo
        provided-com-specs:
          operation=DiagnosticInfo/GetEventStatus, queue-length=1
          operation=DiagnosticInfo/GetEventFailed, queue-length=1
          operation=DiagnosticInfo/GetEventTested, queue-length=1
          operation=DiagnosticInfo/GetDTCOfEvent, queue-length=1
          operation=DiagnosticInfo/GetDebouncingOfEvent, queue-length=1
          operation=DiagnosticInfo/GetFaultDetectionCounter, queue-length=1
          operation=DiagnosticInfo/GetEventExtendedDataRecord, queue-length=1
          operation=DiagnosticInfo/GetEventExtendedDataRecordEx, queue-length=1
          operation=DiagnosticInfo/GetEventFreezeFrameData, queue-length=1
          operation=DiagnosticInfo/GetEventFreezeFrameDataEx, queue-length=1
      EvtInfo_DemEventParameter_ECU4_DTC68: provided-interface=DiagnosticInfo
        provided-com-specs:
          operation=DiagnosticInfo/GetEventStatus, queue-length=1
          operation=DiagnosticInfo/GetEventFailed, queue-length=1
          operation=DiagnosticInfo/GetEventTested, queue-length=1
          operation=DiagnosticInfo/GetDTCOfEvent, queue-length=1
          operation=DiagnosticInfo/GetDebouncingOfEvent, queue-length=1
          operation=DiagnosticInfo/GetFaultDetectionCounter, queue-length=1
          operation=DiagnosticInfo/GetEventExtendedDataRecord, queue-length=1
          operation=DiagnosticInfo/GetEventExtendedDataRecordEx, queue-length=1
          operation=DiagnosticInfo/GetEventFreezeFrameData, queue-length=1
          operation=DiagnosticInfo/GetEventFreezeFrameDataEx, queue-length=1
      EvtInfo_DemEventParameter_ECU4_DTC69: provided-interface=DiagnosticInfo
        provided-com-specs:
          operation=DiagnosticInfo/GetEventStatus, queue-length=1
          operation=DiagnosticInfo/GetEventFailed, queue-length=1
          operation=DiagnosticInfo/GetEventTested, queue-length=1
          operation=DiagnosticInfo/GetDTCOfEvent, queue-length=1
          operation=DiagnosticInfo/GetDebouncingOfEvent, queue-length=1
          operation=DiagnosticInfo/GetFaultDetectionCounter, queue-length=1
          operation=DiagnosticInfo/GetEventExtendedDataRecord, queue-length=1
          operation=DiagnosticInfo/GetEventExtendedDataRecordEx, queue-length=1
          operation=DiagnosticInfo/GetEventFreezeFrameData, queue-length=1
          operation=DiagnosticInfo/GetEventFreezeFrameDataEx, queue-length=1
      EvtInfo_DemEventParameter_ECU4_DTC70: provided-interface=DiagnosticInfo
        provided-com-specs:
          operation=DiagnosticInfo/GetEventStatus, queue-length=1
          operation=DiagnosticInfo/GetEventFailed, queue-length=1
          operation=DiagnosticInfo/GetEventTested, queue-length=1
          operation=DiagnosticInfo/GetDTCOfEvent, queue-length=1
          operation=DiagnosticInfo/GetDebouncingOfEvent, queue-length=1
          operation=DiagnosticInfo/GetFaultDetectionCounter, queue-length=1
          operation=DiagnosticInfo/GetEventExtendedDataRecord, queue-length=1
          operation=DiagnosticInfo/GetEventExtendedDataRecordEx, queue-length=1
          operation=DiagnosticInfo/GetEventFreezeFrameData, queue-length=1
          operation=DiagnosticInfo/GetEventFreezeFrameDataEx, queue-length=1
      EvtInfo_DemEventParameter_ECU4_DTC71: provided-interface=DiagnosticInfo
        provided-com-specs:
          operation=DiagnosticInfo/GetEventStatus, queue-length=1
          operation=DiagnosticInfo/GetEventFailed, queue-length=1
          operation=DiagnosticInfo/GetEventTested, queue-length=1
          operation=DiagnosticInfo/GetDTCOfEvent, queue-length=1
          operation=DiagnosticInfo/GetDebouncingOfEvent, queue-length=1
          operation=DiagnosticInfo/GetFaultDetectionCounter, queue-length=1
          operation=DiagnosticInfo/GetEventExtendedDataRecord, queue-length=1
          operation=DiagnosticInfo/GetEventExtendedDataRecordEx, queue-length=1
          operation=DiagnosticInfo/GetEventFreezeFrameData, queue-length=1
          operation=DiagnosticInfo/GetEventFreezeFrameDataEx, queue-length=1
      EvtInfo_DemEventParameter_ECU4_DTC72: provided-interface=DiagnosticInfo
        provided-com-specs:
          operation=DiagnosticInfo/GetEventStatus, queue-length=1
          operation=DiagnosticInfo/GetEventFailed, queue-length=1
          operation=DiagnosticInfo/GetEventTested, queue-length=1
          operation=DiagnosticInfo/GetDTCOfEvent, queue-length=1
          operation=DiagnosticInfo/GetDebouncingOfEvent, queue-length=1
          operation=DiagnosticInfo/GetFaultDetectionCounter, queue-length=1
          operation=DiagnosticInfo/GetEventExtendedDataRecord, queue-length=1
          operation=DiagnosticInfo/GetEventExtendedDataRecordEx, queue-length=1
          operation=DiagnosticInfo/GetEventFreezeFrameData, queue-length=1
          operation=DiagnosticInfo/GetEventFreezeFrameDataEx, queue-length=1
      EvtInfo_DemEventParameter_ECU4_DTC73: provided-interface=DiagnosticInfo
        provided-com-specs:
          operation=DiagnosticInfo/GetEventStatus, queue-length=1
          operation=DiagnosticInfo/GetEventFailed, queue-length=1
          operation=DiagnosticInfo/GetEventTested, queue-length=1
          operation=DiagnosticInfo/GetDTCOfEvent, queue-length=1
          operation=DiagnosticInfo/GetDebouncingOfEvent, queue-length=1
          operation=DiagnosticInfo/GetFaultDetectionCounter, queue-length=1
          operation=DiagnosticInfo/GetEventExtendedDataRecord, queue-length=1
          operation=DiagnosticInfo/GetEventExtendedDataRecordEx, queue-length=1
          operation=DiagnosticInfo/GetEventFreezeFrameData, queue-length=1
          operation=DiagnosticInfo/GetEventFreezeFrameDataEx, queue-length=1
      EvtInfo_DemEventParameter_ECU4_DTC74: provided-interface=DiagnosticInfo
        provided-com-specs:
          operation=DiagnosticInfo/GetEventStatus, queue-length=1
          operation=DiagnosticInfo/GetEventFailed, queue-length=1
          operation=DiagnosticInfo/GetEventTested, queue-length=1
          operation=DiagnosticInfo/GetDTCOfEvent, queue-length=1
          operation=DiagnosticInfo/GetDebouncingOfEvent, queue-length=1
          operation=DiagnosticInfo/GetFaultDetectionCounter, queue-length=1
          operation=DiagnosticInfo/GetEventExtendedDataRecord, queue-length=1
          operation=DiagnosticInfo/GetEventExtendedDataRecordEx, queue-length=1
          operation=DiagnosticInfo/GetEventFreezeFrameData, queue-length=1
          operation=DiagnosticInfo/GetEventFreezeFrameDataEx, queue-length=1
      EvtInfo_DemEventParameter_ECU4_DTC75: provided-interface=DiagnosticInfo
        provided-com-specs:
          operation=DiagnosticInfo/GetEventStatus, queue-length=1
          operation=DiagnosticInfo/GetEventFailed, queue-length=1
          operation=DiagnosticInfo/GetEventTested, queue-length=1
          operation=DiagnosticInfo/GetDTCOfEvent, queue-length=1
          operation=DiagnosticInfo/GetDebouncingOfEvent, queue-length=1
          operation=DiagnosticInfo/GetFaultDetectionCounter, queue-length=1
          operation=DiagnosticInfo/GetEventExtendedDataRecord, queue-length=1
          operation=DiagnosticInfo/GetEventExtendedDataRecordEx, queue-length=1
          operation=DiagnosticInfo/GetEventFreezeFrameData, queue-length=1
          operation=DiagnosticInfo/GetEventFreezeFrameDataEx, queue-length=1
      EvtInfo_DemEventParameter_ECU4_DTC76: provided-interface=DiagnosticInfo
        provided-com-specs:
          operation=DiagnosticInfo/GetEventStatus, queue-length=1
          operation=DiagnosticInfo/GetEventFailed, queue-length=1
          operation=DiagnosticInfo/GetEventTested, queue-length=1
          operation=DiagnosticInfo/GetDTCOfEvent, queue-length=1
          operation=DiagnosticInfo/GetDebouncingOfEvent, queue-length=1
          operation=DiagnosticInfo/GetFaultDetectionCounter, queue-length=1
          operation=DiagnosticInfo/GetEventExtendedDataRecord, queue-length=1
          operation=DiagnosticInfo/GetEventExtendedDataRecordEx, queue-length=1
          operation=DiagnosticInfo/GetEventFreezeFrameData, queue-length=1
          operation=DiagnosticInfo/GetEventFreezeFrameDataEx, queue-length=1
      EvtInfo_DemEventParameter_ECU4_DTC77: provided-interface=DiagnosticInfo
        provided-com-specs:
          operation=DiagnosticInfo/GetEventStatus, queue-length=1
          operation=DiagnosticInfo/GetEventFailed, queue-length=1
          operation=DiagnosticInfo/GetEventTested, queue-length=1
          operation=DiagnosticInfo/GetDTCOfEvent, queue-length=1
          operation=DiagnosticInfo/GetDebouncingOfEvent, queue-length=1
          operation=DiagnosticInfo/GetFaultDetectionCounter, queue-length=1
          operation=DiagnosticInfo/GetEventExtendedDataRecord, queue-length=1
          operation=DiagnosticInfo/GetEventExtendedDataRecordEx, queue-length=1
          operation=DiagnosticInfo/GetEventFreezeFrameData, queue-length=1
          operation=DiagnosticInfo/GetEventFreezeFrameDataEx, queue-length=1
      EvtInfo_DemEventParameter_ECU4_DTC78: provided-interface=DiagnosticInfo
        provided-com-specs:
          operation=DiagnosticInfo/GetEventStatus, queue-length=1
          operation=DiagnosticInfo/GetEventFailed, queue-length=1
          operation=DiagnosticInfo/GetEventTested, queue-length=1
          operation=DiagnosticInfo/GetDTCOfEvent, queue-length=1
          operation=DiagnosticInfo/GetDebouncingOfEvent, queue-length=1
          operation=DiagnosticInfo/GetFaultDetectionCounter, queue-length=1
          operation=DiagnosticInfo/GetEventExtendedDataRecord, queue-length=1
          operation=DiagnosticInfo/GetEventExtendedDataRecordEx, queue-length=1
          operation=DiagnosticInfo/GetEventFreezeFrameData, queue-length=1
          operation=DiagnosticInfo/GetEventFreezeFrameDataEx, queue-length=1
      EvtInfo_DemEventParameter_ECU4_DTC79: provided-interface=DiagnosticInfo
        provided-com-specs:
          operation=DiagnosticInfo/GetEventStatus, queue-length=1
          operation=DiagnosticInfo/GetEventFailed, queue-length=1
          operation=DiagnosticInfo/GetEventTested, queue-length=1
          operation=DiagnosticInfo/GetDTCOfEvent, queue-length=1
          operation=DiagnosticInfo/GetDebouncingOfEvent, queue-length=1
          operation=DiagnosticInfo/GetFaultDetectionCounter, queue-length=1
          operation=DiagnosticInfo/GetEventExtendedDataRecord, queue-length=1
          operation=DiagnosticInfo/GetEventExtendedDataRecordEx, queue-length=1
          operation=DiagnosticInfo/GetEventFreezeFrameData, queue-length=1
          operation=DiagnosticInfo/GetEventFreezeFrameDataEx, queue-length=1
      EvtInfo_DemEventParameter_ECU4_DTC80: provided-interface=DiagnosticInfo
        provided-com-specs:
          operation=DiagnosticInfo/GetEventStatus, queue-length=1
          operation=DiagnosticInfo/GetEventFailed, queue-length=1
          operation=DiagnosticInfo/GetEventTested, queue-length=1
          operation=DiagnosticInfo/GetDTCOfEvent, queue-length=1
          operation=DiagnosticInfo/GetDebouncingOfEvent, queue-length=1
          operation=DiagnosticInfo/GetFaultDetectionCounter, queue-length=1
          operation=DiagnosticInfo/GetEventExtendedDataRecord, queue-length=1
          operation=DiagnosticInfo/GetEventExtendedDataRecordEx, queue-length=1
          operation=DiagnosticInfo/GetEventFreezeFrameData, queue-length=1
          operation=DiagnosticInfo/GetEventFreezeFrameDataEx, queue-length=1
      EvtInfo_DemEventParameter_ECU4_DTC81: provided-interface=DiagnosticInfo
        provided-com-specs:
          operation=DiagnosticInfo/GetEventStatus, queue-length=1
          operation=DiagnosticInfo/GetEventFailed, queue-length=1
          operation=DiagnosticInfo/GetEventTested, queue-length=1
          operation=DiagnosticInfo/GetDTCOfEvent, queue-length=1
          operation=DiagnosticInfo/GetDebouncingOfEvent, queue-length=1
          operation=DiagnosticInfo/GetFaultDetectionCounter, queue-length=1
          operation=DiagnosticInfo/GetEventExtendedDataRecord, queue-length=1
          operation=DiagnosticInfo/GetEventExtendedDataRecordEx, queue-length=1
          operation=DiagnosticInfo/GetEventFreezeFrameData, queue-length=1
          operation=DiagnosticInfo/GetEventFreezeFrameDataEx, queue-length=1
      EvtInfo_DemEventParameter_ECU4_DTC82: provided-interface=DiagnosticInfo
        provided-com-specs:
          operation=DiagnosticInfo/GetEventStatus, queue-length=1
          operation=DiagnosticInfo/GetEventFailed, queue-length=1
          operation=DiagnosticInfo/GetEventTested, queue-length=1
          operation=DiagnosticInfo/GetDTCOfEvent, queue-length=1
          operation=DiagnosticInfo/GetDebouncingOfEvent, queue-length=1
          operation=DiagnosticInfo/GetFaultDetectionCounter, queue-length=1
          operation=DiagnosticInfo/GetEventExtendedDataRecord, queue-length=1
          operation=DiagnosticInfo/GetEventExtendedDataRecordEx, queue-length=1
          operation=DiagnosticInfo/GetEventFreezeFrameData, queue-length=1
          operation=DiagnosticInfo/GetEventFreezeFrameDataEx, queue-length=1
      EvtInfo_DemEventParameter_ECU4_DTC83: provided-interface=DiagnosticInfo
        provided-com-specs:
          operation=DiagnosticInfo/GetEventStatus, queue-length=1
          operation=DiagnosticInfo/GetEventFailed, queue-length=1
          operation=DiagnosticInfo/GetEventTested, queue-length=1
          operation=DiagnosticInfo/GetDTCOfEvent, queue-length=1
          operation=DiagnosticInfo/GetDebouncingOfEvent, queue-length=1
          operation=DiagnosticInfo/GetFaultDetectionCounter, queue-length=1
          operation=DiagnosticInfo/GetEventExtendedDataRecord, queue-length=1
          operation=DiagnosticInfo/GetEventExtendedDataRecordEx, queue-length=1
          operation=DiagnosticInfo/GetEventFreezeFrameData, queue-length=1
          operation=DiagnosticInfo/GetEventFreezeFrameDataEx, queue-length=1
      EvtInfo_DemEventParameter_ECU4_DTC84: provided-interface=DiagnosticInfo
        provided-com-specs:
          operation=DiagnosticInfo/GetEventStatus, queue-length=1
          operation=DiagnosticInfo/GetEventFailed, queue-length=1
          operation=DiagnosticInfo/GetEventTested, queue-length=1
          operation=DiagnosticInfo/GetDTCOfEvent, queue-length=1
          operation=DiagnosticInfo/GetDebouncingOfEvent, queue-length=1
          operation=DiagnosticInfo/GetFaultDetectionCounter, queue-length=1
          operation=DiagnosticInfo/GetEventExtendedDataRecord, queue-length=1
          operation=DiagnosticInfo/GetEventExtendedDataRecordEx, queue-length=1
          operation=DiagnosticInfo/GetEventFreezeFrameData, queue-length=1
          operation=DiagnosticInfo/GetEventFreezeFrameDataEx, queue-length=1
      EvtInfo_DemEventParameter_ECU4_DTC85: provided-interface=DiagnosticInfo
        provided-com-specs:
          operation=DiagnosticInfo/GetEventStatus, queue-length=1
          operation=DiagnosticInfo/GetEventFailed, queue-length=1
          operation=DiagnosticInfo/GetEventTested, queue-length=1
          operation=DiagnosticInfo/GetDTCOfEvent, queue-length=1
          operation=DiagnosticInfo/GetDebouncingOfEvent, queue-length=1
          operation=DiagnosticInfo/GetFaultDetectionCounter, queue-length=1
          operation=DiagnosticInfo/GetEventExtendedDataRecord, queue-length=1
          operation=DiagnosticInfo/GetEventExtendedDataRecordEx, queue-length=1
          operation=DiagnosticInfo/GetEventFreezeFrameData, queue-length=1
          operation=DiagnosticInfo/GetEventFreezeFrameDataEx, queue-length=1
      EvtInfo_DemEventParameter_ECU4_DTC86: provided-interface=DiagnosticInfo
        provided-com-specs:
          operation=DiagnosticInfo/GetEventStatus, queue-length=1
          operation=DiagnosticInfo/GetEventFailed, queue-length=1
          operation=DiagnosticInfo/GetEventTested, queue-length=1
          operation=DiagnosticInfo/GetDTCOfEvent, queue-length=1
          operation=DiagnosticInfo/GetDebouncingOfEvent, queue-length=1
          operation=DiagnosticInfo/GetFaultDetectionCounter, queue-length=1
          operation=DiagnosticInfo/GetEventExtendedDataRecord, queue-length=1
          operation=DiagnosticInfo/GetEventExtendedDataRecordEx, queue-length=1
          operation=DiagnosticInfo/GetEventFreezeFrameData, queue-length=1
          operation=DiagnosticInfo/GetEventFreezeFrameDataEx, queue-length=1
      EvtInfo_DemEventParameter_ECU4_DTC87: provided-interface=DiagnosticInfo
        provided-com-specs:
          operation=DiagnosticInfo/GetEventStatus, queue-length=1
          operation=DiagnosticInfo/GetEventFailed, queue-length=1
          operation=DiagnosticInfo/GetEventTested, queue-length=1
          operation=DiagnosticInfo/GetDTCOfEvent, queue-length=1
          operation=DiagnosticInfo/GetDebouncingOfEvent, queue-length=1
          operation=DiagnosticInfo/GetFaultDetectionCounter, queue-length=1
          operation=DiagnosticInfo/GetEventExtendedDataRecord, queue-length=1
          operation=DiagnosticInfo/GetEventExtendedDataRecordEx, queue-length=1
          operation=DiagnosticInfo/GetEventFreezeFrameData, queue-length=1
          operation=DiagnosticInfo/GetEventFreezeFrameDataEx, queue-length=1
      EvtInfo_DemEventParameter_ECU4_DTC88: provided-interface=DiagnosticInfo
        provided-com-specs:
          operation=DiagnosticInfo/GetEventStatus, queue-length=1
          operation=DiagnosticInfo/GetEventFailed, queue-length=1
          operation=DiagnosticInfo/GetEventTested, queue-length=1
          operation=DiagnosticInfo/GetDTCOfEvent, queue-length=1
          operation=DiagnosticInfo/GetDebouncingOfEvent, queue-length=1
          operation=DiagnosticInfo/GetFaultDetectionCounter, queue-length=1
          operation=DiagnosticInfo/GetEventExtendedDataRecord, queue-length=1
          operation=DiagnosticInfo/GetEventExtendedDataRecordEx, queue-length=1
          operation=DiagnosticInfo/GetEventFreezeFrameData, queue-length=1
          operation=DiagnosticInfo/GetEventFreezeFrameDataEx, queue-length=1
      EvtInfo_DemEventParameter_ECU4_DTC89: provided-interface=DiagnosticInfo
        provided-com-specs:
          operation=DiagnosticInfo/GetEventStatus, queue-length=1
          operation=DiagnosticInfo/GetEventFailed, queue-length=1
          operation=DiagnosticInfo/GetEventTested, queue-length=1
          operation=DiagnosticInfo/GetDTCOfEvent, queue-length=1
          operation=DiagnosticInfo/GetDebouncingOfEvent, queue-length=1
          operation=DiagnosticInfo/GetFaultDetectionCounter, queue-length=1
          operation=DiagnosticInfo/GetEventExtendedDataRecord, queue-length=1
          operation=DiagnosticInfo/GetEventExtendedDataRecordEx, queue-length=1
          operation=DiagnosticInfo/GetEventFreezeFrameData, queue-length=1
          operation=DiagnosticInfo/GetEventFreezeFrameDataEx, queue-length=1
      EvtInfo_DemEventParameter_ECU4_DTC90: provided-interface=DiagnosticInfo
        provided-com-specs:
          operation=DiagnosticInfo/GetEventStatus, queue-length=1
          operation=DiagnosticInfo/GetEventFailed, queue-length=1
          operation=DiagnosticInfo/GetEventTested, queue-length=1
          operation=DiagnosticInfo/GetDTCOfEvent, queue-length=1
          operation=DiagnosticInfo/GetDebouncingOfEvent, queue-length=1
          operation=DiagnosticInfo/GetFaultDetectionCounter, queue-length=1
          operation=DiagnosticInfo/GetEventExtendedDataRecord, queue-length=1
          operation=DiagnosticInfo/GetEventExtendedDataRecordEx, queue-length=1
          operation=DiagnosticInfo/GetEventFreezeFrameData, queue-length=1
          operation=DiagnosticInfo/GetEventFreezeFrameDataEx, queue-length=1
      EvtInfo_DemEventParameter_ECU4_DTC91: provided-interface=DiagnosticInfo
        provided-com-specs:
          operation=DiagnosticInfo/GetEventStatus, queue-length=1
          operation=DiagnosticInfo/GetEventFailed, queue-length=1
          operation=DiagnosticInfo/GetEventTested, queue-length=1
          operation=DiagnosticInfo/GetDTCOfEvent, queue-length=1
          operation=DiagnosticInfo/GetDebouncingOfEvent, queue-length=1
          operation=DiagnosticInfo/GetFaultDetectionCounter, queue-length=1
          operation=DiagnosticInfo/GetEventExtendedDataRecord, queue-length=1
          operation=DiagnosticInfo/GetEventExtendedDataRecordEx, queue-length=1
          operation=DiagnosticInfo/GetEventFreezeFrameData, queue-length=1
          operation=DiagnosticInfo/GetEventFreezeFrameDataEx, queue-length=1
      EvtInfo_DemEventParameter_ECU4_DTC92: provided-interface=DiagnosticInfo
        provided-com-specs:
          operation=DiagnosticInfo/GetEventStatus, queue-length=1
          operation=DiagnosticInfo/GetEventFailed, queue-length=1
          operation=DiagnosticInfo/GetEventTested, queue-length=1
          operation=DiagnosticInfo/GetDTCOfEvent, queue-length=1
          operation=DiagnosticInfo/GetDebouncingOfEvent, queue-length=1
          operation=DiagnosticInfo/GetFaultDetectionCounter, queue-length=1
          operation=DiagnosticInfo/GetEventExtendedDataRecord, queue-length=1
          operation=DiagnosticInfo/GetEventExtendedDataRecordEx, queue-length=1
          operation=DiagnosticInfo/GetEventFreezeFrameData, queue-length=1
          operation=DiagnosticInfo/GetEventFreezeFrameDataEx, queue-length=1
      EvtInfo_DemEventParameter_ECU4_DTC93: provided-interface=DiagnosticInfo
        provided-com-specs:
          operation=DiagnosticInfo/GetEventStatus, queue-length=1
          operation=DiagnosticInfo/GetEventFailed, queue-length=1
          operation=DiagnosticInfo/GetEventTested, queue-length=1
          operation=DiagnosticInfo/GetDTCOfEvent, queue-length=1
          operation=DiagnosticInfo/GetDebouncingOfEvent, queue-length=1
          operation=DiagnosticInfo/GetFaultDetectionCounter, queue-length=1
          operation=DiagnosticInfo/GetEventExtendedDataRecord, queue-length=1
          operation=DiagnosticInfo/GetEventExtendedDataRecordEx, queue-length=1
          operation=DiagnosticInfo/GetEventFreezeFrameData, queue-length=1
          operation=DiagnosticInfo/GetEventFreezeFrameDataEx, queue-length=1
      EvtInfo_DemEventParameter_ECU4_DTC94: provided-interface=DiagnosticInfo
        provided-com-specs:
          operation=DiagnosticInfo/GetEventStatus, queue-length=1
          operation=DiagnosticInfo/GetEventFailed, queue-length=1
          operation=DiagnosticInfo/GetEventTested, queue-length=1
          operation=DiagnosticInfo/GetDTCOfEvent, queue-length=1
          operation=DiagnosticInfo/GetDebouncingOfEvent, queue-length=1
          operation=DiagnosticInfo/GetFaultDetectionCounter, queue-length=1
          operation=DiagnosticInfo/GetEventExtendedDataRecord, queue-length=1
          operation=DiagnosticInfo/GetEventExtendedDataRecordEx, queue-length=1
          operation=DiagnosticInfo/GetEventFreezeFrameData, queue-length=1
          operation=DiagnosticInfo/GetEventFreezeFrameDataEx, queue-length=1
      EvtInfo_DemEventParameter_ECU4_DTC95: provided-interface=DiagnosticInfo
        provided-com-specs:
          operation=DiagnosticInfo/GetEventStatus, queue-length=1
          operation=DiagnosticInfo/GetEventFailed, queue-length=1
          operation=DiagnosticInfo/GetEventTested, queue-length=1
          operation=DiagnosticInfo/GetDTCOfEvent, queue-length=1
          operation=DiagnosticInfo/GetDebouncingOfEvent, queue-length=1
          operation=DiagnosticInfo/GetFaultDetectionCounter, queue-length=1
          operation=DiagnosticInfo/GetEventExtendedDataRecord, queue-length=1
          operation=DiagnosticInfo/GetEventExtendedDataRecordEx, queue-length=1
          operation=DiagnosticInfo/GetEventFreezeFrameData, queue-length=1
          operation=DiagnosticInfo/GetEventFreezeFrameDataEx, queue-length=1
      EvtInfo_DemEventParameter_ECU4_DTC96: provided-interface=DiagnosticInfo
        provided-com-specs:
          operation=DiagnosticInfo/GetEventStatus, queue-length=1
          operation=DiagnosticInfo/GetEventFailed, queue-length=1
          operation=DiagnosticInfo/GetEventTested, queue-length=1
          operation=DiagnosticInfo/GetDTCOfEvent, queue-length=1
          operation=DiagnosticInfo/GetDebouncingOfEvent, queue-length=1
          operation=DiagnosticInfo/GetFaultDetectionCounter, queue-length=1
          operation=DiagnosticInfo/GetEventExtendedDataRecord, queue-length=1
          operation=DiagnosticInfo/GetEventExtendedDataRecordEx, queue-length=1
          operation=DiagnosticInfo/GetEventFreezeFrameData, queue-length=1
          operation=DiagnosticInfo/GetEventFreezeFrameDataEx, queue-length=1
      EvtInfo_DemEventParameter_ECU4_DTC97: provided-interface=DiagnosticInfo
        provided-com-specs:
          operation=DiagnosticInfo/GetEventStatus, queue-length=1
          operation=DiagnosticInfo/GetEventFailed, queue-length=1
          operation=DiagnosticInfo/GetEventTested, queue-length=1
          operation=DiagnosticInfo/GetDTCOfEvent, queue-length=1
          operation=DiagnosticInfo/GetDebouncingOfEvent, queue-length=1
          operation=DiagnosticInfo/GetFaultDetectionCounter, queue-length=1
          operation=DiagnosticInfo/GetEventExtendedDataRecord, queue-length=1
          operation=DiagnosticInfo/GetEventExtendedDataRecordEx, queue-length=1
          operation=DiagnosticInfo/GetEventFreezeFrameData, queue-length=1
          operation=DiagnosticInfo/GetEventFreezeFrameDataEx, queue-length=1
      EvtInfo_DemEventParameter_ECU4_DTC98: provided-interface=DiagnosticInfo
        provided-com-specs:
          operation=DiagnosticInfo/GetEventStatus, queue-length=1
          operation=DiagnosticInfo/GetEventFailed, queue-length=1
          operation=DiagnosticInfo/GetEventTested, queue-length=1
          operation=DiagnosticInfo/GetDTCOfEvent, queue-length=1
          operation=DiagnosticInfo/GetDebouncingOfEvent, queue-length=1
          operation=DiagnosticInfo/GetFaultDetectionCounter, queue-length=1
          operation=DiagnosticInfo/GetEventExtendedDataRecord, queue-length=1
          operation=DiagnosticInfo/GetEventExtendedDataRecordEx, queue-length=1
          operation=DiagnosticInfo/GetEventFreezeFrameData, queue-length=1
          operation=DiagnosticInfo/GetEventFreezeFrameDataEx, queue-length=1
      EvtInfo_DemEventParameter_ECU4_DTC99: provided-interface=DiagnosticInfo
        provided-com-specs:
          operation=DiagnosticInfo/GetEventStatus, queue-length=1
          operation=DiagnosticInfo/GetEventFailed, queue-length=1
          operation=DiagnosticInfo/GetEventTested, queue-length=1
          operation=DiagnosticInfo/GetDTCOfEvent, queue-length=1
          operation=DiagnosticInfo/GetDebouncingOfEvent, queue-length=1
          operation=DiagnosticInfo/GetFaultDetectionCounter, queue-length=1
          operation=DiagnosticInfo/GetEventExtendedDataRecord, queue-length=1
          operation=DiagnosticInfo/GetEventExtendedDataRecordEx, queue-length=1
          operation=DiagnosticInfo/GetEventFreezeFrameData, queue-length=1
          operation=DiagnosticInfo/GetEventFreezeFrameDataEx, queue-length=1
      EvtInfo_DemEventParameter_ECU5_DTC00: provided-interface=DiagnosticInfo
        provided-com-specs:
          operation=DiagnosticInfo/GetEventStatus, queue-length=1
          operation=DiagnosticInfo/GetEventFailed, queue-length=1
          operation=DiagnosticInfo/GetEventTested, queue-length=1
          operation=DiagnosticInfo/GetDTCOfEvent, queue-length=1
          operation=DiagnosticInfo/GetDebouncingOfEvent, queue-length=1
          operation=DiagnosticInfo/GetFaultDetectionCounter, queue-length=1
          operation=DiagnosticInfo/GetEventExtendedDataRecord, queue-length=1
          operation=DiagnosticInfo/GetEventExtendedDataRecordEx, queue-length=1
          operation=DiagnosticInfo/GetEventFreezeFrameData, queue-length=1
          operation=DiagnosticInfo/GetEventFreezeFrameDataEx, queue-length=1
      EvtInfo_DemEventParameter_ECU5_DTC01: provided-interface=DiagnosticInfo
        provided-com-specs:
          operation=DiagnosticInfo/GetEventStatus, queue-length=1
          operation=DiagnosticInfo/GetEventFailed, queue-length=1
          operation=DiagnosticInfo/GetEventTested, queue-length=1
          operation=DiagnosticInfo/GetDTCOfEvent, queue-length=1
          operation=DiagnosticInfo/GetDebouncingOfEvent, queue-length=1
          operation=DiagnosticInfo/GetFaultDetectionCounter, queue-length=1
          operation=DiagnosticInfo/GetEventExtendedDataRecord, queue-length=1
          operation=DiagnosticInfo/GetEventExtendedDataRecordEx, queue-length=1
          operation=DiagnosticInfo/GetEventFreezeFrameData, queue-length=1
          operation=DiagnosticInfo/GetEventFreezeFrameDataEx, queue-length=1
      EvtInfo_DemEventParameter_ECU5_DTC02: provided-interface=DiagnosticInfo
        provided-com-specs:
          operation=DiagnosticInfo/GetEventStatus, queue-length=1
          operation=DiagnosticInfo/GetEventFailed, queue-length=1
          operation=DiagnosticInfo/GetEventTested, queue-length=1
          operation=DiagnosticInfo/GetDTCOfEvent, queue-length=1
          operation=DiagnosticInfo/GetDebouncingOfEvent, queue-length=1
          operation=DiagnosticInfo/GetFaultDetectionCounter, queue-length=1
          operation=DiagnosticInfo/GetEventExtendedDataRecord, queue-length=1
          operation=DiagnosticInfo/GetEventExtendedDataRecordEx, queue-length=1
          operation=DiagnosticInfo/GetEventFreezeFrameData, queue-length=1
          operation=DiagnosticInfo/GetEventFreezeFrameDataEx, queue-length=1
      EvtInfo_DemEventParameter_ECU5_DTC03: provided-interface=DiagnosticInfo
        provided-com-specs:
          operation=DiagnosticInfo/GetEventStatus, queue-length=1
          operation=DiagnosticInfo/GetEventFailed, queue-length=1
          operation=DiagnosticInfo/GetEventTested, queue-length=1
          operation=DiagnosticInfo/GetDTCOfEvent, queue-length=1
          operation=DiagnosticInfo/GetDebouncingOfEvent, queue-length=1
          operation=DiagnosticInfo/GetFaultDetectionCounter, queue-length=1
          operation=DiagnosticInfo/GetEventExtendedDataRecord, queue-length=1
          operation=DiagnosticInfo/GetEventExtendedDataRecordEx, queue-length=1
          operation=DiagnosticInfo/GetEventFreezeFrameData, queue-length=1
          operation=DiagnosticInfo/GetEventFreezeFrameDataEx, queue-length=1
      EvtInfo_DemEventParameter_ECU5_DTC04: provided-interface=DiagnosticInfo
        provided-com-specs:
          operation=DiagnosticInfo/GetEventStatus, queue-length=1
          operation=DiagnosticInfo/GetEventFailed, queue-length=1
          operation=DiagnosticInfo/GetEventTested, queue-length=1
          operation=DiagnosticInfo/GetDTCOfEvent, queue-length=1
          operation=DiagnosticInfo/GetDebouncingOfEvent, queue-length=1
          operation=DiagnosticInfo/GetFaultDetectionCounter, queue-length=1
          operation=DiagnosticInfo/GetEventExtendedDataRecord, queue-length=1
          operation=DiagnosticInfo/GetEventExtendedDataRecordEx, queue-length=1
          operation=DiagnosticInfo/GetEventFreezeFrameData, queue-length=1
          operation=DiagnosticInfo/GetEventFreezeFrameDataEx, queue-length=1
      EvtInfo_DemEventParameter_ECU5_DTC05: provided-interface=DiagnosticInfo
        provided-com-specs:
          operation=DiagnosticInfo/GetEventStatus, queue-length=1
          operation=DiagnosticInfo/GetEventFailed, queue-length=1
          operation=DiagnosticInfo/GetEventTested, queue-length=1
          operation=DiagnosticInfo/GetDTCOfEvent, queue-length=1
          operation=DiagnosticInfo/GetDebouncingOfEvent, queue-length=1
          operation=DiagnosticInfo/GetFaultDetectionCounter, queue-length=1
          operation=DiagnosticInfo/GetEventExtendedDataRecord, queue-length=1
          operation=DiagnosticInfo/GetEventExtendedDataRecordEx, queue-length=1
          operation=DiagnosticInfo/GetEventFreezeFrameData, queue-length=1
          operation=DiagnosticInfo/GetEventFreezeFrameDataEx, queue-length=1
      EvtInfo_DemEventParameter_ECU5_DTC06: provided-interface=DiagnosticInfo
        provided-com-specs:
          operation=DiagnosticInfo/GetEventStatus, queue-length=1
          operation=DiagnosticInfo/GetEventFailed, queue-length=1
          operation=DiagnosticInfo/GetEventTested, queue-length=1
          operation=DiagnosticInfo/GetDTCOfEvent, queue-length=1
          operation=DiagnosticInfo/GetDebouncingOfEvent, queue-length=1
          operation=DiagnosticInfo/GetFaultDetectionCounter, queue-length=1
          operation=DiagnosticInfo/GetEventExtendedDataRecord, queue-length=1
          operation=DiagnosticInfo/GetEventExtendedDataRecordEx, queue-length=1
          operation=DiagnosticInfo/GetEventFreezeFrameData, queue-length=1
          operation=DiagnosticInfo/GetEventFreezeFrameDataEx, queue-length=1
      EvtInfo_DemEventParameter_ECU5_DTC07: provided-interface=DiagnosticInfo
        provided-com-specs:
          operation=DiagnosticInfo/GetEventStatus, queue-length=1
          operation=DiagnosticInfo/GetEventFailed, queue-length=1
          operation=DiagnosticInfo/GetEventTested, queue-length=1
          operation=DiagnosticInfo/GetDTCOfEvent, queue-length=1
          operation=DiagnosticInfo/GetDebouncingOfEvent, queue-length=1
          operation=DiagnosticInfo/GetFaultDetectionCounter, queue-length=1
          operation=DiagnosticInfo/GetEventExtendedDataRecord, queue-length=1
          operation=DiagnosticInfo/GetEventExtendedDataRecordEx, queue-length=1
          operation=DiagnosticInfo/GetEventFreezeFrameData, queue-length=1
          operation=DiagnosticInfo/GetEventFreezeFrameDataEx, queue-length=1
      EvtInfo_DemEventParameter_ECU5_DTC08: provided-interface=DiagnosticInfo
        provided-com-specs:
          operation=DiagnosticInfo/GetEventStatus, queue-length=1
          operation=DiagnosticInfo/GetEventFailed, queue-length=1
          operation=DiagnosticInfo/GetEventTested, queue-length=1
          operation=DiagnosticInfo/GetDTCOfEvent, queue-length=1
          operation=DiagnosticInfo/GetDebouncingOfEvent, queue-length=1
          operation=DiagnosticInfo/GetFaultDetectionCounter, queue-length=1
          operation=DiagnosticInfo/GetEventExtendedDataRecord, queue-length=1
          operation=DiagnosticInfo/GetEventExtendedDataRecordEx, queue-length=1
          operation=DiagnosticInfo/GetEventFreezeFrameData, queue-length=1
          operation=DiagnosticInfo/GetEventFreezeFrameDataEx, queue-length=1
