[part 12 of 12: packages /AUTOSAR_Dem/SwComponentTypes to /AUTOSAR_Dem/SwcBswMappings]
AUTOSAR XML (schema 4-2-2)
package /AUTOSAR_Dem/SwComponentTypes  (continued)
  service sw component type Dem  (continued)
    behavior IntBeh_Dem: handle-termination-and-restart=NO-SUPPORT, included-data-type-set=data-type=[Dem_DTCFormatType, Dem_DTCOriginType, Dem_EventIdType, Dem_UdsStatusByteType, Dem_EventStatusType, Dem_DebugDataType, Dem_IndicatorIdType, Dem_IndicatorStatusType, Dem_InitMonitorReasonType, Dem_MaxDataValueType, Dem_OperationCycleIdType, Dem_OperationCycleStateType, Dem_DebouncingStateType, Dem_DebounceResetStatusType, Dem_IumprDenomCondIdType, Dem_IumprDenomCondStatusType]  (continued)
      port-api-options:  (continued)
        {enable-take-address=true, indirect-api=false, port-defined-argument-value{value=EventStatus_DemEventParameter_ECU5_DTC32:433, value-type=Dem_EventIdType}, port=EventStatus_DemEventParameter_ECU5_DTC32}
        {enable-take-address=true, indirect-api=false, port-defined-argument-value{value=Event_DemEventParameter_ECU5_DTC33:434, value-type=Dem_EventIdType}, port=Event_DemEventParameter_ECU5_DTC33}
        {enable-take-address=true, indirect-api=false, port-defined-argument-value{value=EventStatus_DemEventParameter_ECU5_DTC33:434, value-type=Dem_EventIdType}, port=EventStatus_DemEventParameter_ECU5_DTC33}
        {enable-take-address=true, indirect-api=false, port-defined-argument-value{value=Event_DemEventParameter_ECU5_DTC34:435, value-type=Dem_EventIdType}, port=Event_DemEventParameter_ECU5_DTC34}
        {enable-take-address=true, indirect-api=false, port-defined-argument-value{value=EventStatus_DemEventParameter_ECU5_DTC34:435, value-type=Dem_EventIdType}, port=EventStatus_DemEventParameter_ECU5_DTC34}
        {enable-take-address=true, indirect-api=false, port-defined-argument-value{value=Event_DemEventParameter_ECU5_DTC35:436, value-type=Dem_EventIdType}, port=Event_DemEventParameter_ECU5_DTC35}
        {enable-take-address=true, indirect-api=false, port-defined-argument-value{value=EventStatus_DemEventParameter_ECU5_DTC35:436, value-type=Dem_EventIdType}, port=EventStatus_DemEventParameter_ECU5_DTC35}
        {enable-take-address=true, indirect-api=false, port-defined-argument-value{value=Event_DemEventParameter_ECU5_DTC36:437, value-type=Dem_EventIdType}, port=Event_DemEventParameter_ECU5_DTC36}
        {enable-take-address=true, indirect-api=false, port-defined-argument-value{value=EventStatus_DemEventParameter_ECU5_DTC36:437, value-type=Dem_EventIdType}, port=EventStatus_DemEventParameter_ECU5_DTC36}
        {enable-take-address=true, indirect-api=false, port-defined-argument-value{value=Event_DemEventParameter_ECU5_DTC37:438, value-type=Dem_EventIdType}, port=Event_DemEventParameter_ECU5_DTC37}
        {enable-take-address=true, indirect-api=false, port-defined-argument-value{value=EventStatus_DemEventParameter_ECU5_DTC37:438, value-type=Dem_EventIdType}, port=EventStatus_DemEventParameter_ECU5_DTC37}
        {enable-take-address=true, indirect-api=false, port-defined-argument-value{value=Event_DemEventParameter_ECU5_DTC38:439, value-type=Dem_EventIdType}, port=Event_DemEventParameter_ECU5_DTC38}
        {enable-take-address=true, indirect-api=false, port-defined-argument-value{value=EventStatus_DemEventParameter_ECU5_DTC38:439, value-type=Dem_EventIdType}, port=EventStatus_DemEventParameter_ECU5_DTC38}
        {enable-take-address=true, indirect-api=false, port-defined-argument-value{value=Event_DemEventParameter_ECU5_DTC39:440, value-type=Dem_EventIdType}, port=Event_DemEventParameter_ECU5_DTC39}
        {enable-take-address=true, indirect-api=false, port-defined-argument-value{value=EventStatus_DemEventParameter_ECU5_DTC39:440, value-type=Dem_EventIdType}, port=EventStatus_DemEventParameter_ECU5_DTC39}
        {enable-take-address=true, indirect-api=false, port-defined-argument-value{value=Event_DemEventParameter_ECU5_DTC40:441, value-type=Dem_EventIdType}, port=Event_DemEventParameter_ECU5_DTC40}
        {enable-take-address=true, indirect-api=false, port-defined-argument-value{value=EventStatus_DemEventParameter_ECU5_DTC40:441, value-type=Dem_EventIdType}, port=EventStatus_DemEventParameter_ECU5_DTC40}
        {enable-take-address=true, indirect-api=false, port-defined-argument-value{value=Event_DemEventParameter_ECU5_DTC41:442, value-type=Dem_EventIdType}, port=Event_DemEventParameter_ECU5_DTC41}
        {enable-take-address=true, indirect-api=false, port-defined-argument-value{value=EventStatus_DemEventParameter_ECU5_DTC41:442, value-type=Dem_EventIdType}, port=EventStatus_DemEventParameter_ECU5_DTC41}
        {enable-take-address=true, indirect-api=false, port-defined-argument-value{value=Event_DemEventParameter_ECU5_DTC42:443, value-type=Dem_EventIdType}, port=Event_DemEventParameter_ECU5_DTC42}
        {enable-take-address=true, indirect-api=false, port-defined-argument-value{value=EventStatus_DemEventParameter_ECU5_DTC42:443, value-type=Dem_EventIdType}, port=EventStatus_DemEventParameter_ECU5_DTC42}
        {enable-take-address=true, indirect-api=false, port-defined-argument-value{value=Event_DemEventParameter_ECU5_DTC43:444, value-type=Dem_EventIdType}, port=Event_DemEventParameter_ECU5_DTC43}
        {enable-take-address=true, indirect-api=false, port-defined-argument-value{value=EventStatus_DemEventParameter_ECU5_DTC43:444, value-type=Dem_EventIdType}, port=EventStatus_DemEventParameter_ECU5_DTC43}
        {enable-take-address=true, indirect-api=false, port-defined-argument-value{value=Event_DemEventParameter_ECU5_DTC44:445, value-type=Dem_EventIdType}, port=Event_DemEventParameter_ECU5_DTC44}
        {enable-take-address=true, indirect-api=false, port-defined-argument-value{value=EventStatus_DemEventParameter_ECU5_DTC44:445, value-type=Dem_EventIdType}, port=EventStatus_DemEventParameter_ECU5_DTC44}
        {enable-take-address=true, indirect-api=false, port-defined-argument-value{value=Event_DemEventParameter_ECU5_DTC45:446, value-type=Dem_EventIdType}, port=Event_DemEventParameter_ECU5_DTC45}
        {enable-take-address=true, indirect-api=false, port-defined-argument-value{value=EventStatus_DemEventParameter_ECU5_DTC45:446, value-type=Dem_EventIdType}, port=EventStatus_DemEventParameter_ECU5_DTC45}
        {enable-take-address=true, indirect-api=false, port-defined-argument-value{value=Event_DemEventParameter_ECU5_DTC46:447, value-type=Dem_EventIdType}, port=Event_DemEventParameter_ECU5_DTC46}
        {enable-take-address=true, indirect-api=false, port-defined-argument-value{value=EventStatus_DemEventParameter_ECU5_DTC46:447, value-type=Dem_EventIdType}, port=EventStatus_DemEventParameter_ECU5_DTC46}
        {enable-take-address=true, indirect-api=false, port-defined-argument-value{value=Event_DemEventParameter_ECU5_DTC47:448, value-type=Dem_EventIdType}, port=Event_DemEventParameter_ECU5_DTC47}
        {enable-take-address=true, indirect-api=false, port-defined-argument-value{value=EventStatus_DemEventParameter_ECU5_DTC47:448, value-type=Dem_EventIdType}, port=EventStatus_DemEventParameter_ECU5_DTC47}
        {enable-take-address=true, indirect-api=false, port-defined-argument-value{value=Event_DemEventParameter_ECU5_DTC48:449, value-type=Dem_EventIdType}, port=Event_DemEventParameter_ECU5_DTC48}
        {enable-take-address=true, indirect-api=false, port-defined-argument-value{value=EventStatus_DemEventParameter_ECU5_DTC48:449, value-type=Dem_EventIdType}, port=EventStatus_DemEventParameter_ECU5_DTC48}
        {enable-take-address=true, indirect-api=false, port-defined-argument-value{value=Event_DemEventParameter_ECU5_DTC49:450, value-type=Dem_EventIdType}, port=Event_DemEventParameter_ECU5_DTC49}
        {enable-take-address=true, indirect-api=false, port-defined-argument-value{value=EventStatus_DemEventParameter_ECU5_DTC49:450, value-type=Dem_EventIdType}, port=EventStatus_DemEventParameter_ECU5_DTC49}
        {enable-take-address=true, indirect-api=false, port-defined-argument-value{value=Event_DemEventParameter_ECU5_DTC50:451, value-type=Dem_EventIdType}, port=Event_DemEventParameter_ECU5_DTC50}
        {enable-take-address=true, indirect-api=false, port-defined-argument-value{value=EventStatus_DemEventParameter_ECU5_DTC50:451, value-type=Dem_EventIdType}, port=EventStatus_DemEventParameter_ECU5_DTC50}
        {enable-take-address=true, indirect-api=false, port-defined-argument-value{value=Event_DemEventParameter_ECU5_DTC51:452, value-type=Dem_EventIdType}, port=Event_DemEventParameter_ECU5_DTC51}
        {enable-take-address=true, indirect-api=false, port-defined-argument-value{value=EventStatus_DemEventParameter_ECU5_DTC51:452, value-type=Dem_EventIdType}, port=EventStatus_DemEventParameter_ECU5_DTC51}
        {enable-take-address=true, indirect-api=false, port-defined-argument-value{value=Event_DemEventParameter_ECU5_DTC52:453, value-type=Dem_EventIdType}, port=Event_DemEventParameter_ECU5_DTC52}
        {enable-take-address=true, indirect-api=false, port-defined-argument-value{value=EventStatus_DemEventParameter_ECU5_DTC52:453, value-type=Dem_EventIdType}, port=EventStatus_DemEventParameter_ECU5_DTC52}
        {enable-take-address=true, indirect-api=false, port-defined-argument-value{value=Event_DemEventParameter_ECU5_DTC53:454, value-type=Dem_EventIdType}, port=Event_DemEventParameter_ECU5_DTC53}
        {enable-take-address=true, indirect-api=false, port-defined-argument-value{value=EventStatus_DemEventParameter_ECU5_DTC53:454, value-type=Dem_EventIdType}, port=EventStatus_DemEventParameter_ECU5_DTC53}
        {enable-take-address=true, indirect-api=false, port-defined-argument-value{value=Event_DemEventParameter_ECU5_DTC54:455, value-type=Dem_EventIdType}, port=Event_DemEventParameter_ECU5_DTC54}
        {enable-take-address=true, indirect-api=false, port-defined-argument-value{value=EventStatus_DemEventParameter_ECU5_DTC54:455, value-type=Dem_EventIdType}, port=EventStatus_DemEventParameter_ECU5_DTC54}
        {enable-take-address=true, indirect-api=false, port-defined-argument-value{value=Event_DemEventParameter_ECU5_DTC55:456, value-type=Dem_EventIdType}, port=Event_DemEventParameter_ECU5_DTC55}
        {enable-take-address=true, indirect-api=false, port-defined-argument-value{value=EventStatus_DemEventParameter_ECU5_DTC55:456, value-type=Dem_EventIdType}, port=EventStatus_DemEventParameter_ECU5_DTC55}
        {enable-take-address=true, indirect-api=false, port-defined-argument-value{value=Event_DemEventParameter_ECU5_DTC56:457, value-type=Dem_EventIdType}, port=Event_DemEventParameter_ECU5_DTC56}
        {enable-take-address=true, indirect-api=false, port-defined-argument-value{value=EventStatus_DemEventParameter_ECU5_DTC56:457, value-type=Dem_EventIdType}, port=EventStatus_DemEventParameter_ECU5_DTC56}
        {enable-take-address=true, indirect-api=false, port-defined-argument-value{value=Event_DemEventParameter_ECU5_DTC57:458, value-type=Dem_EventIdType}, port=Event_DemEventParameter_ECU5_DTC57}
        {enable-take-address=true, indirect-api=false, port-defined-argument-value{value=EventStatus_DemEventParameter_ECU5_DTC57:458, value-type=Dem_EventIdType}, port=EventStatus_DemEventParameter_ECU5_DTC57}
        {enable-take-address=true, indirect-api=false, port-defined-argument-value{value=Event_DemEventParameter_ECU5_DTC58:459, value-type=Dem_EventIdType}, port=Event_DemEventParameter_ECU5_DTC58}
        {enable-take-address=true, indirect-api=false, port-defined-argument-value{value=EventStatus_DemEventParameter_ECU5_DTC58:459, value-type=Dem_EventIdType}, port=EventStatus_DemEventParameter_ECU5_DTC58}
        {enable-take-address=true, indirect-api=false, port-defined-argument-value{value=Event_DemEventParameter_ECU5_DTC59:460, value-type=Dem_EventIdType}, port=Event_DemEventParameter_ECU5_DTC59}
        {enable-take-address=true, indirect-api=false, port-defined-argument-value{value=EventStatus_DemEventParameter_ECU5_DTC59:460, value-type=Dem_EventIdType}, port=EventStatus_DemEventParameter_ECU5_DTC59}
        {enable-take-address=true, indirect-api=false, port-defined-argument-value{value=Event_DemEventParameter_ECU5_DTC60:461, value-type=Dem_EventIdType}, port=Event_DemEventParameter_ECU5_DTC60}
        {enable-take-address=true, indirect-api=false, port-defined-argument-value{value=EventStatus_DemEventParameter_ECU5_DTC60:461, value-type=Dem_EventIdType}, port=EventStatus_DemEventParameter_ECU5_DTC60}
        {enable-take-address=true, indirect-api=false, port-defined-argument-value{value=Event_DemEventParameter_ECU5_DTC61:462, value-type=Dem_EventIdType}, port=Event_DemEventParameter_ECU5_DTC61}
        {enable-take-address=true, indirect-api=false, port-defined-argument-value{value=EventStatus_DemEventParameter_ECU5_DTC61:462, value-type=Dem_EventIdType}, port=EventStatus_DemEventParameter_ECU5_DTC61}
        {enable-take-address=true, indirect-api=false, port-defined-argument-value{value=Event_DemEventParameter_ECU5_DTC62:463, value-type=Dem_EventIdType}, port=Event_DemEventParameter_ECU5_DTC62}
        {enable-take-address=true, indirect-api=false, port-defined-argument-value{value=EventStatus_DemEventParameter_ECU5_DTC62:463, value-type=Dem_EventIdType}, port=EventStatus_DemEventParameter_ECU5_DTC62}
        {enable-take-address=true, indirect-api=false, port-defined-argument-value{value=Event_DemEventParameter_ECU5_DTC63:464, value-type=Dem_EventIdType}, port=Event_DemEventParameter_ECU5_DTC63}
        {enable-take-address=true, indirect-api=false, port-defined-argument-value{value=EventStatus_DemEventParameter_ECU5_DTC63:464, value-type=Dem_EventIdType}, port=EventStatus_DemEventParameter_ECU5_DTC63}
        {enable-take-address=true, indirect-api=false, port-defined-argument-value{value=Event_DemEventParameter_ECU5_DTC64:465, value-type=Dem_EventIdType}, port=Event_DemEventParameter_ECU5_DTC64}
        {enable-take-address=true, indirect-api=false, port-defined-argument-value{value=EventStatus_DemEventParameter_ECU5_DTC64:465, value-type=Dem_EventIdType}, port=EventStatus_DemEventParameter_ECU5_DTC64}
        {enable-take-address=true, indirect-api=false, port-defined-argument-value{value=Event_DemEventParameter_ECU5_DTC65:466, value-type=Dem_EventIdType}, port=Event_DemEventParameter_ECU5_DTC65}
        {enable-take-address=true, indirect-api=false, port-defined-argument-value{value=EventStatus_DemEventParameter_ECU5_DTC65:466, value-type=Dem_EventIdType}, port=EventStatus_DemEventParameter_ECU5_DTC65}
        {enable-take-address=true, indirect-api=false, port-defined-argument-value{value=Event_DemEventParameter_ECU5_DTC66:467, value-type=Dem_EventIdType}, port=Event_DemEventParameter_ECU5_DTC66}
        {enable-take-address=true, indirect-api=false, port-defined-argument-value{value=EventStatus_DemEventParameter_ECU5_DTC66:467, value-type=Dem_EventIdType}, port=EventStatus_DemEventParameter_ECU5_DTC66}
        {enable-take-address=true, indirect-api=false, port-defined-argument-value{value=Event_DemEventParameter_ECU5_DTC67:468, value-type=Dem_EventIdType}, port=Event_DemEventParameter_ECU5_DTC67}
        {enable-take-address=true, indirect-api=false, port-defined-argument-value{value=EventStatus_DemEventParameter_ECU5_DTC67:468, value-type=Dem_EventIdType}, port=EventStatus_DemEventParameter_ECU5_DTC67}
        {enable-take-address=true, indirect-api=false, port-defined-argument-value{value=Event_DemEventParameter_ECU5_DTC68:469, value-type=Dem_EventIdType}, port=Event_DemEventParameter_ECU5_DTC68}
        {enable-take-address=true, indirect-api=false, port-defined-argument-value{value=EventStatus_DemEventParameter_ECU5_DTC68:469, value-type=Dem_EventIdType}, port=EventStatus_DemEventParameter_ECU5_DTC68}
        {enable-take-address=true, indirect-api=false, port-defined-argument-value{value=Event_DemEventParameter_ECU5_DTC69:470, value-type=Dem_EventIdType}, port=Event_DemEventParameter_ECU5_DTC69}
        {enable-take-address=true, indirect-api=false, port-defined-argument-value{value=EventStatus_DemEventParameter_ECU5_DTC69:470, value-type=Dem_EventIdType}, port=EventStatus_DemEventParameter_ECU5_DTC69}
        {enable-take-address=true, indirect-api=false, port-defined-argument-value{value=Event_DemEventParameter_ECU5_DTC70:471, value-type=Dem_EventIdType}, port=Event_DemEventParameter_ECU5_DTC70}
        {enable-take-address=true, indirect-api=false, port-defined-argument-value{value=EventStatus_DemEventParameter_ECU5_DTC70:471, value-type=Dem_EventIdType}, port=EventStatus_DemEventParameter_ECU5_DTC70}
        {enable-take-address=true, indirect-api=false, port-defined-argument-value{value=Event_DemEventParameter_ECU5_DTC71:472, value-type=Dem_EventIdType}, port=Event_DemEventParameter_ECU5_DTC71}
        {enable-take-address=true, indirect-api=false, port-defined-argument-value{value=EventStatus_DemEventParameter_ECU5_DTC71:472, value-type=Dem_EventIdType}, port=EventStatus_DemEventParameter_ECU5_DTC71}
        {enable-take-address=true, indirect-api=false, port-defined-argument-value{value=Event_DemEventParameter_ECU5_DTC72:473, value-type=Dem_EventIdType}, port=Event_DemEventParameter_ECU5_DTC72}
        {enable-take-address=true, indirect-api=false, port-defined-argument-value{value=EventStatus_DemEventParameter_ECU5_DTC72:473, value-type=Dem_EventIdType}, port=EventStatus_DemEventParameter_ECU5_DTC72}
        {enable-take-address=true, indirect-api=false, port-defined-argument-value{value=Event_DemEventParameter_ECU5_DTC73:474, value-type=Dem_EventIdType}, port=Event_DemEventParameter_ECU5_DTC73}
        {enable-take-address=true, indirect-api=false, port-defined-argument-value{value=EventStatus_DemEventParameter_ECU5_DTC73:474, value-type=Dem_EventIdType}, port=EventStatus_DemEventParameter_ECU5_DTC73}
        {enable-take-address=true, indirect-api=false, port-defined-argument-value{value=Event_DemEventParameter_ECU5_DTC74:475, value-type=Dem_EventIdType}, port=Event_DemEventParameter_ECU5_DTC74}
        {enable-take-address=true, indirect-api=false, port-defined-argument-value{value=EventStatus_DemEventParameter_ECU5_DTC74:475, value-type=Dem_EventIdType}, port=EventStatus_DemEventParameter_ECU5_DTC74}
        {enable-take-address=true, indirect-api=false, port-defined-argument-value{value=Event_DemEventParameter_ECU5_DTC75:476, value-type=Dem_EventIdType}, port=Event_DemEventParameter_ECU5_DTC75}
        {enable-take-address=true, indirect-api=false, port-defined-argument-value{value=EventStatus_DemEventParameter_ECU5_DTC75:476, value-type=Dem_EventIdType}, port=EventStatus_DemEventParameter_ECU5_DTC75}
        {enable-take-address=true, indirect-api=false, port-defined-argument-value{value=Event_DemEventParameter_ECU5_DTC76:477, value-type=Dem_EventIdType}, port=Event_DemEventParameter_ECU5_DTC76}
        {enable-take-address=true, indirect-api=false, port-defined-argument-value{value=EventStatus_DemEventParameter_ECU5_DTC76:477, value-type=Dem_EventIdType}, port=EventStatus_DemEventParameter_ECU5_DTC76}
        {enable-take-address=true, indirect-api=false, port-defined-argument-value{value=Event_DemEventParameter_ECU5_DTC77:478, value-type=Dem_EventIdType}, port=Event_DemEventParameter_ECU5_DTC77}
        {enable-take-address=true, indirect-api=false, port-defined-argument-value{value=EventStatus_DemEventParameter_ECU5_DTC77:478, value-type=Dem_EventIdType}, port=EventStatus_DemEventParameter_ECU5_DTC77}
        {enable-take-address=true, indirect-api=false, port-defined-argument-value{value=Event_DemEventParameter_ECU5_DTC78:479, value-type=Dem_EventIdType}, port=Event_DemEventParameter_ECU5_DTC78}
        {enable-take-address=true, indirect-api=false, port-defined-argument-value{value=EventStatus_DemEventParameter_ECU5_DTC78:479, value-type=Dem_EventIdType}, port=EventStatus_DemEventParameter_ECU5_DTC78}
        {enable-take-address=true, indirect-api=false, port-defined-argument-value{value=Event_DemEventParameter_ECU5_DTC79:480, value-type=Dem_EventIdType}, port=Event_DemEventParameter_ECU5_DTC79}
        {enable-take-address=true, indirect-api=false, port-defined-argument-value{value=EventStatus_DemEventParameter_ECU5_DTC79:480, value-type=Dem_EventIdType}, port=EventStatus_DemEventParameter_ECU5_DTC79}
        {enable-take-address=true, indirect-api=false, port-defined-argument-value{value=Event_DemEventParameter_ECU5_DTC80:481, value-type=Dem_EventIdType}, port=Event_DemEventParameter_ECU5_DTC80}
        {enable-take-address=true, indirect-api=false, port-defined-argument-value{value=EventStatus_DemEventParameter_ECU5_DTC80:481, value-type=Dem_EventIdType}, port=EventStatus_DemEventParameter_ECU5_DTC80}
        {enable-take-address=true, indirect-api=false, port-defined-argument-value{value=Event_DemEventParameter_ECU5_DTC81:482, value-type=Dem_EventIdType}, port=Event_DemEventParameter_ECU5_DTC81}
        {enable-take-address=true, indirect-api=false, port-defined-argument-value{value=EventStatus_DemEventParameter_ECU5_DTC81:482, value-type=Dem_EventIdType}, port=EventStatus_DemEventParameter_ECU5_DTC81}
        {enable-take-address=true, indirect-api=false, port-defined-argument-value{value=Event_DemEventParameter_ECU5_DTC82:483, value-type=Dem_EventIdType}, port=Event_DemEventParameter_ECU5_DTC82}
        {enable-take-address=true, indirect-api=false, port-defined-argument-value{value=EventStatus_DemEventParameter_ECU5_DTC82:483, value-type=Dem_EventIdType}, port=EventStatus_DemEventParameter_ECU5_DTC82}
        {enable-take-address=true, indirect-api=false, port-defined-argument-value{value=Event_DemEventParameter_ECU5_DTC83:484, value-type=Dem_EventIdType}, port=Event_DemEventParameter_ECU5_DTC83}
        {enable-take-address=true, indirect-api=false, port-defined-argument-value{value=EventStatus_DemEventParameter_ECU5_DTC83:484, value-type=Dem_EventIdType}, port=EventStatus_DemEventParameter_ECU5_DTC83}
        {enable-take-address=true, indirect-api=false, port-defined-argument-value{value=Event_DemEventParameter_ECU5_DTC84:485, value-type=Dem_EventIdType}, port=Event_DemEventParameter_ECU5_DTC84}
        {enable-take-address=true, indirect-api=false, port-defined-argument-value{value=EventStatus_DemEventParameter_ECU5_DTC84:485, value-type=Dem_EventIdType}, port=EventStatus_DemEventParameter_ECU5_DTC84}
        {enable-take-address=true, indirect-api=false, port-defined-argument-value{value=Event_DemEventParameter_ECU5_DTC85:486, value-type=Dem_EventIdType}, port=Event_DemEventParameter_ECU5_DTC85}
        {enable-take-address=true, indirect-api=false, port-defined-argument-value{value=EventStatus_DemEventParameter_ECU5_DTC85:486, value-type=Dem_EventIdType}, port=EventStatus_DemEventParameter_ECU5_DTC85}
        {enable-take-address=true, indirect-api=false, port-defined-argument-value{value=Event_DemEventParameter_ECU5_DTC86:487, value-type=Dem_EventIdType}, port=Event_DemEventParameter_ECU5_DTC86}
        {enable-take-address=true, indirect-api=false, port-defined-argument-value{value=EventStatus_DemEventParameter_ECU5_DTC86:487, value-type=Dem_EventIdType}, port=EventStatus_DemEventParameter_ECU5_DTC86}
        {enable-take-address=true, indirect-api=false, port-defined-argument-value{value=Event_DemEventParameter_ECU5_DTC87:488, value-type=Dem_EventIdType}, port=Event_DemEventParameter_ECU5_DTC87}
        {enable-take-address=true, indirect-api=false, port-defined-argument-value{value=EventStatus_DemEventParameter_ECU5_DTC87:488, value-type=Dem_EventIdType}, port=EventStatus_DemEventParameter_ECU5_DTC87}
        {enable-take-address=true, indirect-api=false, port-defined-argument-value{value=Event_DemEventParameter_ECU5_DTC88:489, value-type=Dem_EventIdType}, port=Event_DemEventParameter_ECU5_DTC88}
        {enable-take-address=true, indirect-api=false, port-defined-argument-value{value=EventStatus_DemEventParameter_ECU5_DTC88:489, value-type=Dem_EventIdType}, port=EventStatus_DemEventParameter_ECU5_DTC88}
        {enable-take-address=true, indirect-api=false, port-defined-argument-value{value=Event_DemEventParameter_ECU5_DTC89:490, value-type=Dem_EventIdType}, port=Event_DemEventParameter_ECU5_DTC89}
        {enable-take-address=true, indirect-api=false, port-defined-argument-value{value=EventStatus_DemEventParameter_ECU5_DTC89:490, value-type=Dem_EventIdType}, port=EventStatus_DemEventParameter_ECU5_DTC89}
        {enable-take-address=true, indirect-api=false, port-defined-argument-value{value=Event_DemEventParameter_ECU5_DTC90:491, value-type=Dem_EventIdType}, port=Event_DemEventParameter_ECU5_DTC90}
        {enable-take-address=true, indirect-api=false, port-defined-argument-value{value=EventStatus_DemEventParameter_ECU5_DTC90:491, value-type=Dem_EventIdType}, port=EventStatus_DemEventParameter_ECU5_DTC90}
        {enable-take-address=true, indirect-api=false, port-defined-argument-value{value=Event_DemEventParameter_ECU5_DTC91:492, value-type=Dem_EventIdType}, port=Event_DemEventParameter_ECU5_DTC91}
        {enable-take-address=true, indirect-api=false, port-defined-argument-value{value=EventStatus_DemEventParameter_ECU5_DTC91:492, value-type=Dem_EventIdType}, port=EventStatus_DemEventParameter_ECU5_DTC91}
        {enable-take-address=true, indirect-api=false, port-defined-argument-value{value=Event_DemEventParameter_ECU5_DTC92:493, value-type=Dem_EventIdType}, port=Event_DemEventParameter_ECU5_DTC92}
        {enable-take-address=true, indirect-api=false, port-defined-argument-value{value=EventStatus_DemEventParameter_ECU5_DTC92:493, value-type=Dem_EventIdType}, port=EventStatus_DemEventParameter_ECU5_DTC92}
        {enable-take-address=true, indirect-api=false, port-defined-argument-value{value=Event_DemEventParameter_ECU5_DTC93:494, value-type=Dem_EventIdType}, port=Event_DemEventParameter_ECU5_DTC93}
        {enable-take-address=true, indirect-api=false, port-defined-argument-value{value=EventStatus_DemEventParameter_ECU5_DTC93:494, value-type=Dem_EventIdType}, port=EventStatus_DemEventParameter_ECU5_DTC93}
        {enable-take-address=true, indirect-api=false, port-defined-argument-value{value=Event_DemEventParameter_ECU5_DTC94:495, value-type=Dem_EventIdType}, port=Event_DemEventParameter_ECU5_DTC94}
        {enable-take-address=true, indirect-api=false, port-defined-argument-value{value=EventStatus_DemEventParameter_ECU5_DTC94:495, value-type=Dem_EventIdType}, port=EventStatus_DemEventParameter_ECU5_DTC94}
        {enable-take-address=true, indirect-api=false, port-defined-argument-value{value=Event_DemEventParameter_ECU5_DTC95:496, value-type=Dem_EventIdType}, port=Event_DemEventParameter_ECU5_DTC95}
        {enable-take-address=true, indirect-api=false, port-defined-argument-value{value=EventStatus_DemEventParameter_ECU5_DTC95:496, value-type=Dem_EventIdType}, port=EventStatus_DemEventParameter_ECU5_DTC95}
        {enable-take-address=true, indirect-api=false, port-defined-argument-value{value=Event_DemEventParameter_ECU5_DTC96:497, value-type=Dem_EventIdType}, port=Event_DemEventParameter_ECU5_DTC96}
        {enable-take-address=true, indirect-api=false, port-defined-argument-value{value=EventStatus_DemEventParameter_ECU5_DTC96:497, value-type=Dem_EventIdType}, port=EventStatus_DemEventParameter_ECU5_DTC96}
        {enable-take-address=true, indirect-api=false, port-defined-argument-value{value=Event_DemEventParameter_ECU5_DTC97:498, value-type=Dem_EventIdType}, port=Event_DemEventParameter_ECU5_DTC97}
        {enable-take-address=true, indirect-api=false, port-defined-argument-value{value=EventStatus_DemEventParameter_ECU5_DTC97:498, value-type=Dem_EventIdType}, port=EventStatus_DemEventParameter_ECU5_DTC97}
        {enable-take-address=true, indirect-api=false, port-defined-argument-value{value=Event_DemEventParameter_ECU5_DTC98:499, value-type=Dem_EventIdType}, port=Event_DemEventParameter_ECU5_DTC98}
        {enable-take-address=true, indirect-api=false, port-defined-argument-value{value=EventStatus_DemEventParameter_ECU5_DTC98:499, value-type=Dem_EventIdType}, port=EventStatus_DemEventParameter_ECU5_DTC98}
        {enable-take-address=true, indirect-api=false, port-defined-argument-value{value=Event_DemEventParameter_ECU5_DTC99:500, value-type=Dem_EventIdType}, port=Event_DemEventParameter_ECU5_DTC99}
        {enable-take-address=true, indirect-api=false, port-defined-argument-value{value=EventStatus_DemEventParameter_ECU5_DTC99:500, value-type=Dem_EventIdType}, port=EventStatus_DemEventParameter_ECU5_DTC99}
        {enable-take-address=true, indirect-api=false, port-defined-argument-value{value=OpCycle_DemOperationCycle_Power:4, value-type=Dem_OperationCycleIdType}, port=OpCycle_DemOperationCycle_Power}
        {enable-take-address=true, indirect-api=false, port-defined-argument-value{value=OpCycle_DemOperationCycle_Ignition:3, value-type=Dem_OperationCycleIdType}, port=OpCycle_DemOperationCycle_Ignition}
        {enable-take-address=true, indirect-api=false, port-defined-argument-value{value=OpCycle_WARM_UP:2, value-type=Dem_OperationCycleIdType}, port=OpCycle_WARM_UP}
        {enable-take-address=true, indirect-api=false, port-defined-argument-value{value=OpCycle_DEM_OPCYC_WARMUP:0, value-type=Dem_OperationCycleIdType}, port=OpCycle_DEM_OPCYC_WARMUP}
        {enable-take-address=true, indirect-api=false, port-defined-argument-value{value=OpCycle_DEM_OPCYC_PFC:1, value-type=Dem_OperationCycleIdType}, port=OpCycle_DEM_OPCYC_PFC}
        {enable-take-address=true, indirect-api=false, port-defined-argument-value{value=IndStatus_MIL:1, value-type=uint8}, port=IndStatus_MIL}
        {enable-take-address=true, indirect-api=false, port-defined-argument-value{value=IndStatus_MIL_Indicator:2, value-type=uint8}, port=IndStatus_MIL_Indicator}
        enable-take-address=true, indirect-api=false, port=GeneralEvtInfo
        {enable-take-address=true, indirect-api=false, port-defined-argument-value{value=ControlEventAvailable_DemEventParameter_ECU1_DTC00:1, value-type=Dem_EventIdType}, port=ControlEventAvailable_DemEventParameter_ECU1_DTC00}
        {enable-take-address=true, indirect-api=false, port-defined-argument-value{value=ControlEventAvailable_DemEventParameter_ECU1_DTC01:2, value-type=Dem_EventIdType}, port=ControlEventAvailable_DemEventParameter_ECU1_DTC01}
        {enable-take-address=true, indirect-api=false, port-defined-argument-value{value=ControlEventAvailable_DemEventParameter_ECU1_DTC02:3, value-type=Dem_EventIdType}, port=ControlEventAvailable_DemEventParameter_ECU1_DTC02}
        {enable-take-address=true, indirect-api=false, port-defined-argument-value{value=ControlEventAvailable_DemEventParameter_ECU1_DTC03:4, value-type=Dem_EventIdType}, port=ControlEventAvailable_DemEventParameter_ECU1_DTC03}
        {enable-take-address=true, indirect-api=false, port-defined-argument-value{value=ControlEventAvailable_DemEventParameter_ECU1_DTC04:5, value-type=Dem_EventIdType}, port=ControlEventAvailable_DemEventParameter_ECU1_DTC04}
        {enable-take-address=true, indirect-api=false, port-defined-argument-value{value=ControlEventAvailable_DemEventParameter_ECU1_DTC05:6, value-type=Dem_EventIdType}, port=ControlEventAvailable_DemEventParameter_ECU1_DTC05}
        {enable-take-address=true, indirect-api=false, port-defined-argument-value{value=ControlEventAvailable_DemEventParameter_ECU1_DTC06:7, value-type=Dem_EventIdType}, port=ControlEventAvailable_DemEventParameter_ECU1_DTC06}
        {enable-take-address=true, indirect-api=false, port-defined-argument-value{value=ControlEventAvailable_DemEventParameter_ECU1_DTC07:8, value-type=Dem_EventIdType}, port=ControlEventAvailable_DemEventParameter_ECU1_DTC07}
        {enable-take-address=true, indirect-api=false, port-defined-argument-value{value=ControlEventAvailable_DemEventParameter_ECU1_DTC08:9, value-type=Dem_EventIdType}, port=ControlEventAvailable_DemEventParameter_ECU1_DTC08}
        {enable-take-address=true, indirect-api=false, port-defined-argument-value{value=ControlEventAvailable_DemEventParameter_ECU1_DTC09:10, value-type=Dem_EventIdType}, port=ControlEventAvailable_DemEventParameter_ECU1_DTC09}
        {enable-take-address=true, indirect-api=false, port-defined-argument-value{value=ControlEventAvailable_DemEventParameter_ECU1_DTC10:11, value-type=Dem_EventIdType}, port=ControlEventAvailable_DemEventParameter_ECU1_DTC10}
        {enable-take-address=true, indirect-api=false, port-defined-argument-value{value=ControlEventAvailable_DemEventParameter_ECU1_DTC11:12, value-type=Dem_EventIdType}, port=ControlEventAvailable_DemEventParameter_ECU1_DTC11}
        {enable-take-address=true, indirect-api=false, port-defined-argument-value{value=ControlEventAvailable_DemEventParameter_ECU1_DTC12:13, value-type=Dem_EventIdType}, port=ControlEventAvailable_DemEventParameter_ECU1_DTC12}
        {enable-take-address=true, indirect-api=false, port-defined-argument-value{value=ControlEventAvailable_DemEventParameter_ECU1_DTC13:14, value-type=Dem_EventIdType}, port=ControlEventAvailable_DemEventParameter_ECU1_DTC13}
        {enable-take-address=true, indirect-api=false, port-defined-argument-value{value=ControlEventAvailable_DemEventParameter_ECU1_DTC14:15, value-type=Dem_EventIdType}, port=ControlEventAvailable_DemEventParameter_ECU1_DTC14}
        {enable-take-address=true, indirect-api=false, port-defined-argument-value{value=ControlEventAvailable_DemEventParameter_ECU1_DTC15:16, value-type=Dem_EventIdType}, port=ControlEventAvailable_DemEventParameter_ECU1_DTC15}
        {enable-take-address=true, indirect-api=false, port-defined-argument-value{value=ControlEventAvailable_DemEventParameter_ECU1_DTC16:17, value-type=Dem_EventIdType}, port=ControlEventAvailable_DemEventParameter_ECU1_DTC16}
        {enable-take-address=true, indirect-api=false, port-defined-argument-value{value=ControlEventAvailable_DemEventParameter_ECU1_DTC17:18, value-type=Dem_EventIdType}, port=ControlEventAvailable_DemEventParameter_ECU1_DTC17}
        {enable-take-address=true, indirect-api=false, port-defined-argument-value{value=ControlEventAvailable_DemEventParameter_ECU1_DTC18:19, value-type=Dem_EventIdType}, port=ControlEventAvailable_DemEventParameter_ECU1_DTC18}
        {enable-take-address=true, indirect-api=false, port-defined-argument-value{value=ControlEventAvailable_DemEventParameter_ECU1_DTC19:20, value-type=Dem_EventIdType}, port=ControlEventAvailable_DemEventParameter_ECU1_DTC19}
        {enable-take-address=true, indirect-api=false, port-defined-argument-value{value=ControlEventAvailable_DemEventParameter_ECU1_DTC20:21, value-type=Dem_EventIdType}, port=ControlEventAvailable_DemEventParameter_ECU1_DTC20}
        {enable-take-address=true, indirect-api=false, port-defined-argument-value{value=ControlEventAvailable_DemEventParameter_ECU1_DTC21:22, value-type=Dem_EventIdType}, port=ControlEventAvailable_DemEventParameter_ECU1_DTC21}
        {enable-take-address=true, indirect-api=false, port-defined-argument-value{value=ControlEventAvailable_DemEventParameter_ECU1_DTC22:23, value-type=Dem_EventIdType}, port=ControlEventAvailable_DemEventParameter_ECU1_DTC22}
        {enable-take-address=true, indirect-api=false, port-defined-argument-value{value=ControlEventAvailable_DemEventParameter_ECU1_DTC23:24, value-type=Dem_EventIdType}, port=ControlEventAvailable_DemEventParameter_ECU1_DTC23}
        {enable-take-address=true, indirect-api=false, port-defined-argument-value{value=ControlEventAvailable_DemEventParameter_ECU1_DTC24:25, value-type=Dem_EventIdType}, port=ControlEventAvailable_DemEventParameter_ECU1_DTC24}
        {enable-take-address=true, indirect-api=false, port-defined-argument-value{value=ControlEventAvailable_DemEventParameter_ECU1_DTC25:26, value-type=Dem_EventIdType}, port=ControlEventAvailable_DemEventParameter_ECU1_DTC25}
        {enable-take-address=true, indirect-api=false, port-defined-argument-value{value=ControlEventAvailable_DemEventParameter_ECU1_DTC26:27, value-type=Dem_EventIdType}, port=ControlEventAvailable_DemEventParameter_ECU1_DTC26}
        {enable-take-address=true, indirect-api=false, port-defined-argument-value{value=ControlEventAvailable_DemEventParameter_ECU1_DTC27:28, value-type=Dem_EventIdType}, port=ControlEventAvailable_DemEventParameter_ECU1_DTC27}
        {enable-take-address=true, indirect-api=false, port-defined-argument-value{value=ControlEventAvailable_DemEventParameter_ECU1_DTC28:29, value-type=Dem_EventIdType}, port=ControlEventAvailable_DemEventParameter_ECU1_DTC28}
        {enable-take-address=true, indirect-api=false, port-defined-argument-value{value=ControlEventAvailable_DemEventParameter_ECU1_DTC29:30, value-type=Dem_EventIdType}, port=ControlEventAvailable_DemEventParameter_ECU1_DTC29}
        {enable-take-address=true, indirect-api=false, port-defined-argument-value{value=ControlEventAvailable_DemEventParameter_ECU1_DTC30:31, value-type=Dem_EventIdType}, port=ControlEventAvailable_DemEventParameter_ECU1_DTC30}
        {enable-take-address=true, indirect-api=false, port-defined-argument-value{value=ControlEventAvailable_DemEventParameter_ECU1_DTC31:32, value-type=Dem_EventIdType}, port=ControlEventAvailable_DemEventParameter_ECU1_DTC31}
        {enable-take-address=true, indirect-api=false, port-defined-argument-value{value=ControlEventAvailable_DemEventParameter_ECU1_DTC32:33, value-type=Dem_EventIdType}, port=ControlEventAvailable_DemEventParameter_ECU1_DTC32}
        {enable-take-address=true, indirect-api=false, port-defined-argument-value{value=ControlEventAvailable_DemEventParameter_ECU1_DTC33:34, value-type=Dem_EventIdType}, port=ControlEventAvailable_DemEventParameter_ECU1_DTC33}
        {enable-take-address=true, indirect-api=false, port-defined-argument-value{value=ControlEventAvailable_DemEventParameter_ECU1_DTC34:35, value-type=Dem_EventIdType}, port=ControlEventAvailable_DemEventParameter_ECU1_DTC34}
        {enable-take-address=true, indirect-api=false, port-defined-argument-value{value=ControlEventAvailable_DemEventParameter_ECU1_DTC35:36, value-type=Dem_EventIdType}, port=ControlEventAvailable_DemEventParameter_ECU1_DTC35}
        {enable-take-address=true, indirect-api=false, port-defined-argument-value{value=ControlEventAvailable_DemEventParameter_ECU1_DTC36:37, value-type=Dem_EventIdType}, port=ControlEventAvailable_DemEventParameter_ECU1_DTC36}
        {enable-take-address=true, indirect-api=false, port-defined-argument-value{value=ControlEventAvailable_DemEventParameter_ECU1_DTC37:38, value-type=Dem_EventIdType}, port=ControlEventAvailable_DemEventParameter_ECU1_DTC37}
        {enable-take-address=true, indirect-api=false, port-defined-argument-value{value=ControlEventAvailable_DemEventParameter_ECU1_DTC38:39, value-type=Dem_EventIdType}, port=ControlEventAvailable_DemEventParameter_ECU1_DTC38}
        {enable-take-address=true, indirect-api=false, port-defined-argument-value{value=ControlEventAvailable_DemEventParameter_ECU1_DTC39:40, value-type=Dem_EventIdType}, port=ControlEventAvailable_DemEventParameter_ECU1_DTC39}
        {enable-take-address=true, indirect-api=false, port-defined-argument-value{value=ControlEventAvailable_DemEventParameter_ECU1_DTC40:41, value-type=Dem_EventIdType}, port=ControlEventAvailable_DemEventParameter_ECU1_DTC40}
        {enable-take-address=true, indirect-api=false, port-defined-argument-value{value=ControlEventAvailable_DemEventParameter_ECU1_DTC41:42, value-type=Dem_EventIdType}, port=ControlEventAvailable_DemEventParameter_ECU1_DTC41}
        {enable-take-address=true, indirect-api=false, port-defined-argument-value{value=ControlEventAvailable_DemEventParameter_ECU1_DTC42:43, value-type=Dem_EventIdType}, port=ControlEventAvailable_DemEventParameter_ECU1_DTC42}
        {enable-take-address=true, indirect-api=false, port-defined-argument-value{value=ControlEventAvailable_DemEventParameter_ECU1_DTC43:44, value-type=Dem_EventIdType}, port=ControlEventAvailable_DemEventParameter_ECU1_DTC43}
        {enable-take-address=true, indirect-api=false, port-defined-argument-value{value=ControlEventAvailable_DemEventParameter_ECU1_DTC44:45, value-type=Dem_EventIdType}, port=ControlEventAvailable_DemEventParameter_ECU1_DTC44}
        {enable-take-address=true, indirect-api=false, port-defined-argument-value{value=ControlEventAvailable_DemEventParameter_ECU1_DTC45:46, value-type=Dem_EventIdType}, port=ControlEventAvailable_DemEventParameter_ECU1_DTC45}
        {enable-take-address=true, indirect-api=false, port-defined-argument-value{value=ControlEventAvailable_DemEventParameter_ECU1_DTC46:47, value-type=Dem_EventIdType}, port=ControlEventAvailable_DemEventParameter_ECU1_DTC46}
        {enable-take-address=true, indirect-api=false, port-defined-argument-value{value=ControlEventAvailable_DemEventParameter_ECU1_DTC47:48, value-type=Dem_EventIdType}, port=ControlEventAvailable_DemEventParameter_ECU1_DTC47}
        {enable-take-address=true, indirect-api=false, port-defined-argument-value{value=ControlEventAvailable_DemEventParameter_ECU1_DTC48:49, value-type=Dem_EventIdType}, port=ControlEventAvailable_DemEventParameter_ECU1_DTC48}
        {enable-take-address=true, indirect-api=false, port-defined-argument-value{value=ControlEventAvailable_DemEventParameter_ECU1_DTC49:50, value-type=Dem_EventIdType}, port=ControlEventAvailable_DemEventParameter_ECU1_DTC49}
        {enable-take-address=true, indirect-api=false, port-defined-argument-value{value=ControlEventAvailable_DemEventParameter_ECU1_DTC50:51, value-type=Dem_EventIdType}, port=ControlEventAvailable_DemEventParameter_ECU1_DTC50}
        {enable-take-address=true, indirect-api=false, port-defined-argument-value{value=ControlEventAvailable_DemEventParameter_ECU1_DTC51:52, value-type=Dem_EventIdType}, port=ControlEventAvailable_DemEventParameter_ECU1_DTC51}
        {enable-take-address=true, indirect-api=false, port-defined-argument-value{value=ControlEventAvailable_DemEventParameter_ECU1_DTC52:53, value-type=Dem_EventIdType}, port=ControlEventAvailable_DemEventParameter_ECU1_DTC52}
        {enable-take-address=true, indirect-api=false, port-defined-argument-value{value=ControlEventAvailable_DemEventParameter_ECU1_DTC53:54, value-type=Dem_EventIdType}, port=ControlEventAvailable_DemEventParameter_ECU1_DTC53}
        {enable-take-address=true, indirect-api=false, port-defined-argument-value{value=ControlEventAvailable_DemEventParameter_ECU1_DTC54:55, value-type=Dem_EventIdType}, port=ControlEventAvailable_DemEventParameter_ECU1_DTC54}
        {enable-take-address=true, indirect-api=false, port-defined-argument-value{value=ControlEventAvailable_DemEventParameter_ECU1_DTC55:56, value-type=Dem_EventIdType}, port=ControlEventAvailable_DemEventParameter_ECU1_DTC55}
        {enable-take-address=true, indirect-api=false, port-defined-argument-value{value=ControlEventAvailable_DemEventParameter_ECU1_DTC56:57, value-type=Dem_EventIdType}, port=ControlEventAvailable_DemEventParameter_ECU1_DTC56}
        {enable-take-address=true, indirect-api=false, port-defined-argument-value{value=ControlEventAvailable_DemEventParameter_ECU1_DTC57:58, value-type=Dem_EventIdType}, port=ControlEventAvailable_DemEventParameter_ECU1_DTC57}
        {enable-take-address=true, indirect-api=false, port-defined-argument-value{value=ControlEventAvailable_DemEventParameter_ECU1_DTC58:59, value-type=Dem_EventIdType}, port=ControlEventAvailable_DemEventParameter_ECU1_DTC58}
        {enable-take-address=true, indirect-api=false, port-defined-argument-value{value=ControlEventAvailable_DemEventParameter_ECU1_DTC59:60, value-type=Dem_EventIdType}, port=ControlEventAvailable_DemEventParameter_ECU1_DTC59}
        {enable-take-address=true, indirect-api=false, port-defined-argument-value{value=ControlEventAvailable_DemEventParameter_ECU1_DTC60:61, value-type=Dem_EventIdType}, port=ControlEventAvailable_DemEventParameter_ECU1_DTC60}
        {enable-take-address=true, indirect-api=false, port-defined-argument-value{value=ControlEventAvailable_DemEventParameter_ECU1_DTC61:62, value-type=Dem_EventIdType}, port=ControlEventAvailable_DemEventParameter_ECU1_DTC61}
        {enable-take-address=true, indirect-api=false, port-defined-argument-value{value=ControlEventAvailable_DemEventParameter_ECU1_DTC62:63, value-type=Dem_EventIdType}, port=ControlEventAvailable_DemEventParameter_ECU1_DTC62}
        {enable-take-address=true, indirect-api=false, port-defined-argument-value{value=ControlEventAvailable_DemEventParameter_ECU1_DTC63:64, value-type=Dem_EventIdType}, port=ControlEventAvailable_DemEventParameter_ECU1_DTC63}
        {enable-take-address=true, indirect-api=false, port-defined-argument-value{value=ControlEventAvailable_DemEventParameter_ECU1_DTC64:65, value-type=Dem_EventIdType}, port=ControlEventAvailable_DemEventParameter_ECU1_DTC64}
        {enable-take-address=true, indirect-api=false, port-defined-argument-value{value=ControlEventAvailable_DemEventParameter_ECU1_DTC65:66, value-type=Dem_EventIdType}, port=ControlEventAvailable_DemEventParameter_ECU1_DTC65}
        {enable-take-address=true, indirect-api=false, port-defined-argument-value{value=ControlEventAvailable_DemEventParameter_ECU1_DTC66:67, value-type=Dem_EventIdType}, port=ControlEventAvailable_DemEventParameter_ECU1_DTC66}
        {enable-take-address=true, indirect-api=false, port-defined-argument-value{value=ControlEventAvailable_DemEventParameter_ECU1_DTC67:68, value-type=Dem_EventIdType}, port=ControlEventAvailable_DemEventParameter_ECU1_DTC67}
        {enable-take-address=true, indirect-api=false, port-defined-argument-value{value=ControlEventAvailable_DemEventParameter_ECU1_DTC68:69, value-type=Dem_EventIdType}, port=ControlEventAvailable_DemEventParameter_ECU1_DTC68}
        {enable-take-address=true, indirect-api=false, port-defined-argument-value{value=ControlEventAvailable_DemEventParameter_ECU1_DTC69:70, value-type=Dem_EventIdType}, port=ControlEventAvailable_DemEventParameter_ECU1_DTC69}
        {enable-take-address=true, indirect-api=false, port-defined-argument-value{value=ControlEventAvailable_DemEventParameter_ECU1_DTC70:71, value-type=Dem_EventIdType}, port=ControlEventAvailable_DemEventParameter_ECU1_DTC70}
        {enable-take-address=true, indirect-api=false, port-defined-argument-value{value=ControlEventAvailable_DemEventParameter_ECU1_DTC71:72, value-type=Dem_EventIdType}, port=ControlEventAvailable_DemEventParameter_ECU1_DTC71}
        {enable-take-address=true, indirect-api=false, port-defined-argument-value{value=ControlEventAvailable_DemEventParameter_ECU1_DTC72:73, value-type=Dem_EventIdType}, port=ControlEventAvailable_DemEventParameter_ECU1_DTC72}
        {enable-take-address=true, indirect-api=false, port-defined-argument-value{value=ControlEventAvailable_DemEventParameter_ECU1_DTC73:74, value-type=Dem_EventIdType}, port=ControlEventAvailable_DemEventParameter_ECU1_DTC73}
        {enable-take-address=true, indirect-api=false, port-defined-argument-value{value=ControlEventAvailable_DemEventParameter_ECU1_DTC74:75, value-type=Dem_EventIdType}, port=ControlEventAvailable_DemEventParameter_ECU1_DTC74}
        {enable-take-address=true, indirect-api=false, port-defined-argument-value{value=ControlEventAvailable_DemEventParameter_ECU1_DTC75:76, value-type=Dem_EventIdType}, port=ControlEventAvailable_DemEventParameter_ECU1_DTC75}
        {enable-take-address=true, indirect-api=false, port-defined-argument-value{value=ControlEventAvailable_DemEventParameter_ECU1_DTC76:77, value-type=Dem_EventIdType}, port=ControlEventAvailable_DemEventParameter_ECU1_DTC76}
        {enable-take-address=true, indirect-api=false, port-defined-argument-value{value=ControlEventAvailable_DemEventParameter_ECU1_DTC77:78, value-type=Dem_EventIdType}, port=ControlEventAvailable_DemEventParameter_ECU1_DTC77}
        {enable-take-address=true, indirect-api=false, port-defined-argument-value{value=ControlEventAvailable_DemEventParameter_ECU1_DTC78:79, value-type=Dem_EventIdType}, port=ControlEventAvailable_DemEventParameter_ECU1_DTC78}
        {enable-take-address=true, indirect-api=false, port-defined-argument-value{value=ControlEventAvailable_DemEventParameter_ECU1_DTC79:80, value-type=Dem_EventIdType}, port=ControlEventAvailable_DemEventParameter_ECU1_DTC79}
        {enable-take-address=true, indirect-api=false, port-defined-argument-value{value=ControlEventAvailable_DemEventParameter_ECU1_DTC80:81, value-type=Dem_EventIdType}, port=ControlEventAvailable_DemEventParameter_ECU1_DTC80}
        {enable-take-address=true, indirect-api=false, port-defined-argument-value{value=ControlEventAvailable_DemEventParameter_ECU1_DTC81:82, value-type=Dem_EventIdType}, port=ControlEventAvailable_DemEventParameter_ECU1_DTC81}
        {enable-take-address=true, indirect-api=false, port-defined-argument-value{value=ControlEventAvailable_DemEventParameter_ECU1_DTC82:83, value-type=Dem_EventIdType}, port=ControlEventAvailable_DemEventParameter_ECU1_DTC82}
        {enable-take-address=true, indirect-api=false, port-defined-argument-value{value=ControlEventAvailable_DemEventParameter_ECU1_DTC83:84, value-type=Dem_EventIdType}, port=ControlEventAvailable_DemEventParameter_ECU1_DTC83}
        {enable-take-address=true, indirect-api=false, port-defined-argument-value{value=ControlEventAvailable_DemEventParameter_ECU1_DTC84:85, value-type=Dem_EventIdType}, port=ControlEventAvailable_DemEventParameter_ECU1_DTC84}
        {enable-take-address=true, indirect-api=false, port-defined-argument-value{value=ControlEventAvailable_DemEventParameter_ECU1_DTC85:86, value-type=Dem_EventIdType}, port=ControlEventAvailable_DemEventParameter_ECU1_DTC85}
        {enable-take-address=true, indirect-api=false, port-defined-argument-value{value=ControlEventAvailable_DemEventParameter_ECU1_DTC86:87, value-type=Dem_EventIdType}, port=ControlEventAvailable_DemEventParameter_ECU1_DTC86}
        {enable-take-address=true, indirect-api=false, port-defined-argument-value{value=ControlEventAvailable_DemEventParameter_ECU1_DTC87:88, value-type=Dem_EventIdType}, port=ControlEventAvailable_DemEventParameter_ECU1_DTC87}
        {enable-take-address=true, indirect-api=false, port-defined-argument-value{value=ControlEventAvailable_DemEventParameter_ECU1_DTC88:89, value-type=Dem_EventIdType}, port=ControlEventAvailable_DemEventParameter_ECU1_DTC88}
        {enable-take-address=true, indirect-api=false, port-defined-argument-value{value=ControlEventAvailable_DemEventParameter_ECU1_DTC89:90, value-type=Dem_EventIdType}, port=ControlEventAvailable_DemEventParameter_ECU1_DTC89}
        {enable-take-address=true, indirect-api=false, port-defined-argument-value{value=ControlEventAvailable_DemEventParameter_ECU1_DTC90:91, value-type=Dem_EventIdType}, port=ControlEventAvailable_DemEventParameter_ECU1_DTC90}
        {enable-take-address=true, indirect-api=false, port-defined-argument-value{value=ControlEventAvailable_DemEventParameter_ECU1_DTC91:92, value-type=Dem_EventIdType}, port=ControlEventAvailable_DemEventParameter_ECU1_DTC91}
        {enable-take-address=true, indirect-api=false, port-defined-argument-value{value=ControlEventAvailable_DemEventParameter_ECU1_DTC92:93, value-type=Dem_EventIdType}, port=ControlEventAvailable_DemEventParameter_ECU1_DTC92}
        {enable-take-address=true, indirect-api=false, port-defined-argument-value{value=ControlEventAvailable_DemEventParameter_ECU1_DTC93:94, value-type=Dem_EventIdType}, port=ControlEventAvailable_DemEventParameter_ECU1_DTC93}
        {enable-take-address=true, indirect-api=false, port-defined-argument-value{value=ControlEventAvailable_DemEventParameter_ECU1_DTC94:95, value-type=Dem_EventIdType}, port=ControlEventAvailable_DemEventParameter_ECU1_DTC94}
        {enable-take-address=true, indirect-api=false, port-defined-argument-value{value=ControlEventAvailable_DemEventParameter_ECU1_DTC95:96, value-type=Dem_EventIdType}, port=ControlEventAvailable_DemEventParameter_ECU1_DTC95}
        {enable-take-address=true, indirect-api=false, port-defined-argument-value{value=ControlEventAvailable_DemEventParameter_ECU1_DTC96:97, value-type=Dem_EventIdType}, port=ControlEventAvailable_DemEventParameter_ECU1_DTC96}
        {enable-take-address=true, indirect-api=false, port-defined-argument-value{value=ControlEventAvailable_DemEventParameter_ECU1_DTC97:98, value-type=Dem_EventIdType}, port=ControlEventAvailable_DemEventParameter_ECU1_DTC97}
        {enable-take-address=true, indirect-api=false, port-defined-argument-value{value=ControlEventAvailable_DemEventParameter_ECU1_DTC98:99, value-type=Dem_EventIdType}, port=ControlEventAvailable_DemEventParameter_ECU1_DTC98}
        {enable-take-address=true, indirect-api=false, port-defined-argument-value{value=ControlEventAvailable_DemEventParameter_ECU1_DTC99:100, value-type=Dem_EventIdType}, port=ControlEventAvailable_DemEventParameter_ECU1_DTC99}
        {enable-take-address=true, indirect-api=false, port-defined-argument-value{value=ControlEventAvailable_DemEventParameter_ECU2_DTC00:101, value-type=Dem_EventIdType}, port=ControlEventAvailable_DemEventParameter_ECU2_DTC00}
        {enable-take-address=true, indirect-api=false, port-defined-argument-value{value=ControlEventAvailable_DemEventParameter_ECU2_DTC01:102, value-type=Dem_EventIdType}, port=ControlEventAvailable_DemEventParameter_ECU2_DTC01}
        {enable-take-address=true, indirect-api=false, port-defined-argument-value{value=ControlEventAvailable_DemEventParameter_ECU2_DTC02:103, value-type=Dem_EventIdType}, port=ControlEventAvailable_DemEventParameter_ECU2_DTC02}
        {enable-take-address=true, indirect-api=false, port-defined-argument-value{value=ControlEventAvailable_DemEventParameter_ECU2_DTC03:104, value-type=Dem_EventIdType}, port=ControlEventAvailable_DemEventParameter_ECU2_DTC03}
        {enable-take-address=true, indirect-api=false, port-defined-argument-value{value=ControlEventAvailable_DemEventParameter_ECU2_DTC04:105, value-type=Dem_EventIdType}, port=ControlEventAvailable_DemEventParameter_ECU2_DTC04}
        {enable-take-address=true, indirect-api=false, port-defined-argument-value{value=ControlEventAvailable_DemEventParameter_ECU2_DTC05:106, value-type=Dem_EventIdType}, port=ControlEventAvailable_DemEventParameter_ECU2_DTC05}
        {enable-take-address=true, indirect-api=false, port-defined-argument-value{value=ControlEventAvailable_DemEventParameter_ECU2_DTC06:107, value-type=Dem_EventIdType}, port=ControlEventAvailable_DemEventParameter_ECU2_DTC06}
        {enable-take-address=true, indirect-api=false, port-defined-argument-value{value=ControlEventAvailable_DemEventParameter_ECU2_DTC07:108, value-type=Dem_EventIdType}, port=ControlEventAvailable_DemEventParameter_ECU2_DTC07}
        {enable-take-address=true, indirect-api=false, port-defined-argument-value{value=ControlEventAvailable_DemEventParameter_ECU2_DTC08:109, value-type=Dem_EventIdType}, port=ControlEventAvailable_DemEventParameter_ECU2_DTC08}
        {enable-take-address=true, indirect-api=false, port-defined-argument-value{value=ControlEventAvailable_DemEventParameter_ECU2_DTC09:110, value-type=Dem_EventIdType}, port=ControlEventAvailable_DemEventParameter_ECU2_DTC09}
        {enable-take-address=true, indirect-api=false, port-defined-argument-value{value=ControlEventAvailable_DemEventParameter_ECU2_DTC10:111, value-type=Dem_EventIdType}, port=ControlEventAvailable_DemEventParameter_ECU2_DTC10}
        {enable-take-address=true, indirect-api=false, port-defined-argument-value{value=ControlEventAvailable_DemEventParameter_ECU2_DTC11:112, value-type=Dem_EventIdType}, port=ControlEventAvailable_DemEventParameter_ECU2_DTC11}
        {enable-take-address=true, indirect-api=false, port-defined-argument-value{value=ControlEventAvailable_DemEventParameter_ECU2_DTC12:113, value-type=Dem_EventIdType}, port=ControlEventAvailable_DemEventParameter_ECU2_DTC12}
        {enable-take-address=true, indirect-api=false, port-defined-argument-value{value=ControlEventAvailable_DemEventParameter_ECU2_DTC13:114, value-type=Dem_EventIdType}, port=ControlEventAvailable_DemEventParameter_ECU2_DTC13}
        {enable-take-address=true, indirect-api=false, port-defined-argument-value{value=ControlEventAvailable_DemEventParameter_ECU2_DTC14:115, value-type=Dem_EventIdType}, port=ControlEventAvailable_DemEventParameter_ECU2_DTC14}
        {enable-take-address=true, indirect-api=false, port-defined-argument-value{value=ControlEventAvailable_DemEventParameter_ECU2_DTC15:116, value-type=Dem_EventIdType}, port=ControlEventAvailable_DemEventParameter_ECU2_DTC15}
        {enable-take-address=true, indirect-api=false, port-defined-argument-value{value=ControlEventAvailable_DemEventParameter_ECU2_DTC16:117, value-type=Dem_EventIdType}, port=ControlEventAvailable_DemEventParameter_ECU2_DTC16}
        {enable-take-address=true, indirect-api=false, port-defined-argument-value{value=ControlEventAvailable_DemEventParameter_ECU2_DTC17:118, value-type=Dem_EventIdType}, port=ControlEventAvailable_DemEventParameter_ECU2_DTC17}
        {enable-take-address=true, indirect-api=false, port-defined-argument-value{value=ControlEventAvailable_DemEventParameter_ECU2_DTC18:119, value-type=Dem_EventIdType}, port=ControlEventAvailable_DemEventParameter_ECU2_DTC18}
        {enable-take-address=true, indirect-api=false, port-defined-argument-value{value=ControlEventAvailable_DemEventParameter_ECU2_DTC19:120, value-type=Dem_EventIdType}, port=ControlEventAvailable_DemEventParameter_ECU2_DTC19}
        {enable-take-address=true, indirect-api=false, port-defined-argument-value{value=ControlEventAvailable_DemEventParameter_ECU2_DTC20:121, value-type=Dem_EventIdType}, port=ControlEventAvailable_DemEventParameter_ECU2_DTC20}
        {enable-take-address=true, indirect-api=false, port-defined-argument-value{value=ControlEventAvailable_DemEventParameter_ECU2_DTC21:122, value-type=Dem_EventIdType}, port=ControlEventAvailable_DemEventParameter_ECU2_DTC21}
        {enable-take-address=true, indirect-api=false, port-defined-argument-value{value=ControlEventAvailable_DemEventParameter_ECU2_DTC22:123, value-type=Dem_EventIdType}, port=ControlEventAvailable_DemEventParameter_ECU2_DTC22}
        {enable-take-address=true, indirect-api=false, port-defined-argument-value{value=ControlEventAvailable_DemEventParameter_ECU2_DTC23:124, value-type=Dem_EventIdType}, port=ControlEventAvailable_DemEventParameter_ECU2_DTC23}
        {enable-take-address=true, indirect-api=false, port-defined-argument-value{value=ControlEventAvailable_DemEventParameter_ECU2_DTC24:125, value-type=Dem_EventIdType}, port=ControlEventAvailable_DemEventParameter_ECU2_DTC24}
        {enable-take-address=true, indirect-api=false, port-defined-argument-value{value=ControlEventAvailable_DemEventParameter_ECU2_DTC25:126, value-type=Dem_EventIdType}, port=ControlEventAvailable_DemEventParameter_ECU2_DTC25}
        {enable-take-address=true, indirect-api=false, port-defined-argument-value{value=ControlEventAvailable_DemEventParameter_ECU2_DTC26:127, value-type=Dem_EventIdType}, port=ControlEventAvailable_DemEventParameter_ECU2_DTC26}
        {enable-take-address=true, indirect-api=false, port-defined-argument-value{value=ControlEventAvailable_DemEventParameter_ECU2_DTC27:128, value-type=Dem_EventIdType}, port=ControlEventAvailable_DemEventParameter_ECU2_DTC27}
        {enable-take-address=true, indirect-api=false, port-defined-argument-value{value=ControlEventAvailable_DemEventParameter_ECU2_DTC28:129, value-type=Dem_EventIdType}, port=ControlEventAvailable_DemEventParameter_ECU2_DTC28}
        {enable-take-address=true, indirect-api=false, port-defined-argument-value{value=ControlEventAvailable_DemEventParameter_ECU2_DTC29:130, value-type=Dem_EventIdType}, port=ControlEventAvailable_DemEventParameter_ECU2_DTC29}
        {enable-take-address=true, indirect-api=false, port-defined-argument-value{value=ControlEventAvailable_DemEventParameter_ECU2_DTC30:131, value-type=Dem_EventIdType}, port=ControlEventAvailable_DemEventParameter_ECU2_DTC30}
        {enable-take-address=true, indirect-api=false, port-defined-argument-value{value=ControlEventAvailable_DemEventParameter_ECU2_DTC31:132, value-type=Dem_EventIdType}, port=ControlEventAvailable_DemEventParameter_ECU2_DTC31}
        {enable-take-address=true, indirect-api=false, port-defined-argument-value{value=ControlEventAvailable_DemEventParameter_ECU2_DTC32:133, value-type=Dem_EventIdType}, port=ControlEventAvailable_DemEventParameter_ECU2_DTC32}
        {enable-take-address=true, indirect-api=false, port-defined-argument-value{value=ControlEventAvailable_DemEventParameter_ECU2_DTC33:134, value-type=Dem_EventIdType}, port=ControlEventAvailable_DemEventParameter_ECU2_DTC33}
        {enable-take-address=true, indirect-api=false, port-defined-argument-value{value=ControlEventAvailable_DemEventParameter_ECU2_DTC34:135, value-type=Dem_EventIdType}, port=ControlEventAvailable_DemEventParameter_ECU2_DTC34}
        {enable-take-address=true, indirect-api=false, port-defined-argument-value{value=ControlEventAvailable_DemEventParameter_ECU2_DTC35:136, value-type=Dem_EventIdType}, port=ControlEventAvailable_DemEventParameter_ECU2_DTC35}
        {enable-take-address=true, indirect-api=false, port-defined-argument-value{value=ControlEventAvailable_DemEventParameter_ECU2_DTC36:137, value-type=Dem_EventIdType}, port=ControlEventAvailable_DemEventParameter_ECU2_DTC36}
        {enable-take-address=true, indirect-api=false, port-defined-argument-value{value=ControlEventAvailable_DemEventParameter_ECU2_DTC37:138, value-type=Dem_EventIdType}, port=ControlEventAvailable_DemEventParameter_ECU2_DTC37}
        {enable-take-address=true, indirect-api=false, port-defined-argument-value{value=ControlEventAvailable_DemEventParameter_ECU2_DTC38:139, value-type=Dem_EventIdType}, port=ControlEventAvailable_DemEventParameter_ECU2_DTC38}
        {enable-take-address=true, indirect-api=false, port-defined-argument-value{value=ControlEventAvailable_DemEventParameter_ECU2_DTC39:140, value-type=Dem_EventIdType}, port=ControlEventAvailable_DemEventParameter_ECU2_DTC39}
        {enable-take-address=true, indirect-api=false, port-defined-argument-value{value=ControlEventAvailable_DemEventParameter_ECU2_DTC40:141, value-type=Dem_EventIdType}, port=ControlEventAvailable_DemEventParameter_ECU2_DTC40}
        {enable-take-address=true, indirect-api=false, port-defined-argument-value{value=ControlEventAvailable_DemEventParameter_ECU2_DTC41:142, value-type=Dem_EventIdType}, port=ControlEventAvailable_DemEventParameter_ECU2_DTC41}
        {enable-take-address=true, indirect-api=false, port-defined-argument-value{value=ControlEventAvailable_DemEventParameter_ECU2_DTC42:143, value-type=Dem_EventIdType}, port=ControlEventAvailable_DemEventParameter_ECU2_DTC42}
        {enable-take-address=true, indirect-api=false, port-defined-argument-value{value=ControlEventAvailable_DemEventParameter_ECU2_DTC43:144, value-type=Dem_EventIdType}, port=ControlEventAvailable_DemEventParameter_ECU2_DTC43}
        {enable-take-address=true, indirect-api=false, port-defined-argument-value{value=ControlEventAvailable_DemEventParameter_ECU2_DTC44:145, value-type=Dem_EventIdType}, port=ControlEventAvailable_DemEventParameter_ECU2_DTC44}
        {enable-take-address=true, indirect-api=false, port-defined-argument-value{value=ControlEventAvailable_DemEventParameter_ECU2_DTC45:146, value-type=Dem_EventIdType}, port=ControlEventAvailable_DemEventParameter_ECU2_DTC45}
        {enable-take-address=true, indirect-api=false, port-defined-argument-value{value=ControlEventAvailable_DemEventParameter_ECU2_DTC46:147, value-type=Dem_EventIdType}, port=ControlEventAvailable_DemEventParameter_ECU2_DTC46}
        {enable-take-address=true, indirect-api=false, port-defined-argument-value{value=ControlEventAvailable_DemEventParameter_ECU2_DTC47:148, value-type=Dem_EventIdType}, port=ControlEventAvailable_DemEventParameter_ECU2_DTC47}
        {enable-take-address=true, indirect-api=false, port-defined-argument-value{value=ControlEventAvailable_DemEventParameter_ECU2_DTC48:149, value-type=Dem_EventIdType}, port=ControlEventAvailable_DemEventParameter_ECU2_DTC48}
        {enable-take-address=true, indirect-api=false, port-defined-argument-value{value=ControlEventAvailable_DemEventParameter_ECU2_DTC49:150, value-type=Dem_EventIdType}, port=ControlEventAvailable_DemEventParameter_ECU2_DTC49}
        {enable-take-address=true, indirect-api=false, port-defined-argument-value{value=ControlEventAvailable_DemEventParameter_ECU2_DTC50:151, value-type=Dem_EventIdType}, port=ControlEventAvailable_DemEventParameter_ECU2_DTC50}
        {enable-take-address=true, indirect-api=false, port-defined-argument-value{value=ControlEventAvailable_DemEventParameter_ECU2_DTC51:152, value-type=Dem_EventIdType}, port=ControlEventAvailable_DemEventParameter_ECU2_DTC51}
        {enable-take-address=true, indirect-api=false, port-defined-argument-value{value=ControlEventAvailable_DemEventParameter_ECU2_DTC52:153, value-type=Dem_EventIdType}, port=ControlEventAvailable_DemEventParameter_ECU2_DTC52}
        {enable-take-address=true, indirect-api=false, port-defined-argument-value{value=ControlEventAvailable_DemEventParameter_ECU2_DTC53:154, value-type=Dem_EventIdType}, port=ControlEventAvailable_DemEventParameter_ECU2_DTC53}
        {enable-take-address=true, indirect-api=false, port-defined-argument-value{value=ControlEventAvailable_DemEventParameter_ECU2_DTC54:155, value-type=Dem_EventIdType}, port=ControlEventAvailable_DemEventParameter_ECU2_DTC54}
        {enable-take-address=true, indirect-api=false, port-defined-argument-value{value=ControlEventAvailable_DemEventParameter_ECU2_DTC55:156, value-type=Dem_EventIdType}, port=ControlEventAvailable_DemEventParameter_ECU2_DTC55}
        {enable-take-address=true, indirect-api=false, port-defined-argument-value{value=ControlEventAvailable_DemEventParameter_ECU2_DTC56:157, value-type=Dem_EventIdType}, port=ControlEventAvailable_DemEventParameter_ECU2_DTC56}
        {enable-take-address=true, indirect-api=false, port-defined-argument-value{value=ControlEventAvailable_DemEventParameter_ECU2_DTC57:158, value-type=Dem_EventIdType}, port=ControlEventAvailable_DemEventParameter_ECU2_DTC57}
        {enable-take-address=true, indirect-api=false, port-defined-argument-value{value=ControlEventAvailable_DemEventParameter_ECU2_DTC58:159, value-type=Dem_EventIdType}, port=ControlEventAvailable_DemEventParameter_ECU2_DTC58}
        {enable-take-address=true, indirect-api=false, port-defined-argument-value{value=ControlEventAvailable_DemEventParameter_ECU2_DTC59:160, value-type=Dem_EventIdType}, port=ControlEventAvailable_DemEventParameter_ECU2_DTC59}
        {enable-take-address=true, indirect-api=false, port-defined-argument-value{value=ControlEventAvailable_DemEventParameter_ECU2_DTC60:161, value-type=Dem_EventIdType}, port=ControlEventAvailable_DemEventParameter_ECU2_DTC60}
        {enable-take-address=true, indirect-api=false, port-defined-argument-value{value=ControlEventAvailable_DemEventParameter_ECU2_DTC61:162, value-type=Dem_EventIdType}, port=ControlEventAvailable_DemEventParameter_ECU2_DTC61}
        {enable-take-address=true, indirect-api=false, port-defined-argument-value{value=ControlEventAvailable_DemEventParameter_ECU2_DTC62:163, value-type=Dem_EventIdType}, port=ControlEventAvailable_DemEventParameter_ECU2_DTC62}
        {enable-take-address=true, indirect-api=false, port-defined-argument-value{value=ControlEventAvailable_DemEventParameter_ECU2_DTC63:164, value-type=Dem_EventIdType}, port=ControlEventAvailable_DemEventParameter_ECU2_DTC63}
        {enable-take-address=true, indirect-api=false, port-defined-argument-value{value=ControlEventAvailable_DemEventParameter_ECU2_DTC64:165, value-type=Dem_EventIdType}, port=ControlEventAvailable_DemEventParameter_ECU2_DTC64}
        {enable-take-address=true, indirect-api=false, port-defined-argument-value{value=ControlEventAvailable_DemEventParameter_ECU2_DTC65:166, value-type=Dem_EventIdType}, port=ControlEventAvailable_DemEventParameter_ECU2_DTC65}
        {enable-take-address=true, indirect-api=false, port-defined-argument-value{value=ControlEventAvailable_DemEventParameter_ECU2_DTC66:167, value-type=Dem_EventIdType}, port=ControlEventAvailable_DemEventParameter_ECU2_DTC66}
        {enable-take-address=true, indirect-api=false, port-defined-argument-value{value=ControlEventAvailable_DemEventParameter_ECU2_DTC67:168, value-type=Dem_EventIdType}, port=ControlEventAvailable_DemEventParameter_ECU2_DTC67}
        {enable-take-address=true, indirect-api=false, port-defined-argument-value{value=ControlEventAvailable_DemEventParameter_ECU2_DTC68:169, value-type=Dem_EventIdType}, port=ControlEventAvailable_DemEventParameter_ECU2_DTC68}
        {enable-take-address=true, indirect-api=false, port-defined-argument-value{value=ControlEventAvailable_DemEventParameter_ECU2_DTC69:170, value-type=Dem_EventIdType}, port=ControlEventAvailable_DemEventParameter_ECU2_DTC69}
        {enable-take-address=true, indirect-api=false, port-defined-argument-value{value=ControlEventAvailable_DemEventParameter_ECU2_DTC70:171, value-type=Dem_EventIdType}, port=ControlEventAvailable_DemEventParameter_ECU2_DTC70}
        {enable-take-address=true, indirect-api=false, port-defined-argument-value{value=ControlEventAvailable_DemEventParameter_ECU2_DTC71:172, value-type=Dem_EventIdType}, port=ControlEventAvailable_DemEventParameter_ECU2_DTC71}
        {enable-take-address=true, indirect-api=false, port-defined-argument-value{value=ControlEventAvailable_DemEventParameter_ECU2_DTC72:173, value-type=Dem_EventIdType}, port=ControlEventAvailable_DemEventParameter_ECU2_DTC72}
        {enable-take-address=true, indirect-api=false, port-defined-argument-value{value=ControlEventAvailable_DemEventParameter_ECU2_DTC73:174, value-type=Dem_EventIdType}, port=ControlEventAvailable_DemEventParameter_ECU2_DTC73}
        {enable-take-address=true, indirect-api=false, port-defined-argument-value{value=ControlEventAvailable_DemEventParameter_ECU2_DTC74:175, value-type=Dem_EventIdType}, port=ControlEventAvailable_DemEventParameter_ECU2_DTC74}
        {enable-take-address=true, indirect-api=false, port-defined-argument-value{value=ControlEventAvailable_DemEventParameter_ECU2_DTC75:176, value-type=Dem_EventIdType}, port=ControlEventAvailable_DemEventParameter_ECU2_DTC75}
        {enable-take-address=true, indirect-api=false, port-defined-argument-value{value=ControlEventAvailable_DemEventParameter_ECU2_DTC76:177, value-type=Dem_EventIdType}, port=ControlEventAvailable_DemEventParameter_ECU2_DTC76}
        {enable-take-address=true, indirect-api=false, port-defined-argument-value{value=ControlEventAvailable_DemEventParameter_ECU2_DTC77:178, value-type=Dem_EventIdType}, port=ControlEventAvailable_DemEventParameter_ECU2_DTC77}
        {enable-take-address=true, indirect-api=false, port-defined-argument-value{value=ControlEventAvailable_DemEventParameter_ECU2_DTC78:179, value-type=Dem_EventIdType}, port=ControlEventAvailable_DemEventParameter_ECU2_DTC78}
        {enable-take-address=true, indirect-api=false, port-defined-argument-value{value=ControlEventAvailable_DemEventParameter_ECU2_DTC79:180, value-type=Dem_EventIdType}, port=ControlEventAvailable_DemEventParameter_ECU2_DTC79}
        {enable-take-address=true, indirect-api=false, port-defined-argument-value{value=ControlEventAvailable_DemEventParameter_ECU2_DTC80:181, value-type=Dem_EventIdType}, port=ControlEventAvailable_DemEventParameter_ECU2_DTC80}
        {enable-take-address=true, indirect-api=false, port-defined-argument-value{value=ControlEventAvailable_DemEventParameter_ECU2_DTC81:182, value-type=Dem_EventIdType}, port=ControlEventAvailable_DemEventParameter_ECU2_DTC81}
        {enable-take-address=true, indirect-api=false, port-defined-argument-value{value=ControlEventAvailable_DemEventParameter_ECU2_DTC82:183, value-type=Dem_EventIdType}, port=ControlEventAvailable_DemEventParameter_ECU2_DTC82}
        {enable-take-address=true, indirect-api=false, port-defined-argument-value{value=ControlEventAvailable_DemEventParameter_ECU2_DTC83:184, value-type=Dem_EventIdType}, port=ControlEventAvailable_DemEventParameter_ECU2_DTC83}
        {enable-take-address=true, indirect-api=false, port-defined-argument-value{value=ControlEventAvailable_DemEventParameter_ECU2_DTC84:185, value-type=Dem_EventIdType}, port=ControlEventAvailable_DemEventParameter_ECU2_DTC84}
        {enable-take-address=true, indirect-api=false, port-defined-argument-value{value=ControlEventAvailable_DemEventParameter_ECU2_DTC85:186, value-type=Dem_EventIdType}, port=ControlEventAvailable_DemEventParameter_ECU2_DTC85}
        {enable-take-address=true, indirect-api=false, port-defined-argument-value{value=ControlEventAvailable_DemEventParameter_ECU2_DTC86:187, value-type=Dem_EventIdType}, port=ControlEventAvailable_DemEventParameter_ECU2_DTC86}
        {enable-take-address=true, indirect-api=false, port-defined-argument-value{value=ControlEventAvailable_DemEventParameter_ECU2_DTC87:188, value-type=Dem_EventIdType}, port=ControlEventAvailable_DemEventParameter_ECU2_DTC87}
        {enable-take-address=true, indirect-api=false, port-defined-argument-value{value=ControlEventAvailable_DemEventParameter_ECU2_DTC88:189, value-type=Dem_EventIdType}, port=ControlEventAvailable_DemEventParameter_ECU2_DTC88}
        {enable-take-address=true, indirect-api=false, port-defined-argument-value{value=ControlEventAvailable_DemEventParameter_ECU2_DTC89:190, value-type=Dem_EventIdType}, port=ControlEventAvailable_DemEventParameter_ECU2_DTC89}
        {enable-take-address=true, indirect-api=false, port-defined-argument-value{value=ControlEventAvailable_DemEventParameter_ECU2_DTC90:191, value-type=Dem_EventIdType}, port=ControlEventAvailable_DemEventParameter_ECU2_DTC90}
        {enable-take-address=true, indirect-api=false, port-defined-argument-value{value=ControlEventAvailable_DemEventParameter_ECU2_DTC91:192, value-type=Dem_EventIdType}, port=ControlEventAvailable_DemEventParameter_ECU2_DTC91}
        {enable-take-address=true, indirect-api=false, port-defined-argument-value{value=ControlEventAvailable_DemEventParameter_ECU2_DTC92:193, value-type=Dem_EventIdType}, port=ControlEventAvailable_DemEventParameter_ECU2_DTC92}
        {enable-take-address=true, indirect-api=false, port-defined-argument-value{value=ControlEventAvailable_DemEventParameter_ECU2_DTC93:194, value-type=Dem_EventIdType}, port=ControlEventAvailable_DemEventParameter_ECU2_DTC93}
        {enable-take-address=true, indirect-api=false, port-defined-argument-value{value=ControlEventAvailable_DemEventParameter_ECU2_DTC94:195, value-type=Dem_EventIdType}, port=ControlEventAvailable_DemEventParameter_ECU2_DTC94}
        {enable-take-address=true, indirect-api=false, port-defined-argument-value{value=ControlEventAvailable_DemEventParameter_ECU2_DTC95:196, value-type=Dem_EventIdType}, port=ControlEventAvailable_DemEventParameter_ECU2_DTC95}
        {enable-take-address=true, indirect-api=false, port-defined-argument-value{value=ControlEventAvailable_DemEventParameter_ECU2_DTC96:197, value-type=Dem_EventIdType}, port=ControlEventAvailable_DemEventParameter_ECU2_DTC96}
        {enable-take-address=true, indirect-api=false, port-defined-argument-value{value=ControlEventAvailable_DemEventParameter_ECU2_DTC97:198, value-type=Dem_EventIdType}, port=ControlEventAvailable_DemEventParameter_ECU2_DTC97}
        {enable-take-address=true, indirect-api=false, port-defined-argument-value{value=ControlEventAvailable_DemEventParameter_ECU2_DTC98:199, value-type=Dem_EventIdType}, port=ControlEventAvailable_DemEventParameter_ECU2_DTC98}
        {enable-take-address=true, indirect-api=false, port-defined-argument-value{value=ControlEventAvailable_DemEventParameter_ECU2_DTC99:200, value-type=Dem_EventIdType}, port=ControlEventAvailable_DemEventParameter_ECU2_DTC99}
        {enable-take-address=true, indirect-api=false, port-defined-argument-value{value=ControlEventAvailable_DemEventParameter_ECU3_DTC00:201, value-type=Dem_EventIdType}, port=ControlEventAvailable_DemEventParameter_ECU3_DTC00}
        {enable-take-address=true, indirect-api=false, port-defined-argument-value{value=ControlEventAvailable_DemEventParameter_ECU3_DTC01:202, value-type=Dem_EventIdType}, port=ControlEventAvailable_DemEventParameter_ECU3_DTC01}
        {enable-take-address=true, indirect-api=false, port-defined-argument-value{value=ControlEventAvailable_DemEventParameter_ECU3_DTC02:203, value-type=Dem_EventIdType}, port=ControlEventAvailable_DemEventParameter_ECU3_DTC02}
        {enable-take-address=true, indirect-api=false, port-defined-argument-value{value=ControlEventAvailable_DemEventParameter_ECU3_DTC03:204, value-type=Dem_EventIdType}, port=ControlEventAvailable_DemEventParameter_ECU3_DTC03}
        {enable-take-address=true, indirect-api=false, port-defined-argument-value{value=ControlEventAvailable_DemEventParameter_ECU3_DTC04:205, value-type=Dem_EventIdType}, port=ControlEventAvailable_DemEventParameter_ECU3_DTC04}
        {enable-take-address=true, indirect-api=false, port-defined-argument-value{value=ControlEventAvailable_DemEventParameter_ECU3_DTC05:206, value-type=Dem_EventIdType}, port=ControlEventAvailable_DemEventParameter_ECU3_DTC05}
        {enable-take-address=true, indirect-api=false, port-defined-argument-value{value=ControlEventAvailable_DemEventParameter_ECU3_DTC06:207, value-type=Dem_EventIdType}, port=ControlEventAvailable_DemEventParameter_ECU3_DTC06}
        {enable-take-address=true, indirect-api=false, port-defined-argument-value{value=ControlEventAvailable_DemEventParameter_ECU3_DTC07:208, value-type=Dem_EventIdType}, port=ControlEventAvailable_DemEventParameter_ECU3_DTC07}
        {enable-take-address=true, indirect-api=false, port-defined-argument-value{value=ControlEventAvailable_DemEventParameter_ECU3_DTC08:209, value-type=Dem_EventIdType}, port=ControlEventAvailable_DemEventParameter_ECU3_DTC08}
        {enable-take-address=true, indirect-api=false, port-defined-argument-value{value=ControlEventAvailable_DemEventParameter_ECU3_DTC09:210, value-type=Dem_EventIdType}, port=ControlEventAvailable_DemEventParameter_ECU3_DTC09}
        {enable-take-address=true, indirect-api=false, port-defined-argument-value{value=ControlEventAvailable_DemEventParameter_ECU3_DTC10:211, value-type=Dem_EventIdType}, port=ControlEventAvailable_DemEventParameter_ECU3_DTC10}
        {enable-take-address=true, indirect-api=false, port-defined-argument-value{value=ControlEventAvailable_DemEventParameter_ECU3_DTC11:212, value-type=Dem_EventIdType}, port=ControlEventAvailable_DemEventParameter_ECU3_DTC11}
        {enable-take-address=true, indirect-api=false, port-defined-argument-value{value=ControlEventAvailable_DemEventParameter_ECU3_DTC12:213, value-type=Dem_EventIdType}, port=ControlEventAvailable_DemEventParameter_ECU3_DTC12}
        {enable-take-address=true, indirect-api=false, port-defined-argument-value{value=ControlEventAvailable_DemEventParameter_ECU3_DTC13:214, value-type=Dem_EventIdType}, port=ControlEventAvailable_DemEventParameter_ECU3_DTC13}
        {enable-take-address=true, indirect-api=false, port-defined-argument-value{value=ControlEventAvailable_DemEventParameter_ECU3_DTC14:215, value-type=Dem_EventIdType}, port=ControlEventAvailable_DemEventParameter_ECU3_DTC14}
        {enable-take-address=true, indirect-api=false, port-defined-argument-value{value=ControlEventAvailable_DemEventParameter_ECU3_DTC15:216, value-type=Dem_EventIdType}, port=ControlEventAvailable_DemEventParameter_ECU3_DTC15}
        {enable-take-address=true, indirect-api=false, port-defined-argument-value{value=ControlEventAvailable_DemEventParameter_ECU3_DTC16:217, value-type=Dem_EventIdType}, port=ControlEventAvailable_DemEventParameter_ECU3_DTC16}
        {enable-take-address=true, indirect-api=false, port-defined-argument-value{value=ControlEventAvailable_DemEventParameter_ECU3_DTC17:218, value-type=Dem_EventIdType}, port=ControlEventAvailable_DemEventParameter_ECU3_DTC17}
        {enable-take-address=true, indirect-api=false, port-defined-argument-value{value=ControlEventAvailable_DemEventParameter_ECU3_DTC18:219, value-type=Dem_EventIdType}, port=ControlEventAvailable_DemEventParameter_ECU3_DTC18}
        {enable-take-address=true, indirect-api=false, port-defined-argument-value{value=ControlEventAvailable_DemEventParameter_ECU3_DTC19:220, value-type=Dem_EventIdType}, port=ControlEventAvailable_DemEventParameter_ECU3_DTC19}
        {enable-take-address=true, indirect-api=false, port-defined-argument-value{value=ControlEventAvailable_DemEventParameter_ECU3_DTC20:221, value-type=Dem_EventIdType}, port=ControlEventAvailable_DemEventParameter_ECU3_DTC20}
        {enable-take-address=true, indirect-api=false, port-defined-argument-value{value=ControlEventAvailable_DemEventParameter_ECU3_DTC21:222, value-type=Dem_EventIdType}, port=ControlEventAvailable_DemEventParameter_ECU3_DTC21}
        {enable-take-address=true, indirect-api=false, port-defined-argument-value{value=ControlEventAvailable_DemEventParameter_ECU3_DTC22:223, value-type=Dem_EventIdType}, port=ControlEventAvailable_DemEventParameter_ECU3_DTC22}
        {enable-take-address=true, indirect-api=false, port-defined-argument-value{value=ControlEventAvailable_DemEventParameter_ECU3_DTC23:224, value-type=Dem_EventIdType}, port=ControlEventAvailable_DemEventParameter_ECU3_DTC23}
        {enable-take-address=true, indirect-api=false, port-defined-argument-value{value=ControlEventAvailable_DemEventParameter_ECU3_DTC24:225, value-type=Dem_EventIdType}, port=ControlEventAvailable_DemEventParameter_ECU3_DTC24}
        {enable-take-address=true, indirect-api=false, port-defined-argument-value{value=ControlEventAvailable_DemEventParameter_ECU3_DTC25:226, value-type=Dem_EventIdType}, port=ControlEventAvailable_DemEventParameter_ECU3_DTC25}
        {enable-take-address=true, indirect-api=false, port-defined-argument-value{value=ControlEventAvailable_DemEventParameter_ECU3_DTC26:227, value-type=Dem_EventIdType}, port=ControlEventAvailable_DemEventParameter_ECU3_DTC26}
        {enable-take-address=true, indirect-api=false, port-defined-argument-value{value=ControlEventAvailable_DemEventParameter_ECU3_DTC27:228, value-type=Dem_EventIdType}, port=ControlEventAvailable_DemEventParameter_ECU3_DTC27}
        {enable-take-address=true, indirect-api=false, port-defined-argument-value{value=ControlEventAvailable_DemEventParameter_ECU3_DTC28:229, value-type=Dem_EventIdType}, port=ControlEventAvailable_DemEventParameter_ECU3_DTC28}
        {enable-take-address=true, indirect-api=false, port-defined-argument-value{value=ControlEventAvailable_DemEventParameter_ECU3_DTC29:230, value-type=Dem_EventIdType}, port=ControlEventAvailable_DemEventParameter_ECU3_DTC29}
        {enable-take-address=true, indirect-api=false, port-defined-argument-value{value=ControlEventAvailable_DemEventParameter_ECU3_DTC30:231, value-type=Dem_EventIdType}, port=ControlEventAvailable_DemEventParameter_ECU3_DTC30}
        {enable-take-address=true, indirect-api=false, port-defined-argument-value{value=ControlEventAvailable_DemEventParameter_ECU3_DTC31:232, value-type=Dem_EventIdType}, port=ControlEventAvailable_DemEventParameter_ECU3_DTC31}
        {enable-take-address=true, indirect-api=false, port-defined-argument-value{value=ControlEventAvailable_DemEventParameter_ECU3_DTC32:233, value-type=Dem_EventIdType}, port=ControlEventAvailable_DemEventParameter_ECU3_DTC32}
        {enable-take-address=true, indirect-api=false, port-defined-argument-value{value=ControlEventAvailable_DemEventParameter_ECU3_DTC33:234, value-type=Dem_EventIdType}, port=ControlEventAvailable_DemEventParameter_ECU3_DTC33}
        {enable-take-address=true, indirect-api=false, port-defined-argument-value{value=ControlEventAvailable_DemEventParameter_ECU3_DTC34:235, value-type=Dem_EventIdType}, port=ControlEventAvailable_DemEventParameter_ECU3_DTC34}
        {enable-take-address=true, indirect-api=false, port-defined-argument-value{value=ControlEventAvailable_DemEventParameter_ECU3_DTC35:236, value-type=Dem_EventIdType}, port=ControlEventAvailable_DemEventParameter_ECU3_DTC35}
        {enable-take-address=true, indirect-api=false, port-defined-argument-value{value=ControlEventAvailable_DemEventParameter_ECU3_DTC36:237, value-type=Dem_EventIdType}, port=ControlEventAvailable_DemEventParameter_ECU3_DTC36}
        {enable-take-address=true, indirect-api=false, port-defined-argument-value{value=ControlEventAvailable_DemEventParameter_ECU3_DTC37:238, value-type=Dem_EventIdType}, port=ControlEventAvailable_DemEventParameter_ECU3_DTC37}
        {enable-take-address=true, indirect-api=false, port-defined-argument-value{value=ControlEventAvailable_DemEventParameter_ECU3_DTC38:239, value-type=Dem_EventIdType}, port=ControlEventAvailable_DemEventParameter_ECU3_DTC38}
        {enable-take-address=true, indirect-api=false, port-defined-argument-value{value=ControlEventAvailable_DemEventParameter_ECU3_DTC39:240, value-type=Dem_EventIdType}, port=ControlEventAvailable_DemEventParameter_ECU3_DTC39}
        {enable-take-address=true, indirect-api=false, port-defined-argument-value{value=ControlEventAvailable_DemEventParameter_ECU3_DTC40:241, value-type=Dem_EventIdType}, port=ControlEventAvailable_DemEventParameter_ECU3_DTC40}
        {enable-take-address=true, indirect-api=false, port-defined-argument-value{value=ControlEventAvailable_DemEventParameter_ECU3_DTC41:242, value-type=Dem_EventIdType}, port=ControlEventAvailable_DemEventParameter_ECU3_DTC41}
        {enable-take-address=true, indirect-api=false, port-defined-argument-value{value=ControlEventAvailable_DemEventParameter_ECU3_DTC42:243, value-type=Dem_EventIdType}, port=ControlEventAvailable_DemEventParameter_ECU3_DTC42}
        {enable-take-address=true, indirect-api=false, port-defined-argument-value{value=ControlEventAvailable_DemEventParameter_ECU3_DTC43:244, value-type=Dem_EventIdType}, port=ControlEventAvailable_DemEventParameter_ECU3_DTC43}
        {enable-take-address=true, indirect-api=false, port-defined-argument-value{value=ControlEventAvailable_DemEventParameter_ECU3_DTC44:245, value-type=Dem_EventIdType}, port=ControlEventAvailable_DemEventParameter_ECU3_DTC44}
        {enable-take-address=true, indirect-api=false, port-defined-argument-value{value=ControlEventAvailable_DemEventParameter_ECU3_DTC45:246, value-type=Dem_EventIdType}, port=ControlEventAvailable_DemEventParameter_ECU3_DTC45}
        {enable-take-address=true, indirect-api=false, port-defined-argument-value{value=ControlEventAvailable_DemEventParameter_ECU3_DTC46:247, value-type=Dem_EventIdType}, port=ControlEventAvailable_DemEventParameter_ECU3_DTC46}
        {enable-take-address=true, indirect-api=false, port-defined-argument-value{value=ControlEventAvailable_DemEventParameter_ECU3_DTC47:248, value-type=Dem_EventIdType}, port=ControlEventAvailable_DemEventParameter_ECU3_DTC47}
        {enable-take-address=true, indirect-api=false, port-defined-argument-value{value=ControlEventAvailable_DemEventParameter_ECU3_DTC48:249, value-type=Dem_EventIdType}, port=ControlEventAvailable_DemEventParameter_ECU3_DTC48}
        {enable-take-address=true, indirect-api=false, port-defined-argument-value{value=ControlEventAvailable_DemEventParameter_ECU3_DTC49:250, value-type=Dem_EventIdType}, port=ControlEventAvailable_DemEventParameter_ECU3_DTC49}
        {enable-take-address=true, indirect-api=false, port-defined-argument-value{value=ControlEventAvailable_DemEventParameter_ECU3_DTC50:251, value-type=Dem_EventIdType}, port=ControlEventAvailable_DemEventParameter_ECU3_DTC50}
        {enable-take-address=true, indirect-api=false, port-defined-argument-value{value=ControlEventAvailable_DemEventParameter_ECU3_DTC51:252, value-type=Dem_EventIdType}, port=ControlEventAvailable_DemEventParameter_ECU3_DTC51}
        {enable-take-address=true, indirect-api=false, port-defined-argument-value{value=ControlEventAvailable_DemEventParameter_ECU3_DTC52:253, value-type=Dem_EventIdType}, port=ControlEventAvailable_DemEventParameter_ECU3_DTC52}
        {enable-take-address=true, indirect-api=false, port-defined-argument-value{value=ControlEventAvailable_DemEventParameter_ECU3_DTC53:254, value-type=Dem_EventIdType}, port=ControlEventAvailable_DemEventParameter_ECU3_DTC53}
        {enable-take-address=true, indirect-api=false, port-defined-argument-value{value=ControlEventAvailable_DemEventParameter_ECU3_DTC54:255, value-type=Dem_EventIdType}, port=ControlEventAvailable_DemEventParameter_ECU3_DTC54}
        {enable-take-address=true, indirect-api=false, port-defined-argument-value{value=ControlEventAvailable_DemEventParameter_ECU3_DTC55:256, value-type=Dem_EventIdType}, port=ControlEventAvailable_DemEventParameter_ECU3_DTC55}
        {enable-take-address=true, indirect-api=false, port-defined-argument-value{value=ControlEventAvailable_DemEventParameter_ECU3_DTC56:257, value-type=Dem_EventIdType}, port=ControlEventAvailable_DemEventParameter_ECU3_DTC56}
        {enable-take-address=true, indirect-api=false, port-defined-argument-value{value=ControlEventAvailable_DemEventParameter_ECU3_DTC57:258, value-type=Dem_EventIdType}, port=ControlEventAvailable_DemEventParameter_ECU3_DTC57}
        {enable-take-address=true, indirect-api=false, port-defined-argument-value{value=ControlEventAvailable_DemEventParameter_ECU3_DTC58:259, value-type=Dem_EventIdType}, port=ControlEventAvailable_DemEventParameter_ECU3_DTC58}
        {enable-take-address=true, indirect-api=false, port-defined-argument-value{value=ControlEventAvailable_DemEventParameter_ECU3_DTC59:260, value-type=Dem_EventIdType}, port=ControlEventAvailable_DemEventParameter_ECU3_DTC59}
        {enable-take-address=true, indirect-api=false, port-defined-argument-value{value=ControlEventAvailable_DemEventParameter_ECU3_DTC60:261, value-type=Dem_EventIdType}, port=ControlEventAvailable_DemEventParameter_ECU3_DTC60}
        {enable-take-address=true, indirect-api=false, port-defined-argument-value{value=ControlEventAvailable_DemEventParameter_ECU3_DTC61:262, value-type=Dem_EventIdType}, port=ControlEventAvailable_DemEventParameter_ECU3_DTC61}
        {enable-take-address=true, indirect-api=false, port-defined-argument-value{value=ControlEventAvailable_DemEventParameter_ECU3_DTC62:263, value-type=Dem_EventIdType}, port=ControlEventAvailable_DemEventParameter_ECU3_DTC62}
        {enable-take-address=true, indirect-api=false, port-defined-argument-value{value=ControlEventAvailable_DemEventParameter_ECU3_DTC63:264, value-type=Dem_EventIdType}, port=ControlEventAvailable_DemEventParameter_ECU3_DTC63}
        {enable-take-address=true, indirect-api=false, port-defined-argument-value{value=ControlEventAvailable_DemEventParameter_ECU3_DTC64:265, value-type=Dem_EventIdType}, port=ControlEventAvailable_DemEventParameter_ECU3_DTC64}
        {enable-take-address=true, indirect-api=false, port-defined-argument-value{value=ControlEventAvailable_DemEventParameter_ECU3_DTC65:266, value-type=Dem_EventIdType}, port=ControlEventAvailable_DemEventParameter_ECU3_DTC65}
        {enable-take-address=true, indirect-api=false, port-defined-argument-value{value=ControlEventAvailable_DemEventParameter_ECU3_DTC66:267, value-type=Dem_EventIdType}, port=ControlEventAvailable_DemEventParameter_ECU3_DTC66}
        {enable-take-address=true, indirect-api=false, port-defined-argument-value{value=ControlEventAvailable_DemEventParameter_ECU3_DTC67:268, value-type=Dem_EventIdType}, port=ControlEventAvailable_DemEventParameter_ECU3_DTC67}
        {enable-take-address=true, indirect-api=false, port-defined-argument-value{value=ControlEventAvailable_DemEventParameter_ECU3_DTC68:269, value-type=Dem_EventIdType}, port=ControlEventAvailable_DemEventParameter_ECU3_DTC68}
        {enable-take-address=true, indirect-api=false, port-defined-argument-value{value=ControlEventAvailable_DemEventParameter_ECU3_DTC69:270, value-type=Dem_EventIdType}, port=ControlEventAvailable_DemEventParameter_ECU3_DTC69}
        {enable-take-address=true, indirect-api=false, port-defined-argument-value{value=ControlEventAvailable_DemEventParameter_ECU3_DTC70:271, value-type=Dem_EventIdType}, port=ControlEventAvailable_DemEventParameter_ECU3_DTC70}
        {enable-take-address=true, indirect-api=false, port-defined-argument-value{value=ControlEventAvailable_DemEventParameter_ECU3_DTC71:272, value-type=Dem_EventIdType}, port=ControlEventAvailable_DemEventParameter_ECU3_DTC71}
        {enable-take-address=true, indirect-api=false, port-defined-argument-value{value=ControlEventAvailable_DemEventParameter_ECU3_DTC72:273, value-type=Dem_EventIdType}, port=ControlEventAvailable_DemEventParameter_ECU3_DTC72}
        {enable-take-address=true, indirect-api=false, port-defined-argument-value{value=ControlEventAvailable_DemEventParameter_ECU3_DTC73:274, value-type=Dem_EventIdType}, port=ControlEventAvailable_DemEventParameter_ECU3_DTC73}
        {enable-take-address=true, indirect-api=false, port-defined-argument-value{value=ControlEventAvailable_DemEventParameter_ECU3_DTC74:275, value-type=Dem_EventIdType}, port=ControlEventAvailable_DemEventParameter_ECU3_DTC74}
        {enable-take-address=true, indirect-api=false, port-defined-argument-value{value=ControlEventAvailable_DemEventParameter_ECU3_DTC75:276, value-type=Dem_EventIdType}, port=ControlEventAvailable_DemEventParameter_ECU3_DTC75}
        {enable-take-address=true, indirect-api=false, port-defined-argument-value{value=ControlEventAvailable_DemEventParameter_ECU3_DTC76:277, value-type=Dem_EventIdType}, port=ControlEventAvailable_DemEventParameter_ECU3_DTC76}
        {enable-take-address=true, indirect-api=false, port-defined-argument-value{value=ControlEventAvailable_DemEventParameter_ECU3_DTC77:278, value-type=Dem_EventIdType}, port=ControlEventAvailable_DemEventParameter_ECU3_DTC77}
        {enable-take-address=true, indirect-api=false, port-defined-argument-value{value=ControlEventAvailable_DemEventParameter_ECU3_DTC78:279, value-type=Dem_EventIdType}, port=ControlEventAvailable_DemEventParameter_ECU3_DTC78}
        {enable-take-address=true, indirect-api=false, port-defined-argument-value{value=ControlEventAvailable_DemEventParameter_ECU3_DTC79:280, value-type=Dem_EventIdType}, port=ControlEventAvailable_DemEventParameter_ECU3_DTC79}
        {enable-take-address=true, indirect-api=false, port-defined-argument-value{value=ControlEventAvailable_DemEventParameter_ECU3_DTC80:281, value-type=Dem_EventIdType}, port=ControlEventAvailable_DemEventParameter_ECU3_DTC80}
        {enable-take-address=true, indirect-api=false, port-defined-argument-value{value=ControlEventAvailable_DemEventParameter_ECU3_DTC81:282, value-type=Dem_EventIdType}, port=ControlEventAvailable_DemEventParameter_ECU3_DTC81}
        {enable-take-address=true, indirect-api=false, port-defined-argument-value{value=ControlEventAvailable_DemEventParameter_ECU3_DTC82:283, value-type=Dem_EventIdType}, port=ControlEventAvailable_DemEventParameter_ECU3_DTC82}
        {enable-take-address=true, indirect-api=false, port-defined-argument-value{value=ControlEventAvailable_DemEventParameter_ECU3_DTC83:284, value-type=Dem_EventIdType}, port=ControlEventAvailable_DemEventParameter_ECU3_DTC83}
        {enable-take-address=true, indirect-api=false, port-defined-argument-value{value=ControlEventAvailable_DemEventParameter_ECU3_DTC84:285, value-type=Dem_EventIdType}, port=ControlEventAvailable_DemEventParameter_ECU3_DTC84}
        {enable-take-address=true, indirect-api=false, port-defined-argument-value{value=ControlEventAvailable_DemEventParameter_ECU3_DTC85:286, value-type=Dem_EventIdType}, port=ControlEventAvailable_DemEventParameter_ECU3_DTC85}
        {enable-take-address=true, indirect-api=false, port-defined-argument-value{value=ControlEventAvailable_DemEventParameter_ECU3_DTC86:287, value-type=Dem_EventIdType}, port=ControlEventAvailable_DemEventParameter_ECU3_DTC86}
        {enable-take-address=true, indirect-api=false, port-defined-argument-value{value=ControlEventAvailable_DemEventParameter_ECU3_DTC87:288, value-type=Dem_EventIdType}, port=ControlEventAvailable_DemEventParameter_ECU3_DTC87}
        {enable-take-address=true, indirect-api=false, port-defined-argument-value{value=ControlEventAvailable_DemEventParameter_ECU3_DTC88:289, value-type=Dem_EventIdType}, port=ControlEventAvailable_DemEventParameter_ECU3_DTC88}
        {enable-take-address=true, indirect-api=false, port-defined-argument-value{value=ControlEventAvailable_DemEventParameter_ECU3_DTC89:290, value-type=Dem_EventIdType}, port=ControlEventAvailable_DemEventParameter_ECU3_DTC89}
        {enable-take-address=true, indirect-api=false, port-defined-argument-value{value=ControlEventAvailable_DemEventParameter_ECU3_DTC90:291, value-type=Dem_EventIdType}, port=ControlEventAvailable_DemEventParameter_ECU3_DTC90}
        {enable-take-address=true, indirect-api=false, port-defined-argument-value{value=ControlEventAvailable_DemEventParameter_ECU3_DTC91:292, value-type=Dem_EventIdType}, port=ControlEventAvailable_DemEventParameter_ECU3_DTC91}
        {enable-take-address=true, indirect-api=false, port-defined-argument-value{value=ControlEventAvailable_DemEventParameter_ECU3_DTC92:293, value-type=Dem_EventIdType}, port=ControlEventAvailable_DemEventParameter_ECU3_DTC92}
        {enable-take-address=true, indirect-api=false, port-defined-argument-value{value=ControlEventAvailable_DemEventParameter_ECU3_DTC93:294, value-type=Dem_EventIdType}, port=ControlEventAvailable_DemEventParameter_ECU3_DTC93}
        {enable-take-address=true, indirect-api=false, port-defined-argument-value{value=ControlEventAvailable_DemEventParameter_ECU3_DTC94:295, value-type=Dem_EventIdType}, port=ControlEventAvailable_DemEventParameter_ECU3_DTC94}
        {enable-take-address=true, indirect-api=false, port-defined-argument-value{value=ControlEventAvailable_DemEventParameter_ECU3_DTC95:296, value-type=Dem_EventIdType}, port=ControlEventAvailable_DemEventParameter_ECU3_DTC95}
        {enable-take-address=true, indirect-api=false, port-defined-argument-value{value=ControlEventAvailable_DemEventParameter_ECU3_DTC96:297, value-type=Dem_EventIdType}, port=ControlEventAvailable_DemEventParameter_ECU3_DTC96}
        {enable-take-address=true, indirect-api=false, port-defined-argument-value{value=ControlEventAvailable_DemEventParameter_ECU3_DTC97:298, value-type=Dem_EventIdType}, port=ControlEventAvailable_DemEventParameter_ECU3_DTC97}
        {enable-take-address=true, indirect-api=false, port-defined-argument-value{value=ControlEventAvailable_DemEventParameter_ECU3_DTC98:299, value-type=Dem_EventIdType}, port=ControlEventAvailable_DemEventParameter_ECU3_DTC98}
        {enable-take-address=true, indirect-api=false, port-defined-argument-value{value=ControlEventAvailable_DemEventParameter_ECU3_DTC99:300, value-type=Dem_EventIdType}, port=ControlEventAvailable_DemEventParameter_ECU3_DTC99}
        {enable-take-address=true, indirect-api=false, port-defined-argument-value{value=ControlEventAvailable_DemEventParameter_ECU4_DTC00:301, value-type=Dem_EventIdType}, port=ControlEventAvailable_DemEventParameter_ECU4_DTC00}
        {enable-take-address=true, indirect-api=false, port-defined-argument-value{value=ControlEventAvailable_DemEventParameter_ECU4_DTC01:302, value-type=Dem_EventIdType}, port=ControlEventAvailable_DemEventParameter_ECU4_DTC01}
        {enable-take-address=true, indirect-api=false, port-defined-argument-value{value=ControlEventAvailable_DemEventParameter_ECU4_DTC02:303, value-type=Dem_EventIdType}, port=ControlEventAvailable_DemEventParameter_ECU4_DTC02}
        {enable-take-address=true, indirect-api=false, port-defined-argument-value{value=ControlEventAvailable_DemEventParameter_ECU4_DTC03:304, value-type=Dem_EventIdType}, port=ControlEventAvailable_DemEventParameter_ECU4_DTC03}
        {enable-take-address=true, indirect-api=false, port-defined-argument-value{value=ControlEventAvailable_DemEventParameter_ECU4_DTC04:305, value-type=Dem_EventIdType}, port=ControlEventAvailable_DemEventParameter_ECU4_DTC04}
        {enable-take-address=true, indirect-api=false, port-defined-argument-value{value=ControlEventAvailable_DemEventParameter_ECU4_DTC05:306, value-type=Dem_EventIdType}, port=ControlEventAvailable_DemEventParameter_ECU4_DTC05}
        {enable-take-address=true, indirect-api=false, port-defined-argument-value{value=ControlEventAvailable_DemEventParameter_ECU4_DTC06:307, value-type=Dem_EventIdType}, port=ControlEventAvailable_DemEventParameter_ECU4_DTC06}
        {enable-take-address=true, indirect-api=false, port-defined-argument-value{value=ControlEventAvailable_DemEventParameter_ECU4_DTC07:308, value-type=Dem_EventIdType}, port=ControlEventAvailable_DemEventParameter_ECU4_DTC07}
        {enable-take-address=true, indirect-api=false, port-defined-argument-value{value=ControlEventAvailable_DemEventParameter_ECU4_DTC08:309, value-type=Dem_EventIdType}, port=ControlEventAvailable_DemEventParameter_ECU4_DTC08}
        {enable-take-address=true, indirect-api=false, port-defined-argument-value{value=ControlEventAvailable_DemEventParameter_ECU4_DTC09:310, value-type=Dem_EventIdType}, port=ControlEventAvailable_DemEventParameter_ECU4_DTC09}
        {enable-take-address=true, indirect-api=false, port-defined-argument-value{value=ControlEventAvailable_DemEventParameter_ECU4_DTC10:311, value-type=Dem_EventIdType}, port=ControlEventAvailable_DemEventParameter_ECU4_DTC10}
        {enable-take-address=true, indirect-api=false, port-defined-argument-value{value=ControlEventAvailable_DemEventParameter_ECU4_DTC11:312, value-type=Dem_EventIdType}, port=ControlEventAvailable_DemEventParameter_ECU4_DTC11}
        {enable-take-address=true, indirect-api=false, port-defined-argument-value{value=ControlEventAvailable_DemEventParameter_ECU4_DTC12:313, value-type=Dem_EventIdType}, port=ControlEventAvailable_DemEventParameter_ECU4_DTC12}
        {enable-take-address=true, indirect-api=false, port-defined-argument-value{value=ControlEventAvailable_DemEventParameter_ECU4_DTC13:314, value-type=Dem_EventIdType}, port=ControlEventAvailable_DemEventParameter_ECU4_DTC13}
        {enable-take-address=true, indirect-api=false, port-defined-argument-value{value=ControlEventAvailable_DemEventParameter_ECU4_DTC14:315, value-type=Dem_EventIdType}, port=ControlEventAvailable_DemEventParameter_ECU4_DTC14}
        {enable-take-address=true, indirect-api=false, port-defined-argument-value{value=ControlEventAvailable_DemEventParameter_ECU4_DTC15:316, value-type=Dem_EventIdType}, port=ControlEventAvailable_DemEventParameter_ECU4_DTC15}
        {enable-take-address=true, indirect-api=false, port-defined-argument-value{value=ControlEventAvailable_DemEventParameter_ECU4_DTC16:317, value-type=Dem_EventIdType}, port=ControlEventAvailable_DemEventParameter_ECU4_DTC16}
        {enable-take-address=true, indirect-api=false, port-defined-argument-value{value=ControlEventAvailable_DemEventParameter_ECU4_DTC17:318, value-type=Dem_EventIdType}, port=ControlEventAvailable_DemEventParameter_ECU4_DTC17}
        {enable-take-address=true, indirect-api=false, port-defined-argument-value{value=ControlEventAvailable_DemEventParameter_ECU4_DTC18:319, value-type=Dem_EventIdType}, port=ControlEventAvailable_DemEventParameter_ECU4_DTC18}
        {enable-take-address=true, indirect-api=false, port-defined-argument-value{value=ControlEventAvailable_DemEventParameter_ECU4_DTC19:320, value-type=Dem_EventIdType}, port=ControlEventAvailable_DemEventParameter_ECU4_DTC19}
        {enable-take-address=true, indirect-api=false, port-defined-argument-value{value=ControlEventAvailable_DemEventParameter_ECU4_DTC20:321, value-type=Dem_EventIdType}, port=ControlEventAvailable_DemEventParameter_ECU4_DTC20}
        {enable-take-address=true, indirect-api=false, port-defined-argument-value{value=ControlEventAvailable_DemEventParameter_ECU4_DTC21:322, value-type=Dem_EventIdType}, port=ControlEventAvailable_DemEventParameter_ECU4_DTC21}
        {enable-take-address=true, indirect-api=false, port-defined-argument-value{value=ControlEventAvailable_DemEventParameter_ECU4_DTC22:323, value-type=Dem_EventIdType}, port=ControlEventAvailable_DemEventParameter_ECU4_DTC22}
        {enable-take-address=true, indirect-api=false, port-defined-argument-value{value=ControlEventAvailable_DemEventParameter_ECU4_DTC23:324, value-type=Dem_EventIdType}, port=ControlEventAvailable_DemEventParameter_ECU4_DTC23}
        {enable-take-address=true, indirect-api=false, port-defined-argument-value{value=ControlEventAvailable_DemEventParameter_ECU4_DTC24:325, value-type=Dem_EventIdType}, port=ControlEventAvailable_DemEventParameter_ECU4_DTC24}
        {enable-take-address=true, indirect-api=false, port-defined-argument-value{value=ControlEventAvailable_DemEventParameter_ECU4_DTC25:326, value-type=Dem_EventIdType}, port=ControlEventAvailable_DemEventParameter_ECU4_DTC25}
        {enable-take-address=true, indirect-api=false, port-defined-argument-value{value=ControlEventAvailable_DemEventParameter_ECU4_DTC26:327, value-type=Dem_EventIdType}, port=ControlEventAvailable_DemEventParameter_ECU4_DTC26}
        {enable-take-address=true, indirect-api=false, port-defined-argument-value{value=ControlEventAvailable_DemEventParameter_ECU4_DTC27:328, value-type=Dem_EventIdType}, port=ControlEventAvailable_DemEventParameter_ECU4_DTC27}
        {enable-take-address=true, indirect-api=false, port-defined-argument-value{value=ControlEventAvailable_DemEventParameter_ECU4_DTC28:329, value-type=Dem_EventIdType}, port=ControlEventAvailable_DemEventParameter_ECU4_DTC28}
        {enable-take-address=true, indirect-api=false, port-defined-argument-value{value=ControlEventAvailable_DemEventParameter_ECU4_DTC29:330, value-type=Dem_EventIdType}, port=ControlEventAvailable_DemEventParameter_ECU4_DTC29}
        {enable-take-address=true, indirect-api=false, port-defined-argument-value{value=ControlEventAvailable_DemEventParameter_ECU4_DTC30:331, value-type=Dem_EventIdType}, port=ControlEventAvailable_DemEventParameter_ECU4_DTC30}
        {enable-take-address=true, indirect-api=false, port-defined-argument-value{value=ControlEventAvailable_DemEventParameter_ECU4_DTC31:332, value-type=Dem_EventIdType}, port=ControlEventAvailable_DemEventParameter_ECU4_DTC31}
        {enable-take-address=true, indirect-api=false, port-defined-argument-value{value=ControlEventAvailable_DemEventParameter_ECU4_DTC32:333, value-type=Dem_EventIdType}, port=ControlEventAvailable_DemEventParameter_ECU4_DTC32}
        {enable-take-address=true, indirect-api=false, port-defined-argument-value{value=ControlEventAvailable_DemEventParameter_ECU4_DTC33:334, value-type=Dem_EventIdType}, port=ControlEventAvailable_DemEventParameter_ECU4_DTC33}
        {enable-take-address=true, indirect-api=false, port-defined-argument-value{value=ControlEventAvailable_DemEventParameter_ECU4_DTC34:335, value-type=Dem_EventIdType}, port=ControlEventAvailable_DemEventParameter_ECU4_DTC34}
        {enable-take-address=true, indirect-api=false, port-defined-argument-value{value=ControlEventAvailable_DemEventParameter_ECU4_DTC35:336, value-type=Dem_EventIdType}, port=ControlEventAvailable_DemEventParameter_ECU4_DTC35}
        {enable-take-address=true, indirect-api=false, port-defined-argument-value{value=ControlEventAvailable_DemEventParameter_ECU4_DTC36:337, value-type=Dem_EventIdType}, port=ControlEventAvailable_DemEventParameter_ECU4_DTC36}
        {enable-take-address=true, indirect-api=false, port-defined-argument-value{value=ControlEventAvailable_DemEventParameter_ECU4_DTC37:338, value-type=Dem_EventIdType}, port=ControlEventAvailable_DemEventParameter_ECU4_DTC37}
        {enable-take-address=true, indirect-api=false, port-defined-argument-value{value=ControlEventAvailable_DemEventParameter_ECU4_DTC38:339, value-type=Dem_EventIdType}, port=ControlEventAvailable_DemEventParameter_ECU4_DTC38}
        {enable-take-address=true, indirect-api=false, port-defined-argument-value{value=ControlEventAvailable_DemEventParameter_ECU4_DTC39:340, value-type=Dem_EventIdType}, port=ControlEventAvailable_DemEventParameter_ECU4_DTC39}
        {enable-take-address=true, indirect-api=false, port-defined-argument-value{value=ControlEventAvailable_DemEventParameter_ECU4_DTC40:341, value-type=Dem_EventIdType}, port=ControlEventAvailable_DemEventParameter_ECU4_DTC40}
        {enable-take-address=true, indirect-api=false, port-defined-argument-value{value=ControlEventAvailable_DemEventParameter_ECU4_DTC41:342, value-type=Dem_EventIdType}, port=ControlEventAvailable_DemEventParameter_ECU4_DTC41}
        {enable-take-address=true, indirect-api=false, port-defined-argument-value{value=ControlEventAvailable_DemEventParameter_ECU4_DTC42:343, value-type=Dem_EventIdType}, port=ControlEventAvailable_DemEventParameter_ECU4_DTC42}
        {enable-take-address=true, indirect-api=false, port-defined-argument-value{value=ControlEventAvailable_DemEventParameter_ECU4_DTC43:344, value-type=Dem_EventIdType}, port=ControlEventAvailable_DemEventParameter_ECU4_DTC43}
        {enable-take-address=true, indirect-api=false, port-defined-argument-value{value=ControlEventAvailable_DemEventParameter_ECU4_DTC44:345, value-type=Dem_EventIdType}, port=ControlEventAvailable_DemEventParameter_ECU4_DTC44}
        {enable-take-address=true, indirect-api=false, port-defined-argument-value{value=ControlEventAvailable_DemEventParameter_ECU4_DTC45:346, value-type=Dem_EventIdType}, port=ControlEventAvailable_DemEventParameter_ECU4_DTC45}
        {enable-take-address=true, indirect-api=false, port-defined-argument-value{value=ControlEventAvailable_DemEventParameter_ECU4_DTC46:347, value-type=Dem_EventIdType}, port=ControlEventAvailable_DemEventParameter_ECU4_DTC46}
        {enable-take-address=true, indirect-api=false, port-defined-argument-value{value=ControlEventAvailable_DemEventParameter_ECU4_DTC47:348, value-type=Dem_EventIdType}, port=ControlEventAvailable_DemEventParameter_ECU4_DTC47}
        {enable-take-address=true, indirect-api=false, port-defined-argument-value{value=ControlEventAvailable_DemEventParameter_ECU4_DTC48:349, value-type=Dem_EventIdType}, port=ControlEventAvailable_DemEventParameter_ECU4_DTC48}
        {enable-take-address=true, indirect-api=false, port-defined-argument-value{value=ControlEventAvailable_DemEventParameter_ECU4_DTC49:350, value-type=Dem_EventIdType}, port=ControlEventAvailable_DemEventParameter_ECU4_DTC49}
        {enable-take-address=true, indirect-api=false, port-defined-argument-value{value=ControlEventAvailable_DemEventParameter_ECU4_DTC50:351, value-type=Dem_EventIdType}, port=ControlEventAvailable_DemEventParameter_ECU4_DTC50}
        {enable-take-address=true, indirect-api=false, port-defined-argument-value{value=ControlEventAvailable_DemEventParameter_ECU4_DTC51:352, value-type=Dem_EventIdType}, port=ControlEventAvailable_DemEventParameter_ECU4_DTC51}
        {enable-take-address=true, indirect-api=false, port-defined-argument-value{value=ControlEventAvailable_DemEventParameter_ECU4_DTC52:353, value-type=Dem_EventIdType}, port=ControlEventAvailable_DemEventParameter_ECU4_DTC52}
        {enable-take-address=true, indirect-api=false, port-defined-argument-value{value=ControlEventAvailable_DemEventParameter_ECU4_DTC53:354, value-type=Dem_EventIdType}, port=ControlEventAvailable_DemEventParameter_ECU4_DTC53}
        {enable-take-address=true, indirect-api=false, port-defined-argument-value{value=ControlEventAvailable_DemEventParameter_ECU4_DTC54:355, value-type=Dem_EventIdType}, port=ControlEventAvailable_DemEventParameter_ECU4_DTC54}
        {enable-take-address=true, indirect-api=false, port-defined-argument-value{value=ControlEventAvailable_DemEventParameter_ECU4_DTC55:356, value-type=Dem_EventIdType}, port=ControlEventAvailable_DemEventParameter_ECU4_DTC55}
        {enable-take-address=true, indirect-api=false, port-defined-argument-value{value=ControlEventAvailable_DemEventParameter_ECU4_DTC56:357, value-type=Dem_EventIdType}, port=ControlEventAvailable_DemEventParameter_ECU4_DTC56}
        {enable-take-address=true, indirect-api=false, port-defined-argument-value{value=ControlEventAvailable_DemEventParameter_ECU4_DTC57:358, value-type=Dem_EventIdType}, port=ControlEventAvailable_DemEventParameter_ECU4_DTC57}
        {enable-take-address=true, indirect-api=false, port-defined-argument-value{value=ControlEventAvailable_DemEventParameter_ECU4_DTC58:359, value-type=Dem_EventIdType}, port=ControlEventAvailable_DemEventParameter_ECU4_DTC58}
        {enable-take-address=true, indirect-api=false, port-defined-argument-value{value=ControlEventAvailable_DemEventParameter_ECU4_DTC59:360, value-type=Dem_EventIdType}, port=ControlEventAvailable_DemEventParameter_ECU4_DTC59}
        {enable-take-address=true, indirect-api=false, port-defined-argument-value{value=ControlEventAvailable_DemEventParameter_ECU4_DTC60:361, value-type=Dem_EventIdType}, port=ControlEventAvailable_DemEventParameter_ECU4_DTC60}
        {enable-take-address=true, indirect-api=false, port-defined-argument-value{value=ControlEventAvailable_DemEventParameter_ECU4_DTC61:362, value-type=Dem_EventIdType}, port=ControlEventAvailable_DemEventParameter_ECU4_DTC61}
        {enable-take-address=true, indirect-api=false, port-defined-argument-value{value=ControlEventAvailable_DemEventParameter_ECU4_DTC62:363, value-type=Dem_EventIdType}, port=ControlEventAvailable_DemEventParameter_ECU4_DTC62}
        {enable-take-address=true, indirect-api=false, port-defined-argument-value{value=ControlEventAvailable_DemEventParameter_ECU4_DTC63:364, value-type=Dem_EventIdType}, port=ControlEventAvailable_DemEventParameter_ECU4_DTC63}
        {enable-take-address=true, indirect-api=false, port-defined-argument-value{value=ControlEventAvailable_DemEventParameter_ECU4_DTC64:365, value-type=Dem_EventIdType}, port=ControlEventAvailable_DemEventParameter_ECU4_DTC64}
        {enable-take-address=true, indirect-api=false, port-defined-argument-value{value=ControlEventAvailable_DemEventParameter_ECU4_DTC65:366, value-type=Dem_EventIdType}, port=ControlEventAvailable_DemEventParameter_ECU4_DTC65}
        {enable-take-address=true, indirect-api=false, port-defined-argument-value{value=ControlEventAvailable_DemEventParameter_ECU4_DTC66:367, value-type=Dem_EventIdType}, port=ControlEventAvailable_DemEventParameter_ECU4_DTC66}
        {enable-take-address=true, indirect-api=false, port-defined-argument-value{value=ControlEventAvailable_DemEventParameter_ECU4_DTC67:368, value-type=Dem_EventIdType}, port=ControlEventAvailable_DemEventParameter_ECU4_DTC67}
        {enable-take-address=true, indirect-api=false, port-defined-argument-value{value=ControlEventAvailable_DemEventParameter_ECU4_DTC68:369, value-type=Dem_EventIdType}, port=ControlEventAvailable_DemEventParameter_ECU4_DTC68}
        {enable-take-address=true, indirect-api=false, port-defined-argument-value{value=ControlEventAvailable_DemEventParameter_ECU4_DTC69:370, value-type=Dem_EventIdType}, port=ControlEventAvailable_DemEventParameter_ECU4_DTC69}
        {enable-take-address=true, indirect-api=false, port-defined-argument-value{value=ControlEventAvailable_DemEventParameter_ECU4_DTC70:371, value-type=Dem_EventIdType}, port=ControlEventAvailable_DemEventParameter_ECU4_DTC70}
        {enable-take-address=true, indirect-api=false, port-defined-argument-value{value=ControlEventAvailable_DemEventParameter_ECU4_DTC71:372, value-type=Dem_EventIdType}, port=ControlEventAvailable_DemEventParameter_ECU4_DTC71}
        {enable-take-address=true, indirect-api=false, port-defined-argument-value{value=ControlEventAvailable_DemEventParameter_ECU4_DTC72:373, value-type=Dem_EventIdType}, port=ControlEventAvailable_DemEventParameter_ECU4_DTC72}
        {enable-take-address=true, indirect-api=false, port-defined-argument-value{value=ControlEventAvailable_DemEventParameter_ECU4_DTC73:374, value-type=Dem_EventIdType}, port=ControlEventAvailable_DemEventParameter_ECU4_DTC73}
        {enable-take-address=true, indirect-api=false, port-defined-argument-value{value=ControlEventAvailable_DemEventParameter_ECU4_DTC74:375, value-type=Dem_EventIdType}, port=ControlEventAvailable_DemEventParameter_ECU4_DTC74}
        {enable-take-address=true, indirect-api=false, port-defined-argument-value{value=ControlEventAvailable_DemEventParameter_ECU4_DTC75:376, value-type=Dem_EventIdType}, port=ControlEventAvailable_DemEventParameter_ECU4_DTC75}
        {enable-take-address=true, indirect-api=false, port-defined-argument-value{value=ControlEventAvailable_DemEventParameter_ECU4_DTC76:377, value-type=Dem_EventIdType}, port=ControlEventAvailable_DemEventParameter_ECU4_DTC76}
        {enable-take-address=true, indirect-api=false, port-defined-argument-value{value=ControlEventAvailable_DemEventParameter_ECU4_DTC77:378, value-type=Dem_EventIdType}, port=ControlEventAvailable_DemEventParameter_ECU4_DTC77}
        {enable-take-address=true, indirect-api=false, port-defined-argument-value{value=ControlEventAvailable_DemEventParameter_ECU4_DTC78:379, value-type=Dem_EventIdType}, port=ControlEventAvailable_DemEventParameter_ECU4_DTC78}
        {enable-take-address=true, indirect-api=false, port-defined-argument-value{value=ControlEventAvailable_DemEventParameter_ECU4_DTC79:380, value-type=Dem_EventIdType}, port=ControlEventAvailable_DemEventParameter_ECU4_DTC79}
        {enable-take-address=true, indirect-api=false, port-defined-argument-value{value=ControlEventAvailable_DemEventParameter_ECU4_DTC80:381, value-type=Dem_EventIdType}, port=ControlEventAvailable_DemEventParameter_ECU4_DTC80}
        {enable-take-address=true, indirect-api=false, port-defined-argument-value{value=ControlEventAvailable_DemEventParameter_ECU4_DTC81:382, value-type=Dem_EventIdType}, port=ControlEventAvailable_DemEventParameter_ECU4_DTC81}
        {enable-take-address=true, indirect-api=false, port-defined-argument-value{value=ControlEventAvailable_DemEventParameter_ECU4_DTC82:383, value-type=Dem_EventIdType}, port=ControlEventAvailable_DemEventParameter_ECU4_DTC82}
        {enable-take-address=true, indirect-api=false, port-defined-argument-value{value=ControlEventAvailable_DemEventParameter_ECU4_DTC83:384, value-type=Dem_EventIdType}, port=ControlEventAvailable_DemEventParameter_ECU4_DTC83}
        {enable-take-address=true, indirect-api=false, port-defined-argument-value{value=ControlEventAvailable_DemEventParameter_ECU4_DTC84:385, value-type=Dem_EventIdType}, port=ControlEventAvailable_DemEventParameter_ECU4_DTC84}
        {enable-take-address=true, indirect-api=false, port-defined-argument-value{value=ControlEventAvailable_DemEventParameter_ECU4_DTC85:386, value-type=Dem_EventIdType}, port=ControlEventAvailable_DemEventParameter_ECU4_DTC85}
        {enable-take-address=true, indirect-api=false, port-defined-argument-value{value=ControlEventAvailable_DemEventParameter_ECU4_DTC86:387, value-type=Dem_EventIdType}, port=ControlEventAvailable_DemEventParameter_ECU4_DTC86}
        {enable-take-address=true, indirect-api=false, port-defined-argument-value{value=ControlEventAvailable_DemEventParameter_ECU4_DTC87:388, value-type=Dem_EventIdType}, port=ControlEventAvailable_DemEventParameter_ECU4_DTC87}
        {enable-take-address=true, indirect-api=false, port-defined-argument-value{value=ControlEventAvailable_DemEventParameter_ECU4_DTC88:389, value-type=Dem_EventIdType}, port=ControlEventAvailable_DemEventParameter_ECU4_DTC88}
        {enable-take-address=true, indirect-api=false, port-defined-argument-value{value=ControlEventAvailable_DemEventParameter_ECU4_DTC89:390, value-type=Dem_EventIdType}, port=ControlEventAvailable_DemEventParameter_ECU4_DTC89}
        {enable-take-address=true, indirect-api=false, port-defined-argument-value{value=ControlEventAvailable_DemEventParameter_ECU4_DTC90:391, value-type=Dem_EventIdType}, port=ControlEventAvailable_DemEventParameter_ECU4_DTC90}
        {enable-take-address=true, indirect-api=false, port-defined-argument-value{value=ControlEventAvailable_DemEventParameter_ECU4_DTC91:392, value-type=Dem_EventIdType}, port=ControlEventAvailable_DemEventParameter_ECU4_DTC91}
        {enable-take-address=true, indirect-api=false, port-defined-argument-value{value=ControlEventAvailable_DemEventParameter_ECU4_DTC92:393, value-type=Dem_EventIdType}, port=ControlEventAvailable_DemEventParameter_ECU4_DTC92}
        {enable-take-address=true, indirect-api=false, port-defined-argument-value{value=ControlEventAvailable_DemEventParameter_ECU4_DTC93:394, value-type=Dem_EventIdType}, port=ControlEventAvailable_DemEventParameter_ECU4_DTC93}
        {enable-take-address=true, indirect-api=false, port-defined-argument-value{value=ControlEventAvailable_DemEventParameter_ECU4_DTC94:395, value-type=Dem_EventIdType}, port=ControlEventAvailable_DemEventParameter_ECU4_DTC94}
        {enable-take-address=true, indirect-api=false, port-defined-argument-value{value=ControlEventAvailable_DemEventParameter_ECU4_DTC95:396, value-type=Dem_EventIdType}, port=ControlEventAvailable_DemEventParameter_ECU4_DTC95}
        {enable-take-address=true, indirect-api=false, port-defined-argument-value{value=ControlEventAvailable_DemEventParameter_ECU4_DTC96:397, value-type=Dem_EventIdType}, port=ControlEventAvailable_DemEventParameter_ECU4_DTC96}
        {enable-take-address=true, indirect-api=false, port-defined-argument-value{value=ControlEventAvailable_DemEventParameter_ECU4_DTC97:398, value-type=Dem_EventIdType}, port=ControlEventAvailable_DemEventParameter_ECU4_DTC97}
        {enable-take-address=true, indirect-api=false, port-defined-argument-value{value=ControlEventAvailable_DemEventParameter_ECU4_DTC98:399, value-type=Dem_EventIdType}, port=ControlEventAvailable_DemEventParameter_ECU4_DTC98}
        {enable-take-address=true, indirect-api=false, port-defined-argument-value{value=ControlEventAvailable_DemEventParameter_ECU4_DTC99:400, value-type=Dem_EventIdType}, port=ControlEventAvailable_DemEventParameter_ECU4_DTC99}
        {enable-take-address=true, indirect-api=false, port-defined-argument-value{value=ControlEventAvailable_DemEventParameter_ECU5_DTC00:401, value-type=Dem_EventIdType}, port=ControlEventAvailable_DemEventParameter_ECU5_DTC00}
        {enable-take-address=true, indirect-api=false, port-defined-argument-value{value=ControlEventAvailable_DemEventParameter_ECU5_DTC01:402, value-type=Dem_EventIdType}, port=ControlEventAvailable_DemEventParameter_ECU5_DTC01}
        {enable-take-address=true, indirect-api=false, port-defined-argument-value{value=ControlEventAvailable_DemEventParameter_ECU5_DTC02:403, value-type=Dem_EventIdType}, port=ControlEventAvailable_DemEventParameter_ECU5_DTC02}
        {enable-take-address=true, indirect-api=false, port-defined-argument-value{value=ControlEventAvailable_DemEventParameter_ECU5_DTC03:404, value-type=Dem_EventIdType}, port=ControlEventAvailable_DemEventParameter_ECU5_DTC03}
        {enable-take-address=true, indirect-api=false, port-defined-argument-value{value=ControlEventAvailable_DemEventParameter_ECU5_DTC04:405, value-type=Dem_EventIdType}, port=ControlEventAvailable_DemEventParameter_ECU5_DTC04}
        {enable-take-address=true, indirect-api=false, port-defined-argument-value{value=ControlEventAvailable_DemEventParameter_ECU5_DTC05:406, value-type=Dem_EventIdType}, port=ControlEventAvailable_DemEventParameter_ECU5_DTC05}
        {enable-take-address=true, indirect-api=false, port-defined-argument-value{value=ControlEventAvailable_DemEventParameter_ECU5_DTC06:407, value-type=Dem_EventIdType}, port=ControlEventAvailable_DemEventParameter_ECU5_DTC06}
        {enable-take-address=true, indirect-api=false, port-defined-argument-value{value=ControlEventAvailable_DemEventParameter_ECU5_DTC07:408, value-type=Dem_EventIdType}, port=ControlEventAvailable_DemEventParameter_ECU5_DTC07}
        {enable-take-address=true, indirect-api=false, port-defined-argument-value{value=ControlEventAvailable_DemEventParameter_ECU5_DTC08:409, value-type=Dem_EventIdType}, port=ControlEventAvailable_DemEventParameter_ECU5_DTC08}
        {enable-take-address=true, indirect-api=false, port-defined-argument-value{value=ControlEventAvailable_DemEventParameter_ECU5_DTC09:410, value-type=Dem_EventIdType}, port=ControlEventAvailable_DemEventParameter_ECU5_DTC09}
        {enable-take-address=true, indirect-api=false, port-defined-argument-value{value=ControlEventAvailable_DemEventParameter_ECU5_DTC10:411, value-type=Dem_EventIdType}, port=ControlEventAvailable_DemEventParameter_ECU5_DTC10}
        {enable-take-address=true, indirect-api=false, port-defined-argument-value{value=ControlEventAvailable_DemEventParameter_ECU5_DTC11:412, value-type=Dem_EventIdType}, port=ControlEventAvailable_DemEventParameter_ECU5_DTC11}
        {enable-take-address=true, indirect-api=false, port-defined-argument-value{value=ControlEventAvailable_DemEventParameter_ECU5_DTC12:413, value-type=Dem_EventIdType}, port=ControlEventAvailable_DemEventParameter_ECU5_DTC12}
        {enable-take-address=true, indirect-api=false, port-defined-argument-value{value=ControlEventAvailable_DemEventParameter_ECU5_DTC13:414, value-type=Dem_EventIdType}, port=ControlEventAvailable_DemEventParameter_ECU5_DTC13}
        {enable-take-address=true, indirect-api=false, port-defined-argument-value{value=ControlEventAvailable_DemEventParameter_ECU5_DTC14:415, value-type=Dem_EventIdType}, port=ControlEventAvailable_DemEventParameter_ECU5_DTC14}
        {enable-take-address=true, indirect-api=false, port-defined-argument-value{value=ControlEventAvailable_DemEventParameter_ECU5_DTC15:416, value-type=Dem_EventIdType}, port=ControlEventAvailable_DemEventParameter_ECU5_DTC15}
        {enable-take-address=true, indirect-api=false, port-defined-argument-value{value=ControlEventAvailable_DemEventParameter_ECU5_DTC16:417, value-type=Dem_EventIdType}, port=ControlEventAvailable_DemEventParameter_ECU5_DTC16}
        {enable-take-address=true, indirect-api=false, port-defined-argument-value{value=ControlEventAvailable_DemEventParameter_ECU5_DTC17:418, value-type=Dem_EventIdType}, port=ControlEventAvailable_DemEventParameter_ECU5_DTC17}
        {enable-take-address=true, indirect-api=false, port-defined-argument-value{value=ControlEventAvailable_DemEventParameter_ECU5_DTC18:419, value-type=Dem_EventIdType}, port=ControlEventAvailable_DemEventParameter_ECU5_DTC18}
        {enable-take-address=true, indirect-api=false, port-defined-argument-value{value=ControlEventAvailable_DemEventParameter_ECU5_DTC19:420, value-type=Dem_EventIdType}, port=ControlEventAvailable_DemEventParameter_ECU5_DTC19}
        {enable-take-address=true, indirect-api=false, port-defined-argument-value{value=ControlEventAvailable_DemEventParameter_ECU5_DTC20:421, value-type=Dem_EventIdType}, port=ControlEventAvailable_DemEventParameter_ECU5_DTC20}
        {enable-take-address=true, indirect-api=false, port-defined-argument-value{value=ControlEventAvailable_DemEventParameter_ECU5_DTC21:422, value-type=Dem_EventIdType}, port=ControlEventAvailable_DemEventParameter_ECU5_DTC21}
        {enable-take-address=true, indirect-api=false, port-defined-argument-value{value=ControlEventAvailable_DemEventParameter_ECU5_DTC22:423, value-type=Dem_EventIdType}, port=ControlEventAvailable_DemEventParameter_ECU5_DTC22}
        {enable-take-address=true, indirect-api=false, port-defined-argument-value{value=ControlEventAvailable_DemEventParameter_ECU5_DTC23:424, value-type=Dem_EventIdType}, port=ControlEventAvailable_DemEventParameter_ECU5_DTC23}
        {enable-take-address=true, indirect-api=false, port-defined-argument-value{value=ControlEventAvailable_DemEventParameter_ECU5_DTC24:425, value-type=Dem_EventIdType}, port=ControlEventAvailable_DemEventParameter_ECU5_DTC24}
        {enable-take-address=true, indirect-api=false, port-defined-argument-value{value=ControlEventAvailable_DemEventParameter_ECU5_DTC25:426, value-type=Dem_EventIdType}, port=ControlEventAvailable_DemEventParameter_ECU5_DTC25}
        {enable-take-address=true, indirect-api=false, port-defined-argument-value{value=ControlEventAvailable_DemEventParameter_ECU5_DTC26:427, value-type=Dem_EventIdType}, port=ControlEventAvailable_DemEventParameter_ECU5_DTC26}
        {enable-take-address=true, indirect-api=false, port-defined-argument-value{value=ControlEventAvailable_DemEventParameter_ECU5_DTC27:428, value-type=Dem_EventIdType}, port=ControlEventAvailable_DemEventParameter_ECU5_DTC27}
        {enable-take-address=true, indirect-api=false, port-defined-argument-value{value=ControlEventAvailable_DemEventParameter_ECU5_DTC28:429, value-type=Dem_EventIdType}, port=ControlEventAvailable_DemEventParameter_ECU5_DTC28}
        {enable-take-address=true, indirect-api=false, port-defined-argument-value{value=ControlEventAvailable_DemEventParameter_ECU5_DTC29:430, value-type=Dem_EventIdType}, port=ControlEventAvailable_DemEventParameter_ECU5_DTC29}
        {enable-take-address=true, indirect-api=false, port-defined-argument-value{value=ControlEventAvailable_DemEventParameter_ECU5_DTC30:431, value-type=Dem_EventIdType}, port=ControlEventAvailable_DemEventParameter_ECU5_DTC30}
        {enable-take-address=true, indirect-api=false, port-defined-argument-value{value=ControlEventAvailable_DemEventParameter_ECU5_DTC31:432, value-type=Dem_EventIdType}, port=ControlEventAvailable_DemEventParameter_ECU5_DTC31}
        {enable-take-address=true, indirect-api=false, port-defined-argument-value{value=ControlEventAvailable_DemEventParameter_ECU5_DTC32:433, value-type=Dem_EventIdType}, port=ControlEventAvailable_DemEventParameter_ECU5_DTC32}
        {enable-take-address=true, indirect-api=false, port-defined-argument-value{value=ControlEventAvailable_DemEventParameter_ECU5_DTC33:434, value-type=Dem_EventIdType}, port=ControlEventAvailable_DemEventParameter_ECU5_DTC33}
        {enable-take-address=true, indirect-api=false, port-defined-argument-value{value=ControlEventAvailable_DemEventParameter_ECU5_DTC34:435, value-type=Dem_EventIdType}, port=ControlEventAvailable_DemEventParameter_ECU5_DTC34}
        {enable-take-address=true, indirect-api=false, port-defined-argument-value{value=ControlEventAvailable_DemEventParameter_ECU5_DTC35:436, value-type=Dem_EventIdType}, port=ControlEventAvailable_DemEventParameter_ECU5_DTC35}
        {enable-take-address=true, indirect-api=false, port-defined-argument-value{value=ControlEventAvailable_DemEventParameter_ECU5_DTC36:437, value-type=Dem_EventIdType}, port=ControlEventAvailable_DemEventParameter_ECU5_DTC36}
        {enable-take-address=true, indirect-api=false, port-defined-argument-value{value=ControlEventAvailable_DemEventParameter_ECU5_DTC37:438, value-type=Dem_EventIdType}, port=ControlEventAvailable_DemEventParameter_ECU5_DTC37}
        {enable-take-address=true, indirect-api=false, port-defined-argument-value{value=ControlEventAvailable_DemEventParameter_ECU5_DTC38:439, value-type=Dem_EventIdType}, port=ControlEventAvailable_DemEventParameter_ECU5_DTC38}
        {enable-take-address=true, indirect-api=false, port-defined-argument-value{value=ControlEventAvailable_DemEventParameter_ECU5_DTC39:440, value-type=Dem_EventIdType}, port=ControlEventAvailable_DemEventParameter_ECU5_DTC39}
        {enable-take-address=true, indirect-api=false, port-defined-argument-value{value=ControlEventAvailable_DemEventParameter_ECU5_DTC40:441, value-type=Dem_EventIdType}, port=ControlEventAvailable_DemEventParameter_ECU5_DTC40}
        {enable-take-address=true, indirect-api=false, port-defined-argument-value{value=ControlEventAvailable_DemEventParameter_ECU5_DTC41:442, value-type=Dem_EventIdType}, port=ControlEventAvailable_DemEventParameter_ECU5_DTC41}
        {enable-take-address=true, indirect-api=false, port-defined-argument-value{value=ControlEventAvailable_DemEventParameter_ECU5_DTC42:443, value-type=Dem_EventIdType}, port=ControlEventAvailable_DemEventParameter_ECU5_DTC42}
        {enable-take-address=true, indirect-api=false, port-defined-argument-value{value=ControlEventAvailable_DemEventParameter_ECU5_DTC43:444, value-type=Dem_EventIdType}, port=ControlEventAvailable_DemEventParameter_ECU5_DTC43}
        {enable-take-address=true, indirect-api=false, port-defined-argument-value{value=ControlEventAvailable_DemEventParameter_ECU5_DTC44:445, value-type=Dem_EventIdType}, port=ControlEventAvailable_DemEventParameter_ECU5_DTC44}
        {enable-take-address=true, indirect-api=false, port-defined-argument-value{value=ControlEventAvailable_DemEventParameter_ECU5_DTC45:446, value-type=Dem_EventIdType}, port=ControlEventAvailable_DemEventParameter_ECU5_DTC45}
        {enable-take-address=true, indirect-api=false, port-defined-argument-value{value=ControlEventAvailable_DemEventParameter_ECU5_DTC46:447, value-type=Dem_EventIdType}, port=ControlEventAvailable_DemEventParameter_ECU5_DTC46}
        {enable-take-address=true, indirect-api=false, port-defined-argument-value{value=ControlEventAvailable_DemEventParameter_ECU5_DTC47:448, value-type=Dem_EventIdType}, port=ControlEventAvailable_DemEventParameter_ECU5_DTC47}
        {enable-take-address=true, indirect-api=false, port-defined-argument-value{value=ControlEventAvailable_DemEventParameter_ECU5_DTC48:449, value-type=Dem_EventIdType}, port=ControlEventAvailable_DemEventParameter_ECU5_DTC48}
        {enable-take-address=true, indirect-api=false, port-defined-argument-value{value=ControlEventAvailable_DemEventParameter_ECU5_DTC49:450, value-type=Dem_EventIdType}, port=ControlEventAvailable_DemEventParameter_ECU5_DTC49}
        {enable-take-address=true, indirect-api=false, port-defined-argument-value{value=ControlEventAvailable_DemEventParameter_ECU5_DTC50:451, value-type=Dem_EventIdType}, port=ControlEventAvailable_DemEventParameter_ECU5_DTC50}
        {enable-take-address=true, indirect-api=false, port-defined-argument-value{value=ControlEventAvailable_DemEventParameter_ECU5_DTC51:452, value-type=Dem_EventIdType}, port=ControlEventAvailable_DemEventParameter_ECU5_DTC51}
        {enable-take-address=true, indirect-api=false, port-defined-argument-value{value=ControlEventAvailable_DemEventParameter_ECU5_DTC52:453, value-type=Dem_EventIdType}, port=ControlEventAvailable_DemEventParameter_ECU5_DTC52}
        {enable-take-address=true, indirect-api=false, port-defined-argument-value{value=ControlEventAvailable_DemEventParameter_ECU5_DTC53:454, value-type=Dem_EventIdType}, port=ControlEventAvailable_DemEventParameter_ECU5_DTC53}
        {enable-take-address=true, indirect-api=false, port-defined-argument-value{value=ControlEventAvailable_DemEventParameter_ECU5_DTC54:455, value-type=Dem_EventIdType}, port=ControlEventAvailable_DemEventParameter_ECU5_DTC54}
        {enable-take-address=true, indirect-api=false, port-defined-argument-value{value=ControlEventAvailable_DemEventParameter_ECU5_DTC55:456, value-type=Dem_EventIdType}, port=ControlEventAvailable_DemEventParameter_ECU5_DTC55}
        {enable-take-address=true, indirect-api=false, port-defined-argument-value{value=ControlEventAvailable_DemEventParameter_ECU5_DTC56:457, value-type=Dem_EventIdType}, port=ControlEventAvailable_DemEventParameter_ECU5_DTC56}
        {enable-take-address=true, indirect-api=false, port-defined-argument-value{value=ControlEventAvailable_DemEventParameter_ECU5_DTC57:458, value-type=Dem_EventIdType}, port=ControlEventAvailable_DemEventParameter_ECU5_DTC57}
        {enable-take-address=true, indirect-api=false, port-defined-argument-value{value=ControlEventAvailable_DemEventParameter_ECU5_DTC58:459, value-type=Dem_EventIdType}, port=ControlEventAvailable_DemEventParameter_ECU5_DTC58}
        {enable-take-address=true, indirect-api=false, port-defined-argument-value{value=ControlEventAvailable_DemEventParameter_ECU5_DTC59:460, value-type=Dem_EventIdType}, port=ControlEventAvailable_DemEventParameter_ECU5_DTC59}
        {enable-take-address=true, indirect-api=false, port-defined-argument-value{value=ControlEventAvailable_DemEventParameter_ECU5_DTC60:461, value-type=Dem_EventIdType}, port=ControlEventAvailable_DemEventParameter_ECU5_DTC60}
        {enable-take-address=true, indirect-api=false, port-defined-argument-value{value=ControlEventAvailable_DemEventParameter_ECU5_DTC61:462, value-type=Dem_EventIdType}, port=ControlEventAvailable_DemEventParameter_ECU5_DTC61}
        {enable-take-address=true, indirect-api=false, port-defined-argument-value{value=ControlEventAvailable_DemEventParameter_ECU5_DTC62:463, value-type=Dem_EventIdType}, port=ControlEventAvailable_DemEventParameter_ECU5_DTC62}
        {enable-take-address=true, indirect-api=false, port-defined-argument-value{value=ControlEventAvailable_DemEventParameter_ECU5_DTC63:464, value-type=Dem_EventIdType}, port=ControlEventAvailable_DemEventParameter_ECU5_DTC63}
        {enable-take-address=true, indirect-api=false, port-defined-argument-value{value=ControlEventAvailable_DemEventParameter_ECU5_DTC64:465, value-type=Dem_EventIdType}, port=ControlEventAvailable_DemEventParameter_ECU5_DTC64}
        {enable-take-address=true, indirect-api=false, port-defined-argument-value{value=ControlEventAvailable_DemEventParameter_ECU5_DTC65:466, value-type=Dem_EventIdType}, port=ControlEventAvailable_DemEventParameter_ECU5_DTC65}
        {enable-take-address=true, indirect-api=false, port-defined-argument-value{value=ControlEventAvailable_DemEventParameter_ECU5_DTC66:467, value-type=Dem_EventIdType}, port=ControlEventAvailable_DemEventParameter_ECU5_DTC66}
        {enable-take-address=true, indirect-api=false, port-defined-argument-value{value=ControlEventAvailable_DemEventParameter_ECU5_DTC67:468, value-type=Dem_EventIdType}, port=ControlEventAvailable_DemEventParameter_ECU5_DTC67}
        {enable-take-address=true, indirect-api=false, port-defined-argument-value{value=ControlEventAvailable_DemEventParameter_ECU5_DTC68:469, value-type=Dem_EventIdType}, port=ControlEventAvailable_DemEventParameter_ECU5_DTC68}
        {enable-take-address=true, indirect-api=false, port-defined-argument-value{value=ControlEventAvailable_DemEventParameter_ECU5_DTC69:470, value-type=Dem_EventIdType}, port=ControlEventAvailable_DemEventParameter_ECU5_DTC69}
        {enable-take-address=true, indirect-api=false, port-defined-argument-value{value=ControlEventAvailable_DemEventParameter_ECU5_DTC70:471, value-type=Dem_EventIdType}, port=ControlEventAvailable_DemEventParameter_ECU5_DTC70}
        {enable-take-address=true, indirect-api=false, port-defined-argument-value{value=ControlEventAvailable_DemEventParameter_ECU5_DTC71:472, value-type=Dem_EventIdType}, port=ControlEventAvailable_DemEventParameter_ECU5_DTC71}
        {enable-take-address=true, indirect-api=false, port-defined-argument-value{value=ControlEventAvailable_DemEventParameter_ECU5_DTC72:473, value-type=Dem_EventIdType}, port=ControlEventAvailable_DemEventParameter_ECU5_DTC72}
        {enable-take-address=true, indirect-api=false, port-defined-argument-value{value=ControlEventAvailable_DemEventParameter_ECU5_DTC73:474, value-type=Dem_EventIdType}, port=ControlEventAvailable_DemEventParameter_ECU5_DTC73}
        {enable-take-address=true, indirect-api=false, port-defined-argument-value{value=ControlEventAvailable_DemEventParameter_ECU5_DTC74:475, value-type=Dem_EventIdType}, port=ControlEventAvailable_DemEventParameter_ECU5_DTC74}
        {enable-take-address=true, indirect-api=false, port-defined-argument-value{value=ControlEventAvailable_DemEventParameter_ECU5_DTC75:476, value-type=Dem_EventIdType}, port=ControlEventAvailable_DemEventParameter_ECU5_DTC75}
        {enable-take-address=true, indirect-api=false, port-defined-argument-value{value=ControlEventAvailable_DemEventParameter_ECU5_DTC76:477, value-type=Dem_EventIdType}, port=ControlEventAvailable_DemEventParameter_ECU5_DTC76}
        {enable-take-address=true, indirect-api=false, port-defined-argument-value{value=ControlEventAvailable_DemEventParameter_ECU5_DTC77:478, value-type=Dem_EventIdType}, port=ControlEventAvailable_DemEventParameter_ECU5_DTC77}
        {enable-take-address=true, indirect-api=false, port-defined-argument-value{value=ControlEventAvailable_DemEventParameter_ECU5_DTC78:479, value-type=Dem_EventIdType}, port=ControlEventAvailable_DemEventParameter_ECU5_DTC78}
        {enable-take-address=true, indirect-api=false, port-defined-argument-value{value=ControlEventAvailable_DemEventParameter_ECU5_DTC79:480, value-type=Dem_EventIdType}, port=ControlEventAvailable_DemEventParameter_ECU5_DTC79}
        {enable-take-address=true, indirect-api=false, port-defined-argument-value{value=ControlEventAvailable_DemEventParameter_ECU5_DTC80:481, value-type=Dem_EventIdType}, port=ControlEventAvailable_DemEventParameter_ECU5_DTC80}
        {enable-take-address=true, indirect-api=false, port-defined-argument-value{value=ControlEventAvailable_DemEventParameter_ECU5_DTC81:482, value-type=Dem_EventIdType}, port=ControlEventAvailable_DemEventParameter_ECU5_DTC81}
        {enable-take-address=true, indirect-api=false, port-defined-argument-value{value=ControlEventAvailable_DemEventParameter_ECU5_DTC82:483, value-type=Dem_EventIdType}, port=ControlEventAvailable_DemEventParameter_ECU5_DTC82}
        {enable-take-address=true, indirect-api=false, port-defined-argument-value{value=ControlEventAvailable_DemEventParameter_ECU5_DTC83:484, value-type=Dem_EventIdType}, port=ControlEventAvailable_DemEventParameter_ECU5_DTC83}
        {enable-take-address=true, indirect-api=false, port-defined-argument-value{value=ControlEventAvailable_DemEventParameter_ECU5_DTC84:485, value-type=Dem_EventIdType}, port=ControlEventAvailable_DemEventParameter_ECU5_DTC84}
        {enable-take-address=true, indirect-api=false, port-defined-argument-value{value=ControlEventAvailable_DemEventParameter_ECU5_DTC85:486, value-type=Dem_EventIdType}, port=ControlEventAvailable_DemEventParameter_ECU5_DTC85}
        {enable-take-address=true, indirect-api=false, port-defined-argument-value{value=ControlEventAvailable_DemEventParameter_ECU5_DTC86:487, value-type=Dem_EventIdType}, port=ControlEventAvailable_DemEventParameter_ECU5_DTC86}
        {enable-take-address=true, indirect-api=false, port-defined-argument-value{value=ControlEventAvailable_DemEventParameter_ECU5_DTC87:488, value-type=Dem_EventIdType}, port=ControlEventAvailable_DemEventParameter_ECU5_DTC87}
        {enable-take-address=true, indirect-api=false, port-defined-argument-value{value=ControlEventAvailable_DemEventParameter_ECU5_DTC88:489, value-type=Dem_EventIdType}, port=ControlEventAvailable_DemEventParameter_ECU5_DTC88}
        {enable-take-address=true, indirect-api=false, port-defined-argument-value{value=ControlEventAvailable_DemEventParameter_ECU5_DTC89:490, value-type=Dem_EventIdType}, port=ControlEventAvailable_DemEventParameter_ECU5_DTC89}
        {enable-take-address=true, indirect-api=false, port-defined-argument-value{value=ControlEventAvailable_DemEventParameter_ECU5_DTC90:491, value-type=Dem_EventIdType}, port=ControlEventAvailable_DemEventParameter_ECU5_DTC90}
        {enable-take-address=true, indirect-api=false, port-defined-argument-value{value=ControlEventAvailable_DemEventParameter_ECU5_DTC91:492, value-type=Dem_EventIdType}, port=ControlEventAvailable_DemEventParameter_ECU5_DTC91}
        {enable-take-address=true, indirect-api=false, port-defined-argument-value{value=ControlEventAvailable_DemEventParameter_ECU5_DTC92:493, value-type=Dem_EventIdType}, port=ControlEventAvailable_DemEventParameter_ECU5_DTC92}
        {enable-take-address=true, indirect-api=false, port-defined-argument-value{value=ControlEventAvailable_DemEventParameter_ECU5_DTC93:494, value-type=Dem_EventIdType}, port=ControlEventAvailable_DemEventParameter_ECU5_DTC93}
        {enable-take-address=true, indirect-api=false, port-defined-argument-value{value=ControlEventAvailable_DemEventParameter_ECU5_DTC94:495, value-type=Dem_EventIdType}, port=ControlEventAvailable_DemEventParameter_ECU5_DTC94}
        {enable-take-address=true, indirect-api=false, port-defined-argument-value{value=ControlEventAvailable_DemEventParameter_ECU5_DTC95:496, value-type=Dem_EventIdType}, port=ControlEventAvailable_DemEventParameter_ECU5_DTC95}
        {enable-take-address=true, indirect-api=false, port-defined-argument-value{value=ControlEventAvailable_DemEventParameter_ECU5_DTC96:497, value-type=Dem_EventIdType}, port=ControlEventAvailable_DemEventParameter_ECU5_DTC96}
        {enable-take-address=true, indirect-api=false, port-defined-argument-value{value=ControlEventAvailable_DemEventParameter_ECU5_DTC97:498, value-type=Dem_EventIdType}, port=ControlEventAvailable_DemEventParameter_ECU5_DTC97}
        {enable-take-address=true, indirect-api=false, port-defined-argument-value{value=ControlEventAvailable_DemEventParameter_ECU5_DTC98:499, value-type=Dem_EventIdType}, port=ControlEventAvailable_DemEventParameter_ECU5_DTC98}
        {enable-take-address=true, indirect-api=false, port-defined-argument-value{value=ControlEventAvailable_DemEventParameter_ECU5_DTC99:500, value-type=Dem_EventIdType}, port=ControlEventAvailable_DemEventParameter_ECU5_DTC99}
        enable-take-address=true, indirect-api=false, port=DataServices_PID_02
        enable-take-address=true, indirect-api=false, port=DataServices_PID_04
        enable-take-address=true, indirect-api=false, port=DataServices_PID_05
        enable-take-address=true, indirect-api=false, port=DataServices_PID_0C
        enable-take-address=true, indirect-api=false, port=DataServices_PID_0D
        enable-take-address=true, indirect-api=false, port=DataServices_PID_42
        enable-take-address=true, indirect-api=false, port=DataServices_PID_49
        enable-take-address=true, indirect-api=false, port=DataServices_CS_ExtendedDataRecord_Fault_pending_counter
        enable-take-address=true, indirect-api=false, port=DataServices_CS_ExtendedDataRecord_Aged_counter
        {enable-take-address=true, indirect-api=false, port-defined-argument-value{value=DEM_IUMPR_GENERAL_DENOMINATOR, value-type=Dem_IumprDenomCondIdType}, port=IUMPRDenominatorCondition_DEM_IUMPR_GENERAL_DENOMINATOR}
        {enable-take-address=true, indirect-api=false, port-defined-argument-value{value=DEM_IUMPR_DEN_COND_COLDSTART, value-type=Dem_IumprDenomCondIdType}, port=IUMPRDenominatorCondition_DEM_IUMPR_DEN_COND_COLDSTART}
        {enable-take-address=true, indirect-api=false, port-defined-argument-value{value=DEM_IUMPR_DEN_COND_EVAP, value-type=Dem_IumprDenomCondIdType}, port=IUMPRDenominatorCondition_DEM_IUMPR_DEN_COND_EVAP}
        {enable-take-address=true, indirect-api=false, port-defined-argument-value{value=DEM_IUMPR_DEN_COND_500MI, value-type=Dem_IumprDenomCondIdType}, port=IUMPRDenominatorCondition_DEM_IUMPR_DEN_COND_500MI}
        {enable-take-address=true, indirect-api=false, port-defined-argument-value{value=DTRCentralReport_Mid01:0, value-type=Dem_DtrIdType}, port=DTRCentralReport_Mid01}
      51 x runnable:
        Dem_MainFunction
          9 x sync call, all with timeout=0.0:
            SSC_DataServices_PID_02_ReadData: operation=DataServices_PID_02.ReadData
            SSC_DataServices_PID_04_ReadData: operation=DataServices_PID_04.ReadData
            SSC_DataServices_PID_05_ReadData: operation=DataServices_PID_05.ReadData
            SSC_DataServices_PID_0C_ReadData: operation=DataServices_PID_0C.ReadData
            SSC_DataServices_PID_0D_ReadData: operation=DataServices_PID_0D.ReadData
            SSC_DataServices_PID_42_ReadData: operation=DataServices_PID_42.ReadData
            SSC_DataServices_PID_49_ReadData: operation=DataServices_PID_49.ReadData
            SSC_DataServices_CS_ExtendedDataRecord_Fault_pending_counter_ReadData: operation=DataServices_CS_ExtendedDataRecord_Fault_pending_counter.ReadData
            SSC_DataServices_CS_ExtendedDataRecord_Aged_counter_ReadData: operation=DataServices_CS_ExtendedDataRecord_Aged_counter.ReadData
        SetEventStatus: arguments=[symbol=EventId, symbol=EventStatus], can-be-invoked-concurrently=true, symbol=Dem_SetEventStatus
        SetEventStatusWithEnvdata: arguments=[symbol=EventId, symbol=EventStatus, symbol=debug0, symbol=debug1], can-be-invoked-concurrently=true, symbol=Dem_SetEventStatusWithEnvData
        ResetEventStatus: runnable-entity-argument=symbol=EventId, can-be-invoked-concurrently=true, symbol=Dem_ResetEventStatus
        PrestoreFreezeFrame: runnable-entity-argument=symbol=EventId, can-be-invoked-concurrently=true, symbol=Dem_PrestoreFreezeFrame
        ClearPrestoredFreezeFrame: runnable-entity-argument=symbol=EventId, can-be-invoked-concurrently=true, symbol=Dem_ClearPrestoredFreezeFrame
        ResetEventDebounceStatus: arguments=[symbol=EventId, symbol=DebounceResetStatus], can-be-invoked-concurrently=true, symbol=Dem_ResetEventDebounceStatus
        SetEventDisabled: runnable-entity-argument=symbol=EventId, can-be-invoked-concurrently=true, symbol=Dem_SetEventDisabled
        RepIUMPRFaultDetect: runnable-entity-argument=symbol=RatioID, can-be-invoked-concurrently=true, symbol=Dem_RepIUMPRFaultDetect
        RepIUMPRDenLock: runnable-entity-argument=symbol=RatioID, can-be-invoked-concurrently=true, symbol=Dem_RepIUMPRDenLock
        RepIUMPRDenRelease: runnable-entity-argument=symbol=RatioID, can-be-invoked-concurrently=true, symbol=Dem_RepIUMPRDenRelease
        SetIUMPRDenCondition: arguments=[symbol=ConditionId, symbol=ConditionStatus], can-be-invoked-concurrently=true, symbol=Dem_SetIUMPRDenCondition
        DTRCentralReport: arguments=[symbol=DTRId, symbol=TestResult, symbol=LowerLimit, symbol=UpperLimit, symbol=Ctrlval], can-be-invoked-concurrently=true, symbol=Dem_SetDTR
        GetEventStatus: arguments=[symbol=EventId, symbol=EventStatusExtended], can-be-invoked-concurrently=true, symbol=Dem_GetEventStatus
        GetEventFailed: arguments=[symbol=EventId, symbol=EventFailed], can-be-invoked-concurrently=true, symbol=Dem_GetEventFailed
        GetEventTested: arguments=[symbol=EventId, symbol=EventTested], can-be-invoked-concurrently=true, symbol=Dem_GetEventTested
        GetDTCOfEvent: arguments=[symbol=EventId, symbol=DTCFormat, symbol=DTCOfEvent], can-be-invoked-concurrently=true, symbol=Dem_GetDTCOfEvent
        GetDebouncingOfEvent: arguments=[symbol=EventId, symbol=DebouncingState], can-be-invoked-concurrently=true, symbol=Dem_GetDebouncingOfEvent
        GetFaultDetectionCounter: arguments=[symbol=EventId, symbol=FaultDetectionCounter], can-be-invoked-concurrently=true, symbol=Dem_GetFaultDetectionCounter
        SetWIRStatus: arguments=[symbol=EventId, symbol=WIRStatus], can-be-invoked-concurrently=true, symbol=Dem_SetWIRStatus
        GetEventExtendedDataRecord: arguments=[symbol=EventId, symbol=RecordNumber, symbol=DestBuffer], can-be-invoked-concurrently=true, symbol=Dem_GetEventExtendedDataRecordForRTE
        GetEventExtendedDataRecordEx: arguments=[symbol=EventId, symbol=RecordNumber, symbol=DestBuffer, symbol=BufSize], can-be-invoked-concurrently=true, symbol=Dem_GetEventExtendedDataRecordEx
        GetEventFreezeFrameData: arguments=[symbol=EventId, symbol=RecordNumber, symbol=ReportTotalRecord, symbol=DataId, symbol=DestBuffer], can-be-invoked-concurrently=true, symbol=Dem_GetEventFreezeFrameDataForRTE
        GetEventFreezeFrameDataEx: arguments=[symbol=EventId, symbol=RecordNumber, symbol=DataId, symbol=DestBuffer, symbol=BufSize], can-be-invoked-concurrently=true, symbol=Dem_GetEventFreezeFrameDataEx
        SetOperationCycleState: arguments=[symbol=OperationCycleId, symbol=CycleState], can-be-invoked-concurrently=true, symbol=Dem_SetOperationCycleState
        GetOperationCycleState: arguments=[symbol=OperationCycleId, symbol=CycleState], can-be-invoked-concurrently=true, symbol=Dem_GetOperationCycleState
        GetCycleQualified: arguments=[symbol=OperationCycleId, symbol=isQualified], can-be-invoked-concurrently=true, symbol=Dem_GetCycleQualified
        SetCycleQualified: runnable-entity-argument=symbol=OperationCycleId, can-be-invoked-concurrently=true, symbol=Dem_SetCycleQualified
        SetEnableCondition: arguments=[symbol=EnableConditionID, symbol=ConditionFulfilled], can-be-invoked-concurrently=true, symbol=Dem_SetEnableCondition
        GetEnableCondition: arguments=[symbol=EnableConditionID, symbol=ConditionFulfilled], can-be-invoked-concurrently=true, symbol=Dem_GetEnableCondition
        SetStorageCondition: arguments=[symbol=StorageConditionID, symbol=ConditionFulfilled], can-be-invoked-concurrently=true, symbol=Dem_SetStorageCondition
        GetStorageCondition: arguments=[symbol=StorageConditionID, symbol=ConditionFulfilled], can-be-invoked-concurrently=true, symbol=Dem_GetStorageCondition
        GetIndicatorStatus: arguments=[symbol=IndicatorId, symbol=IndicatorStatus], can-be-invoked-concurrently=true, symbol=Dem_GetIndicatorStatus
        SetDTCSuppression: arguments=[symbol=ClientId, symbol=SuppressionStatus], symbol=Dem_SetDTCSuppression
        GetDTCSuppression: arguments=[symbol=ClientId, symbol=SuppressionStatus], symbol=Dem_GetDTCSuppression
        GetEventMemoryOverflow: arguments=[symbol=ClientId, symbol=DTCOrigin, symbol=OverflowIndication], can-be-invoked-concurrently=true, symbol=Dem_GetEventMemoryOverflow
        GetNumberOfEventMemoryEntries: arguments=[symbol=ClientId, symbol=DTCOrigin, symbol=NumberOfEventMemoryEntries], can-be-invoked-concurrently=true, symbol=Dem_GetNumberOfEventMemoryEntries
        ClearDTC: runnable-entity-argument=symbol=ClientId, symbol=Dem_ClearDTC
        SelectDTC: arguments=[symbol=ClientId, symbol=DTC, symbol=DTCFormat, symbol=DTCOrigin], symbol=Dem_SelectDTC
        Dem_GetEventStatus_GeneralEvtInfo: arguments=[symbol=EventId, symbol=EventStatusExtended], can-be-invoked-concurrently=true
        Dem_GetEventFailed_GeneralEvtInfo: can-be-invoked-concurrently=true
        Dem_GetEventTested_GeneralEvtInfo: arguments=[symbol=EventId, symbol=EventTested], can-be-invoked-concurrently=true
        Dem_GetDTCOfEvent_GeneralEvtInfo: can-be-invoked-concurrently=true
        Dem_GetFaultDetectionCounter_GeneralEvtInfo: arguments=[symbol=EventId, symbol=FaultDetectionCounter], can-be-invoked-concurrently=true
        Dem_GetEventExtendedDataRecord_GeneralEvtInfo: can-be-invoked-concurrently=true
        Dem_GetEventFreezeFrameData_GeneralEvtInfo: can-be-invoked-concurrently=true
        Dem_GetEventExtendedDataRecordEx_GeneralEvtInfo: arguments=[symbol=EventId, symbol=RecordNumber, symbol=DestBuffer, symbol=BufSize], can-be-invoked-concurrently=true
        Dem_GetEventFreezeFrameDataEx_GeneralEvtInfo: can-be-invoked-concurrently=true
        GetDebouncingOfEvent_GeneralEvtInfo: can-be-invoked-concurrently=true, symbol=Dem_GetDebouncingOfEvent_GeneralEvtInfo
        Dem_GetEventIdCausingLastDetError: can-be-invoked-concurrently=true
        SetEventAvailable: arguments=[symbol=EventId, symbol=AvailableStatus], can-be-invoked-concurrently=true, symbol=Dem_SetEventAvailable
package /AUTOSAR_Dem/PortInterfaces
  33 x client server interface, all with is-service=true:
    DiagnosticMonitor
      7 x operation, all with possible-error=[DiagnosticMonitor/E_OK, DiagnosticMonitor/E_NOT_OK]:
        SetEventStatus
          arg EventStatus: type=Dem_EventStatusType, direction=IN
        SetEventStatusWithEnvdata
          arg EventStatus: type=Dem_EventStatusType, direction=IN
          arg debug0: type=Dem_DebugDataType, direction=IN
          arg debug1: type=Dem_DebugDataType, direction=IN
        ResetEventStatus
        PrestoreFreezeFrame
        ClearPrestoredFreezeFrame
        ResetEventDebounceStatus
          arg DebounceResetStatus: type=Dem_DebounceResetStatusType, direction=IN
        SetEventDisabled
      error E_OK: error-code=0
      error E_NOT_OK: error-code=1
    DiagnosticInfo
      10 x operation:
        GetEventStatus: possible-error=[DiagnosticInfo/E_OK, DiagnosticInfo/E_NOT_OK]
          arg EventStatusByte: type=Dem_UdsStatusByteType, direction=OUT
        GetEventFailed: possible-error=[DiagnosticInfo/E_OK, DiagnosticInfo/E_NOT_OK]
          arg EventFailed: type=boolean, direction=OUT
        GetEventTested: possible-error=[DiagnosticInfo/E_OK, DiagnosticInfo/E_NOT_OK]
          arg EventTested: type=boolean, direction=OUT
        GetDTCOfEvent: possible-error=[DiagnosticInfo/E_OK, DiagnosticInfo/E_NOT_OK, DiagnosticInfo/DEM_E_NO_DTC_AVAILABLE]
          arg DTCFormat: type=Dem_DTCFormatType, direction=IN
          arg DTCOfEvent: type=uint32, direction=OUT
        GetDebouncingOfEvent: possible-error=[DiagnosticInfo/E_OK, DiagnosticInfo/E_NOT_OK]
          arg DebouncingState: type=Dem_DebouncingStateType, direction=OUT
        GetFaultDetectionCounter: possible-error=[DiagnosticInfo/E_OK, DiagnosticInfo/E_NOT_OK, DiagnosticInfo/DEM_E_NO_FDC_AVAILABLE]
          arg FaultDetectionCounter: type=sint8, direction=OUT
        GetEventExtendedDataRecord: possible-error=[DiagnosticInfo/E_OK, DiagnosticInfo/E_NOT_OK]
          arg RecordNumber: type=uint8, direction=IN
          arg DestBuffer: type=Dem_MaxDataValueType, direction=OUT
        GetEventExtendedDataRecordEx: possible-error=[DiagnosticInfo/E_OK, DiagnosticInfo/E_NOT_OK]
          arg RecordNumber: type=uint8, direction=IN
          arg DestBuffer: type=Dem_MaxDataValueType, direction=OUT
          arg Bufsize: type=uint16, direction=INOUT
        GetEventFreezeFrameData: possible-error=[DiagnosticInfo/E_OK, DiagnosticInfo/E_NOT_OK]
          4 x arg:
            RecordNumber: type=uint8, direction=IN
            ReportTotalRecord: type=boolean, direction=IN
            DataId: type=uint16, direction=IN
            DestBuffer: type=Dem_MaxDataValueType, direction=OUT
        GetEventFreezeFrameDataEx: possible-error=[DiagnosticInfo/E_OK, DiagnosticInfo/E_NOT_OK]
          4 x arg:
            RecordNumber: type=uint8, direction=IN
            DataId: type=uint16, direction=IN
            DestBuffer: type=Dem_MaxDataValueType, direction=OUT
            BufSize: type=uint16, direction=INOUT
      4 x error:
        E_OK: error-code=0
        E_NOT_OK: error-code=1
        DEM_E_NO_DTC_AVAILABLE: error-code=2
        DEM_E_NO_FDC_AVAILABLE: error-code=3
    GetDataOfPID21
      operation GetDataOfPID21: possible-error=[GetDataOfPID21/E_OK, GetDataOfPID21/E_NOT_OK]
        arg PID21value: type=Dem_PID21valueType, direction=OUT
      error E_OK: error-code=0
      error E_NOT_OK: error-code=1
    GetDataOfPID31
      operation GetDataOfPID31: possible-error=[GetDataOfPID31/E_OK, GetDataOfPID31/E_NOT_OK]
        arg PID31value: type=Dem_PID31valueType, direction=OUT
      error E_OK: error-code=0
      error E_NOT_OK: error-code=1
    SetDataOfPID21
      operation SetDataOfPID21: possible-error=[SetDataOfPID21/E_OK, SetDataOfPID21/E_NOT_OK]
        arg PID21value: type=Dem_PID21valueType, direction=IN
      error E_OK: error-code=0
      error E_NOT_OK: error-code=1
    SetDataOfPID31
      operation SetDataOfPID31: possible-error=[SetDataOfPID31/E_OK, SetDataOfPID31/E_NOT_OK]
        arg PID31value: type=Dem_PID31valueType, direction=IN
      error E_OK: error-code=0
      error E_NOT_OK: error-code=1
    SetDataOfPID4D
      operation SetDataOfPID4D: possible-error=[SetDataOfPID4D/E_OK, SetDataOfPID4D/E_NOT_OK]
        arg PID4Dvalue: type=Dem_PID4DvalueType, direction=IN
      error E_OK: error-code=0
      error E_NOT_OK: error-code=1
    SetDataOfPID4E
      operation SetDataOfPID4E: possible-error=[SetDataOfPID4E/E_OK, SetDataOfPID4E/E_NOT_OK]
        arg PID4Evalue: type=Dem_PID4EvalueType, direction=IN
      error E_OK: error-code=0
      error E_NOT_OK: error-code=1
    GetDataOfPID4D
      operation GetDataOfPID4D: possible-error=[GetDataOfPID4D/E_OK, GetDataOfPID4D/E_NOT_OK]
        arg PID4Dvalue: type=Dem_PID4DvalueType, direction=OUT
      error E_OK: error-code=0
      error E_NOT_OK: error-code=1
    GetDataOfPID4E
      operation GetDataOfPID4E: possible-error=[GetDataOfPID4E/E_OK, GetDataOfPID4E/E_NOT_OK]
        arg PID4Evalue: type=Dem_PID4EvalueType, direction=OUT
      error E_OK: error-code=0
      error E_NOT_OK: error-code=1
    GeneralDiagnosticInfo
      11 x operation:
        GetEventStatus: possible-error=[GeneralDiagnosticInfo/E_OK, GeneralDiagnosticInfo/E_NOT_OK]
          arg EventId: type=Dem_EventIdType, direction=IN
          arg EventStatusByte: type=Dem_UdsStatusByteType, direction=OUT
        GetEventFailed: possible-error=[GeneralDiagnosticInfo/E_OK, GeneralDiagnosticInfo/E_NOT_OK]
          arg EventId: type=Dem_EventIdType, direction=IN
          arg EventFailed: type=boolean, direction=OUT
        GetEventTested: possible-error=[GeneralDiagnosticInfo/E_OK, GeneralDiagnosticInfo/E_NOT_OK]
          arg EventId: type=Dem_EventIdType, direction=IN
          arg EventTested: type=boolean, direction=OUT
        GetDTCOfEvent: possible-error=[GeneralDiagnosticInfo/E_OK, GeneralDiagnosticInfo/E_NOT_OK, GeneralDiagnosticInfo/DEM_E_NO_DTC_AVAILABLE]
          arg EventId: type=Dem_EventIdType, direction=IN
          arg DTCFormat: type=Dem_DTCFormatType, direction=IN
          arg DTCOfEvent: type=uint32, direction=OUT
        GetDebouncingOfEvent: possible-error=[GeneralDiagnosticInfo/E_OK, GeneralDiagnosticInfo/E_NOT_OK]
          arg EventId: type=Dem_EventIdType, direction=IN
          arg DebouncingState: type=Dem_DebouncingStateType, direction=OUT
        GetFaultDetectionCounter: possible-error=[GeneralDiagnosticInfo/E_OK, GeneralDiagnosticInfo/E_NOT_OK, GeneralDiagnosticInfo/DEM_E_NO_FDC_AVAILABLE]
          arg EventId: type=Dem_EventIdType, direction=IN
          arg FaultDetectionCounter: type=sint8, direction=OUT
        GetEventExtendedDataRecord: possible-error=[GeneralDiagnosticInfo/E_OK, GeneralDiagnosticInfo/E_NOT_OK]
          arg EventId: type=Dem_EventIdType, direction=IN
          arg RecordNumber: type=uint8, direction=IN
          arg DestBuffer: type=Dem_MaxDataValueType, direction=OUT
        GetEventFreezeFrameData: possible-error=[GeneralDiagnosticInfo/E_OK, GeneralDiagnosticInfo/E_NOT_OK]
          5 x arg:
            EventId: type=Dem_EventIdType, direction=IN
            RecordNumber: type=uint8, direction=IN
            ReportTotalRecord: type=boolean, direction=IN
            DataId: type=uint16, direction=IN
            DestBuffer: type=Dem_MaxDataValueType, direction=OUT
        GetEventExtendedDataRecordEx: possible-error=[GeneralDiagnosticInfo/E_OK, GeneralDiagnosticInfo/E_NOT_OK]
          4 x arg:
            EventId: type=Dem_EventIdType, direction=IN
            RecordNumber: type=uint8, direction=IN
            DestBuffer: type=Dem_MaxDataValueType, direction=OUT
            Bufsize: type=uint16, direction=INOUT
        GetEventFreezeFrameDataEx: possible-error=[GeneralDiagnosticInfo/E_OK, GeneralDiagnosticInfo/E_NOT_OK]
          5 x arg:
            EventId: type=Dem_EventIdType, direction=IN
            RecordNumber: type=uint8, direction=IN
            DataId: type=uint16, direction=IN
            DestBuffer: type=Dem_MaxDataValueType, direction=OUT
            BufSize: type=uint16, direction=INOUT
        GetEventIdCausingLastDetError: possible-error=[GeneralDiagnosticInfo/E_OK, GeneralDiagnosticInfo/E_NOT_OK]
          arg EventId: type=Dem_EventIdType, direction=OUT
      4 x error:
        E_OK: error-code=0
        E_NOT_OK: error-code=1
        DEM_E_NO_DTC_AVAILABLE: error-code=2
        DEM_E_NO_FDC_AVAILABLE: error-code=3
    OperationCycle
      4 x operation, all with possible-error=[OperationCycle/E_OK, OperationCycle/E_NOT_OK]:
        SetOperationCycleState
          arg CycleState: type=Dem_OperationCycleStateType, direction=IN
        GetOperationCycleState
          arg CycleState: type=Dem_OperationCycleStateType, direction=OUT
        GetCycleQualified
          arg CycleState: type=boolean, direction=OUT
        SetCycleQualified
      error E_OK: error-code=0
      error E_NOT_OK: error-code=1
    EventAvailable
      operation SetEventAvailable: possible-error=[EventAvailable/E_OK, EventAvailable/E_NOT_OK]
        arg AvailableStatus: type=boolean, direction=IN
      error E_OK: error-code=0
      error E_NOT_OK: error-code=1
    EnableCondition
      operation SetEnableCondition: possible-error=[EnableCondition/E_OK, EnableCondition/E_NOT_OK]
        arg ConditionFulfilled: type=boolean, direction=IN
      operation GetEnableCondition: possible-error=[EnableCondition/E_OK, EnableCondition/E_NOT_OK]
        arg ConditionFulfilled: type=boolean, direction=OUT
      error E_OK: error-code=0
      error E_NOT_OK: error-code=1
    StorageCondition
      operation SetStorageCondition: possible-error=[StorageCondition/E_OK, StorageCondition/E_NOT_OK]
        arg ConditionFulfilled: type=boolean, direction=IN
      operation GetStorageCondition: possible-error=[StorageCondition/E_OK, StorageCondition/E_NOT_OK]
        arg ConditionFulfilled: type=boolean, direction=OUT
      error E_OK: error-code=0
      error E_NOT_OK: error-code=1
    IndicatorStatus
      operation GetIndicatorStatus: possible-error=[IndicatorStatus/E_OK, IndicatorStatus/E_NOT_OK]
        arg IndicatorStatus: type=Dem_IndicatorStatusType, direction=OUT
      error E_OK: error-code=0
      error E_NOT_OK: error-code=1
    DTCSuppression
      operation SetDTCSuppression: possible-error=[DTCSuppression/E_OK, DTCSuppression/E_NOT_OK, DTCSuppression/DEM_WRONG_DTC, DTCSuppression/DEM_WRONG_DTCORIGIN, DTCSuppression/DEM_PENDING]
        arg SuppressionStatus: type=boolean, direction=IN
      operation GetDTCSuppression: possible-error=[DTCSuppression/E_OK, DTCSuppression/E_NOT_OK, DTCSuppression/DEM_WRONG_DTC, DTCSuppression/DEM_WRONG_DTCORIGIN, DTCSuppression/DEM_PENDING]
        arg SuppressionStatus: type=boolean, direction=OUT
      5 x error:
        E_OK: error-code=0
        E_NOT_OK: error-code=1
        DEM_PENDING: error-code=4
        DEM_WRONG_DTC: error-code=8
        DEM_WRONG_DTCORIGIN: error-code=9
    EvMemOverflowIndication
      operation GetEventMemoryOverflow: possible-error=[EvMemOverflowIndication/E_OK, EvMemOverflowIndication/E_NOT_OK]
        arg OverflowIndication: type=boolean, direction=OUT
      operation GetNumberOfEventMemoryEntries: possible-error=[EvMemOverflowIndication/E_OK, EvMemOverflowIndication/E_NOT_OK]
        arg NumberOfEventMemoryEntries: type=uint8, direction=OUT
      error E_OK: error-code=0
      error E_NOT_OK: error-code=1
    DataServices_PID_02
      operation ReadData: possible-error=[DataServices_PID_02/E_OK, DataServices_PID_02/E_NOT_OK]
        arg Data: type=DemDataElememtDataSize_PID_02, direction=OUT
      error E_OK: error-code=0
      error E_NOT_OK: error-code=1
    DataServices_PID_04
      operation ReadData: possible-error=[DataServices_PID_04/E_OK, DataServices_PID_04/E_NOT_OK]
        arg Data: type=DemDataElememtDataSize_PID_04, direction=OUT
      error E_OK: error-code=0
      error E_NOT_OK: error-code=1
    DataServices_PID_05
      operation ReadData: possible-error=[DataServices_PID_05/E_OK, DataServices_PID_05/E_NOT_OK]
        arg Data: type=DemDataElememtDataSize_PID_05, direction=OUT
      error E_OK: error-code=0
      error E_NOT_OK: error-code=1
    DataServices_PID_0C
      operation ReadData: possible-error=[DataServices_PID_0C/E_OK, DataServices_PID_0C/E_NOT_OK]
        arg Data: type=DemDataElememtDataSize_PID_0C, direction=OUT
      error E_OK: error-code=0
      error E_NOT_OK: error-code=1
    DataServices_PID_0D
      operation ReadData: possible-error=[DataServices_PID_0D/E_OK, DataServices_PID_0D/E_NOT_OK]
        arg Data: type=DemDataElememtDataSize_PID_0D, direction=OUT
      error E_OK: error-code=0
      error E_NOT_OK: error-code=1
    DataServices_PID_42
      operation ReadData: possible-error=[DataServices_PID_42/E_OK, DataServices_PID_42/E_NOT_OK]
        arg Data: type=DemDataElememtDataSize_PID_42, direction=OUT
      error E_OK: error-code=0
      error E_NOT_OK: error-code=1
    DataServices_PID_49
      operation ReadData: possible-error=[DataServices_PID_49/E_OK, DataServices_PID_49/E_NOT_OK]
        arg Data: type=DemDataElememtDataSize_PID_49, direction=OUT
      error E_OK: error-code=0
      error E_NOT_OK: error-code=1
    DataServices_CS_ExtendedDataRecord_Fault_pending_counter
      operation ReadData: possible-error=[DataServices_CS_ExtendedDataRecord_Fault_pending_counter/E_OK, DataServices_CS_ExtendedDataRecord_Fault_pending_counter/E_NOT_OK]
        arg Data: type=DemDataElememtDataSize_CS_ExtendedDataRecord_Fault_pending_counter, direction=OUT
      error E_OK: error-code=0
      error E_NOT_OK: error-code=1
    DataServices_CS_ExtendedDataRecord_Aged_counter
      operation ReadData: possible-error=[DataServices_CS_ExtendedDataRecord_Aged_counter/E_OK, DataServices_CS_ExtendedDataRecord_Aged_counter/E_NOT_OK]
        arg Data: type=DemDataElememtDataSize_CS_ExtendedDataRecord_Aged_counter, direction=OUT
      error E_OK: error-code=0
      error E_NOT_OK: error-code=1
    EventStatus
      operation SetWIRStatus: possible-error=[EventStatus/E_OK, EventStatus/E_NOT_OK]
        arg WIRStatus: type=boolean, direction=IN
      error E_OK: error-code=0
      error E_NOT_OK: error-code=1
    ClearDTC
      operation ClearDTC: possible-error=[ClearDTC/E_OK, ClearDTC/E_NOT_OK, ClearDTC/DEM_PENDING, DEM_CLEAR_BUSY, DEM_CLEAR_MEMORY_ERROR, DEM_CLEAR_FAILED, ClearDTC/DEM_WRONG_DTC, ClearDTC/DEM_WRONG_DTCORIGIN, DEM_BUSY]
      operation SelectDTC: possible-error=[ClearDTC/E_OK, ClearDTC/E_NOT_OK]
        arg DTC: type=uint32, direction=IN
        arg DTCFormat: type=Dem_DTCFormatType, direction=IN
        arg DTCOrigin: type=Dem_DTCOriginType, direction=IN
      9 x error:
        E_OK: error-code=0
        E_NOT_OK: error-code=1
        DEM_PENDING: error-code=4
        DEM_CLEAR_BUSY: error-code=5
        DEM_CLEAR_MEMORY_ERROR: error-code=6
        DEM_CLEAR_FAILED: error-code=7
        DEM_WRONG_DTC: error-code=8
        DEM_WRONG_DTCORIGIN: error-code=9
        DEM_BUSY: error-code=22
    IUMPRNumerator
      operation RepIUMPRFaultDetect: possible-error=[IUMPRNumerator/E_OK, IUMPRNumerator/E_NOT_OK]
      error E_OK: error-code=0
      error E_NOT_OK: error-code=1
    IUMPRDenominator
      operation RepIUMPRDenLock: possible-error=[IUMPRDenominator/E_OK, IUMPRDenominator/E_NOT_OK]
      operation RepIUMPRDenRelease: possible-error=[IUMPRDenominator/E_OK, IUMPRDenominator/E_NOT_OK]
      error E_OK: error-code=0
      error E_NOT_OK: error-code=1
    IUMPRDenominatorCondition
      operation SetIUMPRDenCondition: possible-error=[IUMPRDenominatorCondition/E_OK, IUMPRDenominatorCondition/E_NOT_OK]
        arg ConditionStatus: type=Dem_IumprDenomCondStatusType, direction=IN
      error E_OK: error-code=0
      error E_NOT_OK: error-code=1
    DTRCentralReport
      operation SetDTR: possible-error=[DTRCentralReport/E_OK, DTRCentralReport/E_NOT_OK]
        4 x arg, all with direction=IN:
          TestResult: type=sint32
          LowerLimit: type=sint32
          UpperLimit: type=sint32
          CtrlVal: type=Dem_DTRControlType
      error E_OK: error-code=0
      error E_NOT_OK: error-code=1
package /AUTOSAR_Dem/SwcImplementations
  swc implementation Impl_Dem: programming-language=C, sw-version=9.0.0, swc-bsw-mapping=SwcBswMappings, vendor-id=6, behavior=IntBeh_Dem
    code-descriptors:
      code CodeDescr_Dem: artifact-descriptors=autosar-engineering-object={short-label=Code_0, category=SWSRC}
package /AUTOSAR_Dem/ImplementationDataTypes
  32 x impl type:
    Dem_EventStatusType: compu {1=DEM_EVENT_STATUS_FAILED, 4=DEM_EVENT_STATUS_FDC_THRESHOLD_REACHED, 0=DEM_EVENT_STATUS_PASSED, 3=DEM_EVENT_STATUS_PREFAILED, 2=DEM_EVENT_STATUS_PREPASSED}, implementation-data-type=uint8
    Dem_DebugDataType: implementation-data-type=uint32
    Dem_EventIdType: implementation-data-type=uint16
    Dem_UdsStatusByteType: compu {0x01=DEM_UDS_STATUS_TF, 0x02=DEM_UDS_STATUS_TFTOC, 0x04=DEM_UDS_STATUS_PDTC, 0x08=DEM_UDS_STATUS_CDTC, 0x10=DEM_UDS_STATUS_TNCSLC, 0x20=DEM_UDS_STATUS_TFSLC, 0x40=DEM_UDS_STATUS_TNCTOC, 0x80=DEM_UDS_STATUS_WIR}, implementation-data-type=uint8
    Dem_OperationCycleStateType: compu {0x01=DEM_CYCLE_STATE_END, 0x00=DEM_CYCLE_STATE_START}, implementation-data-type=uint8
    Dem_OperationCycleIdType: implementation-data-type=uint8
    Dem_MaxDataValueType: category=ARRAY, type-emitter=RTE
      element uint8: array-size=4, array-size-semantics=FIXED-SIZE, implementation-data-type=uint8
    Dem_PID21valueType: category=ARRAY, type-emitter=RTE
      element PID21value: array-size=2, array-size-semantics=FIXED-SIZE, implementation-data-type=uint8
    Dem_PID31valueType: category=ARRAY, type-emitter=RTE
      element PID31value: array-size=2, array-size-semantics=FIXED-SIZE, implementation-data-type=uint8
    Dem_PID4DvalueType: category=ARRAY, type-emitter=RTE
      element PID4Dvalue: array-size=2, array-size-semantics=FIXED-SIZE, implementation-data-type=uint8
    Dem_PID4EvalueType: category=ARRAY, type-emitter=RTE
      element PID4Evalue: array-size=2, array-size-semantics=FIXED-SIZE, implementation-data-type=uint8
    Dem_IndicatorIdType: implementation-data-type=uint8
    Dem_IndicatorStatusType: compu {0x00=DEM_INDICATOR_OFF, 0x01=DEM_INDICATOR_CONTINUOUS, 0x02=DEM_INDICATOR_BLINKING, 0x03=DEM_INDICATOR_BLINK_CONT, 0x04=DEM_INDICATOR_SLOW_FLASH, 0x05=DEM_INDICATOR_FAST_FLASH}, implementation-data-type=uint8
    Dem_DTCOriginType: compu {0x0001=DEM_DTC_ORIGIN_PRIMARY_MEMORY, 0x0002=DEM_DTC_ORIGIN_MIRROR_MEMORY, 0x0003=DEM_DTC_ORIGIN_PERMANENT_MEMORY, 0x0004=DEM_DTC_ORIGIN_OBD_RELEVANT_MEMORY, 0x0005=DEM_DTC_ORIGIN_SECONDARY_MEMORY}, implementation-data-type=uint16
    Dem_InitMonitorReasonType: compu {0x01=DEM_INIT_MONITOR_CLEAR, 0x02=DEM_INIT_MONITOR_RESTART, 0x03=DEM_INIT_MONITOR_REENABLED, 0x04=DEM_INIT_MONITOR_STORAGE_REENABLED}, implementation-data-type=uint8
    Dem_DTCFormatType: compu {0=DEM_DTC_FORMAT_OBD, 1=DEM_DTC_FORMAT_UDS, 2=DEM_DTC_FORMAT_J1939}, implementation-data-type=uint8
    Dem_DebouncingStateType: compu {0x01=DEM_TEMPORARILY_DEFECTIVE, 0x02=DEM_FINALLY_DEFECTIVE, 0x04=DEM_TEMPORARILY_HEALED, 0x08=DEM_TEST_COMPLETE, 0x10=DEM_DTR_UPDATE}, implementation-data-type=uint8
    Dem_DebounceResetStatusType: compu {0x00=DEM_DEBOUNCE_STATUS_FREEZE, 0x01=DEM_DEBOUNCE_STATUS_RESET}, implementation-data-type=uint8
    DemDataElememtDataSize_PID_02: category=ARRAY
      element DemDataElememtDataSize_PID_02: array-size=2, array-size-semantics=FIXED-SIZE, implementation-data-type=uint8
    DemDataElememtDataSize_PID_04: category=ARRAY
      element DemDataElememtDataSize_PID_04: array-size=1, array-size-semantics=FIXED-SIZE, implementation-data-type=uint8
    DemDataElememtDataSize_PID_05: category=ARRAY
      element DemDataElememtDataSize_PID_05: array-size=1, array-size-semantics=FIXED-SIZE, implementation-data-type=uint8
    DemDataElememtDataSize_PID_0C: category=ARRAY
      element DemDataElememtDataSize_PID_0C: array-size=2, array-size-semantics=FIXED-SIZE, implementation-data-type=uint8
    DemDataElememtDataSize_PID_0D: category=ARRAY
      element DemDataElememtDataSize_PID_0D: array-size=1, array-size-semantics=FIXED-SIZE, implementation-data-type=uint8
    DemDataElememtDataSize_PID_42: category=ARRAY
      element DemDataElememtDataSize_PID_42: array-size=2, array-size-semantics=FIXED-SIZE, implementation-data-type=uint8
    DemDataElememtDataSize_PID_49: category=ARRAY
      element DemDataElememtDataSize_PID_49: array-size=1, array-size-semantics=FIXED-SIZE, implementation-data-type=uint8
    DemDataElememtDataSize_CS_ExtendedDataRecord_Fault_pending_counter: category=ARRAY
      element DemDataElememtDataSize_CS_ExtendedDataRecord_Fault_pending_counter: array-size=1, array-size-semantics=FIXED-SIZE, implementation-data-type=uint8
    DemDataElememtDataSize_CS_ExtendedDataRecord_Aged_counter: category=ARRAY
      element DemDataElememtDataSize_CS_ExtendedDataRecord_Aged_counter: array-size=1, array-size-semantics=FIXED-SIZE, implementation-data-type=uint8
    Dem_RatioIdType: implementation-data-type=uint8
    Dem_IumprDenomCondStatusType: compu {0x00=DEM_IUMPR_DEN_STATUS_NOT_REACHED, 0x01=DEM_IUMPR_DEN_STATUS_REACHED, 0x02=DEM_IUMPR_DEN_STATUS_INHIBITED}, implementation-data-type=uint8
    Dem_IumprDenomCondIdType: compu {0x01=DEM_IUMPR_GENERAL_DENOMINATOR, 0x02=DEM_IUMPR_DEN_COND_COLDSTART, 0x03=DEM_IUMPR_DEN_COND_EVAP, 0x04=DEM_IUMPR_DEN_COND_500MI}, implementation-data-type=uint8
    Dem_DTRControlType: compu {0x00=DEM_DTR_CTL_NORMAL, 0x01=DEM_DTR_CTL_NO_MAX, 0x02=DEM_DTR_CTL_NO_MIN, 0x03=DEM_DTR_CTL_RESET, 0x04=DEM_DTR_CTL_INVISIBLE}, implementation-data-type=uint8
    Dem_DtrIdType: implementation-data-type=uint16
package /AUTOSAR_Dem/SwcBswMappings
  swc bsw mapping SwcBswMappings: bsw-behavior=IB_Dem, swc-bsw-runnable-mapping{bsw-entity=BSWSE_DemMainFunction, swc-runnable=Dem_MainFunction}, swc-behavior=IntBeh_Dem
