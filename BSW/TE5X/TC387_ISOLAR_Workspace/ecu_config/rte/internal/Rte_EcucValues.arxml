AUTOSAR XML (schema 00047)
package /RTE
  module config Rte
    RteBswGeneral: RteSchMVersionInfoApi=0
    RteGeneration:
      RteBypassSupport = NONE
      RteCalibrationSupport = NONE
      RteCodeVendorId = 11
      RteDevErrorDetect = 0
      RteDevErrorDetectUninit = 0
      RteGenerationMode = VENDOR_MODE
      RteInExclusiveAreaCheckEnabled = 1
      RteMeasurementSupport = 0
      RteOptimizationMode = RUNTIME
      RteValueRangeCheckEnabled = 0
      RteVfbTraceAnonymousClientEnabled = 0
      RteVfbTraceEnabled = 0
    NoneSectionPolicies (RteInitializationBehavior): RteInitializationStrategy=RTE_INITIALIZATION_STRATEGY_NONE, RteSectionInitializationPolicy=NO-INIT
    RteOsInteraction
    DataDeclarationSectionPolicies (RteInitializationBehavior):
      RteInitializationStrategy = RTE_INITIALIZATION_STRATEGY_AT_DATA_DECLARATION
      RteSectionInitializationPolicy = INIT
      RteSectionInitializationPolicy = CLEARED
    RteStartSectionPolicies (RteInitializationBehavior):
      RteInitializationStrategy = RTE_INITIALIZATION_STRATEGY_AT_RTE_START_AND_PARTITION_RESTART
      RteSectionInitializationPolicy = POWER-ON-INIT
      RteSectionInitializationPolicy = POWER-ON-CLEARED
    CPT_ASW_BASE (RteSwComponentInstance): RteSoftwareComponentInstanceRef=CPT_ASW_BASE
      TE_Base_SWC_100ms (RteEventToTaskMapping): RtePositionInTask=1, RteActivationOffset=0.0, RteMappedToTaskRef=Core0_OsTask_ASW_100ms, RteEventRef=TE_Base_SWC_100ms
    4 x RteBswModuleInstance:
      Com: RteBswImplementationRef=Com
        EV_SE_MainFunctionRx (RteBswEventToTaskMapping): RteBswPositionInTask=10, RteBswActivationOffset=0.0, RteBswMappedToTaskRef=Core0_OsTask_BSW_1ms, RteBswEventRef=EV_SE_MainFunctionRx
        EV_SE_MainFunctionTx (RteBswEventToTaskMapping):
          RteBswPositionInTask = 9
          RteBswActivationOffset = 0.0
          RteBswImmediateRestart = false
          RteBswMappedToTaskRef = Core0_OsTask_BSW_1ms
          RteBswEventRef = EV_SE_MainFunctionTx
      BSWIMPL_BswM: RteBswImplementationRef=BSWIMPL_BswM, RteBswModuleConfigurationRef=BswM
        4 x RteBswEventToTaskMapping:
          TE_BswM_MainFunction: RteBswPositionInTask=9, RteBswActivationOffset=0.0, RteBswMappedToTaskRef=Core0_OsTask_BSW_10ms, RteBswEventRef=TE_BswM_MainFunction
          MSE_BswM_Cfg_DfrdBswNotification_BswM_MRP_DCM_ModeNotification_EcuReset_HARD: RteBswPositionInTask=4, RteBswEventRef=MSE_BswM_Cfg_DfrdBswNotification_BswM_MRP_DCM_ModeNotification_EcuReset_HARD
          MSE_BswM_Cfg_DfrdBswNotification_BswM_MRP_DCM_ModeNotification_EcuReset_KEYONOFF: RteBswPositionInTask=5, RteBswEventRef=MSE_BswM_Cfg_DfrdBswNotification_BswM_MRP_DCM_ModeNotification_EcuReset_KEYONOFF
          MSE_BswM_Cfg_DfrdBswNotification_BswM_MRP_DCM_ModeNotification_EcuReset_SOFT: RteBswPositionInTask=6, RteBswEventRef=MSE_BswM_Cfg_DfrdBswNotification_BswM_MRP_DCM_ModeNotification_EcuReset_SOFT
        RteBswRequiredModeGroupEcuReset (RteBswRequiredModeGroupConnection):
          RteBswProvidedModeGrpModInstRef = Dcm
          RteBswProvidedModeGroupRef = DcmEcuReset
          RteBswRequiredModeGroupRef = MDGR_BswM_MRP_DCM_ModeNotification_EcuReset
        RteBswRequiredModeGroupConnection:
          RteBswProvidedModeGrpModInstRef = BSWIMPL_BswM
          RteBswProvidedModeGroupRef = MDGP_AUTOSAR_BswM_ModeDeclarationGroups_MDG_ECUM_STATE
          RteBswRequiredModeGroupRef = MDGR_BswM_MRP_BswM_MDG
        6 x RteBswEventToTaskMapping:
          MSE_BswM_Cfg_DfrdBswNotification_BswM_MRP_BswM_MDG_ECUM_STATE_STARTUP_TWO: RteBswEventRef=MSE_BswM_Cfg_DfrdBswNotification_BswM_MRP_BswM_MDG_ECUM_STATE_STARTUP_TWO
          MSE_BswM_Cfg_DfrdBswNotification_BswM_MRP_BswM_MDG_ECUM_STATE_PREP_SHUTDOWN: RteBswEventRef=MSE_BswM_Cfg_DfrdBswNotification_BswM_MRP_BswM_MDG_ECUM_STATE_PREP_SHUTDOWN
          MSE_BswM_Cfg_DfrdBswNotification_BswM_MRP_BswM_MDG_ECUM_STATE_SHUTDOWN: RteBswEventRef=MSE_BswM_Cfg_DfrdBswNotification_BswM_MRP_BswM_MDG_ECUM_STATE_SHUTDOWN
          MSE_BswM_Cfg_DfrdBswNotification_BswM_MRP_BswM_MDG_ECUM_STATE_APP_RUN: RteBswEventRef=MSE_BswM_Cfg_DfrdBswNotification_BswM_MRP_BswM_MDG_ECUM_STATE_APP_RUN
          MSE_BswM_Cfg_DfrdBswNotification_BswM_MRP_BswM_MDG_ECUM_STATE_STARTUP_ONE: RteBswEventRef=MSE_BswM_Cfg_DfrdBswNotification_BswM_MRP_BswM_MDG_ECUM_STATE_STARTUP_ONE
          MSE_BswM_Cfg_DfrdBswNotification_BswM_MRP_BswM_MDG_ECUM_STATE_RUN: RteBswEventRef=MSE_BswM_Cfg_DfrdBswNotification_BswM_MRP_BswM_MDG_ECUM_STATE_RUN
      BSWIMPL_Can: RteBswImplementationRef=BSWIMPL_Can
      CanTp: RteBswImplementationRef=CanTp
        TE_CanTpNormalOperatingMode (RteBswEventToTaskMapping): RteBswPositionInTask=6, RteBswActivationOffset=0.0, RteBswMappedToTaskRef=Core0_OsTask_BSW_1ms, RteBswEventRef=TE_CanTpNormalOperatingMode
    10 x RteSwComponentInstance:
      CPT_ASW_CORE0: RteSoftwareComponentInstanceRef=CPT_ASW_CORE0
        12 x RteEventToTaskMapping, all with RteActivationOffset=0.0:
          TimingEvent_0: RtePositionInTask=2, RteMappedToTaskRef=Core0_OsTask_ASW_100ms, RteEventRef=TimingEvent_0
          TimingEvent_1: RtePositionInTask=8, RteMappedToTaskRef=Core0_OsTask_ASW_10ms, RteEventRef=TimingEvent_1
          TimingEvent_2: RteImmediateRestart=0, RtePositionInTask=1, RteEventRef=TimingEvent_2, RteMappedToTaskRef=Core0_OsTask_ASW_1ms
          TimingEvent_3: RteImmediateRestart=0, RtePositionInTask=2, RteEventRef=TimingEvent_3, RteMappedToTaskRef=Core0_OsTask_ASW_1ms
          TimingEvent_4: RteImmediateRestart=0, RtePositionInTask=11, RteEventRef=TimingEvent_4, RteMappedToTaskRef=Core0_OsTask_ASW_10ms
          TimingEvent_5: RteImmediateRestart=0, RtePositionInTask=3, RteEventRef=TimingEvent_5, RteMappedToTaskRef=Core0_OsTask_ASW_1ms
          TimingEvent_6: RteImmediateRestart=0, RtePositionInTask=4, RteEventRef=TimingEvent_6, RteMappedToTaskRef=Core0_OsTask_ASW_1ms
          TimingEvent_7: RteImmediateRestart=0, RtePositionInTask=5, RteEventRef=TimingEvent_7, RteMappedToTaskRef=Core0_OsTask_ASW_1ms
          TimingEvent_8: RteImmediateRestart=0, RtePositionInTask=12, RteEventRef=TimingEvent_8, RteMappedToTaskRef=Core0_OsTask_ASW_10ms
          TimingEvent_9: RteImmediateRestart=0, RtePositionInTask=13, RteEventRef=TimingEvent_9, RteMappedToTaskRef=Core0_OsTask_ASW_10ms
          TimingEvent_10: RteImmediateRestart=0, RtePositionInTask=5, RteEventRef=TimingEvent_10, RteMappedToTaskRef=Core0_OsTask_ASW_100ms
          TimingEvent_11: RteImmediateRestart=0, RtePositionInTask=6, RteEventRef=TimingEvent_11, RteMappedToTaskRef=Core0_OsTask_ASW_100ms
      CPT_ASW_CORE1: RteSoftwareComponentInstanceRef=CPT_ASW_CORE1
        4 x RteEventToTaskMapping, all with RteActivationOffset=0.0:
          TimingEvent_0: RtePositionInTask=2, RteMappedToTaskRef=Core1_OsTask_ASW_10ms, RteEventRef=TimingEvent_0
          TimingEvent_1: RteImmediateRestart=0, RtePositionInTask=1, RteEventRef=TimingEvent_1, RteMappedToTaskRef=Core1_OsTask_ASW_1ms
          TimingEvent_2: RteImmediateRestart=0, RtePositionInTask=2, RteEventRef=TimingEvent_2, RteMappedToTaskRef=Core1_OsTask_ASW_1ms
          TimingEvent_3: RteImmediateRestart=0, RtePositionInTask=3, RteEventRef=TimingEvent_3, RteMappedToTaskRef=Core1_OsTask_ASW_10ms
      CPT_ASW_CORE2: RteSoftwareComponentInstanceRef=CPT_ASW_CORE2
        7 x RteEventToTaskMapping, all with RteActivationOffset=0.0:
          TimingEvent_0: RtePositionInTask=1, RteMappedToTaskRef=Core2_OsTask_ASW_5ms, RteEventRef=TimingEvent_0
          TimingEvent_1: RtePositionInTask=1, RteMappedToTaskRef=Core2_OsTask_ASW_1ms, RteEventRef=TimingEvent_1
          TimingEvent_2: RteImmediateRestart=0, RtePositionInTask=2, RteEventRef=TimingEvent_2, RteMappedToTaskRef=Core2_OsTask_ASW_1ms
          TimingEvent_3: RteImmediateRestart=0, RtePositionInTask=2, RteEventRef=TimingEvent_3, RteMappedToTaskRef=Core2_OsTask_ASW_5ms
          TimingEvent_4: RteImmediateRestart=0, RtePositionInTask=1, RteEventRef=TimingEvent_4, RteMappedToTaskRef=Core2_OsTask_ASW_10ms
          TimingEvent_5: RteImmediateRestart=0, RtePositionInTask=1, RteEventRef=TimingEvent_5, RteMappedToTaskRef=Core2_OsTask_ASW_100ms
          TimingEvent_6: RteImmediateRestart=0, RtePositionInTask=2, RteEventRef=TimingEvent_6, RteMappedToTaskRef=Core2_OsTask_ASW_100ms
      CPT_ASW_CORE3: RteSoftwareComponentInstanceRef=CPT_ASW_CORE3
        TimingEvent_0 (RteEventToTaskMapping): RteActivationOffset=0.0, RtePositionInTask=1, RteMappedToTaskRef=Core3_OsTask_ASW_5ms, RteEventRef=TimingEvent_0
        TimingEvent_1 (RteEventToTaskMapping): RtePositionInTask=1, RteActivationOffset=0.0, RteMappedToTaskRef=Core3_OsTask_ASW_1ms, RteEventRef=TimingEvent_1
      CPT_BswM: RteSoftwareComponentInstanceRef=CPT_BswM
        DRE_BswM_Cfg_DfrdSwcReqst_BswM_MRP_SWC_Network (RteEventToTaskMapping):
          RtePositionInTask = 1
          RteActivationOffset = 0.0
          RteMappedToTaskRef = Core0_BSW_OsTask_SwcRequest
          RteEventRef = DRE_BswM_Cfg_DfrdSwcReqst_BswM_MRP_SWC_Network
        DRE_BswM_Cfg_DfrdSwcReqst_BswMSwcModeRequest (RteEventToTaskMapping):
          RtePositionInTask = 2
          RteActivationOffset = 0.0
          RteMappedToTaskRef = Core0_BSW_OsTask_SwcRequest
          RteEventRef = DRE_BswM_Cfg_DfrdSwcReqst_BswMSwcModeRequest
      CPT_ASW_XCP: RteSoftwareComponentInstanceRef=CPT_ASW_XCP
        TimingEvent_0 (RteEventToTaskMapping): RtePositionInTask=3, RteActivationOffset=0.0, RteMappedToTaskRef=Core0_OsTask_ASW_100ms, RteEventRef=TimingEvent_0
      CPT_ASW_WDG: RteSoftwareComponentInstanceRef=CPT_ASW_WDG
        TimingEvent_Alive_Supervision_Entity1 (RteEventToTaskMapping): RtePositionInTask=4, RteActivationOffset=0.0, RteMappedToTaskRef=Core0_OsTask_ASW_10ms, RteEventRef=TimingEvent_Alive_Supervision_Entity1
      CPT_CDD_CORE0: RteSoftwareComponentInstanceRef=CPT_CDD_CORE0
        TimingEvent_1 (RteEventToTaskMapping): RtePositionInTask=27, RteActivationOffset=0.0, RteMappedToTaskRef=Core0_OsTask_ASW_10ms, RteEventRef=TimingEvent_1
        TimingEvent_2 (RteEventToTaskMapping): RtePositionInTask=3, RteActivationOffset=0.0, RteMappedToTaskRef=Core0_OsTask_BSW_1ms, RteEventRef=TimingEvent_2
      CPT_CDD_CORE1: RteSoftwareComponentInstanceRef=CPT_CDD_CORE1
        TimingEvent_0 (RteEventToTaskMapping): RtePositionInTask=1, RteActivationOffset=0.0, RteMappedToTaskRef=Core1_OsTask_ASW_10ms, RteEventRef=TimingEvent_0
      CPT_CDD_CORE2: RteSoftwareComponentInstanceRef=CPT_CDD_CORE2
        TimingEvent_0 (RteEventToTaskMapping): RtePositionInTask=2, RteActivationOffset=0.0, RteMappedToTaskRef=Core2_OsTask_BSW_10ms, RteEventRef=TimingEvent_0
    6 x RteBswModuleInstance:
      NvM: RteBswImplementationRef=NvM
        EV_SE_MainFunction (RteBswEventToTaskMapping): RteBswPositionInTask=5, RteBswActivationOffset=0.0, RteBswMappedToTaskRef=Core0_OsTask_BSW_1ms, RteBswEventRef=EV_SE_MainFunction
      Dem: RteBswImplementationRef=Dem, RteBswModuleConfigurationRef=Dem
        EV_MainFunction (RteBswEventToTaskMapping): RteBswPositionInTask=8, RteBswActivationOffset=0.0, RteBswMappedToTaskRef=Core0_OsTask_BSW_1ms, RteBswEventRef=EV_MainFunction
      Dcm: RteBswImplementationRef=Dcm
        EV_Dcm_MainFunction (RteBswEventToTaskMapping): RteBswPositionInTask=7, RteBswActivationOffset=0.0, RteBswMappedToTaskRef=Core0_OsTask_BSW_1ms, RteBswEventRef=EV_Dcm_MainFunction
        RteBswRequiredModeGroupConnection:
          RteBswProvidedModeGrpModInstRef = Dcm
          RteBswProvidedModeGroupRef = DcmCommunicationControl_Can_Network_CanNodeNum_01
          RteBswRequiredModeGroupRef = R_DcmCommunicationControl_Can_Network_CanNodeNum_01
      PduR: RteBswImplementationRef=PduR
      Xcp: RteBswImplementationRef=Xcp
        4 x RteBswEventToTaskMapping, all with RteBswActivationOffset=0.0:
          EV_SE_EventChannel_10ms: RteBswPositionInTask=11, RteBswMappedToTaskRef=Core0_OsTask_BSW_10ms, RteBswEventRef=EV_SE_EventChannel_10ms
          EV_SE_MainFunction: RteBswPositionInTask=12, RteBswMappedToTaskRef=Core0_OsTask_BSW_10ms, RteBswEventRef=EV_SE_MainFunction
          EV_SE_EventChannel_50ms: RteBswPositionInTask=2, RteBswMappedToTaskRef=Core0_OsTask_BSW_50ms, RteBswEventRef=EV_SE_EventChannel_50ms
          EV_SE_EventChannel_100ms: RteBswPositionInTask=1, RteBswMappedToTaskRef=Core0_OsTask_BSW_100ms, RteBswEventRef=EV_SE_EventChannel_100ms
      WdgM: RteBswImplementationRef=WdgM
        TE_WdgMSupervisionCycle0 (RteBswEventToTaskMapping): RteBswPositionInTask=32, RteBswActivationOffset=0.0, RteBswMappedToTaskRef=Core0_OsTask_ASW_10ms, RteBswEventRef=TE_WdgMSupervisionCycle0
        RteBswRequiredModeGroupConnection: RteBswProvidedModeGrpModInstRef=WdgM, RteBswProvidedModeGroupRef=WdgMSupervisionCycle, RteBswRequiredModeGroupRef=Current_WdgMSupervisionCycle
    5 x RteSwComponentInstance:
      CPT_CDD_CORE3: RteSoftwareComponentInstanceRef=CPT_CDD_CORE3
        TimingEvent_0 (RteEventToTaskMapping): RteActivationOffset=0.0, RtePositionInTask=2, RteMappedToTaskRef=Core3_OsTask_BSW_10ms, RteEventRef=TimingEvent_0
      CPT_ASW_NVM: RteSoftwareComponentInstanceRef=CPT_ASW_NVM
        TE_ASW_NVM_10ms (RteEventToTaskMapping): RtePositionInTask=5, RteActivationOffset=0.0, RteMappedToTaskRef=Core0_OsTask_ASW_10ms, RteEventRef=TE_ASW_NVM_10ms
      CPT_ASW_DCM: RteSoftwareComponentInstanceRef=CPT_ASW_DCM
        TE_ASW_DCM (RteEventToTaskMapping): RtePositionInTask=6, RteActivationOffset=0.0, RteMappedToTaskRef=Core0_OsTask_ASW_10ms, RteEventRef=TE_ASW_DCM
      CPT_ASW_DEM: RteSoftwareComponentInstanceRef=CPT_ASW_DEM
        TimingEvent_Dem_SWC (RteEventToTaskMapping): RtePositionInTask=7, RteActivationOffset=0.0, RteMappedToTaskRef=Core0_OsTask_ASW_10ms, RteEventRef=TimingEvent_Dem_SWC
      CPT_ASW_NM: RteSoftwareComponentInstanceRef=CPT_ASW_NM
        TE_ASW_Nm_10ms (RteEventToTaskMapping): RtePositionInTask=3, RteActivationOffset=0.0, RteMappedToTaskRef=Core0_OsTask_ASW_10ms, RteEventRef=TE_ASW_Nm_10ms
    ComM (RteBswModuleInstance): RteBswImplementationRef=ComM
      4 x RteBswEventToTaskMapping, all with RteBswActivationOffset=0.0, RteBswMappedToTaskRef=Core0_OsTask_BSW_10ms:
        EV_SE_MainFunction_Can_Network_CanNodeNum_00: RteBswPositionInTask=6, RteBswEventRef=EV_SE_MainFunction_Can_Network_CanNodeNum_00
        EV_SE_MainFunction_Can_Network_CanNodeNum_01: RteBswPositionInTask=3, RteBswEventRef=EV_SE_MainFunction_Can_Network_CanNodeNum_01
        EV_SE_MainFunction_Can_Network_CanNodeNum_02: RteBswPositionInTask=4, RteBswEventRef=EV_SE_MainFunction_Can_Network_CanNodeNum_02
        EV_SE_MainFunction_Can_Network_CanNodeNum_03: RteBswPositionInTask=5, RteBswEventRef=EV_SE_MainFunction_Can_Network_CanNodeNum_03
    EcuM (RteBswModuleInstance): RteBswImplementationRef=EcuM
      4 x RteBswEventToTaskMapping, all with RteBswPositionInTask=1, RteBswActivationOffset=0.0:
        TE_EcuM_MainFunction_Core{0..2}: RteBswMappedToTaskRef=Core{0..2}_OsTask_BSW_10ms, RteBswEventRef=TE_EcuM_MainFunction_Core{0..2}
        TE_EcuM_MainFunction_Core3: RteBswEventRef=TE_EcuM_MainFunction_Core3, RteBswMappedToTaskRef=Core3_OsTask_BSW_10ms
    CPT_ASW_COM (RteSwComponentInstance): RteSoftwareComponentInstanceRef=CPT_ASW_COM
      9 x RteEventToTaskMapping, all with RteImmediateRestart=0, RteActivationOffset=0.0:
        EvMap_Can01_Below100ms: RtePositionInTask=10, RteEventRef=TE_Can01_Below100ms, RteMappedToTaskRef=Core1_OsTask_ASW_10ms
        EvMap_Can01_Above100ms: RtePositionInTask=10, RteMappedToTaskRef=Core1_OsTask_ASW_100ms, RteEventRef=TE_Can01_Above100ms
        EvMap_Can01_SpecialPeriod: RtePositionInTask=10, RteMappedToTaskRef=Core1_OsTask_ASW_1ms, RteEventRef=TE_Can01_SpecialPeriod
        EvMap_Can02_Below100ms: RtePositionInTask=11, RteMappedToTaskRef=Core1_OsTask_ASW_10ms, RteEventRef=TE_Can02_Below100ms
        EvMap_Can02_Above100ms: RtePositionInTask=11, RteMappedToTaskRef=Core1_OsTask_ASW_100ms, RteEventRef=TE_Can02_Above100ms
        EvMap_Can02_SpecialPeriod: RtePositionInTask=11, RteMappedToTaskRef=Core1_OsTask_ASW_1ms, RteEventRef=TE_Can02_SpecialPeriod
        EvMap_Can03_Below100ms: RtePositionInTask=12, RteMappedToTaskRef=Core1_OsTask_ASW_10ms, RteEventRef=TE_Can03_Below100ms
        EvMap_Can03_Above100ms: RtePositionInTask=12, RteMappedToTaskRef=Core1_OsTask_ASW_100ms, RteEventRef=TE_Can03_Above100ms
        EvMap_Can03_SpecialPeriod: RtePositionInTask=12, RteMappedToTaskRef=Core1_OsTask_ASW_1ms, RteEventRef=TE_Can03_SpecialPeriod
    CPT_RSID (RteSwComponentInstance): RteSoftwareComponentInstanceRef=CPT_RSID
      TE_Runnable_RSID_100ms (RteEventToTaskMapping): RtePositionInTask=4, RteActivationOffset=0.0, RteMappedToTaskRef=Core0_OsTask_ASW_100ms, RteEventRef=TE_Runnable_RSID_100ms
    CanSM (RteBswModuleInstance): RteBswImplementationRef=CanSM
      EV_SE_MainFunction (RteBswEventToTaskMapping): RteBswPositionInTask=2, RteBswActivationOffset=0.0, RteBswMappedToTaskRef=Core0_OsTask_BSW_10ms, RteBswEventRef=EV_SE_MainFunction
    CPT_SWC_DEM (RteSwComponentInstance): RteSoftwareComponentInstanceRef=CPT_SWC_DEM
      TimingEvent_SWC_DEM (RteEventToTaskMapping): RtePositionInTask=2, RteActivationOffset=0.0, RteMappedToTaskRef=Core0_OsTask_ASW_10ms, RteEventRef=TimingEvent_SWC_DEM
    6 x RteBswModuleInstance:
      CanTrcv: RteBswImplementationRef=CanTrcv
        EV_SE_MainFunction_CanTrcv (RteBswEventToTaskMapping): RteBswPositionInTask=1, RteBswActivationOffset=0.0, RteBswMappedToTaskRef=Core0_OsTask_BSW_1ms, RteBswEventRef=EV_SE_MainFunction_CanTrcv
      CanNm: RteBswImplementationRef=CanNm
        EV_SE_MainFunction (RteBswEventToTaskMapping): RteBswPositionInTask=2, RteBswActivationOffset=0.0, RteBswMappedToTaskRef=Core0_OsTask_BSW_1ms, RteBswEventRef=EV_SE_MainFunction
      CanNm: RteBswImplementationRef=CanNm
        EV_SE_MainFunction (RteBswEventToTaskMapping): RteBswPositionInTask=4, RteBswActivationOffset=0.0, RteBswMappedToTaskRef=Core0_OsTask_BSW_1ms, RteBswEventRef=EV_SE_MainFunction
      CanNm: RteBswImplementationRef=CanNm
        EV_SE_MainFunction (RteBswEventToTaskMapping): RteBswPositionInTask=2, RteBswActivationOffset=0.0, RteBswMappedToTaskRef=Core0_OsTask_BSW_1ms, RteBswEventRef=EV_SE_MainFunction
      CanNm: RteBswImplementationRef=CanNm
        EV_SE_MainFunction (RteBswEventToTaskMapping): RteBswPositionInTask=2, RteBswActivationOffset=0.0, RteBswMappedToTaskRef=Core0_OsTask_BSW_1ms, RteBswEventRef=EV_SE_MainFunction
      CanNm: RteBswImplementationRef=CanNm
        EV_SE_MainFunction (RteBswEventToTaskMapping): RteBswPositionInTask=2, RteBswActivationOffset=0.0, RteBswMappedToTaskRef=Core0_OsTask_BSW_1ms, RteBswEventRef=EV_SE_MainFunction
