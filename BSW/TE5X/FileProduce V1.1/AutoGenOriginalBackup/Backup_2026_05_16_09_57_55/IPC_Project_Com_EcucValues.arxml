AUTOSAR XML (schema 00047)
package /ETAS_Project/EcucModuleConfigurationValuess
  module config Com: implementation-config-variant=VARIANT-PRE-COMPILE
    ComConfig
      ComTimeBase: ComTxTimeBase=0.001, ComRxTimeBase=0.001, ComGwTimeBase=0.001
      Com_IPdu_CanNodeNum_01_Rx_01 (ComIPdu):
        ComIPduDirection = RECEIVE
        ComIPduSignalProcessing = IMMEDIATE
        ComIPduType = NORMAL
        ComIpduNotificationCallback = Bsw_ComIPduAck_CanNodeNum_01_Rx_01
        ComTimeout = 0.25
        ComFirstTimeout = 2.0
        ComIPduSignalRef = Com_Signal_CanNodeNum_01_Rx_01
        ComIPduGroupRef = ComIPduGroup_CanNodeNum_01_Rx
        ComPduIdRef = CanPdu_PduR2Com_CanNodeNum_01_Rx_01
      Com_Signal_CanNodeNum_01_Rx_01 (ComSignal):
        ComRxDataTimeoutAction = NONE
        ComSignalType = UINT8_N
        ComSignalEndianness = opaque
        ComTransferProperty = PENDING
        ComBitPosition = 0
        ComSignalInitValue = 0
        ComTimeoutNotification = Bsw_ComSignalTimeout_CanNodeNum_01_Rx_01
        ComSignalLength = 8
      Com_IPdu_CanNodeNum_01_Rx_02 (ComIPdu):
        ComIPduDirection = RECEIVE
        ComIPduSignalProcessing = IMMEDIATE
        ComIPduType = NORMAL
        ComTimeout = 3.0
        ComIpduNotificationCallback = Bsw_ComIPduAck_CanNodeNum_01_Rx_02
        ComFirstTimeout = 2.0
        ComIPduSignalRef = Com_Signal_CanNodeNum_01_Rx_02
        ComIPduGroupRef = ComIPduGroup_CanNodeNum_01_Rx
        ComPduIdRef = CanPdu_PduR2Com_CanNodeNum_01_Rx_02
      Com_Signal_CanNodeNum_01_Rx_02 (ComSignal):
        ComRxDataTimeoutAction = NONE
        ComSignalType = UINT8_N
        ComSignalEndianness = opaque
        ComTransferProperty = PENDING
        ComBitPosition = 0
        ComSignalInitValue = 0
        ComTimeoutNotification = Bsw_ComSignalTimeout_CanNodeNum_01_Rx_02
        ComSignalLength = 8
      Com_IPdu_CanNodeNum_01_Rx_03 (ComIPdu):
        ComIPduDirection = RECEIVE
        ComIPduSignalProcessing = IMMEDIATE
        ComIPduType = NORMAL
        ComIpduNotificationCallback = Bsw_ComIPduAck_CanNodeNum_01_Rx_03
        ComTimeout = 0.5
        ComFirstTimeout = 2.0
        ComIPduSignalRef = Com_Signal_CanNodeNum_01_Rx_03
        ComIPduGroupRef = ComIPduGroup_CanNodeNum_01_Rx
        ComPduIdRef = CanPdu_PduR2Com_CanNodeNum_01_Rx_03
      Com_Signal_CanNodeNum_01_Rx_03 (ComSignal):
        ComRxDataTimeoutAction = NONE
        ComSignalType = UINT8_N
        ComSignalEndianness = opaque
        ComTransferProperty = PENDING
        ComBitPosition = 0
        ComSignalInitValue = 0
        ComTimeoutNotification = Bsw_ComSignalTimeout_CanNodeNum_01_Rx_03
        ComSignalLength = 8
      Com_IPdu_CanNodeNum_01_Rx_04 (ComIPdu):
        ComIPduDirection = RECEIVE
        ComIPduSignalProcessing = IMMEDIATE
        ComIPduType = NORMAL
        ComIpduNotificationCallback = Bsw_ComIPduAck_CanNodeNum_01_Rx_04
        ComTimeout = 0.25
        ComFirstTimeout = 2.0
        ComIPduSignalRef = Com_Signal_CanNodeNum_01_Rx_04
        ComIPduGroupRef = ComIPduGroup_CanNodeNum_01_Rx
        ComPduIdRef = CanPdu_PduR2Com_CanNodeNum_01_Rx_04
      Com_Signal_CanNodeNum_01_Rx_04 (ComSignal):
        ComRxDataTimeoutAction = NONE
        ComSignalType = UINT8_N
        ComSignalEndianness = opaque
        ComTransferProperty = PENDING
        ComBitPosition = 0
        ComSignalInitValue = 0
        ComTimeoutNotification = Bsw_ComSignalTimeout_CanNodeNum_01_Rx_04
        ComSignalLength = 8
      Com_IPdu_CanNodeNum_01_Rx_05 (ComIPdu):
        ComIPduDirection = RECEIVE
        ComIPduSignalProcessing = IMMEDIATE
        ComIPduType = NORMAL
        ComIpduNotificationCallback = Bsw_ComIPduAck_CanNodeNum_01_Rx_05
        ComTimeout = 0.25
        ComFirstTimeout = 2.0
        ComIPduCallout = Bsw_IPduCallout_CanNodeNum_01_Rx_05
        ComIPduSignalRef = Com_Signal_CanNodeNum_01_Rx_05
        ComIPduGroupRef = ComIPduGroup_CanNodeNum_01_Rx
        ComPduIdRef = CanPdu_PduR2Com_CanNodeNum_01_Rx_05
      Com_Signal_CanNodeNum_01_Rx_05 (ComSignal):
        ComRxDataTimeoutAction = NONE
        ComSignalType = UINT8_N
        ComSignalEndianness = opaque
        ComTransferProperty = PENDING
        ComBitPosition = 0
        ComSignalInitValue = 0
        ComTimeoutNotification = Bsw_ComSignalTimeout_CanNodeNum_01_Rx_05
        ComSignalLength = 8
      Com_IPdu_CanNodeNum_01_Rx_06 (ComIPdu):
        ComIPduDirection = RECEIVE
        ComIPduSignalProcessing = IMMEDIATE
        ComIPduType = NORMAL
        ComIpduNotificationCallback = Bsw_ComIPduAck_CanNodeNum_01_Rx_06
        ComTimeout = 0.15
        ComFirstTimeout = 2.0
        ComIPduCallout = Bsw_IPduCallout_CanNodeNum_01_Rx_06
        ComIPduSignalRef = Com_Signal_CanNodeNum_01_Rx_06
        ComIPduGroupRef = ComIPduGroup_CanNodeNum_01_Rx
        ComPduIdRef = CanPdu_PduR2Com_CanNodeNum_01_Rx_06
      Com_Signal_CanNodeNum_01_Rx_06 (ComSignal):
        ComRxDataTimeoutAction = NONE
        ComSignalType = UINT8_N
        ComSignalEndianness = opaque
        ComTransferProperty = PENDING
        ComBitPosition = 0
        ComSignalInitValue = 0
        ComTimeoutNotification = Bsw_ComSignalTimeout_CanNodeNum_01_Rx_06
        ComSignalLength = 8
      Com_IPdu_CanNodeNum_01_Rx_07 (ComIPdu):
        ComIPduDirection = RECEIVE
        ComIPduSignalProcessing = IMMEDIATE
        ComIPduType = NORMAL
        ComIpduNotificationCallback = Bsw_ComIPduAck_CanNodeNum_01_Rx_07
        ComTimeout = 0.5
        ComFirstTimeout = 2.0
        ComIPduSignalRef = Com_Signal_CanNodeNum_01_Rx_07
        ComIPduGroupRef = ComIPduGroup_CanNodeNum_01_Rx
        ComPduIdRef = CanPdu_PduR2Com_CanNodeNum_01_Rx_07
      Com_Signal_CanNodeNum_01_Rx_07 (ComSignal):
        ComRxDataTimeoutAction = NONE
        ComSignalType = UINT8_N
        ComSignalEndianness = opaque
        ComTransferProperty = PENDING
        ComBitPosition = 0
        ComSignalInitValue = 0
        ComTimeoutNotification = Bsw_ComSignalTimeout_CanNodeNum_01_Rx_07
        ComSignalLength = 8
      Com_IPdu_CanNodeNum_01_Rx_08 (ComIPdu):
        ComIPduDirection = RECEIVE
        ComIPduSignalProcessing = IMMEDIATE
        ComIPduType = NORMAL
        ComIpduNotificationCallback = Bsw_ComIPduAck_CanNodeNum_01_Rx_08
        ComTimeout = 0.25
        ComFirstTimeout = 2.0
        ComIPduCallout = Bsw_IPduCallout_CanNodeNum_01_Rx_08
        ComIPduSignalRef = Com_Signal_CanNodeNum_01_Rx_08
        ComIPduGroupRef = ComIPduGroup_CanNodeNum_01_Rx
        ComPduIdRef = CanPdu_PduR2Com_CanNodeNum_01_Rx_08
      Com_Signal_CanNodeNum_01_Rx_08 (ComSignal):
        ComRxDataTimeoutAction = NONE
        ComSignalType = UINT8_N
        ComSignalEndianness = opaque
        ComTransferProperty = PENDING
        ComBitPosition = 0
        ComSignalInitValue = 0
        ComTimeoutNotification = Bsw_ComSignalTimeout_CanNodeNum_01_Rx_08
        ComSignalLength = 8
      Com_IPdu_CanNodeNum_01_Rx_09 (ComIPdu):
        ComIPduDirection = RECEIVE
        ComIPduSignalProcessing = IMMEDIATE
        ComIPduType = NORMAL
        ComIpduNotificationCallback = Bsw_ComIPduAck_CanNodeNum_01_Rx_09
        ComTimeout = 0.5
        ComFirstTimeout = 2.0
        ComIPduSignalRef = Com_Signal_CanNodeNum_01_Rx_09
        ComIPduGroupRef = ComIPduGroup_CanNodeNum_01_Rx
        ComPduIdRef = CanPdu_PduR2Com_CanNodeNum_01_Rx_09
      Com_Signal_CanNodeNum_01_Rx_09 (ComSignal):
        ComRxDataTimeoutAction = NONE
        ComSignalType = UINT8_N
        ComSignalEndianness = opaque
        ComTransferProperty = PENDING
        ComBitPosition = 0
        ComSignalInitValue = 0
        ComTimeoutNotification = Bsw_ComSignalTimeout_CanNodeNum_01_Rx_09
        ComSignalLength = 8
      Com_IPdu_CanNodeNum_01_Rx_10 (ComIPdu):
        ComIPduDirection = RECEIVE
        ComIPduSignalProcessing = IMMEDIATE
        ComIPduType = NORMAL
        ComIpduNotificationCallback = Bsw_ComIPduAck_CanNodeNum_01_Rx_10
        ComTimeout = 0.25
        ComFirstTimeout = 2.0
        ComIPduSignalRef = Com_Signal_CanNodeNum_01_Rx_10
        ComIPduGroupRef = ComIPduGroup_CanNodeNum_01_Rx
        ComPduIdRef = CanPdu_PduR2Com_CanNodeNum_01_Rx_10
      Com_Signal_CanNodeNum_01_Rx_10 (ComSignal):
        ComRxDataTimeoutAction = NONE
        ComSignalType = UINT8_N
        ComSignalEndianness = opaque
        ComTransferProperty = PENDING
        ComBitPosition = 0
        ComSignalInitValue = 0
        ComTimeoutNotification = Bsw_ComSignalTimeout_CanNodeNum_01_Rx_10
        ComSignalLength = 8
      Com_IPdu_CanNodeNum_01_Rx_11 (ComIPdu):
        ComIPduDirection = RECEIVE
        ComIPduSignalProcessing = IMMEDIATE
        ComIPduType = NORMAL
        ComTimeout = 0.25
        ComFirstTimeout = 2.0
        ComIpduNotificationCallback = Bsw_ComIPduAck_CanNodeNum_01_Rx_11
        ComIPduSignalRef = Com_Signal_CanNodeNum_01_Rx_11
        ComIPduGroupRef = ComIPduGroup_CanNodeNum_01_Rx
        ComPduIdRef = CanPdu_PduR2Com_CanNodeNum_01_Rx_11
      Com_Signal_CanNodeNum_01_Rx_11 (ComSignal):
        ComRxDataTimeoutAction = NONE
        ComSignalType = UINT8_N
        ComSignalEndianness = opaque
        ComTransferProperty = PENDING
        ComBitPosition = 0
        ComSignalInitValue = 0
        ComSignalLength = 8
        ComTimeoutNotification = Bsw_ComSignalTimeout_CanNodeNum_01_Rx_11
      Com_IPdu_CanNodeNum_01_Rx_12 (ComIPdu):
        ComIPduDirection = RECEIVE
        ComIPduSignalProcessing = IMMEDIATE
        ComIPduType = NORMAL
        ComFirstTimeout = 2.0
        ComTimeout = 0.25
        ComIPduSignalRef = Com_Signal_CanNodeNum_01_Rx_12
        ComIPduGroupRef = ComIPduGroup_CanNodeNum_01_Rx
        ComPduIdRef = CanPdu_PduR2Com_CanNodeNum_01_Rx_12
      Com_Signal_CanNodeNum_01_Rx_12 (ComSignal):
        ComSignalType = UINT8_N
        ComSignalEndianness = opaque
        ComTransferProperty = PENDING
        ComBitPosition = 0
        ComSignalInitValue = 0
        ComRxDataTimeoutAction = NONE
        ComSignalLength = 8
      Com_IPdu_CanNodeNum_01_Rx_13 (ComIPdu):
        ComIPduDirection = RECEIVE
        ComIPduSignalProcessing = IMMEDIATE
        ComIPduType = NORMAL
        ComTimeout = 0.25
        ComFirstTimeout = 2.0
        ComIPduSignalRef = Com_Signal_CanNodeNum_01_Rx_13
        ComIPduGroupRef = ComIPduGroup_CanNodeNum_01_Rx
        ComPduIdRef = CanPdu_PduR2Com_CanNodeNum_01_Rx_13
      Com_Signal_CanNodeNum_01_Rx_13 (ComSignal):
        ComRxDataTimeoutAction = NONE
        ComSignalType = UINT8_N
        ComSignalEndianness = opaque
        ComTransferProperty = PENDING
        ComBitPosition = 0
        ComSignalInitValue = 0
        ComSignalLength = 8
      Com_IPdu_CanNodeNum_01_Rx_14 (ComIPdu):
        ComIPduDirection = RECEIVE
        ComIPduSignalProcessing = IMMEDIATE
        ComIPduType = NORMAL
        ComTimeout = 0.25
        ComFirstTimeout = 2.0
        ComIPduSignalRef = Com_Signal_CanNodeNum_01_Rx_14
        ComIPduGroupRef = ComIPduGroup_CanNodeNum_01_Rx
        ComPduIdRef = CanPdu_PduR2Com_CanNodeNum_01_Rx_14
      Com_Signal_CanNodeNum_01_Rx_14 (ComSignal):
        ComRxDataTimeoutAction = NONE
        ComSignalType = UINT8_N
        ComSignalEndianness = opaque
        ComTransferProperty = PENDING
        ComBitPosition = 0
        ComSignalInitValue = 0
        ComSignalLength = 8
      Com_IPdu_CanNodeNum_01_Rx_15 (ComIPdu):
        ComIPduDirection = RECEIVE
        ComIPduSignalProcessing = IMMEDIATE
        ComIPduType = NORMAL
        ComTimeout = 0.25
        ComFirstTimeout = 2.0
        ComIPduSignalRef = Com_Signal_CanNodeNum_01_Rx_15
        ComIPduGroupRef = ComIPduGroup_CanNodeNum_01_Rx
        ComPduIdRef = CanPdu_PduR2Com_CanNodeNum_01_Rx_15
      Com_Signal_CanNodeNum_01_Rx_15 (ComSignal):
        ComRxDataTimeoutAction = NONE
        ComSignalType = UINT8_N
        ComSignalEndianness = opaque
        ComTransferProperty = PENDING
        ComBitPosition = 0
        ComSignalInitValue = 0
        ComSignalLength = 8
      Com_IPdu_CanNodeNum_01_Rx_16 (ComIPdu):
        ComIPduDirection = RECEIVE
        ComIPduSignalProcessing = IMMEDIATE
        ComIPduType = NORMAL
        ComFirstTimeout = 2.0
        ComTimeout = 0.25
        ComIPduSignalRef = Com_Signal_CanNodeNum_01_Rx_16
        ComIPduGroupRef = ComIPduGroup_CanNodeNum_01_Rx
        ComPduIdRef = CanPdu_PduR2Com_CanNodeNum_01_Rx_16
      Com_Signal_CanNodeNum_01_Rx_16 (ComSignal):
        ComSignalType = UINT8_N
        ComSignalEndianness = opaque
        ComTransferProperty = PENDING
        ComBitPosition = 0
        ComSignalInitValue = 0
        ComRxDataTimeoutAction = NONE
        ComSignalLength = 8
      Com_IPdu_CanNodeNum_01_Rx_17 (ComIPdu):
        ComIPduDirection = RECEIVE
        ComIPduSignalProcessing = IMMEDIATE
        ComIPduType = NORMAL
        ComTimeout = 0.25
        ComFirstTimeout = 2.0
        ComIPduSignalRef = Com_Signal_CanNodeNum_01_Rx_17
        ComIPduGroupRef = ComIPduGroup_CanNodeNum_01_Rx
        ComPduIdRef = CanPdu_PduR2Com_CanNodeNum_01_Rx_17
      Com_Signal_CanNodeNum_01_Rx_17 (ComSignal):
        ComRxDataTimeoutAction = NONE
        ComSignalType = UINT8_N
        ComSignalEndianness = opaque
        ComTransferProperty = PENDING
        ComBitPosition = 0
        ComSignalInitValue = 0
        ComSignalLength = 8
      Com_IPdu_CanNodeNum_01_Rx_18 (ComIPdu):
        ComIPduDirection = RECEIVE
        ComIPduSignalProcessing = IMMEDIATE
        ComIPduType = NORMAL
        ComTimeout = 0.25
        ComFirstTimeout = 2.0
        ComIPduSignalRef = Com_Signal_CanNodeNum_01_Rx_18
        ComIPduGroupRef = ComIPduGroup_CanNodeNum_01_Rx
        ComPduIdRef = CanPdu_PduR2Com_CanNodeNum_01_Rx_18
      Com_Signal_CanNodeNum_01_Rx_18 (ComSignal):
        ComRxDataTimeoutAction = NONE
        ComSignalType = UINT8_N
        ComSignalEndianness = opaque
        ComTransferProperty = PENDING
        ComBitPosition = 0
        ComSignalInitValue = 0
        ComSignalLength = 8
      Com_IPdu_CanNodeNum_01_Rx_19 (ComIPdu):
        ComIPduDirection = RECEIVE
        ComIPduSignalProcessing = IMMEDIATE
        ComIPduType = NORMAL
        ComTimeout = 0.25
        ComFirstTimeout = 2.0
        ComIPduSignalRef = Com_Signal_CanNodeNum_01_Rx_19
        ComIPduGroupRef = ComIPduGroup_CanNodeNum_01_Rx
        ComPduIdRef = CanPdu_PduR2Com_CanNodeNum_01_Rx_19
      Com_Signal_CanNodeNum_01_Rx_19 (ComSignal):
        ComRxDataTimeoutAction = NONE
        ComSignalType = UINT8_N
        ComSignalEndianness = opaque
        ComTransferProperty = PENDING
        ComBitPosition = 0
        ComSignalInitValue = 0
        ComSignalLength = 8
      Com_IPdu_CanNodeNum_01_Rx_20 (ComIPdu):
        ComIPduDirection = RECEIVE
        ComIPduSignalProcessing = IMMEDIATE
        ComIPduType = NORMAL
        ComTimeout = 0.25
        ComFirstTimeout = 2.0
        ComIPduSignalRef = Com_Signal_CanNodeNum_01_Rx_20
        ComIPduGroupRef = ComIPduGroup_CanNodeNum_01_Rx
        ComPduIdRef = CanPdu_PduR2Com_CanNodeNum_01_Rx_20
      Com_Signal_CanNodeNum_01_Rx_20 (ComSignal):
        ComRxDataTimeoutAction = NONE
        ComSignalType = UINT8_N
        ComSignalEndianness = opaque
        ComTransferProperty = PENDING
        ComBitPosition = 0
        ComSignalInitValue = 0
        ComSignalLength = 8
      Com_IPdu_CanNodeNum_01_Rx_21 (ComIPdu):
        ComIPduDirection = RECEIVE
        ComIPduSignalProcessing = IMMEDIATE
        ComIPduType = NORMAL
        ComTimeout = 0.25
        ComFirstTimeout = 2.0
        ComIPduSignalRef = Com_Signal_CanNodeNum_01_Rx_21
        ComIPduGroupRef = ComIPduGroup_CanNodeNum_01_Rx
        ComPduIdRef = CanPdu_PduR2Com_CanNodeNum_01_Rx_21
      Com_Signal_CanNodeNum_01_Rx_21 (ComSignal):
        ComRxDataTimeoutAction = NONE
        ComSignalType = UINT8_N
        ComSignalEndianness = opaque
        ComTransferProperty = PENDING
        ComBitPosition = 0
        ComSignalInitValue = 0
        ComSignalLength = 8
      Com_IPdu_CanNodeNum_01_Rx_22 (ComIPdu):
        ComIPduDirection = RECEIVE
        ComIPduSignalProcessing = IMMEDIATE
        ComIPduType = NORMAL
        ComFirstTimeout = 2.0
        ComTimeout = 0.25
        ComIPduSignalRef = Com_Signal_CanNodeNum_01_Rx_22
        ComIPduGroupRef = ComIPduGroup_CanNodeNum_01_Rx
        ComPduIdRef = CanPdu_PduR2Com_CanNodeNum_01_Rx_22
      Com_Signal_CanNodeNum_01_Rx_22 (ComSignal):
        ComSignalType = UINT8_N
        ComSignalEndianness = opaque
        ComTransferProperty = PENDING
        ComBitPosition = 0
        ComSignalInitValue = 0
        ComRxDataTimeoutAction = NONE
        ComSignalLength = 8
      Com_IPdu_CanNodeNum_01_Rx_23 (ComIPdu):
        ComIPduDirection = RECEIVE
        ComIPduSignalProcessing = IMMEDIATE
        ComIPduType = NORMAL
        ComTimeout = 0.25
        ComFirstTimeout = 2.0
        ComIPduSignalRef = Com_Signal_CanNodeNum_01_Rx_23
        ComIPduGroupRef = ComIPduGroup_CanNodeNum_01_Rx
        ComPduIdRef = CanPdu_PduR2Com_CanNodeNum_01_Rx_23
      Com_Signal_CanNodeNum_01_Rx_23 (ComSignal):
        ComRxDataTimeoutAction = NONE
        ComSignalType = UINT8_N
        ComSignalEndianness = opaque
        ComTransferProperty = PENDING
        ComBitPosition = 0
        ComSignalInitValue = 0
        ComSignalLength = 8
      Com_IPdu_CanNodeNum_01_Rx_24 (ComIPdu):
        ComIPduDirection = RECEIVE
        ComIPduSignalProcessing = IMMEDIATE
        ComIPduType = NORMAL
        ComTimeout = 0.25
        ComFirstTimeout = 2.0
        ComIPduSignalRef = Com_Signal_CanNodeNum_01_Rx_24
        ComIPduGroupRef = ComIPduGroup_CanNodeNum_01_Rx
        ComPduIdRef = CanPdu_PduR2Com_CanNodeNum_01_Rx_24
      Com_Signal_CanNodeNum_01_Rx_24 (ComSignal):
        ComRxDataTimeoutAction = NONE
        ComSignalType = UINT8_N
        ComSignalEndianness = opaque
        ComTransferProperty = PENDING
        ComBitPosition = 0
        ComSignalInitValue = 0
        ComSignalLength = 8
      Com_IPdu_CanNodeNum_01_Rx_25 (ComIPdu):
        ComIPduDirection = RECEIVE
        ComIPduSignalProcessing = IMMEDIATE
        ComIPduType = NORMAL
        ComTimeout = 0.25
        ComFirstTimeout = 2.0
        ComIPduSignalRef = Com_Signal_CanNodeNum_01_Rx_25
        ComIPduGroupRef = ComIPduGroup_CanNodeNum_01_Rx
        ComPduIdRef = CanPdu_PduR2Com_CanNodeNum_01_Rx_25
      Com_Signal_CanNodeNum_01_Rx_25 (ComSignal):
        ComRxDataTimeoutAction = NONE
        ComSignalType = UINT8_N
        ComSignalEndianness = opaque
        ComTransferProperty = PENDING
        ComBitPosition = 0
        ComSignalInitValue = 0
        ComSignalLength = 8
      Com_IPdu_CanNodeNum_01_Rx_26 (ComIPdu):
        ComIPduDirection = RECEIVE
        ComIPduSignalProcessing = IMMEDIATE
        ComIPduType = NORMAL
        ComTimeout = 0.25
        ComFirstTimeout = 2.0
        ComIPduSignalRef = Com_Signal_CanNodeNum_01_Rx_26
        ComIPduGroupRef = ComIPduGroup_CanNodeNum_01_Rx
        ComPduIdRef = CanPdu_PduR2Com_CanNodeNum_01_Rx_26
      Com_Signal_CanNodeNum_01_Rx_26 (ComSignal):
        ComRxDataTimeoutAction = NONE
        ComSignalType = UINT8_N
        ComSignalEndianness = opaque
        ComTransferProperty = PENDING
        ComBitPosition = 0
        ComSignalInitValue = 0
        ComSignalLength = 8
      35 x ComIPdu, all with ComIPduSignalProcessing=IMMEDIATE, ComIPduType=NORMAL:
        Com_IPdu_CanNodeNum_01_Rx_27: ComFirstTimeout=2.0, ComIPduDirection=RECEIVE, ComTimeout=0.25, ComPduIdRef=CanPdu_PduR2Com_CanNodeNum_01_Rx_27, ComIPduGroupRef=ComIPduGroup_CanNodeNum_01_Rx, ComIPduSignalRef=Com_Signal_CanNodeNum_01_Rx_27
        Com_IPdu_CanNodeNum_01_Rx_28: ComFirstTimeout=2.0, ComIPduDirection=RECEIVE, ComTimeout=0.25, ComPduIdRef=CanPdu_PduR2Com_CanNodeNum_01_Rx_28, ComIPduGroupRef=ComIPduGroup_CanNodeNum_01_Rx, ComIPduSignalRef=Com_Signal_CanNodeNum_01_Rx_28
        Com_IPdu_CanNodeNum_01_Rx_{29..40}: ComIPduDirection=RECEIVE, ComTimeout=0.25, ComFirstTimeout=2.0, ComIPduGroupRef=ComIPduGroup_CanNodeNum_01_Rx, ComPduIdRef=CanPdu_PduR2Com_CanNodeNum_01_Rx_{29..40}, ComIPduSignalRef=Com_Signal_CanNodeNum_01_Rx_{29..40}
        Com_IPdu_CanNodeNum_01_TxBasic_01: ComIPduDirection=SEND, ComIPduGroupRef=ComIPduGroup_CanNodeNum_01_Tx, ComPduIdRef=CanPdu_Com2PduR_CanNodeNum_01_TxBasic_01, ComIPduSignalRef=Com_Signal_CanNodeNum_01_TxBasic_01
          ComTxIPdu: ComTxIPduUnusedAreasDefault=0
            ComTxModeTrue
              ComTxMode: ComTxModeNumberOfRepetitions=0, ComTxModeMode=DIRECT, ComTxModeTimeOffset=0.0, ComTxModeTimePeriod=0.1, ComTxModeRepetitionPeriod=0
            ComTxModeFalse
              ComTxMode: ComTxModeNumberOfRepetitions=0, ComTxModeMode=DIRECT, ComTxModeTimeOffset=0.0, ComTxModeTimePeriod=0.1, ComTxModeRepetitionPeriod=0
        Com_IPdu_CanNodeNum_01_TxBasic_02: ComIPduDirection=SEND, ComIPduGroupRef=ComIPduGroup_CanNodeNum_01_Tx, ComPduIdRef=CanPdu_Com2PduR_CanNodeNum_01_TxBasic_02, ComIPduSignalRef=Com_Signal_CanNodeNum_01_TxBasic_02
          ComTxIPdu: ComTxIPduUnusedAreasDefault=0
            ComTxModeTrue
              ComTxMode: ComTxModeNumberOfRepetitions=0, ComTxModeMode=DIRECT, ComTxModeTimeOffset=0.0, ComTxModeTimePeriod=0.1, ComTxModeRepetitionPeriod=0.0
            ComTxModeFalse
              ComTxMode: ComTxModeNumberOfRepetitions=0, ComTxModeMode=DIRECT, ComTxModeTimeOffset=0.0, ComTxModeTimePeriod=0.1, ComTxModeRepetitionPeriod=0
        Com_IPdu_CanNodeNum_01_TxBasic_03: ComIPduDirection=SEND, ComIPduGroupRef=ComIPduGroup_CanNodeNum_01_Tx, ComPduIdRef=CanPdu_Com2PduR_CanNodeNum_01_TxBasic_03, ComIPduSignalRef=Com_Signal_CanNodeNum_01_TxBasic_03
          ComTxIPdu: ComTxIPduUnusedAreasDefault=0
            ComTxModeTrue
              ComTxMode: ComTxModeNumberOfRepetitions=0, ComTxModeMode=DIRECT, ComTxModeTimeOffset=0.0, ComTxModeTimePeriod=0.1, ComTxModeRepetitionPeriod=0.0
            ComTxModeFalse
              ComTxMode: ComTxModeNumberOfRepetitions=0, ComTxModeMode=DIRECT, ComTxModeTimeOffset=0.0, ComTxModeTimePeriod=0.1, ComTxModeRepetitionPeriod=0
        Com_IPdu_CanNodeNum_01_TxBasic_04: ComIPduDirection=SEND, ComIPduGroupRef=ComIPduGroup_CanNodeNum_01_Tx, ComPduIdRef=CanPdu_Com2PduR_CanNodeNum_01_TxBasic_04, ComIPduSignalRef=Com_Signal_CanNodeNum_01_TxBasic_04
          ComTxIPdu: ComTxIPduUnusedAreasDefault=0
            ComTxModeTrue
              ComTxMode: ComTxModeNumberOfRepetitions=0, ComTxModeMode=DIRECT, ComTxModeTimeOffset=0.0, ComTxModeTimePeriod=0.1, ComTxModeRepetitionPeriod=0
            ComTxModeFalse
              ComTxMode: ComTxModeNumberOfRepetitions=0, ComTxModeMode=DIRECT, ComTxModeTimeOffset=0.0, ComTxModeTimePeriod=0.1, ComTxModeRepetitionPeriod=0.0
        Com_IPdu_CanNodeNum_01_TxBasic_05: ComIPduDirection=SEND, ComIPduGroupRef=ComIPduGroup_CanNodeNum_01_Tx, ComPduIdRef=CanPdu_Com2PduR_CanNodeNum_01_TxBasic_05, ComIPduSignalRef=Com_Signal_CanNodeNum_01_TxBasic_05
          ComTxIPdu: ComTxIPduUnusedAreasDefault=0
            ComTxModeTrue
              ComTxMode: ComTxModeNumberOfRepetitions=0, ComTxModeMode=DIRECT, ComTxModeTimeOffset=0.0, ComTxModeTimePeriod=0.1, ComTxModeRepetitionPeriod=0
            ComTxModeFalse
              ComTxMode: ComTxModeNumberOfRepetitions=0, ComTxModeMode=DIRECT, ComTxModeTimeOffset=0.0, ComTxModeTimePeriod=0.1, ComTxModeRepetitionPeriod=0.0
        Com_IPdu_CanNodeNum_01_TxBasic_06: ComIPduDirection=SEND, ComIPduGroupRef=ComIPduGroup_CanNodeNum_01_Tx, ComPduIdRef=CanPdu_Com2PduR_CanNodeNum_01_TxBasic_06, ComIPduSignalRef=Com_Signal_CanNodeNum_01_TxBasic_06
          ComTxIPdu: ComTxIPduUnusedAreasDefault=0
            ComTxModeTrue
              ComTxMode: ComTxModeNumberOfRepetitions=0, ComTxModeMode=DIRECT, ComTxModeTimeOffset=0.0, ComTxModeTimePeriod=0.1, ComTxModeRepetitionPeriod=0
            ComTxModeFalse
              ComTxMode: ComTxModeNumberOfRepetitions=0, ComTxModeMode=DIRECT, ComTxModeTimeOffset=0.0, ComTxModeTimePeriod=0.1, ComTxModeRepetitionPeriod=0
        Com_IPdu_CanNodeNum_01_TxBasic_07: ComIPduDirection=SEND, ComIPduGroupRef=ComIPduGroup_CanNodeNum_01_Tx, ComPduIdRef=CanPdu_Com2PduR_CanNodeNum_01_TxBasic_07, ComIPduSignalRef=Com_Signal_CanNodeNum_01_TxBasic_07
          ComTxIPdu: ComTxIPduUnusedAreasDefault=0
            ComTxModeTrue
              ComTxMode: ComTxModeNumberOfRepetitions=0, ComTxModeMode=DIRECT, ComTxModeTimeOffset=0.0, ComTxModeTimePeriod=0.1, ComTxModeRepetitionPeriod=0
            ComTxModeFalse
              ComTxMode: ComTxModeNumberOfRepetitions=0, ComTxModeMode=DIRECT, ComTxModeTimeOffset=0.0, ComTxModeTimePeriod=0.1, ComTxModeRepetitionPeriod=0.0
        Com_IPdu_CanNodeNum_01_TxBasic_08: ComIPduDirection=SEND, ComIPduGroupRef=ComIPduGroup_CanNodeNum_01_Tx, ComPduIdRef=CanPdu_Com2PduR_CanNodeNum_01_TxBasic_08, ComIPduSignalRef=Com_Signal_CanNodeNum_01_TxBasic_08
          ComTxIPdu: ComTxIPduUnusedAreasDefault=0
            ComTxModeTrue
              ComTxMode: ComTxModeNumberOfRepetitions=0, ComTxModeMode=DIRECT, ComTxModeTimeOffset=0.0, ComTxModeTimePeriod=0.1, ComTxModeRepetitionPeriod=0
            ComTxModeFalse
              ComTxMode: ComTxModeNumberOfRepetitions=0, ComTxModeMode=DIRECT, ComTxModeTimeOffset=0.0, ComTxModeTimePeriod=0.1, ComTxModeRepetitionPeriod=0
        Com_IPdu_CanNodeNum_01_TxBasic_09: ComIPduDirection=SEND, ComIPduGroupRef=ComIPduGroup_CanNodeNum_01_Tx, ComPduIdRef=CanPdu_Com2PduR_CanNodeNum_01_TxBasic_09, ComIPduSignalRef=Com_Signal_CanNodeNum_01_TxBasic_09
          ComTxIPdu: ComTxIPduUnusedAreasDefault=0
            ComTxModeTrue
              ComTxMode: ComTxModeNumberOfRepetitions=0, ComTxModeMode=DIRECT, ComTxModeTimeOffset=0.0, ComTxModeTimePeriod=0.1, ComTxModeRepetitionPeriod=0
            ComTxModeFalse
              ComTxMode: ComTxModeNumberOfRepetitions=0, ComTxModeMode=DIRECT, ComTxModeTimeOffset=0.0, ComTxModeTimePeriod=0.1, ComTxModeRepetitionPeriod=0
        Com_IPdu_CanNodeNum_01_TxBasic_10: ComIPduDirection=SEND, ComIPduGroupRef=ComIPduGroup_CanNodeNum_01_Tx, ComPduIdRef=CanPdu_Com2PduR_CanNodeNum_01_TxBasic_10, ComIPduSignalRef=Com_Signal_CanNodeNum_01_TxBasic_10
          ComTxIPdu: ComTxIPduUnusedAreasDefault=0
            ComTxModeTrue
              ComTxMode: ComTxModeNumberOfRepetitions=0, ComTxModeMode=DIRECT, ComTxModeTimeOffset=0.0, ComTxModeTimePeriod=0.1, ComTxModeRepetitionPeriod=0
            ComTxModeFalse
              ComTxMode: ComTxModeNumberOfRepetitions=0, ComTxModeMode=DIRECT, ComTxModeTimeOffset=0.0, ComTxModeTimePeriod=0.1, ComTxModeRepetitionPeriod=0
        Com_IPdu_CanNodeNum_01_TxBasic_11: ComIPduDirection=SEND, ComIPduGroupRef=ComIPduGroup_CanNodeNum_01_Tx, ComPduIdRef=CanPdu_Com2PduR_CanNodeNum_01_TxBasic_11, ComIPduSignalRef=Com_Signal_CanNodeNum_01_TxBasic_11
          ComTxIPdu: ComTxIPduUnusedAreasDefault=0
            ComTxModeTrue
              ComTxMode: ComTxModeNumberOfRepetitions=0, ComTxModeMode=DIRECT, ComTxModeTimeOffset=0.0, ComTxModeTimePeriod=0.1, ComTxModeRepetitionPeriod=0
            ComTxModeFalse
              ComTxMode: ComTxModeNumberOfRepetitions=0, ComTxModeMode=DIRECT, ComTxModeTimeOffset=0.0, ComTxModeTimePeriod=0.1, ComTxModeRepetitionPeriod=0
        Com_IPdu_CanNodeNum_01_TxBasic_12: ComIPduDirection=SEND, ComIPduGroupRef=ComIPduGroup_CanNodeNum_01_Tx, ComPduIdRef=CanPdu_Com2PduR_CanNodeNum_01_TxBasic_12, ComIPduSignalRef=Com_Signal_CanNodeNum_01_TxBasic_12
          ComTxIPdu: ComTxIPduUnusedAreasDefault=0
            ComTxModeTrue
              ComTxMode: ComTxModeNumberOfRepetitions=0, ComTxModeMode=DIRECT, ComTxModeTimeOffset=0.0, ComTxModeTimePeriod=0.1, ComTxModeRepetitionPeriod=0.0
            ComTxModeFalse
              ComTxMode: ComTxModeNumberOfRepetitions=0, ComTxModeMode=DIRECT, ComTxModeTimeOffset=0.0, ComTxModeTimePeriod=0.1, ComTxModeRepetitionPeriod=0
        Com_IPdu_CanNodeNum_01_TxBasic_13: ComIPduDirection=SEND, ComIPduGroupRef=ComIPduGroup_CanNodeNum_01_Tx, ComPduIdRef=CanPdu_Com2PduR_CanNodeNum_01_TxBasic_13, ComIPduSignalRef=Com_Signal_CanNodeNum_01_TxBasic_13
          ComTxIPdu: ComTxIPduUnusedAreasDefault=0
            ComTxModeTrue
              ComTxMode: ComTxModeNumberOfRepetitions=0, ComTxModeMode=DIRECT, ComTxModeTimeOffset=0.0, ComTxModeTimePeriod=0.1, ComTxModeRepetitionPeriod=0.0
            ComTxModeFalse
              ComTxMode: ComTxModeNumberOfRepetitions=0, ComTxModeMode=DIRECT, ComTxModeTimeOffset=0.0, ComTxModeTimePeriod=0.1, ComTxModeRepetitionPeriod=0
        Com_IPdu_CanNodeNum_01_TxBasic_14: ComIPduDirection=SEND, ComIPduGroupRef=ComIPduGroup_CanNodeNum_01_Tx, ComPduIdRef=CanPdu_Com2PduR_CanNodeNum_01_TxBasic_14, ComIPduSignalRef=Com_Signal_CanNodeNum_01_TxBasic_14
          ComTxIPdu: ComTxIPduUnusedAreasDefault=0
            ComTxModeTrue
              ComTxMode: ComTxModeNumberOfRepetitions=0, ComTxModeMode=DIRECT, ComTxModeTimeOffset=0.0, ComTxModeTimePeriod=0.1, ComTxModeRepetitionPeriod=0
            ComTxModeFalse
              ComTxMode: ComTxModeNumberOfRepetitions=0, ComTxModeMode=DIRECT, ComTxModeTimeOffset=0.0, ComTxModeTimePeriod=0.1, ComTxModeRepetitionPeriod=0.0
        Com_IPdu_CanNodeNum_01_TxBasic_15: ComIPduDirection=SEND, ComIPduGroupRef=ComIPduGroup_CanNodeNum_01_Tx, ComPduIdRef=CanPdu_Com2PduR_CanNodeNum_01_TxBasic_15, ComIPduSignalRef=Com_Signal_CanNodeNum_01_TxBasic_15
          ComTxIPdu: ComTxIPduUnusedAreasDefault=0
            ComTxModeTrue
              ComTxMode: ComTxModeNumberOfRepetitions=0, ComTxModeMode=DIRECT, ComTxModeTimeOffset=0.0, ComTxModeTimePeriod=0.1, ComTxModeRepetitionPeriod=0
            ComTxModeFalse
              ComTxMode: ComTxModeNumberOfRepetitions=0, ComTxModeMode=DIRECT, ComTxModeTimeOffset=0.0, ComTxModeTimePeriod=0.1, ComTxModeRepetitionPeriod=0.0
        Com_IPdu_CanNodeNum_01_TxBasic_16: ComIPduDirection=SEND, ComIPduGroupRef=ComIPduGroup_CanNodeNum_01_Tx, ComPduIdRef=CanPdu_Com2PduR_CanNodeNum_01_TxBasic_16, ComIPduSignalRef=Com_Signal_CanNodeNum_01_TxBasic_16
          ComTxIPdu: ComTxIPduUnusedAreasDefault=0
            ComTxModeTrue
              ComTxMode: ComTxModeNumberOfRepetitions=0, ComTxModeMode=DIRECT, ComTxModeTimeOffset=0.0, ComTxModeTimePeriod=0.1, ComTxModeRepetitionPeriod=0
            ComTxModeFalse
              ComTxMode: ComTxModeNumberOfRepetitions=0, ComTxModeMode=DIRECT, ComTxModeTimeOffset=0.0, ComTxModeTimePeriod=0.1, ComTxModeRepetitionPeriod=0
        Com_IPdu_CanNodeNum_01_TxBasic_17: ComIPduDirection=SEND, ComIPduGroupRef=ComIPduGroup_CanNodeNum_01_Tx, ComPduIdRef=CanPdu_Com2PduR_CanNodeNum_01_TxBasic_17, ComIPduSignalRef=Com_Signal_CanNodeNum_01_TxBasic_17
          ComTxIPdu: ComTxIPduUnusedAreasDefault=0
            ComTxModeTrue
              ComTxMode: ComTxModeNumberOfRepetitions=0, ComTxModeMode=DIRECT, ComTxModeTimeOffset=0.0, ComTxModeTimePeriod=0.1, ComTxModeRepetitionPeriod=0
            ComTxModeFalse
              ComTxMode: ComTxModeNumberOfRepetitions=0, ComTxModeMode=DIRECT, ComTxModeTimeOffset=0.0, ComTxModeTimePeriod=0.1, ComTxModeRepetitionPeriod=0.0
        Com_IPdu_CanNodeNum_01_TxBasic_18: ComIPduDirection=SEND, ComIPduGroupRef=ComIPduGroup_CanNodeNum_01_Tx, ComPduIdRef=CanPdu_Com2PduR_CanNodeNum_01_TxBasic_18, ComIPduSignalRef=Com_Signal_CanNodeNum_01_TxBasic_18
          ComTxIPdu: ComTxIPduUnusedAreasDefault=0
            ComTxModeTrue
              ComTxMode: ComTxModeNumberOfRepetitions=0, ComTxModeMode=DIRECT, ComTxModeTimeOffset=0.0, ComTxModeTimePeriod=0.1, ComTxModeRepetitionPeriod=0
            ComTxModeFalse
              ComTxMode: ComTxModeNumberOfRepetitions=0, ComTxModeMode=DIRECT, ComTxModeTimeOffset=0.0, ComTxModeTimePeriod=0.1, ComTxModeRepetitionPeriod=0
        Com_IPdu_CanNodeNum_01_TxBasic_19: ComIPduDirection=SEND, ComIPduGroupRef=ComIPduGroup_CanNodeNum_01_Tx, ComPduIdRef=CanPdu_Com2PduR_CanNodeNum_01_TxBasic_19, ComIPduSignalRef=Com_Signal_CanNodeNum_01_TxBasic_19
          ComTxIPdu: ComTxIPduUnusedAreasDefault=0
            ComTxModeTrue
              ComTxMode: ComTxModeNumberOfRepetitions=0, ComTxModeMode=DIRECT, ComTxModeTimeOffset=0.0, ComTxModeTimePeriod=0.1, ComTxModeRepetitionPeriod=0
            ComTxModeFalse
              ComTxMode: ComTxModeNumberOfRepetitions=0, ComTxModeMode=DIRECT, ComTxModeTimeOffset=0.0, ComTxModeTimePeriod=0.1, ComTxModeRepetitionPeriod=0
        Com_IPdu_CanNodeNum_01_TxBasic_20: ComIPduDirection=SEND, ComIPduGroupRef=ComIPduGroup_CanNodeNum_01_Tx, ComPduIdRef=CanPdu_Com2PduR_CanNodeNum_01_TxBasic_20, ComIPduSignalRef=Com_Signal_CanNodeNum_01_TxBasic_20
          ComTxIPdu: ComTxIPduUnusedAreasDefault=0
            ComTxModeTrue
              ComTxMode: ComTxModeNumberOfRepetitions=0, ComTxModeMode=DIRECT, ComTxModeTimeOffset=0.0, ComTxModeTimePeriod=0.1, ComTxModeRepetitionPeriod=0
            ComTxModeFalse
              ComTxMode: ComTxModeNumberOfRepetitions=0, ComTxModeMode=DIRECT, ComTxModeTimeOffset=0.0, ComTxModeTimePeriod=0.1, ComTxModeRepetitionPeriod=0
        Com_IPdu_CanNodeNum_01_Tx_01: ComIPduDirection=SEND, ComIPduSignalRef=Com_Signal_CanNodeNum_01_Tx_01, ComIPduGroupRef=ComIPduGroup_CanNodeNum_01_Tx, ComPduIdRef=CanPdu_Com2PduR_CanNodeNum_01_Tx_01
          ComTxIPdu: ComTxIPduUnusedAreasDefault=0
            ComTxModeTrue
              ComTxMode: ComTxModeNumberOfRepetitions=0, ComTxModeMode=DIRECT, ComTxModeTimeOffset=0.0, ComTxModeTimePeriod=0.1, ComTxModeRepetitionPeriod=0
            ComTxModeFalse
              ComTxMode: ComTxModeNumberOfRepetitions=0, ComTxModeMode=DIRECT, ComTxModeTimeOffset=0.0, ComTxModeTimePeriod=0.1, ComTxModeRepetitionPeriod=0
      35 x ComSignal, all with ComSignalInitValue=0, ComBitPosition=0, ComSignalEndianness=opaque, ComSignalType=UINT8_N, ComSignalLength=8:
        Com_Signal_CanNodeNum_01_Rx_27: ComTransferProperty=PENDING, ComRxDataTimeoutAction=NONE
        Com_Signal_CanNodeNum_01_Rx_28: ComTransferProperty=PENDING, ComRxDataTimeoutAction=NONE
        Com_Signal_CanNodeNum_01_Rx_{29..39}: ComRxDataTimeoutAction=NONE, ComTransferProperty=PENDING
        Com_Signal_CanNodeNum_01_Rx_40: ComTransferProperty=PENDING, ComRxDataTimeoutAction=NONE
        Com_Signal_CanNodeNum_01_TxBasic_{01..20}: ComTransferProperty=TRIGGERED, ComInitialValueOnly=false
        Com_Signal_CanNodeNum_01_Tx_01: ComTransferProperty=TRIGGERED, ComInitialValueOnly=false
      Com_IPdu_CanNodeNum_01_Tx_02 (ComIPdu):
        ComIPduDirection = SEND
        ComIPduSignalProcessing = IMMEDIATE
        ComIPduType = NORMAL
        ComIPduSignalRef = Com_Signal_CanNodeNum_01_Tx_02
        ComPduIdRef = CanPdu_Com2PduR_CanNodeNum_01_Tx_02
        ComIPduGroupRef = ComIPduGroup_CanNodeNum_01_Tx
        ComTxIPdu: ComTxIPduUnusedAreasDefault=0
          ComTxModeTrue
            ComTxMode: ComTxModeNumberOfRepetitions=0, ComTxModeMode=DIRECT, ComTxModeTimeOffset=0.0, ComTxModeRepetitionPeriod=0, ComTxModeTimePeriod=0.1
          ComTxModeFalse
            ComTxMode: ComTxModeNumberOfRepetitions=0, ComTxModeMode=DIRECT, ComTxModeTimeOffset=0.0, ComTxModeRepetitionPeriod=0, ComTxModeTimePeriod=0.1
      Com_Signal_CanNodeNum_01_Tx_02 (ComSignal):
        ComSignalType = UINT8_N
        ComSignalEndianness = opaque
        ComTransferProperty = TRIGGERED
        ComInitialValueOnly = false
        ComBitPosition = 0
        ComSignalInitValue = 0
        ComSignalLength = 8
      Com_IPdu_CanNodeNum_01_Tx_03 (ComIPdu):
        ComIPduDirection = SEND
        ComIPduSignalProcessing = IMMEDIATE
        ComIPduType = NORMAL
        ComIPduSignalRef = Com_Signal_CanNodeNum_01_Tx_03
        ComIPduGroupRef = ComIPduGroup_CanNodeNum_01_Tx
        ComPduIdRef = CanPdu_Com2PduR_CanNodeNum_01_Tx_03
        ComTxIPdu: ComTxIPduUnusedAreasDefault=0
          ComTxModeTrue
            ComTxMode: ComTxModeNumberOfRepetitions=0, ComTxModeMode=DIRECT, ComTxModeTimeOffset=0.0, ComTxModeTimePeriod=0.02, ComTxModeRepetitionPeriod=0
          ComTxModeFalse
            ComTxMode: ComTxModeNumberOfRepetitions=0, ComTxModeMode=DIRECT, ComTxModeTimeOffset=0.0, ComTxModeTimePeriod=0.02, ComTxModeRepetitionPeriod=0
      Com_Signal_CanNodeNum_01_Tx_03 (ComSignal):
        ComSignalType = UINT8_N
        ComSignalEndianness = opaque
        ComTransferProperty = TRIGGERED
        ComInitialValueOnly = false
        ComBitPosition = 0
        ComSignalInitValue = 0
        ComSignalLength = 8
      Com_IPdu_CanNodeNum_01_Tx_04 (ComIPdu):
        ComIPduDirection = SEND
        ComIPduSignalProcessing = IMMEDIATE
        ComIPduType = NORMAL
        ComIPduSignalRef = Com_Signal_CanNodeNum_01_Tx_04
        ComIPduGroupRef = ComIPduGroup_CanNodeNum_01_Tx
        ComPduIdRef = CanPdu_Com2PduR_CanNodeNum_01_Tx_04
        ComTxIPdu: ComTxIPduUnusedAreasDefault=0
          ComTxModeTrue
            ComTxMode: ComTxModeNumberOfRepetitions=0, ComTxModeMode=DIRECT, ComTxModeTimeOffset=0.0, ComTxModeTimePeriod=0.02, ComTxModeRepetitionPeriod=0
          ComTxModeFalse
            ComTxMode: ComTxModeNumberOfRepetitions=0, ComTxModeMode=DIRECT, ComTxModeTimeOffset=0.0, ComTxModeTimePeriod=0.02, ComTxModeRepetitionPeriod=0
      Com_Signal_CanNodeNum_01_Tx_04 (ComSignal):
        ComSignalType = UINT8_N
        ComSignalEndianness = opaque
        ComTransferProperty = TRIGGERED
        ComInitialValueOnly = false
        ComBitPosition = 0
        ComSignalInitValue = 0
        ComSignalLength = 8
      Com_IPdu_CanNodeNum_01_Tx_05 (ComIPdu):
        ComIPduDirection = SEND
        ComIPduSignalProcessing = IMMEDIATE
        ComIPduType = NORMAL
        ComIPduSignalRef = Com_Signal_CanNodeNum_01_Tx_05
        ComPduIdRef = CanPdu_Com2PduR_CanNodeNum_01_Tx_05
        ComIPduGroupRef = ComIPduGroup_CanNodeNum_01_Tx
        ComTxIPdu: ComTxIPduUnusedAreasDefault=0
          ComTxModeTrue
            ComTxMode: ComTxModeNumberOfRepetitions=0, ComTxModeMode=DIRECT, ComTxModeTimeOffset=0.0, ComTxModeTimePeriod=0.02, ComTxModeRepetitionPeriod=0
          ComTxModeFalse
            ComTxMode: ComTxModeNumberOfRepetitions=0, ComTxModeMode=DIRECT, ComTxModeTimeOffset=0.0, ComTxModeTimePeriod=0.02, ComTxModeRepetitionPeriod=0
      Com_Signal_CanNodeNum_01_Tx_05 (ComSignal):
        ComSignalType = UINT8_N
        ComSignalEndianness = opaque
        ComTransferProperty = TRIGGERED
        ComInitialValueOnly = false
        ComBitPosition = 0
        ComSignalInitValue = 0
        ComSignalLength = 8
      Com_IPdu_CanNodeNum_01_Tx_06 (ComIPdu):
        ComIPduDirection = SEND
        ComIPduSignalProcessing = IMMEDIATE
        ComIPduType = NORMAL
        ComIPduSignalRef = Com_Signal_CanNodeNum_01_Tx_06
        ComPduIdRef = CanPdu_Com2PduR_CanNodeNum_01_Tx_06
        ComIPduGroupRef = ComIPduGroup_CanNodeNum_01_Tx
        ComTxIPdu: ComTxIPduUnusedAreasDefault=0
          ComTxModeTrue
            ComTxMode: ComTxModeNumberOfRepetitions=0, ComTxModeMode=DIRECT, ComTxModeTimeOffset=0.0, ComTxModeTimePeriod=0.02, ComTxModeRepetitionPeriod=0
          ComTxModeFalse
            ComTxMode: ComTxModeNumberOfRepetitions=0, ComTxModeMode=DIRECT, ComTxModeTimeOffset=0.0, ComTxModeTimePeriod=0.02, ComTxModeRepetitionPeriod=0
      Com_Signal_CanNodeNum_01_Tx_06 (ComSignal):
        ComSignalType = UINT8_N
        ComSignalEndianness = opaque
        ComTransferProperty = TRIGGERED
        ComInitialValueOnly = false
        ComBitPosition = 0
        ComSignalInitValue = 0
        ComSignalLength = 8
      Com_IPdu_CanNodeNum_01_Tx_07 (ComIPdu):
        ComIPduDirection = SEND
        ComIPduSignalProcessing = IMMEDIATE
        ComIPduType = NORMAL
        ComIPduSignalRef = Com_Signal_CanNodeNum_01_Tx_07
        ComPduIdRef = CanPdu_Com2PduR_CanNodeNum_01_Tx_07
        ComIPduGroupRef = ComIPduGroup_CanNodeNum_01_Tx
        ComTxIPdu: ComTxIPduUnusedAreasDefault=0
          ComTxModeTrue
            ComTxMode: ComTxModeNumberOfRepetitions=0, ComTxModeMode=DIRECT, ComTxModeTimeOffset=0.0, ComTxModeTimePeriod=0.01, ComTxModeRepetitionPeriod=0
          ComTxModeFalse
            ComTxMode: ComTxModeNumberOfRepetitions=0, ComTxModeMode=DIRECT, ComTxModeTimeOffset=0.0, ComTxModeTimePeriod=0.01, ComTxModeRepetitionPeriod=0
      Com_Signal_CanNodeNum_01_Tx_07 (ComSignal):
        ComSignalType = UINT8_N
        ComSignalEndianness = opaque
        ComTransferProperty = TRIGGERED
        ComInitialValueOnly = false
        ComBitPosition = 0
        ComSignalInitValue = 0
        ComSignalLength = 8
      Com_IPdu_CanNodeNum_01_Tx_08 (ComIPdu):
        ComIPduDirection = SEND
        ComIPduSignalProcessing = IMMEDIATE
        ComIPduType = NORMAL
        ComIPduSignalRef = Com_Signal_CanNodeNum_01_Tx_08
        ComPduIdRef = CanPdu_Com2PduR_CanNodeNum_01_Tx_08
        ComIPduGroupRef = ComIPduGroup_CanNodeNum_01_Tx
        ComTxIPdu: ComTxIPduUnusedAreasDefault=0
          ComTxModeTrue
            ComTxMode: ComTxModeNumberOfRepetitions=0, ComTxModeMode=DIRECT, ComTxModeTimeOffset=0.0, ComTxModeTimePeriod=0.1, ComTxModeRepetitionPeriod=0
          ComTxModeFalse
            ComTxMode: ComTxModeNumberOfRepetitions=0, ComTxModeMode=DIRECT, ComTxModeTimeOffset=0.0, ComTxModeTimePeriod=0.1, ComTxModeRepetitionPeriod=0
      Com_Signal_CanNodeNum_01_Tx_08 (ComSignal):
        ComSignalType = UINT8_N
        ComSignalEndianness = opaque
        ComTransferProperty = TRIGGERED
        ComInitialValueOnly = false
        ComBitPosition = 0
        ComSignalInitValue = 0
        ComSignalLength = 8
      Com_IPdu_CanNodeNum_01_Tx_09 (ComIPdu):
        ComIPduDirection = SEND
        ComIPduSignalProcessing = IMMEDIATE
        ComIPduType = NORMAL
        ComIPduSignalRef = Com_Signal_CanNodeNum_01_Tx_09
        ComPduIdRef = CanPdu_Com2PduR_CanNodeNum_01_Tx_09
        ComIPduGroupRef = ComIPduGroup_CanNodeNum_01_Tx
        ComTxIPdu: ComTxIPduUnusedAreasDefault=0
          ComTxModeTrue
            ComTxMode: ComTxModeNumberOfRepetitions=0, ComTxModeMode=DIRECT, ComTxModeTimeOffset=0.0, ComTxModeTimePeriod=0.01, ComTxModeRepetitionPeriod=0
          ComTxModeFalse
            ComTxMode: ComTxModeNumberOfRepetitions=0, ComTxModeMode=DIRECT, ComTxModeTimeOffset=0.0, ComTxModeTimePeriod=0.01, ComTxModeRepetitionPeriod=0
      Com_Signal_CanNodeNum_01_Tx_09 (ComSignal):
        ComSignalType = UINT8_N
        ComSignalEndianness = opaque
        ComTransferProperty = TRIGGERED
        ComInitialValueOnly = false
        ComBitPosition = 0
        ComSignalInitValue = 0
        ComSignalLength = 8
      Com_IPdu_CanNodeNum_01_Tx_10 (ComIPdu):
        ComIPduDirection = SEND
        ComIPduSignalProcessing = IMMEDIATE
        ComIPduType = NORMAL
        ComIPduSignalRef = Com_Signal_CanNodeNum_01_Tx_10
        ComIPduGroupRef = ComIPduGroup_CanNodeNum_01_Tx
        ComPduIdRef = CanPdu_Com2PduR_CanNodeNum_01_Tx_10
        ComTxIPdu: ComTxIPduUnusedAreasDefault=0
          ComTxModeTrue
            ComTxMode: ComTxModeNumberOfRepetitions=0, ComTxModeMode=DIRECT, ComTxModeTimeOffset=0.0, ComTxModeTimePeriod=0.01, ComTxModeRepetitionPeriod=0
          ComTxModeFalse
            ComTxMode: ComTxModeNumberOfRepetitions=0, ComTxModeMode=DIRECT, ComTxModeTimeOffset=0.0, ComTxModeTimePeriod=0.1, ComTxModeRepetitionPeriod=0
      Com_Signal_CanNodeNum_01_Tx_10 (ComSignal):
        ComSignalType = UINT8_N
        ComSignalEndianness = opaque
        ComTransferProperty = TRIGGERED
        ComInitialValueOnly = false
        ComBitPosition = 0
        ComSignalInitValue = 0
        ComSignalLength = 8
      Com_IPdu_CanNodeNum_01_Tx_11 (ComIPdu):
        ComIPduDirection = SEND
        ComIPduSignalProcessing = IMMEDIATE
        ComIPduType = NORMAL
        ComIPduSignalRef = Com_Signal_CanNodeNum_01_Tx_11
        ComIPduGroupRef = ComIPduGroup_CanNodeNum_01_Tx
        ComPduIdRef = CanPdu_Com2PduR_CanNodeNum_01_Tx_11
        ComTxIPdu: ComTxIPduUnusedAreasDefault=0
          ComTxModeTrue
            ComTxMode: ComTxModeNumberOfRepetitions=0, ComTxModeMode=DIRECT, ComTxModeTimeOffset=0.0, ComTxModeTimePeriod=0.02, ComTxModeRepetitionPeriod=0
          ComTxModeFalse
            ComTxMode: ComTxModeNumberOfRepetitions=0, ComTxModeMode=DIRECT, ComTxModeTimeOffset=0.0, ComTxModeTimePeriod=0.1, ComTxModeRepetitionPeriod=0
      Com_Signal_CanNodeNum_01_Tx_11 (ComSignal):
        ComSignalType = UINT8_N
        ComSignalEndianness = opaque
        ComTransferProperty = TRIGGERED
        ComInitialValueOnly = false
        ComBitPosition = 0
        ComSignalInitValue = 0
        ComSignalLength = 8
      Com_IPdu_CanNodeNum_01_Tx_12 (ComIPdu):
        ComIPduDirection = SEND
        ComIPduSignalProcessing = IMMEDIATE
        ComIPduType = NORMAL
        ComIPduSignalRef = Com_Signal_CanNodeNum_01_Tx_12
        ComPduIdRef = CanPdu_Com2PduR_CanNodeNum_01_Tx_12
        ComIPduGroupRef = ComIPduGroup_CanNodeNum_01_Tx
        ComTxIPdu: ComTxIPduUnusedAreasDefault=0
          ComTxModeTrue
            ComTxMode: ComTxModeNumberOfRepetitions=0, ComTxModeMode=DIRECT, ComTxModeTimeOffset=0.005, ComTxModeTimePeriod=0.01, ComTxModeRepetitionPeriod=0
          ComTxModeFalse
            ComTxMode: ComTxModeNumberOfRepetitions=0, ComTxModeMode=DIRECT, ComTxModeTimeOffset=0.0, ComTxModeTimePeriod=0.01, ComTxModeRepetitionPeriod=0
      Com_Signal_CanNodeNum_01_Tx_12 (ComSignal):
        ComSignalType = UINT8_N
        ComSignalEndianness = opaque
        ComTransferProperty = TRIGGERED
        ComInitialValueOnly = false
        ComBitPosition = 0
        ComSignalInitValue = 0
        ComSignalLength = 8
      Com_IPdu_CanNodeNum_01_Tx_13 (ComIPdu):
        ComIPduDirection = SEND
        ComIPduSignalProcessing = IMMEDIATE
        ComIPduType = NORMAL
        ComIPduSignalRef = Com_Signal_CanNodeNum_01_Tx_13
        ComIPduGroupRef = ComIPduGroup_CanNodeNum_01_Tx
        ComPduIdRef = CanPdu_Com2PduR_CanNodeNum_01_Tx_13
        ComTxIPdu: ComTxIPduUnusedAreasDefault=0
          ComTxModeTrue
            ComTxMode: ComTxModeNumberOfRepetitions=0, ComTxModeMode=DIRECT, ComTxModeTimeOffset=0.0, ComTxModeTimePeriod=0.02, ComTxModeRepetitionPeriod=0
          ComTxModeFalse
            ComTxMode: ComTxModeNumberOfRepetitions=0, ComTxModeMode=DIRECT, ComTxModeTimeOffset=0.0, ComTxModeTimePeriod=0.02, ComTxModeRepetitionPeriod=0
      Com_Signal_CanNodeNum_01_Tx_13 (ComSignal):
        ComSignalType = UINT8_N
        ComSignalEndianness = opaque
        ComTransferProperty = TRIGGERED
        ComInitialValueOnly = false
        ComBitPosition = 0
        ComSignalInitValue = 0
        ComSignalLength = 8
      Com_IPdu_CanNodeNum_01_Tx_14 (ComIPdu):
        ComIPduDirection = SEND
        ComIPduSignalProcessing = IMMEDIATE
        ComIPduType = NORMAL
        ComIPduSignalRef = Com_Signal_CanNodeNum_01_Tx_14
        ComPduIdRef = CanPdu_Com2PduR_CanNodeNum_01_Tx_14
        ComIPduGroupRef = ComIPduGroup_CanNodeNum_01_Tx
        ComTxIPdu: ComTxIPduUnusedAreasDefault=0
          ComTxModeTrue
            ComTxMode: ComTxModeNumberOfRepetitions=0, ComTxModeMode=DIRECT, ComTxModeTimeOffset=0.0, ComTxModeRepetitionPeriod=0, ComTxModeTimePeriod=0.009
          ComTxModeFalse
            ComTxMode: ComTxModeNumberOfRepetitions=0, ComTxModeMode=DIRECT, ComTxModeTimeOffset=0.0, ComTxModeRepetitionPeriod=0, ComTxModeTimePeriod=0.1
      Com_Signal_CanNodeNum_01_Tx_14 (ComSignal):
        ComSignalType = UINT8_N
        ComSignalEndianness = opaque
        ComTransferProperty = TRIGGERED
        ComInitialValueOnly = false
        ComBitPosition = 0
        ComSignalInitValue = 0
        ComSignalLength = 8
      Com_IPdu_CanNodeNum_01_Tx_15 (ComIPdu):
        ComIPduDirection = SEND
        ComIPduSignalProcessing = IMMEDIATE
        ComIPduType = NORMAL
        ComIPduSignalRef = Com_Signal_CanNodeNum_01_Tx_15
        ComIPduGroupRef = ComIPduGroup_CanNodeNum_01_Tx
        ComPduIdRef = CanPdu_Com2PduR_CanNodeNum_01_Tx_15
        ComTxIPdu: ComTxIPduUnusedAreasDefault=0
          ComTxModeTrue
            ComTxMode: ComTxModeNumberOfRepetitions=0, ComTxModeMode=DIRECT, ComTxModeTimeOffset=0.0, ComTxModeTimePeriod=0.01, ComTxModeRepetitionPeriod=0
          ComTxModeFalse
            ComTxMode: ComTxModeNumberOfRepetitions=0, ComTxModeMode=DIRECT, ComTxModeTimeOffset=0.0, ComTxModeTimePeriod=0.01, ComTxModeRepetitionPeriod=0
      Com_Signal_CanNodeNum_01_Tx_15 (ComSignal):
        ComSignalType = UINT8_N
        ComSignalEndianness = opaque
        ComTransferProperty = TRIGGERED
        ComInitialValueOnly = false
        ComBitPosition = 0
        ComSignalInitValue = 0
        ComSignalLength = 8
      Com_IPdu_CanNodeNum_01_Tx_16 (ComIPdu):
        ComIPduDirection = SEND
        ComIPduSignalProcessing = IMMEDIATE
        ComIPduType = NORMAL
        ComIPduSignalRef = Com_Signal_CanNodeNum_01_Tx_16
        ComIPduGroupRef = ComIPduGroup_CanNodeNum_01_Tx
        ComPduIdRef = CanPdu_Com2PduR_CanNodeNum_01_Tx_16
        ComTxIPdu: ComTxIPduUnusedAreasDefault=0
          ComTxModeTrue
            ComTxMode: ComTxModeNumberOfRepetitions=0, ComTxModeMode=DIRECT, ComTxModeTimeOffset=0.0, ComTxModeTimePeriod=0.02, ComTxModeRepetitionPeriod=0
          ComTxModeFalse
            ComTxMode: ComTxModeNumberOfRepetitions=0, ComTxModeMode=DIRECT, ComTxModeTimeOffset=0.0, ComTxModeTimePeriod=0.02, ComTxModeRepetitionPeriod=0
      Com_Signal_CanNodeNum_01_Tx_16 (ComSignal):
        ComSignalType = UINT8_N
        ComSignalEndianness = opaque
        ComTransferProperty = TRIGGERED
        ComInitialValueOnly = false
        ComBitPosition = 0
        ComSignalInitValue = 0
        ComSignalLength = 8
      Com_IPdu_CanNodeNum_01_Tx_17 (ComIPdu):
        ComIPduDirection = SEND
        ComIPduSignalProcessing = IMMEDIATE
        ComIPduType = NORMAL
        ComIPduSignalRef = Com_Signal_CanNodeNum_01_Tx_17
        ComPduIdRef = CanPdu_Com2PduR_CanNodeNum_01_Tx_17
        ComIPduGroupRef = ComIPduGroup_CanNodeNum_01_Tx
        ComTxIPdu: ComTxIPduUnusedAreasDefault=0
          ComTxModeTrue
            ComTxMode: ComTxModeNumberOfRepetitions=0, ComTxModeMode=DIRECT, ComTxModeTimeOffset=0.0, ComTxModeTimePeriod=0.02, ComTxModeRepetitionPeriod=0
          ComTxModeFalse
            ComTxMode: ComTxModeNumberOfRepetitions=0, ComTxModeMode=DIRECT, ComTxModeTimeOffset=0.0, ComTxModeTimePeriod=0.1, ComTxModeRepetitionPeriod=0
      Com_Signal_CanNodeNum_01_Tx_17 (ComSignal):
        ComSignalType = UINT8_N
        ComSignalEndianness = opaque
        ComTransferProperty = TRIGGERED
        ComInitialValueOnly = false
        ComBitPosition = 0
        ComSignalInitValue = 0
        ComSignalLength = 8
      Com_IPdu_CanNodeNum_01_Tx_18 (ComIPdu):
        ComIPduDirection = SEND
        ComIPduSignalProcessing = IMMEDIATE
        ComIPduType = NORMAL
        ComIPduSignalRef = Com_Signal_CanNodeNum_01_Tx_18
        ComPduIdRef = CanPdu_Com2PduR_CanNodeNum_01_Tx_18
        ComIPduGroupRef = ComIPduGroup_CanNodeNum_01_Tx
        ComTxIPdu: ComTxIPduUnusedAreasDefault=0
          ComTxModeTrue
            ComTxMode: ComTxModeNumberOfRepetitions=0, ComTxModeMode=DIRECT, ComTxModeTimeOffset=0.0, ComTxModeRepetitionPeriod=0, ComTxModeTimePeriod=0.1
          ComTxModeFalse
            ComTxMode: ComTxModeNumberOfRepetitions=0, ComTxModeMode=DIRECT, ComTxModeTimeOffset=0.0, ComTxModeRepetitionPeriod=0, ComTxModeTimePeriod=0.1
      Com_Signal_CanNodeNum_01_Tx_18 (ComSignal):
        ComSignalType = UINT8_N
        ComSignalEndianness = opaque
        ComTransferProperty = TRIGGERED
        ComInitialValueOnly = false
        ComBitPosition = 0
        ComSignalInitValue = 0
        ComSignalLength = 8
      Com_IPdu_CanNodeNum_01_Tx_19 (ComIPdu):
        ComIPduDirection = SEND
        ComIPduSignalProcessing = IMMEDIATE
        ComIPduType = NORMAL
        ComIPduSignalRef = Com_Signal_CanNodeNum_01_Tx_19
        ComPduIdRef = CanPdu_Com2PduR_CanNodeNum_01_Tx_19
        ComIPduGroupRef = ComIPduGroup_CanNodeNum_01_Tx
        ComTxIPdu: ComTxIPduUnusedAreasDefault=0
          ComTxModeTrue
            ComTxMode: ComTxModeNumberOfRepetitions=0, ComTxModeMode=DIRECT, ComTxModeTimeOffset=0.0, ComTxModeTimePeriod=0.01, ComTxModeRepetitionPeriod=0
          ComTxModeFalse
            ComTxMode: ComTxModeNumberOfRepetitions=0, ComTxModeMode=DIRECT, ComTxModeTimeOffset=0.0, ComTxModeTimePeriod=0.01, ComTxModeRepetitionPeriod=0
      Com_Signal_CanNodeNum_01_Tx_19 (ComSignal):
        ComSignalType = UINT8_N
        ComSignalEndianness = opaque
        ComTransferProperty = TRIGGERED
        ComInitialValueOnly = false
        ComBitPosition = 0
        ComSignalInitValue = 0
        ComSignalLength = 8
      Com_IPdu_CanNodeNum_01_Tx_20 (ComIPdu):
        ComIPduDirection = SEND
        ComIPduSignalProcessing = IMMEDIATE
        ComIPduType = NORMAL
        ComIPduSignalRef = Com_Signal_CanNodeNum_01_Tx_20
        ComIPduGroupRef = ComIPduGroup_CanNodeNum_01_Tx
        ComPduIdRef = CanPdu_Com2PduR_CanNodeNum_01_Tx_20
        ComTxIPdu: ComTxIPduUnusedAreasDefault=0
          ComTxModeTrue
            ComTxMode: ComTxModeNumberOfRepetitions=0, ComTxModeMode=DIRECT, ComTxModeTimeOffset=0.0, ComTxModeTimePeriod=0.1, ComTxModeRepetitionPeriod=0
          ComTxModeFalse
            ComTxMode: ComTxModeNumberOfRepetitions=0, ComTxModeMode=DIRECT, ComTxModeTimeOffset=0.0, ComTxModeTimePeriod=0.1, ComTxModeRepetitionPeriod=0
      Com_Signal_CanNodeNum_01_Tx_20 (ComSignal):
        ComSignalType = UINT8_N
        ComSignalEndianness = opaque
        ComTransferProperty = TRIGGERED
        ComInitialValueOnly = false
        ComBitPosition = 0
        ComSignalInitValue = 0
        ComSignalLength = 8
      Com_IPdu_CanNodeNum_01_Tx_21 (ComIPdu):
        ComIPduDirection = SEND
        ComIPduSignalProcessing = IMMEDIATE
        ComIPduType = NORMAL
        ComIPduSignalRef = Com_Signal_CanNodeNum_01_Tx_21
        ComIPduGroupRef = ComIPduGroup_CanNodeNum_01_Tx
        ComPduIdRef = CanPdu_Com2PduR_CanNodeNum_01_Tx_21
        ComTxIPdu: ComTxIPduUnusedAreasDefault=0
          ComTxModeTrue
            ComTxMode: ComTxModeNumberOfRepetitions=0, ComTxModeMode=DIRECT, ComTxModeTimeOffset=0.0, ComTxModeTimePeriod=0.5, ComTxModeRepetitionPeriod=0
          ComTxModeFalse
            ComTxMode: ComTxModeNumberOfRepetitions=0, ComTxModeMode=DIRECT, ComTxModeTimeOffset=0.0, ComTxModeTimePeriod=0.5, ComTxModeRepetitionPeriod=0
      Com_Signal_CanNodeNum_01_Tx_21 (ComSignal):
        ComSignalType = UINT8_N
        ComSignalEndianness = opaque
        ComTransferProperty = TRIGGERED
        ComInitialValueOnly = false
        ComBitPosition = 0
        ComSignalInitValue = 0
        ComSignalLength = 8
      Com_IPdu_CanNodeNum_01_Tx_22 (ComIPdu):
        ComIPduDirection = SEND
        ComIPduSignalProcessing = IMMEDIATE
        ComIPduType = NORMAL
        ComIPduSignalRef = Com_Signal_CanNodeNum_01_Tx_22
        ComPduIdRef = CanPdu_Com2PduR_CanNodeNum_01_Tx_22
        ComIPduGroupRef = ComIPduGroup_CanNodeNum_01_Tx
        ComTxIPdu: ComTxIPduUnusedAreasDefault=0
          ComTxModeTrue
            ComTxMode: ComTxModeNumberOfRepetitions=0, ComTxModeMode=DIRECT, ComTxModeTimeOffset=0.0, ComTxModeRepetitionPeriod=0, ComTxModeTimePeriod=0.1
          ComTxModeFalse
            ComTxMode: ComTxModeNumberOfRepetitions=0, ComTxModeMode=DIRECT, ComTxModeTimeOffset=0.0, ComTxModeRepetitionPeriod=0, ComTxModeTimePeriod=0.1
      Com_Signal_CanNodeNum_01_Tx_22 (ComSignal):
        ComSignalType = UINT8_N
        ComSignalEndianness = opaque
        ComTransferProperty = TRIGGERED
        ComInitialValueOnly = false
        ComBitPosition = 0
        ComSignalInitValue = 0
        ComSignalLength = 8
      Com_IPdu_CanNodeNum_01_Tx_23 (ComIPdu):
        ComIPduDirection = SEND
        ComIPduSignalProcessing = IMMEDIATE
        ComIPduType = NORMAL
        ComIPduSignalRef = Com_Signal_CanNodeNum_01_Tx_23
        ComIPduGroupRef = ComIPduGroup_CanNodeNum_01_Tx
        ComPduIdRef = CanPdu_Com2PduR_CanNodeNum_01_Tx_23
        ComTxIPdu: ComTxIPduUnusedAreasDefault=0
          ComTxModeTrue
            ComTxMode: ComTxModeNumberOfRepetitions=0, ComTxModeMode=DIRECT, ComTxModeTimeOffset=0.0, ComTxModeTimePeriod=0.1, ComTxModeRepetitionPeriod=0
          ComTxModeFalse
            ComTxMode: ComTxModeNumberOfRepetitions=0, ComTxModeMode=DIRECT, ComTxModeTimeOffset=0.0, ComTxModeTimePeriod=0.1, ComTxModeRepetitionPeriod=0
      Com_Signal_CanNodeNum_01_Tx_23 (ComSignal):
        ComSignalType = UINT8_N
        ComSignalEndianness = opaque
        ComTransferProperty = TRIGGERED
        ComInitialValueOnly = false
        ComBitPosition = 0
        ComSignalInitValue = 0
        ComSignalLength = 8
      ComIPduGroup_CanNodeNum_01_Rx (ComIPduGroup)
      ComIPduGroup_CanNodeNum_01_Tx (ComIPduGroup)
      7 x ComIPdu, all with ComIPduSignalProcessing=IMMEDIATE, ComIPduType=NORMAL:
        Com_IPdu_CanNodeNum_01_Tx_24: ComIPduDirection=SEND, ComIPduGroupRef=ComIPduGroup_CanNodeNum_01_Tx, ComPduIdRef=CanPdu_Com2PduR_CanNodeNum_01_Tx_24, ComIPduSignalRef=Com_Signal_CanNodeNum_01_Tx_24
          ComTxIPdu: ComTxIPduUnusedAreasDefault=0
            ComTxModeTrue
              ComTxMode: ComTxModeNumberOfRepetitions=0, ComTxModeMode=DIRECT, ComTxModeTimeOffset=0.0, ComTxModeTimePeriod=0.1, ComTxModeRepetitionPeriod=0
            ComTxModeFalse
              ComTxMode: ComTxModeNumberOfRepetitions=0, ComTxModeMode=DIRECT, ComTxModeTimeOffset=0.0, ComTxModeTimePeriod=0.1, ComTxModeRepetitionPeriod=0
        Com_IPdu_CanNodeNum_01_Tx_25: ComIPduDirection=SEND, ComIPduGroupRef=ComIPduGroup_CanNodeNum_01_Tx, ComPduIdRef=CanPdu_Com2PduR_CanNodeNum_01_Tx_25, ComIPduSignalRef=Com_Signal_CanNodeNum_01_Tx_25
          ComTxIPdu: ComTxIPduUnusedAreasDefault=0
            ComTxModeTrue
              ComTxMode: ComTxModeNumberOfRepetitions=0, ComTxModeMode=DIRECT, ComTxModeTimeOffset=0.0, ComTxModeTimePeriod=0.1, ComTxModeRepetitionPeriod=0
            ComTxModeFalse
              ComTxMode: ComTxModeNumberOfRepetitions=0, ComTxModeMode=DIRECT, ComTxModeTimeOffset=0.0, ComTxModeTimePeriod=0.1, ComTxModeRepetitionPeriod=0
        Com_IPdu_CanNodeNum_01_Tx_25_00: ComIPduDirection=SEND, ComIPduGroupRef=ComIPduGroup_CanNodeNum_01_Tx, ComPduIdRef=CanPdu_Com2PduR_CanNodeNum_01_Tx_25_00, ComIPduSignalRef=Com_Signal_CanNodeNum_01_Tx_25_00
          ComTxIPdu: ComTxIPduUnusedAreasDefault=0
            ComTxModeTrue
              ComTxMode: ComTxModeNumberOfRepetitions=0, ComTxModeMode=DIRECT, ComTxModeTimeOffset=0.0, ComTxModeTimePeriod=0.1, ComTxModeRepetitionPeriod=0
            ComTxModeFalse
              ComTxMode: ComTxModeNumberOfRepetitions=0, ComTxModeMode=DIRECT, ComTxModeTimeOffset=0.0, ComTxModeTimePeriod=0.1, ComTxModeRepetitionPeriod=0
        Com_IPdu_CanNodeNum_01_Tx_25_01: ComIPduDirection=SEND, ComIPduGroupRef=ComIPduGroup_CanNodeNum_01_Tx, ComPduIdRef=CanPdu_Com2PduR_CanNodeNum_01_Tx_25_01, ComIPduSignalRef=Com_Signal_CanNodeNum_01_Tx_25_01
          ComTxIPdu: ComTxIPduUnusedAreasDefault=0
            ComTxModeTrue
              ComTxMode: ComTxModeNumberOfRepetitions=0, ComTxModeMode=DIRECT, ComTxModeTimeOffset=0.0, ComTxModeTimePeriod=0.1, ComTxModeRepetitionPeriod=0
            ComTxModeFalse
              ComTxMode: ComTxModeNumberOfRepetitions=0, ComTxModeMode=DIRECT, ComTxModeTimeOffset=0.0, ComTxModeTimePeriod=0.1, ComTxModeRepetitionPeriod=0
        Com_IPdu_CanNodeNum_01_Tx_26: ComIPduDirection=SEND, ComIPduGroupRef=ComIPduGroup_CanNodeNum_01_Tx, ComPduIdRef=CanPdu_Com2PduR_CanNodeNum_01_Tx_26, ComIPduSignalRef=Com_Signal_CanNodeNum_01_Tx_26
          ComTxIPdu: ComTxIPduUnusedAreasDefault=0
            ComTxModeTrue
              ComTxMode: ComTxModeNumberOfRepetitions=0, ComTxModeMode=DIRECT, ComTxModeTimeOffset=0.0, ComTxModeTimePeriod=0.1, ComTxModeRepetitionPeriod=0
            ComTxModeFalse
              ComTxMode: ComTxModeNumberOfRepetitions=0, ComTxModeMode=DIRECT, ComTxModeTimeOffset=0.0, ComTxModeTimePeriod=0.1, ComTxModeRepetitionPeriod=0
        Com_IPdu_CanNodeNum_02_Rx_01: ComFirstTimeout=2.0, ComIPduCallout=Bsw_IPduCallout_CanNodeNum_02_Rx_01, ComIPduDirection=RECEIVE, ComIpduNotificationCallback=Bsw_ComIPduAck_CanNodeNum_02_Rx_01, ComTimeout=0.25, ComPduIdRef=CanPdu_PduR2Com_CanNodeNum_02_Rx_01, ComIPduSignalRef=Com_Signal_CanNodeNum_02_Rx_01, ComIPduGroupRef=ComIPduGroup_CanNodeNum_02_Rx
        Com_IPdu_CanNodeNum_02_Rx_02: ComFirstTimeout=2.0, ComIPduCallout=Bsw_IPduCallout_CanNodeNum_02_Rx_02, ComIPduDirection=RECEIVE, ComIpduNotificationCallback=Bsw_ComIPduAck_CanNodeNum_02_Rx_02, ComTimeout=0.25, ComPduIdRef=CanPdu_PduR2Com_CanNodeNum_02_Rx_02, ComIPduSignalRef=Com_Signal_CanNodeNum_02_Rx_02, ComIPduGroupRef=ComIPduGroup_CanNodeNum_02_Rx
      177 x ComSignal, all with ComSignalType=UINT8_N, ComSignalEndianness=opaque, ComBitPosition=0, ComSignalInitValue=0, ComSignalLength=8:
        Com_Signal_CanNodeNum_01_Tx_24: ComTransferProperty=TRIGGERED, ComInitialValueOnly=false
        Com_Signal_CanNodeNum_01_Tx_25: ComTransferProperty=TRIGGERED, ComInitialValueOnly=false
        Com_Signal_CanNodeNum_01_Tx_25_00: ComTransferProperty=TRIGGERED, ComInitialValueOnly=false
        Com_Signal_CanNodeNum_01_Tx_25_01: ComTransferProperty=TRIGGERED, ComInitialValueOnly=false
        Com_Signal_CanNodeNum_01_Tx_26: ComTransferProperty=TRIGGERED, ComInitialValueOnly=false
        Com_Signal_CanNodeNum_02_Rx_{01..04}: ComTransferProperty=PENDING, ComRxDataTimeoutAction=NONE, ComTimeoutNotification=Bsw_ComSignalTimeout_CanNodeNum_02_Rx_{01..04}
        Com_Signal_CanNodeNum_02_Rx_{05..40}: ComTransferProperty=PENDING, ComRxDataTimeoutAction=NONE
        Com_Signal_CanNodeNum_02_TxBasic_{01..20}: ComTransferProperty=TRIGGERED, ComInitialValueOnly=false
        Com_Signal_CanNodeNum_02_Tx_{01..26}: ComInitialValueOnly=0, ComTransferProperty=TRIGGERED
        Com_Signal_CanNodeNum_03_Rx_{01..04}: ComTransferProperty=PENDING, ComRxDataTimeoutAction=NONE, ComTimeoutNotification=Bsw_ComSignalTimeout_CanNodeNum_03_Rx_{01..04}
        Com_Signal_CanNodeNum_03_Rx_{05..40}: ComTransferProperty=PENDING, ComRxDataTimeoutAction=NONE
        Com_Signal_CanNodeNum_03_TxBasic_{01..20}: ComTransferProperty=TRIGGERED, ComInitialValueOnly=false
        Com_Signal_CanNodeNum_03_Tx_{01..26}: ComInitialValueOnly=0, ComTransferProperty=TRIGGERED
      170 x ComIPdu, all with ComIPduSignalProcessing=IMMEDIATE, ComIPduType=NORMAL:
        Com_IPdu_CanNodeNum_02_Rx_03: ComFirstTimeout=2.0, ComIPduDirection=RECEIVE, ComTimeout=0.25, ComIpduNotificationCallback=Bsw_ComIPduAck_CanNodeNum_02_Rx_03, ComPduIdRef=CanPdu_PduR2Com_CanNodeNum_02_Rx_03, ComIPduSignalRef=Com_Signal_CanNodeNum_02_Rx_03, ComIPduGroupRef=ComIPduGroup_CanNodeNum_02_Rx
        Com_IPdu_CanNodeNum_02_Rx_04: ComFirstTimeout=2.0, ComIPduDirection=RECEIVE, ComTimeout=0.25, ComIpduNotificationCallback=Bsw_ComIPduAck_CanNodeNum_02_Rx_04, ComPduIdRef=CanPdu_PduR2Com_CanNodeNum_02_Rx_04, ComIPduSignalRef=Com_Signal_CanNodeNum_02_Rx_04, ComIPduGroupRef=ComIPduGroup_CanNodeNum_02_Rx
        Com_IPdu_CanNodeNum_02_Rx_{05..40}: ComFirstTimeout=2.0, ComIPduDirection=RECEIVE, ComTimeout=0.25, ComPduIdRef=CanPdu_PduR2Com_CanNodeNum_02_Rx_{05..40}, ComIPduSignalRef=Com_Signal_CanNodeNum_02_Rx_{05..40}, ComIPduGroupRef=ComIPduGroup_CanNodeNum_02_Rx
        Com_IPdu_CanNodeNum_02_TxBasic_01: ComIPduDirection=SEND, ComPduIdRef=CanPdu_Com2PduR_CanNodeNum_02_TxBasic_01, ComIPduSignalRef=Com_Signal_CanNodeNum_02_TxBasic_01, ComIPduGroupRef=ComIPduGroup_CanNodeNum_02_Tx
          ComTxIPdu: ComTxIPduUnusedAreasDefault=0
            ComTxModeTrue
              ComTxMode: ComTxModeNumberOfRepetitions=0, ComTxModeMode=DIRECT, ComTxModeTimeOffset=0.0, ComTxModeTimePeriod=0.1, ComTxModeRepetitionPeriod=0
            ComTxModeFalse
              ComTxMode: ComTxModeNumberOfRepetitions=0, ComTxModeMode=DIRECT, ComTxModeTimeOffset=0.0, ComTxModeTimePeriod=0.1, ComTxModeRepetitionPeriod=0
        Com_IPdu_CanNodeNum_02_TxBasic_02: ComIPduDirection=SEND, ComPduIdRef=CanPdu_Com2PduR_CanNodeNum_02_TxBasic_02, ComIPduSignalRef=Com_Signal_CanNodeNum_02_TxBasic_02, ComIPduGroupRef=ComIPduGroup_CanNodeNum_02_Tx
          ComTxIPdu: ComTxIPduUnusedAreasDefault=0
            ComTxModeTrue
              ComTxMode: ComTxModeNumberOfRepetitions=0, ComTxModeMode=DIRECT, ComTxModeTimeOffset=0.0, ComTxModeTimePeriod=0.1, ComTxModeRepetitionPeriod=0.0
            ComTxModeFalse
              ComTxMode: ComTxModeNumberOfRepetitions=0, ComTxModeMode=DIRECT, ComTxModeTimeOffset=0.0, ComTxModeTimePeriod=0.1, ComTxModeRepetitionPeriod=0
        Com_IPdu_CanNodeNum_02_TxBasic_03: ComIPduDirection=SEND, ComPduIdRef=CanPdu_Com2PduR_CanNodeNum_02_TxBasic_03, ComIPduSignalRef=Com_Signal_CanNodeNum_02_TxBasic_03, ComIPduGroupRef=ComIPduGroup_CanNodeNum_02_Tx
          ComTxIPdu: ComTxIPduUnusedAreasDefault=0
            ComTxModeTrue
              ComTxMode: ComTxModeNumberOfRepetitions=0, ComTxModeMode=DIRECT, ComTxModeTimeOffset=0.0, ComTxModeTimePeriod=0.1, ComTxModeRepetitionPeriod=0.0
            ComTxModeFalse
              ComTxMode: ComTxModeNumberOfRepetitions=0, ComTxModeMode=DIRECT, ComTxModeTimeOffset=0.0, ComTxModeTimePeriod=0.1, ComTxModeRepetitionPeriod=0
        Com_IPdu_CanNodeNum_02_TxBasic_04: ComIPduDirection=SEND, ComPduIdRef=CanPdu_Com2PduR_CanNodeNum_02_TxBasic_04, ComIPduSignalRef=Com_Signal_CanNodeNum_02_TxBasic_04, ComIPduGroupRef=ComIPduGroup_CanNodeNum_02_Tx
          ComTxIPdu: ComTxIPduUnusedAreasDefault=0
            ComTxModeTrue
              ComTxMode: ComTxModeNumberOfRepetitions=0, ComTxModeMode=DIRECT, ComTxModeTimeOffset=0.0, ComTxModeTimePeriod=0.1, ComTxModeRepetitionPeriod=0
            ComTxModeFalse
              ComTxMode: ComTxModeNumberOfRepetitions=0, ComTxModeMode=DIRECT, ComTxModeTimeOffset=0.0, ComTxModeTimePeriod=0.1, ComTxModeRepetitionPeriod=0.0
        Com_IPdu_CanNodeNum_02_TxBasic_05: ComIPduDirection=SEND, ComPduIdRef=CanPdu_Com2PduR_CanNodeNum_02_TxBasic_05, ComIPduSignalRef=Com_Signal_CanNodeNum_02_TxBasic_05, ComIPduGroupRef=ComIPduGroup_CanNodeNum_02_Tx
          ComTxIPdu: ComTxIPduUnusedAreasDefault=0
            ComTxModeTrue
              ComTxMode: ComTxModeNumberOfRepetitions=0, ComTxModeMode=DIRECT, ComTxModeTimeOffset=0.0, ComTxModeTimePeriod=0.1, ComTxModeRepetitionPeriod=0
            ComTxModeFalse
              ComTxMode: ComTxModeNumberOfRepetitions=0, ComTxModeMode=DIRECT, ComTxModeTimeOffset=0.0, ComTxModeTimePeriod=0.1, ComTxModeRepetitionPeriod=0.0
        Com_IPdu_CanNodeNum_02_TxBasic_06: ComIPduDirection=SEND, ComPduIdRef=CanPdu_Com2PduR_CanNodeNum_02_TxBasic_06, ComIPduSignalRef=Com_Signal_CanNodeNum_02_TxBasic_06, ComIPduGroupRef=ComIPduGroup_CanNodeNum_02_Tx
          ComTxIPdu: ComTxIPduUnusedAreasDefault=0
            ComTxModeTrue
              ComTxMode: ComTxModeNumberOfRepetitions=0, ComTxModeMode=DIRECT, ComTxModeTimeOffset=0.0, ComTxModeTimePeriod=0.1, ComTxModeRepetitionPeriod=0
            ComTxModeFalse
              ComTxMode: ComTxModeNumberOfRepetitions=0, ComTxModeMode=DIRECT, ComTxModeTimeOffset=0.0, ComTxModeTimePeriod=0.1, ComTxModeRepetitionPeriod=0
        Com_IPdu_CanNodeNum_02_TxBasic_07: ComIPduDirection=SEND, ComPduIdRef=CanPdu_Com2PduR_CanNodeNum_02_TxBasic_07, ComIPduSignalRef=Com_Signal_CanNodeNum_02_TxBasic_07, ComIPduGroupRef=ComIPduGroup_CanNodeNum_02_Tx
          ComTxIPdu: ComTxIPduUnusedAreasDefault=0
            ComTxModeTrue
              ComTxMode: ComTxModeNumberOfRepetitions=0, ComTxModeMode=DIRECT, ComTxModeTimeOffset=0.0, ComTxModeTimePeriod=0.1, ComTxModeRepetitionPeriod=0
            ComTxModeFalse
              ComTxMode: ComTxModeNumberOfRepetitions=0, ComTxModeMode=DIRECT, ComTxModeTimeOffset=0.0, ComTxModeTimePeriod=0.1, ComTxModeRepetitionPeriod=0.0
        Com_IPdu_CanNodeNum_02_TxBasic_08: ComIPduDirection=SEND, ComPduIdRef=CanPdu_Com2PduR_CanNodeNum_02_TxBasic_08, ComIPduSignalRef=Com_Signal_CanNodeNum_02_TxBasic_08, ComIPduGroupRef=ComIPduGroup_CanNodeNum_02_Tx
          ComTxIPdu: ComTxIPduUnusedAreasDefault=0
            ComTxModeTrue
              ComTxMode: ComTxModeNumberOfRepetitions=0, ComTxModeMode=DIRECT, ComTxModeTimeOffset=0.0, ComTxModeTimePeriod=0.1, ComTxModeRepetitionPeriod=0
            ComTxModeFalse
              ComTxMode: ComTxModeNumberOfRepetitions=0, ComTxModeMode=DIRECT, ComTxModeTimeOffset=0.0, ComTxModeTimePeriod=0.1, ComTxModeRepetitionPeriod=0
        Com_IPdu_CanNodeNum_02_TxBasic_09: ComIPduDirection=SEND, ComPduIdRef=CanPdu_Com2PduR_CanNodeNum_02_TxBasic_09, ComIPduSignalRef=Com_Signal_CanNodeNum_02_TxBasic_09, ComIPduGroupRef=ComIPduGroup_CanNodeNum_02_Tx
          ComTxIPdu: ComTxIPduUnusedAreasDefault=0
            ComTxModeTrue
              ComTxMode: ComTxModeNumberOfRepetitions=0, ComTxModeMode=DIRECT, ComTxModeTimeOffset=0.0, ComTxModeTimePeriod=0.1, ComTxModeRepetitionPeriod=0
            ComTxModeFalse
              ComTxMode: ComTxModeNumberOfRepetitions=0, ComTxModeMode=DIRECT, ComTxModeTimeOffset=0.0, ComTxModeTimePeriod=0.1, ComTxModeRepetitionPeriod=0
        Com_IPdu_CanNodeNum_02_TxBasic_10: ComIPduDirection=SEND, ComPduIdRef=CanPdu_Com2PduR_CanNodeNum_02_TxBasic_10, ComIPduSignalRef=Com_Signal_CanNodeNum_02_TxBasic_10, ComIPduGroupRef=ComIPduGroup_CanNodeNum_02_Tx
          ComTxIPdu: ComTxIPduUnusedAreasDefault=0
            ComTxModeTrue
              ComTxMode: ComTxModeNumberOfRepetitions=0, ComTxModeMode=DIRECT, ComTxModeTimeOffset=0.0, ComTxModeTimePeriod=0.1, ComTxModeRepetitionPeriod=0
            ComTxModeFalse
              ComTxMode: ComTxModeNumberOfRepetitions=0, ComTxModeMode=DIRECT, ComTxModeTimeOffset=0.0, ComTxModeTimePeriod=0.1, ComTxModeRepetitionPeriod=0
        Com_IPdu_CanNodeNum_02_TxBasic_11: ComIPduDirection=SEND, ComPduIdRef=CanPdu_Com2PduR_CanNodeNum_02_TxBasic_11, ComIPduGroupRef=ComIPduGroup_CanNodeNum_02_Tx, ComIPduSignalRef=Com_Signal_CanNodeNum_02_TxBasic_11
          ComTxIPdu: ComTxIPduUnusedAreasDefault=0
            ComTxModeTrue
              ComTxMode: ComTxModeNumberOfRepetitions=0, ComTxModeMode=DIRECT, ComTxModeTimeOffset=0.0, ComTxModeTimePeriod=0.1, ComTxModeRepetitionPeriod=0
            ComTxModeFalse
              ComTxMode: ComTxModeNumberOfRepetitions=0, ComTxModeMode=DIRECT, ComTxModeTimeOffset=0.0, ComTxModeTimePeriod=0.1, ComTxModeRepetitionPeriod=0
        Com_IPdu_CanNodeNum_02_TxBasic_12: ComIPduDirection=SEND, ComPduIdRef=CanPdu_Com2PduR_CanNodeNum_02_TxBasic_12, ComIPduGroupRef=ComIPduGroup_CanNodeNum_02_Tx, ComIPduSignalRef=Com_Signal_CanNodeNum_02_TxBasic_12
          ComTxIPdu: ComTxIPduUnusedAreasDefault=0
            ComTxModeTrue
              ComTxMode: ComTxModeNumberOfRepetitions=0, ComTxModeMode=DIRECT, ComTxModeTimeOffset=0.0, ComTxModeTimePeriod=0.1, ComTxModeRepetitionPeriod=0.0
            ComTxModeFalse
              ComTxMode: ComTxModeNumberOfRepetitions=0, ComTxModeMode=DIRECT, ComTxModeTimeOffset=0.0, ComTxModeTimePeriod=0.1, ComTxModeRepetitionPeriod=0
        Com_IPdu_CanNodeNum_02_TxBasic_13: ComIPduDirection=SEND, ComPduIdRef=CanPdu_Com2PduR_CanNodeNum_02_TxBasic_13, ComIPduGroupRef=ComIPduGroup_CanNodeNum_02_Tx, ComIPduSignalRef=Com_Signal_CanNodeNum_02_TxBasic_13
          ComTxIPdu: ComTxIPduUnusedAreasDefault=0
            ComTxModeTrue
              ComTxMode: ComTxModeNumberOfRepetitions=0, ComTxModeMode=DIRECT, ComTxModeTimeOffset=0.0, ComTxModeTimePeriod=0.1, ComTxModeRepetitionPeriod=0.0
            ComTxModeFalse
              ComTxMode: ComTxModeNumberOfRepetitions=0, ComTxModeMode=DIRECT, ComTxModeTimeOffset=0.0, ComTxModeTimePeriod=0.1, ComTxModeRepetitionPeriod=0
        Com_IPdu_CanNodeNum_02_TxBasic_14: ComIPduDirection=SEND, ComPduIdRef=CanPdu_Com2PduR_CanNodeNum_02_TxBasic_14, ComIPduGroupRef=ComIPduGroup_CanNodeNum_02_Tx, ComIPduSignalRef=Com_Signal_CanNodeNum_02_TxBasic_14
          ComTxIPdu: ComTxIPduUnusedAreasDefault=0
            ComTxModeTrue
              ComTxMode: ComTxModeNumberOfRepetitions=0, ComTxModeMode=DIRECT, ComTxModeTimeOffset=0.0, ComTxModeTimePeriod=0.1, ComTxModeRepetitionPeriod=0
            ComTxModeFalse
              ComTxMode: ComTxModeNumberOfRepetitions=0, ComTxModeMode=DIRECT, ComTxModeTimeOffset=0.0, ComTxModeTimePeriod=0.1, ComTxModeRepetitionPeriod=0.0
        Com_IPdu_CanNodeNum_02_TxBasic_15: ComIPduDirection=SEND, ComPduIdRef=CanPdu_Com2PduR_CanNodeNum_02_TxBasic_15, ComIPduGroupRef=ComIPduGroup_CanNodeNum_02_Tx, ComIPduSignalRef=Com_Signal_CanNodeNum_02_TxBasic_15
          ComTxIPdu: ComTxIPduUnusedAreasDefault=0
            ComTxModeTrue
              ComTxMode: ComTxModeNumberOfRepetitions=0, ComTxModeMode=DIRECT, ComTxModeTimeOffset=0.0, ComTxModeTimePeriod=0.1, ComTxModeRepetitionPeriod=0
            ComTxModeFalse
              ComTxMode: ComTxModeNumberOfRepetitions=0, ComTxModeMode=DIRECT, ComTxModeTimeOffset=0.0, ComTxModeTimePeriod=0.1, ComTxModeRepetitionPeriod=0.0
        Com_IPdu_CanNodeNum_02_TxBasic_16: ComIPduDirection=SEND, ComPduIdRef=CanPdu_Com2PduR_CanNodeNum_02_TxBasic_16, ComIPduGroupRef=ComIPduGroup_CanNodeNum_02_Tx, ComIPduSignalRef=Com_Signal_CanNodeNum_02_TxBasic_16
          ComTxIPdu: ComTxIPduUnusedAreasDefault=0
            ComTxModeTrue
              ComTxMode: ComTxModeNumberOfRepetitions=0, ComTxModeMode=DIRECT, ComTxModeTimeOffset=0.0, ComTxModeTimePeriod=0.1, ComTxModeRepetitionPeriod=0
            ComTxModeFalse
              ComTxMode: ComTxModeNumberOfRepetitions=0, ComTxModeMode=DIRECT, ComTxModeTimeOffset=0.0, ComTxModeTimePeriod=0.1, ComTxModeRepetitionPeriod=0
        Com_IPdu_CanNodeNum_02_TxBasic_17: ComIPduDirection=SEND, ComPduIdRef=CanPdu_Com2PduR_CanNodeNum_02_TxBasic_17, ComIPduGroupRef=ComIPduGroup_CanNodeNum_02_Tx, ComIPduSignalRef=Com_Signal_CanNodeNum_02_TxBasic_17
          ComTxIPdu: ComTxIPduUnusedAreasDefault=0
            ComTxModeTrue
              ComTxMode: ComTxModeNumberOfRepetitions=0, ComTxModeMode=DIRECT, ComTxModeTimeOffset=0.0, ComTxModeTimePeriod=0.1, ComTxModeRepetitionPeriod=0
            ComTxModeFalse
              ComTxMode: ComTxModeNumberOfRepetitions=0, ComTxModeMode=DIRECT, ComTxModeTimeOffset=0.0, ComTxModeTimePeriod=0.1, ComTxModeRepetitionPeriod=0.0
        Com_IPdu_CanNodeNum_02_TxBasic_18: ComIPduDirection=SEND, ComPduIdRef=CanPdu_Com2PduR_CanNodeNum_02_TxBasic_18, ComIPduGroupRef=ComIPduGroup_CanNodeNum_02_Tx, ComIPduSignalRef=Com_Signal_CanNodeNum_02_TxBasic_18
          ComTxIPdu: ComTxIPduUnusedAreasDefault=0
            ComTxModeTrue
              ComTxMode: ComTxModeNumberOfRepetitions=0, ComTxModeMode=DIRECT, ComTxModeTimeOffset=0.0, ComTxModeTimePeriod=0.1, ComTxModeRepetitionPeriod=0
            ComTxModeFalse
              ComTxMode: ComTxModeNumberOfRepetitions=0, ComTxModeMode=DIRECT, ComTxModeTimeOffset=0.0, ComTxModeTimePeriod=0.1, ComTxModeRepetitionPeriod=0
        Com_IPdu_CanNodeNum_02_TxBasic_19: ComIPduDirection=SEND, ComPduIdRef=CanPdu_Com2PduR_CanNodeNum_02_TxBasic_19, ComIPduGroupRef=ComIPduGroup_CanNodeNum_02_Tx, ComIPduSignalRef=Com_Signal_CanNodeNum_02_TxBasic_19
          ComTxIPdu: ComTxIPduUnusedAreasDefault=0
            ComTxModeTrue
              ComTxMode: ComTxModeNumberOfRepetitions=0, ComTxModeMode=DIRECT, ComTxModeTimeOffset=0.0, ComTxModeTimePeriod=0.1, ComTxModeRepetitionPeriod=0
            ComTxModeFalse
              ComTxMode: ComTxModeNumberOfRepetitions=0, ComTxModeMode=DIRECT, ComTxModeTimeOffset=0.0, ComTxModeTimePeriod=0.1, ComTxModeRepetitionPeriod=0
        Com_IPdu_CanNodeNum_02_TxBasic_20: ComIPduDirection=SEND, ComPduIdRef=CanPdu_Com2PduR_CanNodeNum_02_TxBasic_20, ComIPduGroupRef=ComIPduGroup_CanNodeNum_02_Tx, ComIPduSignalRef=Com_Signal_CanNodeNum_02_TxBasic_20
          ComTxIPdu: ComTxIPduUnusedAreasDefault=0
            ComTxModeTrue
              ComTxMode: ComTxModeNumberOfRepetitions=0, ComTxModeMode=DIRECT, ComTxModeTimeOffset=0.0, ComTxModeTimePeriod=0.1, ComTxModeRepetitionPeriod=0
            ComTxModeFalse
              ComTxMode: ComTxModeNumberOfRepetitions=0, ComTxModeMode=DIRECT, ComTxModeTimeOffset=0.0, ComTxModeTimePeriod=0.1, ComTxModeRepetitionPeriod=0
        Com_IPdu_CanNodeNum_02_Tx_01: ComIPduDirection=SEND, ComIPduCallout=Bsw_IPduCallout_CanNodeNum_02_Tx_01, ComPduIdRef=CanPdu_Com2PduR_CanNodeNum_02_Tx_01, ComIPduSignalRef=Com_Signal_CanNodeNum_02_Tx_01, ComIPduGroupRef=ComIPduGroup_CanNodeNum_02_Tx
          ComTxIPdu: ComTxIPduUnusedAreasDefault=0
            ComTxModeFalse
              ComTxMode_0 (ComTxMode): ComTxModeMode=DIRECT, ComTxModeNumberOfRepetitions=0, ComTxModeRepetitionPeriod=0.0, ComTxModeTimeOffset=0.0, ComTxModeTimePeriod=0.1
            ComTxModeTrue
              ComTxMode_0 (ComTxMode): ComTxModeMode=DIRECT, ComTxModeNumberOfRepetitions=0, ComTxModeRepetitionPeriod=0.0, ComTxModeTimeOffset=0.0, ComTxModeTimePeriod=0.1
        Com_IPdu_CanNodeNum_02_Tx_02: ComIPduDirection=SEND, ComIPduCallout=Bsw_IPduCallout_CanNodeNum_02_Tx_02, ComPduIdRef=CanPdu_Com2PduR_CanNodeNum_02_Tx_02, ComIPduSignalRef=Com_Signal_CanNodeNum_02_Tx_02, ComIPduGroupRef=ComIPduGroup_CanNodeNum_02_Tx
          ComTxIPdu: ComTxIPduUnusedAreasDefault=0
            ComTxModeFalse
              ComTxMode_0 (ComTxMode): ComTxModeMode=DIRECT, ComTxModeNumberOfRepetitions=0, ComTxModeRepetitionPeriod=0.0, ComTxModeTimeOffset=0.0, ComTxModeTimePeriod=0.1
            ComTxModeTrue
              ComTxMode_0 (ComTxMode): ComTxModeMode=DIRECT, ComTxModeNumberOfRepetitions=0, ComTxModeRepetitionPeriod=0.0, ComTxModeTimeOffset=0.0, ComTxModeTimePeriod=0.1
        Com_IPdu_CanNodeNum_02_Tx_03: ComIPduDirection=SEND, ComPduIdRef=CanPdu_Com2PduR_CanNodeNum_02_Tx_03, ComIPduSignalRef=Com_Signal_CanNodeNum_02_Tx_03, ComIPduGroupRef=ComIPduGroup_CanNodeNum_02_Tx
          ComTxIPdu: ComTxIPduUnusedAreasDefault=0
            ComTxModeFalse
              ComTxMode_0 (ComTxMode): ComTxModeMode=DIRECT, ComTxModeNumberOfRepetitions=0, ComTxModeRepetitionPeriod=0.0, ComTxModeTimeOffset=0.0, ComTxModeTimePeriod=0.1
            ComTxModeTrue
              ComTxMode_0 (ComTxMode): ComTxModeMode=DIRECT, ComTxModeNumberOfRepetitions=0, ComTxModeRepetitionPeriod=0.0, ComTxModeTimeOffset=0.0, ComTxModeTimePeriod=0.1
        Com_IPdu_CanNodeNum_02_Tx_04: ComIPduDirection=SEND, ComPduIdRef=CanPdu_Com2PduR_CanNodeNum_02_Tx_04, ComIPduSignalRef=Com_Signal_CanNodeNum_02_Tx_04, ComIPduGroupRef=ComIPduGroup_CanNodeNum_02_Tx
          ComTxIPdu: ComTxIPduUnusedAreasDefault=0
            ComTxModeFalse
              ComTxMode_0 (ComTxMode): ComTxModeMode=DIRECT, ComTxModeNumberOfRepetitions=0, ComTxModeRepetitionPeriod=0.0, ComTxModeTimeOffset=0.0, ComTxModeTimePeriod=0.1
            ComTxModeTrue
              ComTxMode_0 (ComTxMode): ComTxModeMode=DIRECT, ComTxModeNumberOfRepetitions=0, ComTxModeRepetitionPeriod=0.0, ComTxModeTimeOffset=0.0, ComTxModeTimePeriod=0.1
        Com_IPdu_CanNodeNum_02_Tx_05: ComIPduDirection=SEND, ComPduIdRef=CanPdu_Com2PduR_CanNodeNum_02_Tx_05, ComIPduSignalRef=Com_Signal_CanNodeNum_02_Tx_05, ComIPduGroupRef=ComIPduGroup_CanNodeNum_02_Tx
          ComTxIPdu: ComTxIPduUnusedAreasDefault=0
            ComTxModeFalse
              ComTxMode_0 (ComTxMode): ComTxModeMode=DIRECT, ComTxModeNumberOfRepetitions=0, ComTxModeRepetitionPeriod=0.0, ComTxModeTimeOffset=0.0, ComTxModeTimePeriod=0.1
            ComTxModeTrue
              ComTxMode_0 (ComTxMode): ComTxModeMode=DIRECT, ComTxModeNumberOfRepetitions=0, ComTxModeRepetitionPeriod=0.0, ComTxModeTimeOffset=0.0, ComTxModeTimePeriod=0.1
        Com_IPdu_CanNodeNum_02_Tx_06: ComIPduDirection=SEND, ComPduIdRef=CanPdu_Com2PduR_CanNodeNum_02_Tx_06, ComIPduSignalRef=Com_Signal_CanNodeNum_02_Tx_06, ComIPduGroupRef=ComIPduGroup_CanNodeNum_02_Tx
          ComTxIPdu: ComTxIPduUnusedAreasDefault=0
            ComTxModeFalse
              ComTxMode_0 (ComTxMode): ComTxModeMode=DIRECT, ComTxModeNumberOfRepetitions=0, ComTxModeRepetitionPeriod=0.0, ComTxModeTimeOffset=0.0, ComTxModeTimePeriod=0.1
            ComTxModeTrue
              ComTxMode_0 (ComTxMode): ComTxModeMode=DIRECT, ComTxModeNumberOfRepetitions=0, ComTxModeRepetitionPeriod=0.0, ComTxModeTimeOffset=0.0, ComTxModeTimePeriod=0.1
        Com_IPdu_CanNodeNum_02_Tx_07: ComIPduDirection=SEND, ComPduIdRef=CanPdu_Com2PduR_CanNodeNum_02_Tx_07, ComIPduSignalRef=Com_Signal_CanNodeNum_02_Tx_07, ComIPduGroupRef=ComIPduGroup_CanNodeNum_02_Tx
          ComTxIPdu: ComTxIPduUnusedAreasDefault=0
            ComTxModeFalse
              ComTxMode_0 (ComTxMode): ComTxModeMode=DIRECT, ComTxModeNumberOfRepetitions=0, ComTxModeRepetitionPeriod=0.0, ComTxModeTimeOffset=0.0, ComTxModeTimePeriod=0.1
            ComTxModeTrue
              ComTxMode_0 (ComTxMode): ComTxModeMode=DIRECT, ComTxModeNumberOfRepetitions=0, ComTxModeRepetitionPeriod=0.0, ComTxModeTimeOffset=0.0, ComTxModeTimePeriod=0.1
        Com_IPdu_CanNodeNum_02_Tx_08: ComIPduDirection=SEND, ComPduIdRef=CanPdu_Com2PduR_CanNodeNum_02_Tx_08, ComIPduSignalRef=Com_Signal_CanNodeNum_02_Tx_08, ComIPduGroupRef=ComIPduGroup_CanNodeNum_02_Tx
          ComTxIPdu: ComTxIPduUnusedAreasDefault=0
            ComTxModeFalse
              ComTxMode_0 (ComTxMode): ComTxModeMode=DIRECT, ComTxModeNumberOfRepetitions=0, ComTxModeRepetitionPeriod=0.0, ComTxModeTimeOffset=0.0, ComTxModeTimePeriod=0.1
            ComTxModeTrue
              ComTxMode_0 (ComTxMode): ComTxModeMode=DIRECT, ComTxModeNumberOfRepetitions=0, ComTxModeRepetitionPeriod=0.0, ComTxModeTimeOffset=0.0, ComTxModeTimePeriod=0.1
        Com_IPdu_CanNodeNum_02_Tx_09: ComIPduDirection=SEND, ComPduIdRef=CanPdu_Com2PduR_CanNodeNum_02_Tx_09, ComIPduSignalRef=Com_Signal_CanNodeNum_02_Tx_09, ComIPduGroupRef=ComIPduGroup_CanNodeNum_02_Tx
          ComTxIPdu: ComTxIPduUnusedAreasDefault=0
            ComTxModeFalse
              ComTxMode_0 (ComTxMode): ComTxModeMode=DIRECT, ComTxModeNumberOfRepetitions=0, ComTxModeRepetitionPeriod=0.0, ComTxModeTimeOffset=0.0, ComTxModeTimePeriod=0.1
            ComTxModeTrue
              ComTxMode_0 (ComTxMode): ComTxModeMode=DIRECT, ComTxModeNumberOfRepetitions=0, ComTxModeRepetitionPeriod=0.0, ComTxModeTimeOffset=0.0, ComTxModeTimePeriod=0.1
        Com_IPdu_CanNodeNum_02_Tx_10: ComIPduDirection=SEND, ComPduIdRef=CanPdu_Com2PduR_CanNodeNum_02_Tx_10, ComIPduSignalRef=Com_Signal_CanNodeNum_02_Tx_10, ComIPduGroupRef=ComIPduGroup_CanNodeNum_02_Tx
          ComTxIPdu: ComTxIPduUnusedAreasDefault=0
            ComTxModeFalse
              ComTxMode_0 (ComTxMode): ComTxModeMode=DIRECT, ComTxModeNumberOfRepetitions=0, ComTxModeRepetitionPeriod=0.0, ComTxModeTimeOffset=0.0, ComTxModeTimePeriod=0.1
            ComTxModeTrue
              ComTxMode_0 (ComTxMode): ComTxModeMode=DIRECT, ComTxModeNumberOfRepetitions=0, ComTxModeRepetitionPeriod=0.0, ComTxModeTimeOffset=0.0, ComTxModeTimePeriod=0.1
        Com_IPdu_CanNodeNum_02_Tx_11: ComIPduDirection=SEND, ComPduIdRef=CanPdu_Com2PduR_CanNodeNum_02_Tx_11, ComIPduSignalRef=Com_Signal_CanNodeNum_02_Tx_11, ComIPduGroupRef=ComIPduGroup_CanNodeNum_02_Tx
          ComTxIPdu: ComTxIPduUnusedAreasDefault=0
            ComTxModeFalse
              ComTxMode_0 (ComTxMode): ComTxModeMode=DIRECT, ComTxModeNumberOfRepetitions=0, ComTxModeRepetitionPeriod=0.0, ComTxModeTimeOffset=0.0, ComTxModeTimePeriod=0.1
            ComTxModeTrue
              ComTxMode_0 (ComTxMode): ComTxModeMode=DIRECT, ComTxModeNumberOfRepetitions=0, ComTxModeRepetitionPeriod=0.0, ComTxModeTimeOffset=0.0, ComTxModeTimePeriod=0.1
        Com_IPdu_CanNodeNum_02_Tx_12: ComIPduDirection=SEND, ComPduIdRef=CanPdu_Com2PduR_CanNodeNum_02_Tx_12, ComIPduSignalRef=Com_Signal_CanNodeNum_02_Tx_12, ComIPduGroupRef=ComIPduGroup_CanNodeNum_02_Tx
          ComTxIPdu: ComTxIPduUnusedAreasDefault=0
            ComTxModeFalse
              ComTxMode_0 (ComTxMode): ComTxModeMode=DIRECT, ComTxModeNumberOfRepetitions=0, ComTxModeRepetitionPeriod=0.0, ComTxModeTimeOffset=0.0, ComTxModeTimePeriod=0.1
            ComTxModeTrue
              ComTxMode_0 (ComTxMode): ComTxModeMode=DIRECT, ComTxModeNumberOfRepetitions=0, ComTxModeRepetitionPeriod=0.0, ComTxModeTimeOffset=0.0, ComTxModeTimePeriod=0.1
        Com_IPdu_CanNodeNum_02_Tx_13: ComIPduDirection=SEND, ComPduIdRef=CanPdu_Com2PduR_CanNodeNum_02_Tx_13, ComIPduSignalRef=Com_Signal_CanNodeNum_02_Tx_13, ComIPduGroupRef=ComIPduGroup_CanNodeNum_02_Tx
          ComTxIPdu: ComTxIPduUnusedAreasDefault=0
            ComTxModeFalse
              ComTxMode_0 (ComTxMode): ComTxModeMode=DIRECT, ComTxModeNumberOfRepetitions=0, ComTxModeRepetitionPeriod=0.0, ComTxModeTimeOffset=0.0, ComTxModeTimePeriod=0.1
            ComTxModeTrue
              ComTxMode_0 (ComTxMode): ComTxModeMode=DIRECT, ComTxModeNumberOfRepetitions=0, ComTxModeRepetitionPeriod=0.0, ComTxModeTimeOffset=0.0, ComTxModeTimePeriod=0.1
        Com_IPdu_CanNodeNum_02_Tx_14: ComIPduDirection=SEND, ComPduIdRef=CanPdu_Com2PduR_CanNodeNum_02_Tx_14, ComIPduSignalRef=Com_Signal_CanNodeNum_02_Tx_14, ComIPduGroupRef=ComIPduGroup_CanNodeNum_02_Tx
          ComTxIPdu: ComTxIPduUnusedAreasDefault=0
            ComTxModeFalse
              ComTxMode_0 (ComTxMode): ComTxModeMode=DIRECT, ComTxModeNumberOfRepetitions=0, ComTxModeRepetitionPeriod=0.0, ComTxModeTimeOffset=0.0, ComTxModeTimePeriod=0.1
            ComTxModeTrue
              ComTxMode_0 (ComTxMode): ComTxModeMode=DIRECT, ComTxModeNumberOfRepetitions=0, ComTxModeRepetitionPeriod=0.0, ComTxModeTimeOffset=0.0, ComTxModeTimePeriod=0.1
        Com_IPdu_CanNodeNum_02_Tx_15: ComIPduDirection=SEND, ComPduIdRef=CanPdu_Com2PduR_CanNodeNum_02_Tx_15, ComIPduSignalRef=Com_Signal_CanNodeNum_02_Tx_15, ComIPduGroupRef=ComIPduGroup_CanNodeNum_02_Tx
          ComTxIPdu: ComTxIPduUnusedAreasDefault=0
            ComTxModeFalse
              ComTxMode_0 (ComTxMode): ComTxModeMode=DIRECT, ComTxModeNumberOfRepetitions=0, ComTxModeRepetitionPeriod=0.0, ComTxModeTimeOffset=0.0, ComTxModeTimePeriod=0.1
            ComTxModeTrue
              ComTxMode_0 (ComTxMode): ComTxModeMode=DIRECT, ComTxModeNumberOfRepetitions=0, ComTxModeRepetitionPeriod=0.0, ComTxModeTimeOffset=0.0, ComTxModeTimePeriod=0.1
        Com_IPdu_CanNodeNum_02_Tx_16: ComIPduDirection=SEND, ComPduIdRef=CanPdu_Com2PduR_CanNodeNum_02_Tx_16, ComIPduSignalRef=Com_Signal_CanNodeNum_02_Tx_16, ComIPduGroupRef=ComIPduGroup_CanNodeNum_02_Tx
          ComTxIPdu: ComTxIPduUnusedAreasDefault=0
            ComTxModeFalse
              ComTxMode_0 (ComTxMode): ComTxModeMode=DIRECT, ComTxModeNumberOfRepetitions=0, ComTxModeRepetitionPeriod=0.0, ComTxModeTimeOffset=0.0, ComTxModeTimePeriod=0.1
            ComTxModeTrue
              ComTxMode_0 (ComTxMode): ComTxModeMode=DIRECT, ComTxModeNumberOfRepetitions=0, ComTxModeRepetitionPeriod=0.0, ComTxModeTimeOffset=0.0, ComTxModeTimePeriod=0.1
        Com_IPdu_CanNodeNum_02_Tx_17: ComIPduDirection=SEND, ComPduIdRef=CanPdu_Com2PduR_CanNodeNum_02_Tx_17, ComIPduSignalRef=Com_Signal_CanNodeNum_02_Tx_17, ComIPduGroupRef=ComIPduGroup_CanNodeNum_02_Tx
          ComTxIPdu: ComTxIPduUnusedAreasDefault=0
            ComTxModeFalse
              ComTxMode_0 (ComTxMode): ComTxModeMode=DIRECT, ComTxModeNumberOfRepetitions=0, ComTxModeRepetitionPeriod=0.0, ComTxModeTimeOffset=0.0, ComTxModeTimePeriod=0.1
            ComTxModeTrue
              ComTxMode_0 (ComTxMode): ComTxModeMode=DIRECT, ComTxModeNumberOfRepetitions=0, ComTxModeRepetitionPeriod=0.0, ComTxModeTimeOffset=0.0, ComTxModeTimePeriod=0.1
        Com_IPdu_CanNodeNum_02_Tx_18: ComIPduDirection=SEND, ComPduIdRef=CanPdu_Com2PduR_CanNodeNum_02_Tx_18, ComIPduSignalRef=Com_Signal_CanNodeNum_02_Tx_18, ComIPduGroupRef=ComIPduGroup_CanNodeNum_02_Tx
          ComTxIPdu: ComTxIPduUnusedAreasDefault=0
            ComTxModeFalse
              ComTxMode_0 (ComTxMode): ComTxModeMode=DIRECT, ComTxModeNumberOfRepetitions=0, ComTxModeRepetitionPeriod=0.0, ComTxModeTimeOffset=0.0, ComTxModeTimePeriod=0.1
            ComTxModeTrue
              ComTxMode_0 (ComTxMode): ComTxModeMode=DIRECT, ComTxModeNumberOfRepetitions=0, ComTxModeRepetitionPeriod=0.0, ComTxModeTimeOffset=0.0, ComTxModeTimePeriod=0.1
        Com_IPdu_CanNodeNum_02_Tx_19: ComIPduDirection=SEND, ComPduIdRef=CanPdu_Com2PduR_CanNodeNum_02_Tx_19, ComIPduSignalRef=Com_Signal_CanNodeNum_02_Tx_19, ComIPduGroupRef=ComIPduGroup_CanNodeNum_02_Tx
          ComTxIPdu: ComTxIPduUnusedAreasDefault=0
            ComTxModeFalse
              ComTxMode_0 (ComTxMode): ComTxModeMode=DIRECT, ComTxModeNumberOfRepetitions=0, ComTxModeRepetitionPeriod=0.0, ComTxModeTimeOffset=0.0, ComTxModeTimePeriod=0.1
            ComTxModeTrue
              ComTxMode_0 (ComTxMode): ComTxModeMode=DIRECT, ComTxModeNumberOfRepetitions=0, ComTxModeRepetitionPeriod=0.0, ComTxModeTimeOffset=0.0, ComTxModeTimePeriod=0.1
        Com_IPdu_CanNodeNum_02_Tx_20: ComIPduDirection=SEND, ComPduIdRef=CanPdu_Com2PduR_CanNodeNum_02_Tx_20, ComIPduSignalRef=Com_Signal_CanNodeNum_02_Tx_20, ComIPduGroupRef=ComIPduGroup_CanNodeNum_02_Tx
          ComTxIPdu: ComTxIPduUnusedAreasDefault=0
            ComTxModeFalse
              ComTxMode_0 (ComTxMode): ComTxModeMode=DIRECT, ComTxModeNumberOfRepetitions=0, ComTxModeRepetitionPeriod=0.0, ComTxModeTimeOffset=0.0, ComTxModeTimePeriod=0.1
            ComTxModeTrue
              ComTxMode_0 (ComTxMode): ComTxModeMode=DIRECT, ComTxModeNumberOfRepetitions=0, ComTxModeRepetitionPeriod=0.0, ComTxModeTimeOffset=0.0, ComTxModeTimePeriod=0.1
        Com_IPdu_CanNodeNum_02_Tx_21: ComIPduDirection=SEND, ComPduIdRef=CanPdu_Com2PduR_CanNodeNum_02_Tx_21, ComIPduSignalRef=Com_Signal_CanNodeNum_02_Tx_21, ComIPduGroupRef=ComIPduGroup_CanNodeNum_02_Tx
          ComTxIPdu: ComTxIPduUnusedAreasDefault=0
            ComTxModeFalse
              ComTxMode_0 (ComTxMode): ComTxModeMode=DIRECT, ComTxModeNumberOfRepetitions=0, ComTxModeRepetitionPeriod=0.0, ComTxModeTimeOffset=0.0, ComTxModeTimePeriod=0.1
            ComTxModeTrue
              ComTxMode_0 (ComTxMode): ComTxModeMode=DIRECT, ComTxModeNumberOfRepetitions=0, ComTxModeRepetitionPeriod=0.0, ComTxModeTimeOffset=0.0, ComTxModeTimePeriod=0.1
        Com_IPdu_CanNodeNum_02_Tx_22: ComIPduDirection=SEND, ComPduIdRef=CanPdu_Com2PduR_CanNodeNum_02_Tx_22, ComIPduSignalRef=Com_Signal_CanNodeNum_02_Tx_22, ComIPduGroupRef=ComIPduGroup_CanNodeNum_02_Tx
          ComTxIPdu: ComTxIPduUnusedAreasDefault=0
            ComTxModeFalse
              ComTxMode_0 (ComTxMode): ComTxModeMode=DIRECT, ComTxModeNumberOfRepetitions=0, ComTxModeRepetitionPeriod=0.0, ComTxModeTimeOffset=0.0, ComTxModeTimePeriod=0.1
            ComTxModeTrue
              ComTxMode_0 (ComTxMode): ComTxModeMode=DIRECT, ComTxModeNumberOfRepetitions=0, ComTxModeRepetitionPeriod=0.0, ComTxModeTimeOffset=0.0, ComTxModeTimePeriod=0.1
        Com_IPdu_CanNodeNum_02_Tx_23: ComIPduDirection=SEND, ComPduIdRef=CanPdu_Com2PduR_CanNodeNum_02_Tx_23, ComIPduSignalRef=Com_Signal_CanNodeNum_02_Tx_23, ComIPduGroupRef=ComIPduGroup_CanNodeNum_02_Tx
          ComTxIPdu: ComTxIPduUnusedAreasDefault=0
            ComTxModeFalse
              ComTxMode_0 (ComTxMode): ComTxModeMode=DIRECT, ComTxModeNumberOfRepetitions=0, ComTxModeRepetitionPeriod=0.0, ComTxModeTimeOffset=0.0, ComTxModeTimePeriod=0.1
            ComTxModeTrue
              ComTxMode_0 (ComTxMode): ComTxModeMode=DIRECT, ComTxModeNumberOfRepetitions=0, ComTxModeRepetitionPeriod=0.0, ComTxModeTimeOffset=0.0, ComTxModeTimePeriod=0.1
        Com_IPdu_CanNodeNum_02_Tx_24: ComIPduDirection=SEND, ComPduIdRef=CanPdu_Com2PduR_CanNodeNum_02_Tx_24, ComIPduSignalRef=Com_Signal_CanNodeNum_02_Tx_24, ComIPduGroupRef=ComIPduGroup_CanNodeNum_02_Tx
          ComTxIPdu: ComTxIPduUnusedAreasDefault=0
            ComTxModeFalse
              ComTxMode_0 (ComTxMode): ComTxModeMode=DIRECT, ComTxModeNumberOfRepetitions=0, ComTxModeRepetitionPeriod=0.0, ComTxModeTimeOffset=0.0, ComTxModeTimePeriod=0.1
            ComTxModeTrue
              ComTxMode_0 (ComTxMode): ComTxModeMode=DIRECT, ComTxModeNumberOfRepetitions=0, ComTxModeRepetitionPeriod=0.0, ComTxModeTimeOffset=0.0, ComTxModeTimePeriod=0.1
        Com_IPdu_CanNodeNum_02_Tx_25: ComIPduDirection=SEND, ComPduIdRef=CanPdu_Com2PduR_CanNodeNum_02_Tx_25, ComIPduSignalRef=Com_Signal_CanNodeNum_02_Tx_25, ComIPduGroupRef=ComIPduGroup_CanNodeNum_02_Tx
          ComTxIPdu: ComTxIPduUnusedAreasDefault=0
            ComTxModeFalse
              ComTxMode_0 (ComTxMode): ComTxModeMode=DIRECT, ComTxModeNumberOfRepetitions=0, ComTxModeRepetitionPeriod=0.0, ComTxModeTimeOffset=0.0, ComTxModeTimePeriod=0.1
            ComTxModeTrue
              ComTxMode_0 (ComTxMode): ComTxModeMode=DIRECT, ComTxModeNumberOfRepetitions=0, ComTxModeRepetitionPeriod=0.0, ComTxModeTimeOffset=0.0, ComTxModeTimePeriod=0.1
        Com_IPdu_CanNodeNum_02_Tx_26: ComIPduDirection=SEND, ComPduIdRef=CanPdu_Com2PduR_CanNodeNum_02_Tx_26, ComIPduSignalRef=Com_Signal_CanNodeNum_02_Tx_26, ComIPduGroupRef=ComIPduGroup_CanNodeNum_02_Tx
          ComTxIPdu: ComTxIPduUnusedAreasDefault=0
            ComTxModeFalse
              ComTxMode_0 (ComTxMode): ComTxModeMode=DIRECT, ComTxModeNumberOfRepetitions=0, ComTxModeRepetitionPeriod=0.0, ComTxModeTimeOffset=0.0, ComTxModeTimePeriod=0.1
            ComTxModeTrue
              ComTxMode_0 (ComTxMode): ComTxModeMode=DIRECT, ComTxModeNumberOfRepetitions=0, ComTxModeRepetitionPeriod=0.0, ComTxModeTimeOffset=0.0, ComTxModeTimePeriod=0.1
        Com_IPdu_CanNodeNum_03_Rx_01: ComIPduDirection=RECEIVE, ComTimeout=0.25, ComIpduNotificationCallback=Bsw_ComIPduAck_CanNodeNum_03_Rx_01, ComFirstTimeout=2.0, ComIPduCallout=Bsw_IPduCallout_CanNodeNum_03_Rx_01, ComPduIdRef=CanPdu_PduR2Com_CanNodeNum_03_Rx_01, ComIPduSignalRef=Com_Signal_CanNodeNum_03_Rx_01, ComIPduGroupRef=ComIPduGroup_CanNodeNum_03_Rx
        Com_IPdu_CanNodeNum_03_Rx_02: ComIPduDirection=RECEIVE, ComTimeout=0.25, ComIpduNotificationCallback=Bsw_ComIPduAck_CanNodeNum_03_Rx_02, ComFirstTimeout=2.0, ComIPduCallout=Bsw_IPduCallout_CanNodeNum_03_Rx_02, ComPduIdRef=CanPdu_PduR2Com_CanNodeNum_03_Rx_02, ComIPduSignalRef=Com_Signal_CanNodeNum_03_Rx_02, ComIPduGroupRef=ComIPduGroup_CanNodeNum_03_Rx
        Com_IPdu_CanNodeNum_03_Rx_03: ComIPduDirection=RECEIVE, ComTimeout=0.25, ComFirstTimeout=2.0, ComIpduNotificationCallback=Bsw_ComIPduAck_CanNodeNum_03_Rx_03, ComPduIdRef=CanPdu_PduR2Com_CanNodeNum_03_Rx_03, ComIPduSignalRef=Com_Signal_CanNodeNum_03_Rx_03, ComIPduGroupRef=ComIPduGroup_CanNodeNum_03_Rx
        Com_IPdu_CanNodeNum_03_Rx_04: ComIPduDirection=RECEIVE, ComTimeout=0.25, ComFirstTimeout=2.0, ComIpduNotificationCallback=Bsw_ComIPduAck_CanNodeNum_03_Rx_04, ComPduIdRef=CanPdu_PduR2Com_CanNodeNum_03_Rx_04, ComIPduSignalRef=Com_Signal_CanNodeNum_03_Rx_04, ComIPduGroupRef=ComIPduGroup_CanNodeNum_03_Rx
        Com_IPdu_CanNodeNum_03_Rx_{05..40}: ComIPduDirection=RECEIVE, ComTimeout=0.25, ComFirstTimeout=2.0, ComPduIdRef=CanPdu_PduR2Com_CanNodeNum_03_Rx_{05..40}, ComIPduSignalRef=Com_Signal_CanNodeNum_03_Rx_{05..40}, ComIPduGroupRef=ComIPduGroup_CanNodeNum_03_Rx
        Com_IPdu_CanNodeNum_03_TxBasic_01: ComIPduDirection=SEND, ComPduIdRef=CanPdu_Com2PduR_CanNodeNum_03_TxBasic_01, ComIPduSignalRef=Com_Signal_CanNodeNum_03_TxBasic_01, ComIPduGroupRef=ComIPduGroup_CanNodeNum_03_Tx
          ComTxIPdu: ComTxIPduUnusedAreasDefault=0
            ComTxModeTrue
              ComTxMode: ComTxModeNumberOfRepetitions=0, ComTxModeMode=DIRECT, ComTxModeTimeOffset=0.0, ComTxModeTimePeriod=0.1, ComTxModeRepetitionPeriod=0
            ComTxModeFalse
              ComTxMode: ComTxModeNumberOfRepetitions=0, ComTxModeMode=DIRECT, ComTxModeTimeOffset=0.0, ComTxModeTimePeriod=0.1, ComTxModeRepetitionPeriod=0
        Com_IPdu_CanNodeNum_03_TxBasic_02: ComIPduDirection=SEND, ComPduIdRef=CanPdu_Com2PduR_CanNodeNum_03_TxBasic_02, ComIPduSignalRef=Com_Signal_CanNodeNum_03_TxBasic_02, ComIPduGroupRef=ComIPduGroup_CanNodeNum_03_Tx
          ComTxIPdu: ComTxIPduUnusedAreasDefault=0
            ComTxModeTrue
              ComTxMode: ComTxModeNumberOfRepetitions=0, ComTxModeMode=DIRECT, ComTxModeTimeOffset=0.0, ComTxModeTimePeriod=0.1, ComTxModeRepetitionPeriod=0.0
            ComTxModeFalse
              ComTxMode: ComTxModeNumberOfRepetitions=0, ComTxModeMode=DIRECT, ComTxModeTimeOffset=0.0, ComTxModeTimePeriod=0.1, ComTxModeRepetitionPeriod=0
        Com_IPdu_CanNodeNum_03_TxBasic_03: ComIPduDirection=SEND, ComPduIdRef=CanPdu_Com2PduR_CanNodeNum_03_TxBasic_03, ComIPduSignalRef=Com_Signal_CanNodeNum_03_TxBasic_03, ComIPduGroupRef=ComIPduGroup_CanNodeNum_03_Tx
          ComTxIPdu: ComTxIPduUnusedAreasDefault=0
            ComTxModeTrue
              ComTxMode: ComTxModeNumberOfRepetitions=0, ComTxModeMode=DIRECT, ComTxModeTimeOffset=0.0, ComTxModeTimePeriod=0.1, ComTxModeRepetitionPeriod=0.0
            ComTxModeFalse
              ComTxMode: ComTxModeNumberOfRepetitions=0, ComTxModeMode=DIRECT, ComTxModeTimeOffset=0.0, ComTxModeTimePeriod=0.1, ComTxModeRepetitionPeriod=0
        Com_IPdu_CanNodeNum_03_TxBasic_04: ComIPduDirection=SEND, ComPduIdRef=CanPdu_Com2PduR_CanNodeNum_03_TxBasic_04, ComIPduSignalRef=Com_Signal_CanNodeNum_03_TxBasic_04, ComIPduGroupRef=ComIPduGroup_CanNodeNum_03_Tx
          ComTxIPdu: ComTxIPduUnusedAreasDefault=0
            ComTxModeTrue
              ComTxMode: ComTxModeNumberOfRepetitions=0, ComTxModeMode=DIRECT, ComTxModeTimeOffset=0.0, ComTxModeTimePeriod=0.1, ComTxModeRepetitionPeriod=0
            ComTxModeFalse
              ComTxMode: ComTxModeNumberOfRepetitions=0, ComTxModeMode=DIRECT, ComTxModeTimeOffset=0.0, ComTxModeTimePeriod=0.1, ComTxModeRepetitionPeriod=0.0
        Com_IPdu_CanNodeNum_03_TxBasic_05: ComIPduDirection=SEND, ComPduIdRef=CanPdu_Com2PduR_CanNodeNum_03_TxBasic_05, ComIPduSignalRef=Com_Signal_CanNodeNum_03_TxBasic_05, ComIPduGroupRef=ComIPduGroup_CanNodeNum_03_Tx
          ComTxIPdu: ComTxIPduUnusedAreasDefault=0
            ComTxModeTrue
              ComTxMode: ComTxModeNumberOfRepetitions=0, ComTxModeMode=DIRECT, ComTxModeTimeOffset=0.0, ComTxModeTimePeriod=0.1, ComTxModeRepetitionPeriod=0
            ComTxModeFalse
              ComTxMode: ComTxModeNumberOfRepetitions=0, ComTxModeMode=DIRECT, ComTxModeTimeOffset=0.0, ComTxModeTimePeriod=0.1, ComTxModeRepetitionPeriod=0.0
        Com_IPdu_CanNodeNum_03_TxBasic_06: ComIPduDirection=SEND, ComPduIdRef=CanPdu_Com2PduR_CanNodeNum_03_TxBasic_06, ComIPduSignalRef=Com_Signal_CanNodeNum_03_TxBasic_06, ComIPduGroupRef=ComIPduGroup_CanNodeNum_03_Tx
          ComTxIPdu: ComTxIPduUnusedAreasDefault=0
            ComTxModeTrue
              ComTxMode: ComTxModeNumberOfRepetitions=0, ComTxModeMode=DIRECT, ComTxModeTimeOffset=0.0, ComTxModeTimePeriod=0.1, ComTxModeRepetitionPeriod=0
            ComTxModeFalse
              ComTxMode: ComTxModeNumberOfRepetitions=0, ComTxModeMode=DIRECT, ComTxModeTimeOffset=0.0, ComTxModeTimePeriod=0.1, ComTxModeRepetitionPeriod=0
        Com_IPdu_CanNodeNum_03_TxBasic_07: ComIPduDirection=SEND, ComPduIdRef=CanPdu_Com2PduR_CanNodeNum_03_TxBasic_07, ComIPduSignalRef=Com_Signal_CanNodeNum_03_TxBasic_07, ComIPduGroupRef=ComIPduGroup_CanNodeNum_03_Tx
          ComTxIPdu: ComTxIPduUnusedAreasDefault=0
            ComTxModeTrue
              ComTxMode: ComTxModeNumberOfRepetitions=0, ComTxModeMode=DIRECT, ComTxModeTimeOffset=0.0, ComTxModeTimePeriod=0.1, ComTxModeRepetitionPeriod=0
            ComTxModeFalse
              ComTxMode: ComTxModeNumberOfRepetitions=0, ComTxModeMode=DIRECT, ComTxModeTimeOffset=0.0, ComTxModeTimePeriod=0.1, ComTxModeRepetitionPeriod=0.0
        Com_IPdu_CanNodeNum_03_TxBasic_08: ComIPduDirection=SEND, ComPduIdRef=CanPdu_Com2PduR_CanNodeNum_03_TxBasic_08, ComIPduSignalRef=Com_Signal_CanNodeNum_03_TxBasic_08, ComIPduGroupRef=ComIPduGroup_CanNodeNum_03_Tx
          ComTxIPdu: ComTxIPduUnusedAreasDefault=0
            ComTxModeTrue
              ComTxMode: ComTxModeNumberOfRepetitions=0, ComTxModeMode=DIRECT, ComTxModeTimeOffset=0.0, ComTxModeTimePeriod=0.1, ComTxModeRepetitionPeriod=0
            ComTxModeFalse
              ComTxMode: ComTxModeNumberOfRepetitions=0, ComTxModeMode=DIRECT, ComTxModeTimeOffset=0.0, ComTxModeTimePeriod=0.1, ComTxModeRepetitionPeriod=0
        Com_IPdu_CanNodeNum_03_TxBasic_09: ComIPduDirection=SEND, ComPduIdRef=CanPdu_Com2PduR_CanNodeNum_03_TxBasic_09, ComIPduSignalRef=Com_Signal_CanNodeNum_03_TxBasic_09, ComIPduGroupRef=ComIPduGroup_CanNodeNum_03_Tx
          ComTxIPdu: ComTxIPduUnusedAreasDefault=0
            ComTxModeTrue
              ComTxMode: ComTxModeNumberOfRepetitions=0, ComTxModeMode=DIRECT, ComTxModeTimeOffset=0.0, ComTxModeTimePeriod=0.1, ComTxModeRepetitionPeriod=0
            ComTxModeFalse
              ComTxMode: ComTxModeNumberOfRepetitions=0, ComTxModeMode=DIRECT, ComTxModeTimeOffset=0.0, ComTxModeTimePeriod=0.1, ComTxModeRepetitionPeriod=0
        Com_IPdu_CanNodeNum_03_TxBasic_10: ComIPduDirection=SEND, ComPduIdRef=CanPdu_Com2PduR_CanNodeNum_03_TxBasic_10, ComIPduSignalRef=Com_Signal_CanNodeNum_03_TxBasic_10, ComIPduGroupRef=ComIPduGroup_CanNodeNum_03_Tx
          ComTxIPdu: ComTxIPduUnusedAreasDefault=0
            ComTxModeTrue
              ComTxMode: ComTxModeNumberOfRepetitions=0, ComTxModeMode=DIRECT, ComTxModeTimeOffset=0.0, ComTxModeTimePeriod=0.1, ComTxModeRepetitionPeriod=0
            ComTxModeFalse
              ComTxMode: ComTxModeNumberOfRepetitions=0, ComTxModeMode=DIRECT, ComTxModeTimeOffset=0.0, ComTxModeTimePeriod=0.1, ComTxModeRepetitionPeriod=0
        Com_IPdu_CanNodeNum_03_TxBasic_11: ComIPduDirection=SEND, ComPduIdRef=CanPdu_Com2PduR_CanNodeNum_03_TxBasic_11, ComIPduGroupRef=ComIPduGroup_CanNodeNum_03_Tx, ComIPduSignalRef=Com_Signal_CanNodeNum_03_TxBasic_11
          ComTxIPdu: ComTxIPduUnusedAreasDefault=0
            ComTxModeTrue
              ComTxMode: ComTxModeNumberOfRepetitions=0, ComTxModeMode=DIRECT, ComTxModeTimeOffset=0.0, ComTxModeTimePeriod=0.1, ComTxModeRepetitionPeriod=0
            ComTxModeFalse
              ComTxMode: ComTxModeNumberOfRepetitions=0, ComTxModeMode=DIRECT, ComTxModeTimeOffset=0.0, ComTxModeTimePeriod=0.1, ComTxModeRepetitionPeriod=0
        Com_IPdu_CanNodeNum_03_TxBasic_12: ComIPduDirection=SEND, ComPduIdRef=CanPdu_Com2PduR_CanNodeNum_03_TxBasic_12, ComIPduGroupRef=ComIPduGroup_CanNodeNum_03_Tx, ComIPduSignalRef=Com_Signal_CanNodeNum_03_TxBasic_12
          ComTxIPdu: ComTxIPduUnusedAreasDefault=0
            ComTxModeTrue
              ComTxMode: ComTxModeNumberOfRepetitions=0, ComTxModeMode=DIRECT, ComTxModeTimeOffset=0.0, ComTxModeTimePeriod=0.1, ComTxModeRepetitionPeriod=0.0
            ComTxModeFalse
              ComTxMode: ComTxModeNumberOfRepetitions=0, ComTxModeMode=DIRECT, ComTxModeTimeOffset=0.0, ComTxModeTimePeriod=0.1, ComTxModeRepetitionPeriod=0
        Com_IPdu_CanNodeNum_03_TxBasic_13: ComIPduDirection=SEND, ComPduIdRef=CanPdu_Com2PduR_CanNodeNum_03_TxBasic_13, ComIPduGroupRef=ComIPduGroup_CanNodeNum_03_Tx, ComIPduSignalRef=Com_Signal_CanNodeNum_03_TxBasic_13
          ComTxIPdu: ComTxIPduUnusedAreasDefault=0
            ComTxModeTrue
              ComTxMode: ComTxModeNumberOfRepetitions=0, ComTxModeMode=DIRECT, ComTxModeTimeOffset=0.0, ComTxModeTimePeriod=0.1, ComTxModeRepetitionPeriod=0.0
            ComTxModeFalse
              ComTxMode: ComTxModeNumberOfRepetitions=0, ComTxModeMode=DIRECT, ComTxModeTimeOffset=0.0, ComTxModeTimePeriod=0.1, ComTxModeRepetitionPeriod=0
        Com_IPdu_CanNodeNum_03_TxBasic_14: ComIPduDirection=SEND, ComPduIdRef=CanPdu_Com2PduR_CanNodeNum_03_TxBasic_14, ComIPduGroupRef=ComIPduGroup_CanNodeNum_03_Tx, ComIPduSignalRef=Com_Signal_CanNodeNum_03_TxBasic_14
          ComTxIPdu: ComTxIPduUnusedAreasDefault=0
            ComTxModeTrue
              ComTxMode: ComTxModeNumberOfRepetitions=0, ComTxModeMode=DIRECT, ComTxModeTimeOffset=0.0, ComTxModeTimePeriod=0.1, ComTxModeRepetitionPeriod=0
            ComTxModeFalse
              ComTxMode: ComTxModeNumberOfRepetitions=0, ComTxModeMode=DIRECT, ComTxModeTimeOffset=0.0, ComTxModeTimePeriod=0.1, ComTxModeRepetitionPeriod=0.0
        Com_IPdu_CanNodeNum_03_TxBasic_15: ComIPduDirection=SEND, ComPduIdRef=CanPdu_Com2PduR_CanNodeNum_03_TxBasic_15, ComIPduGroupRef=ComIPduGroup_CanNodeNum_03_Tx, ComIPduSignalRef=Com_Signal_CanNodeNum_03_TxBasic_15
          ComTxIPdu: ComTxIPduUnusedAreasDefault=0
            ComTxModeTrue
              ComTxMode: ComTxModeNumberOfRepetitions=0, ComTxModeMode=DIRECT, ComTxModeTimeOffset=0.0, ComTxModeTimePeriod=0.1, ComTxModeRepetitionPeriod=0
            ComTxModeFalse
              ComTxMode: ComTxModeNumberOfRepetitions=0, ComTxModeMode=DIRECT, ComTxModeTimeOffset=0.0, ComTxModeTimePeriod=0.1, ComTxModeRepetitionPeriod=0.0
        Com_IPdu_CanNodeNum_03_TxBasic_16: ComIPduDirection=SEND, ComPduIdRef=CanPdu_Com2PduR_CanNodeNum_03_TxBasic_16, ComIPduGroupRef=ComIPduGroup_CanNodeNum_03_Tx, ComIPduSignalRef=Com_Signal_CanNodeNum_03_TxBasic_16
          ComTxIPdu: ComTxIPduUnusedAreasDefault=0
            ComTxModeTrue
              ComTxMode: ComTxModeNumberOfRepetitions=0, ComTxModeMode=DIRECT, ComTxModeTimeOffset=0.0, ComTxModeTimePeriod=0.1, ComTxModeRepetitionPeriod=0
            ComTxModeFalse
              ComTxMode: ComTxModeNumberOfRepetitions=0, ComTxModeMode=DIRECT, ComTxModeTimeOffset=0.0, ComTxModeTimePeriod=0.1, ComTxModeRepetitionPeriod=0
        Com_IPdu_CanNodeNum_03_TxBasic_17: ComIPduDirection=SEND, ComPduIdRef=CanPdu_Com2PduR_CanNodeNum_03_TxBasic_17, ComIPduGroupRef=ComIPduGroup_CanNodeNum_03_Tx, ComIPduSignalRef=Com_Signal_CanNodeNum_03_TxBasic_17
          ComTxIPdu: ComTxIPduUnusedAreasDefault=0
            ComTxModeTrue
              ComTxMode: ComTxModeNumberOfRepetitions=0, ComTxModeMode=DIRECT, ComTxModeTimeOffset=0.0, ComTxModeTimePeriod=0.1, ComTxModeRepetitionPeriod=0
            ComTxModeFalse
              ComTxMode: ComTxModeNumberOfRepetitions=0, ComTxModeMode=DIRECT, ComTxModeTimeOffset=0.0, ComTxModeTimePeriod=0.1, ComTxModeRepetitionPeriod=0.0
        Com_IPdu_CanNodeNum_03_TxBasic_18: ComIPduDirection=SEND, ComPduIdRef=CanPdu_Com2PduR_CanNodeNum_03_TxBasic_18, ComIPduGroupRef=ComIPduGroup_CanNodeNum_03_Tx, ComIPduSignalRef=Com_Signal_CanNodeNum_03_TxBasic_18
          ComTxIPdu: ComTxIPduUnusedAreasDefault=0
            ComTxModeTrue
              ComTxMode: ComTxModeNumberOfRepetitions=0, ComTxModeMode=DIRECT, ComTxModeTimeOffset=0.0, ComTxModeTimePeriod=0.1, ComTxModeRepetitionPeriod=0
            ComTxModeFalse
              ComTxMode: ComTxModeNumberOfRepetitions=0, ComTxModeMode=DIRECT, ComTxModeTimeOffset=0.0, ComTxModeTimePeriod=0.1, ComTxModeRepetitionPeriod=0
        Com_IPdu_CanNodeNum_03_TxBasic_19: ComIPduDirection=SEND, ComPduIdRef=CanPdu_Com2PduR_CanNodeNum_03_TxBasic_19, ComIPduGroupRef=ComIPduGroup_CanNodeNum_03_Tx, ComIPduSignalRef=Com_Signal_CanNodeNum_03_TxBasic_19
          ComTxIPdu: ComTxIPduUnusedAreasDefault=0
            ComTxModeTrue
              ComTxMode: ComTxModeNumberOfRepetitions=0, ComTxModeMode=DIRECT, ComTxModeTimeOffset=0.0, ComTxModeTimePeriod=0.1, ComTxModeRepetitionPeriod=0
            ComTxModeFalse
              ComTxMode: ComTxModeNumberOfRepetitions=0, ComTxModeMode=DIRECT, ComTxModeTimeOffset=0.0, ComTxModeTimePeriod=0.1, ComTxModeRepetitionPeriod=0
        Com_IPdu_CanNodeNum_03_TxBasic_20: ComIPduDirection=SEND, ComPduIdRef=CanPdu_Com2PduR_CanNodeNum_03_TxBasic_20, ComIPduGroupRef=ComIPduGroup_CanNodeNum_03_Tx, ComIPduSignalRef=Com_Signal_CanNodeNum_03_TxBasic_20
          ComTxIPdu: ComTxIPduUnusedAreasDefault=0
            ComTxModeTrue
              ComTxMode: ComTxModeNumberOfRepetitions=0, ComTxModeMode=DIRECT, ComTxModeTimeOffset=0.0, ComTxModeTimePeriod=0.1, ComTxModeRepetitionPeriod=0
            ComTxModeFalse
              ComTxMode: ComTxModeNumberOfRepetitions=0, ComTxModeMode=DIRECT, ComTxModeTimeOffset=0.0, ComTxModeTimePeriod=0.1, ComTxModeRepetitionPeriod=0
        Com_IPdu_CanNodeNum_03_Tx_01: ComIPduDirection=SEND, ComIPduCallout=Bsw_IPduCallout_CanNodeNum_03_Tx_01, ComPduIdRef=CanPdu_Com2PduR_CanNodeNum_03_Tx_01, ComIPduSignalRef=Com_Signal_CanNodeNum_03_Tx_01, ComIPduGroupRef=ComIPduGroup_CanNodeNum_03_Tx
          ComTxIPdu: ComTxIPduUnusedAreasDefault=0
            ComTxModeFalse
              ComTxMode_0 (ComTxMode): ComTxModeMode=DIRECT, ComTxModeNumberOfRepetitions=0, ComTxModeRepetitionPeriod=0.0, ComTxModeTimeOffset=0.0, ComTxModeTimePeriod=0.1
            ComTxModeTrue
              ComTxMode_0 (ComTxMode): ComTxModeMode=DIRECT, ComTxModeNumberOfRepetitions=0, ComTxModeRepetitionPeriod=0.0, ComTxModeTimeOffset=0.0, ComTxModeTimePeriod=0.1
        Com_IPdu_CanNodeNum_03_Tx_02: ComIPduDirection=SEND, ComIPduCallout=Bsw_IPduCallout_CanNodeNum_03_Tx_02, ComPduIdRef=CanPdu_Com2PduR_CanNodeNum_03_Tx_02, ComIPduSignalRef=Com_Signal_CanNodeNum_03_Tx_02, ComIPduGroupRef=ComIPduGroup_CanNodeNum_03_Tx
          ComTxIPdu: ComTxIPduUnusedAreasDefault=0
            ComTxModeFalse
              ComTxMode_0 (ComTxMode): ComTxModeMode=DIRECT, ComTxModeNumberOfRepetitions=0, ComTxModeRepetitionPeriod=0.0, ComTxModeTimeOffset=0.0, ComTxModeTimePeriod=0.1
            ComTxModeTrue
              ComTxMode_0 (ComTxMode): ComTxModeMode=DIRECT, ComTxModeNumberOfRepetitions=0, ComTxModeRepetitionPeriod=0.0, ComTxModeTimeOffset=0.0, ComTxModeTimePeriod=0.1
        Com_IPdu_CanNodeNum_03_Tx_03: ComIPduDirection=SEND, ComPduIdRef=CanPdu_Com2PduR_CanNodeNum_03_Tx_03, ComIPduSignalRef=Com_Signal_CanNodeNum_03_Tx_03, ComIPduGroupRef=ComIPduGroup_CanNodeNum_03_Tx
          ComTxIPdu: ComTxIPduUnusedAreasDefault=0
            ComTxModeFalse
              ComTxMode_0 (ComTxMode): ComTxModeMode=DIRECT, ComTxModeNumberOfRepetitions=0, ComTxModeRepetitionPeriod=0.0, ComTxModeTimeOffset=0.0, ComTxModeTimePeriod=0.1
            ComTxModeTrue
              ComTxMode_0 (ComTxMode): ComTxModeMode=DIRECT, ComTxModeNumberOfRepetitions=0, ComTxModeRepetitionPeriod=0.0, ComTxModeTimeOffset=0.0, ComTxModeTimePeriod=0.1
        Com_IPdu_CanNodeNum_03_Tx_04: ComIPduDirection=SEND, ComPduIdRef=CanPdu_Com2PduR_CanNodeNum_03_Tx_04, ComIPduSignalRef=Com_Signal_CanNodeNum_03_Tx_04, ComIPduGroupRef=ComIPduGroup_CanNodeNum_03_Tx
          ComTxIPdu: ComTxIPduUnusedAreasDefault=0
            ComTxModeFalse
              ComTxMode_0 (ComTxMode): ComTxModeMode=DIRECT, ComTxModeNumberOfRepetitions=0, ComTxModeRepetitionPeriod=0.0, ComTxModeTimeOffset=0.0, ComTxModeTimePeriod=0.1
            ComTxModeTrue
              ComTxMode_0 (ComTxMode): ComTxModeMode=DIRECT, ComTxModeNumberOfRepetitions=0, ComTxModeRepetitionPeriod=0.0, ComTxModeTimeOffset=0.0, ComTxModeTimePeriod=0.1
        Com_IPdu_CanNodeNum_03_Tx_05: ComIPduDirection=SEND, ComPduIdRef=CanPdu_Com2PduR_CanNodeNum_03_Tx_05, ComIPduSignalRef=Com_Signal_CanNodeNum_03_Tx_05, ComIPduGroupRef=ComIPduGroup_CanNodeNum_03_Tx
          ComTxIPdu: ComTxIPduUnusedAreasDefault=0
            ComTxModeFalse
              ComTxMode_0 (ComTxMode): ComTxModeMode=DIRECT, ComTxModeNumberOfRepetitions=0, ComTxModeRepetitionPeriod=0.0, ComTxModeTimeOffset=0.0, ComTxModeTimePeriod=0.1
            ComTxModeTrue
              ComTxMode_0 (ComTxMode): ComTxModeMode=DIRECT, ComTxModeNumberOfRepetitions=0, ComTxModeRepetitionPeriod=0.0, ComTxModeTimeOffset=0.0, ComTxModeTimePeriod=0.1
        Com_IPdu_CanNodeNum_03_Tx_06: ComIPduDirection=SEND, ComPduIdRef=CanPdu_Com2PduR_CanNodeNum_03_Tx_06, ComIPduSignalRef=Com_Signal_CanNodeNum_03_Tx_06, ComIPduGroupRef=ComIPduGroup_CanNodeNum_03_Tx
          ComTxIPdu: ComTxIPduUnusedAreasDefault=0
            ComTxModeFalse
              ComTxMode_0 (ComTxMode): ComTxModeMode=DIRECT, ComTxModeNumberOfRepetitions=0, ComTxModeRepetitionPeriod=0.0, ComTxModeTimeOffset=0.0, ComTxModeTimePeriod=0.1
            ComTxModeTrue
              ComTxMode_0 (ComTxMode): ComTxModeMode=DIRECT, ComTxModeNumberOfRepetitions=0, ComTxModeRepetitionPeriod=0.0, ComTxModeTimeOffset=0.0, ComTxModeTimePeriod=0.1
        Com_IPdu_CanNodeNum_03_Tx_07: ComIPduDirection=SEND, ComPduIdRef=CanPdu_Com2PduR_CanNodeNum_03_Tx_07, ComIPduSignalRef=Com_Signal_CanNodeNum_03_Tx_07, ComIPduGroupRef=ComIPduGroup_CanNodeNum_03_Tx
          ComTxIPdu: ComTxIPduUnusedAreasDefault=0
            ComTxModeFalse
              ComTxMode_0 (ComTxMode): ComTxModeMode=DIRECT, ComTxModeNumberOfRepetitions=0, ComTxModeRepetitionPeriod=0.0, ComTxModeTimeOffset=0.0, ComTxModeTimePeriod=0.1
            ComTxModeTrue
              ComTxMode_0 (ComTxMode): ComTxModeMode=DIRECT, ComTxModeNumberOfRepetitions=0, ComTxModeRepetitionPeriod=0.0, ComTxModeTimeOffset=0.0, ComTxModeTimePeriod=0.1
        Com_IPdu_CanNodeNum_03_Tx_08: ComIPduDirection=SEND, ComPduIdRef=CanPdu_Com2PduR_CanNodeNum_03_Tx_08, ComIPduSignalRef=Com_Signal_CanNodeNum_03_Tx_08, ComIPduGroupRef=ComIPduGroup_CanNodeNum_03_Tx
          ComTxIPdu: ComTxIPduUnusedAreasDefault=0
            ComTxModeFalse
              ComTxMode_0 (ComTxMode): ComTxModeMode=DIRECT, ComTxModeNumberOfRepetitions=0, ComTxModeRepetitionPeriod=0.0, ComTxModeTimeOffset=0.0, ComTxModeTimePeriod=0.1
            ComTxModeTrue
              ComTxMode_0 (ComTxMode): ComTxModeMode=DIRECT, ComTxModeNumberOfRepetitions=0, ComTxModeRepetitionPeriod=0.0, ComTxModeTimeOffset=0.0, ComTxModeTimePeriod=0.1
        Com_IPdu_CanNodeNum_03_Tx_09: ComIPduDirection=SEND, ComPduIdRef=CanPdu_Com2PduR_CanNodeNum_03_Tx_09, ComIPduSignalRef=Com_Signal_CanNodeNum_03_Tx_09, ComIPduGroupRef=ComIPduGroup_CanNodeNum_03_Tx
          ComTxIPdu: ComTxIPduUnusedAreasDefault=0
            ComTxModeFalse
              ComTxMode_0 (ComTxMode): ComTxModeMode=DIRECT, ComTxModeNumberOfRepetitions=0, ComTxModeRepetitionPeriod=0.0, ComTxModeTimeOffset=0.0, ComTxModeTimePeriod=0.1
            ComTxModeTrue
              ComTxMode_0 (ComTxMode): ComTxModeMode=DIRECT, ComTxModeNumberOfRepetitions=0, ComTxModeRepetitionPeriod=0.0, ComTxModeTimeOffset=0.0, ComTxModeTimePeriod=0.1
        Com_IPdu_CanNodeNum_03_Tx_10: ComIPduDirection=SEND, ComPduIdRef=CanPdu_Com2PduR_CanNodeNum_03_Tx_10, ComIPduSignalRef=Com_Signal_CanNodeNum_03_Tx_10, ComIPduGroupRef=ComIPduGroup_CanNodeNum_03_Tx
          ComTxIPdu: ComTxIPduUnusedAreasDefault=0
            ComTxModeFalse
              ComTxMode_0 (ComTxMode): ComTxModeMode=DIRECT, ComTxModeNumberOfRepetitions=0, ComTxModeRepetitionPeriod=0.0, ComTxModeTimeOffset=0.0, ComTxModeTimePeriod=0.1
            ComTxModeTrue
              ComTxMode_0 (ComTxMode): ComTxModeMode=DIRECT, ComTxModeNumberOfRepetitions=0, ComTxModeRepetitionPeriod=0.0, ComTxModeTimeOffset=0.0, ComTxModeTimePeriod=0.1
        Com_IPdu_CanNodeNum_03_Tx_11: ComIPduDirection=SEND, ComPduIdRef=CanPdu_Com2PduR_CanNodeNum_03_Tx_11, ComIPduSignalRef=Com_Signal_CanNodeNum_03_Tx_11, ComIPduGroupRef=ComIPduGroup_CanNodeNum_03_Tx
          ComTxIPdu: ComTxIPduUnusedAreasDefault=0
            ComTxModeFalse
              ComTxMode_0 (ComTxMode): ComTxModeMode=DIRECT, ComTxModeNumberOfRepetitions=0, ComTxModeRepetitionPeriod=0.0, ComTxModeTimeOffset=0.0, ComTxModeTimePeriod=0.1
            ComTxModeTrue
              ComTxMode_0 (ComTxMode): ComTxModeMode=DIRECT, ComTxModeNumberOfRepetitions=0, ComTxModeRepetitionPeriod=0.0, ComTxModeTimeOffset=0.0, ComTxModeTimePeriod=0.1
        Com_IPdu_CanNodeNum_03_Tx_12: ComIPduDirection=SEND, ComPduIdRef=CanPdu_Com2PduR_CanNodeNum_03_Tx_12, ComIPduSignalRef=Com_Signal_CanNodeNum_03_Tx_12, ComIPduGroupRef=ComIPduGroup_CanNodeNum_03_Tx
          ComTxIPdu: ComTxIPduUnusedAreasDefault=0
            ComTxModeFalse
              ComTxMode_0 (ComTxMode): ComTxModeMode=DIRECT, ComTxModeNumberOfRepetitions=0, ComTxModeRepetitionPeriod=0.0, ComTxModeTimeOffset=0.0, ComTxModeTimePeriod=0.1
            ComTxModeTrue
              ComTxMode_0 (ComTxMode): ComTxModeMode=DIRECT, ComTxModeNumberOfRepetitions=0, ComTxModeRepetitionPeriod=0.0, ComTxModeTimeOffset=0.0, ComTxModeTimePeriod=0.1
        Com_IPdu_CanNodeNum_03_Tx_13: ComIPduDirection=SEND, ComPduIdRef=CanPdu_Com2PduR_CanNodeNum_03_Tx_13, ComIPduSignalRef=Com_Signal_CanNodeNum_03_Tx_13, ComIPduGroupRef=ComIPduGroup_CanNodeNum_03_Tx
          ComTxIPdu: ComTxIPduUnusedAreasDefault=0
            ComTxModeFalse
              ComTxMode_0 (ComTxMode): ComTxModeMode=DIRECT, ComTxModeNumberOfRepetitions=0, ComTxModeRepetitionPeriod=0.0, ComTxModeTimeOffset=0.0, ComTxModeTimePeriod=0.1
            ComTxModeTrue
              ComTxMode_0 (ComTxMode): ComTxModeMode=DIRECT, ComTxModeNumberOfRepetitions=0, ComTxModeRepetitionPeriod=0.0, ComTxModeTimeOffset=0.0, ComTxModeTimePeriod=0.1
        Com_IPdu_CanNodeNum_03_Tx_14: ComIPduDirection=SEND, ComPduIdRef=CanPdu_Com2PduR_CanNodeNum_03_Tx_14, ComIPduSignalRef=Com_Signal_CanNodeNum_03_Tx_14, ComIPduGroupRef=ComIPduGroup_CanNodeNum_03_Tx
          ComTxIPdu: ComTxIPduUnusedAreasDefault=0
            ComTxModeFalse
              ComTxMode_0 (ComTxMode): ComTxModeMode=DIRECT, ComTxModeNumberOfRepetitions=0, ComTxModeRepetitionPeriod=0.0, ComTxModeTimeOffset=0.0, ComTxModeTimePeriod=0.1
            ComTxModeTrue
              ComTxMode_0 (ComTxMode): ComTxModeMode=DIRECT, ComTxModeNumberOfRepetitions=0, ComTxModeRepetitionPeriod=0.0, ComTxModeTimeOffset=0.0, ComTxModeTimePeriod=0.1
        Com_IPdu_CanNodeNum_03_Tx_15: ComIPduDirection=SEND, ComPduIdRef=CanPdu_Com2PduR_CanNodeNum_03_Tx_15, ComIPduSignalRef=Com_Signal_CanNodeNum_03_Tx_15, ComIPduGroupRef=ComIPduGroup_CanNodeNum_03_Tx
          ComTxIPdu: ComTxIPduUnusedAreasDefault=0
            ComTxModeFalse
              ComTxMode_0 (ComTxMode): ComTxModeMode=DIRECT, ComTxModeNumberOfRepetitions=0, ComTxModeRepetitionPeriod=0.0, ComTxModeTimeOffset=0.0, ComTxModeTimePeriod=0.1
            ComTxModeTrue
              ComTxMode_0 (ComTxMode): ComTxModeMode=DIRECT, ComTxModeNumberOfRepetitions=0, ComTxModeRepetitionPeriod=0.0, ComTxModeTimeOffset=0.0, ComTxModeTimePeriod=0.1
        Com_IPdu_CanNodeNum_03_Tx_16: ComIPduDirection=SEND, ComPduIdRef=CanPdu_Com2PduR_CanNodeNum_03_Tx_16, ComIPduSignalRef=Com_Signal_CanNodeNum_03_Tx_16, ComIPduGroupRef=ComIPduGroup_CanNodeNum_03_Tx
          ComTxIPdu: ComTxIPduUnusedAreasDefault=0
            ComTxModeFalse
              ComTxMode_0 (ComTxMode): ComTxModeMode=DIRECT, ComTxModeNumberOfRepetitions=0, ComTxModeRepetitionPeriod=0.0, ComTxModeTimeOffset=0.0, ComTxModeTimePeriod=0.1
            ComTxModeTrue
              ComTxMode_0 (ComTxMode): ComTxModeMode=DIRECT, ComTxModeNumberOfRepetitions=0, ComTxModeRepetitionPeriod=0.0, ComTxModeTimeOffset=0.0, ComTxModeTimePeriod=0.1
        Com_IPdu_CanNodeNum_03_Tx_17: ComIPduDirection=SEND, ComPduIdRef=CanPdu_Com2PduR_CanNodeNum_03_Tx_17, ComIPduSignalRef=Com_Signal_CanNodeNum_03_Tx_17, ComIPduGroupRef=ComIPduGroup_CanNodeNum_03_Tx
          ComTxIPdu: ComTxIPduUnusedAreasDefault=0
            ComTxModeFalse
              ComTxMode_0 (ComTxMode): ComTxModeMode=DIRECT, ComTxModeNumberOfRepetitions=0, ComTxModeRepetitionPeriod=0.0, ComTxModeTimeOffset=0.0, ComTxModeTimePeriod=0.1
            ComTxModeTrue
              ComTxMode_0 (ComTxMode): ComTxModeMode=DIRECT, ComTxModeNumberOfRepetitions=0, ComTxModeRepetitionPeriod=0.0, ComTxModeTimeOffset=0.0, ComTxModeTimePeriod=0.1
        Com_IPdu_CanNodeNum_03_Tx_18: ComIPduDirection=SEND, ComPduIdRef=CanPdu_Com2PduR_CanNodeNum_03_Tx_18, ComIPduSignalRef=Com_Signal_CanNodeNum_03_Tx_18, ComIPduGroupRef=ComIPduGroup_CanNodeNum_03_Tx
          ComTxIPdu: ComTxIPduUnusedAreasDefault=0
            ComTxModeFalse
              ComTxMode_0 (ComTxMode): ComTxModeMode=DIRECT, ComTxModeNumberOfRepetitions=0, ComTxModeRepetitionPeriod=0.0, ComTxModeTimeOffset=0.0, ComTxModeTimePeriod=0.1
            ComTxModeTrue
              ComTxMode_0 (ComTxMode): ComTxModeMode=DIRECT, ComTxModeNumberOfRepetitions=0, ComTxModeRepetitionPeriod=0.0, ComTxModeTimeOffset=0.0, ComTxModeTimePeriod=0.1
        Com_IPdu_CanNodeNum_03_Tx_19: ComIPduDirection=SEND, ComPduIdRef=CanPdu_Com2PduR_CanNodeNum_03_Tx_19, ComIPduSignalRef=Com_Signal_CanNodeNum_03_Tx_19, ComIPduGroupRef=ComIPduGroup_CanNodeNum_03_Tx
          ComTxIPdu: ComTxIPduUnusedAreasDefault=0
            ComTxModeFalse
              ComTxMode_0 (ComTxMode): ComTxModeMode=DIRECT, ComTxModeNumberOfRepetitions=0, ComTxModeRepetitionPeriod=0.0, ComTxModeTimeOffset=0.0, ComTxModeTimePeriod=0.1
            ComTxModeTrue
              ComTxMode_0 (ComTxMode): ComTxModeMode=DIRECT, ComTxModeNumberOfRepetitions=0, ComTxModeRepetitionPeriod=0.0, ComTxModeTimeOffset=0.0, ComTxModeTimePeriod=0.1
        Com_IPdu_CanNodeNum_03_Tx_20: ComIPduDirection=SEND, ComPduIdRef=CanPdu_Com2PduR_CanNodeNum_03_Tx_20, ComIPduSignalRef=Com_Signal_CanNodeNum_03_Tx_20, ComIPduGroupRef=ComIPduGroup_CanNodeNum_03_Tx
          ComTxIPdu: ComTxIPduUnusedAreasDefault=0
            ComTxModeFalse
              ComTxMode_0 (ComTxMode): ComTxModeMode=DIRECT, ComTxModeNumberOfRepetitions=0, ComTxModeRepetitionPeriod=0.0, ComTxModeTimeOffset=0.0, ComTxModeTimePeriod=0.1
            ComTxModeTrue
              ComTxMode_0 (ComTxMode): ComTxModeMode=DIRECT, ComTxModeNumberOfRepetitions=0, ComTxModeRepetitionPeriod=0.0, ComTxModeTimeOffset=0.0, ComTxModeTimePeriod=0.1
        Com_IPdu_CanNodeNum_03_Tx_21: ComIPduDirection=SEND, ComPduIdRef=CanPdu_Com2PduR_CanNodeNum_03_Tx_21, ComIPduSignalRef=Com_Signal_CanNodeNum_03_Tx_21, ComIPduGroupRef=ComIPduGroup_CanNodeNum_03_Tx
          ComTxIPdu: ComTxIPduUnusedAreasDefault=0
            ComTxModeFalse
              ComTxMode_0 (ComTxMode): ComTxModeMode=DIRECT, ComTxModeNumberOfRepetitions=0, ComTxModeRepetitionPeriod=0.0, ComTxModeTimeOffset=0.0, ComTxModeTimePeriod=0.1
            ComTxModeTrue
              ComTxMode_0 (ComTxMode): ComTxModeMode=DIRECT, ComTxModeNumberOfRepetitions=0, ComTxModeRepetitionPeriod=0.0, ComTxModeTimeOffset=0.0, ComTxModeTimePeriod=0.1
        Com_IPdu_CanNodeNum_03_Tx_22: ComIPduDirection=SEND, ComPduIdRef=CanPdu_Com2PduR_CanNodeNum_03_Tx_22, ComIPduSignalRef=Com_Signal_CanNodeNum_03_Tx_22, ComIPduGroupRef=ComIPduGroup_CanNodeNum_03_Tx
          ComTxIPdu: ComTxIPduUnusedAreasDefault=0
            ComTxModeFalse
              ComTxMode_0 (ComTxMode): ComTxModeMode=DIRECT, ComTxModeNumberOfRepetitions=0, ComTxModeRepetitionPeriod=0.0, ComTxModeTimeOffset=0.0, ComTxModeTimePeriod=0.1
            ComTxModeTrue
              ComTxMode_0 (ComTxMode): ComTxModeMode=DIRECT, ComTxModeNumberOfRepetitions=0, ComTxModeRepetitionPeriod=0.0, ComTxModeTimeOffset=0.0, ComTxModeTimePeriod=0.1
        Com_IPdu_CanNodeNum_03_Tx_23: ComIPduDirection=SEND, ComPduIdRef=CanPdu_Com2PduR_CanNodeNum_03_Tx_23, ComIPduSignalRef=Com_Signal_CanNodeNum_03_Tx_23, ComIPduGroupRef=ComIPduGroup_CanNodeNum_03_Tx
          ComTxIPdu: ComTxIPduUnusedAreasDefault=0
            ComTxModeFalse
              ComTxMode_0 (ComTxMode): ComTxModeMode=DIRECT, ComTxModeNumberOfRepetitions=0, ComTxModeRepetitionPeriod=0.0, ComTxModeTimeOffset=0.0, ComTxModeTimePeriod=0.1
            ComTxModeTrue
              ComTxMode_0 (ComTxMode): ComTxModeMode=DIRECT, ComTxModeNumberOfRepetitions=0, ComTxModeRepetitionPeriod=0.0, ComTxModeTimeOffset=0.0, ComTxModeTimePeriod=0.1
        Com_IPdu_CanNodeNum_03_Tx_24: ComIPduDirection=SEND, ComPduIdRef=CanPdu_Com2PduR_CanNodeNum_03_Tx_24, ComIPduSignalRef=Com_Signal_CanNodeNum_03_Tx_24, ComIPduGroupRef=ComIPduGroup_CanNodeNum_03_Tx
          ComTxIPdu: ComTxIPduUnusedAreasDefault=0
            ComTxModeFalse
              ComTxMode_0 (ComTxMode): ComTxModeMode=DIRECT, ComTxModeNumberOfRepetitions=0, ComTxModeRepetitionPeriod=0.0, ComTxModeTimeOffset=0.0, ComTxModeTimePeriod=0.1
            ComTxModeTrue
              ComTxMode_0 (ComTxMode): ComTxModeMode=DIRECT, ComTxModeNumberOfRepetitions=0, ComTxModeRepetitionPeriod=0.0, ComTxModeTimeOffset=0.0, ComTxModeTimePeriod=0.1
        Com_IPdu_CanNodeNum_03_Tx_25: ComIPduDirection=SEND, ComPduIdRef=CanPdu_Com2PduR_CanNodeNum_03_Tx_25, ComIPduSignalRef=Com_Signal_CanNodeNum_03_Tx_25, ComIPduGroupRef=ComIPduGroup_CanNodeNum_03_Tx
          ComTxIPdu: ComTxIPduUnusedAreasDefault=0
            ComTxModeFalse
              ComTxMode_0 (ComTxMode): ComTxModeMode=DIRECT, ComTxModeNumberOfRepetitions=0, ComTxModeRepetitionPeriod=0.0, ComTxModeTimeOffset=0.0, ComTxModeTimePeriod=0.1
            ComTxModeTrue
              ComTxMode_0 (ComTxMode): ComTxModeMode=DIRECT, ComTxModeNumberOfRepetitions=0, ComTxModeRepetitionPeriod=0.0, ComTxModeTimeOffset=0.0, ComTxModeTimePeriod=0.1
        Com_IPdu_CanNodeNum_03_Tx_26: ComIPduDirection=SEND, ComPduIdRef=CanPdu_Com2PduR_CanNodeNum_03_Tx_26, ComIPduSignalRef=Com_Signal_CanNodeNum_03_Tx_26, ComIPduGroupRef=ComIPduGroup_CanNodeNum_03_Tx
          ComTxIPdu: ComTxIPduUnusedAreasDefault=0
            ComTxModeFalse
              ComTxMode_0 (ComTxMode): ComTxModeMode=DIRECT, ComTxModeNumberOfRepetitions=0, ComTxModeRepetitionPeriod=0.0, ComTxModeTimeOffset=0.0, ComTxModeTimePeriod=0.1
            ComTxModeTrue
              ComTxMode_0 (ComTxMode): ComTxModeMode=DIRECT, ComTxModeNumberOfRepetitions=0, ComTxModeRepetitionPeriod=0.0, ComTxModeTimeOffset=0.0, ComTxModeTimePeriod=0.1
      4 x ComIPduGroup:
        ComIPduGroup_CanNodeNum_02_Rx
        ComIPduGroup_CanNodeNum_02_Tx
        ComIPduGroup_CanNodeNum_03_Rx
        ComIPduGroup_CanNodeNum_03_Tx
    ComGeneral:
      ComCancellationSupport = false
      ComEnableJitterFilter = false
      ComCommonIPduTxPeriodFeature = false
      ComVersionInfoApi = false
      ComEnableSignalGroupArrayApi = false
      ComConfigurationUseDet = true
