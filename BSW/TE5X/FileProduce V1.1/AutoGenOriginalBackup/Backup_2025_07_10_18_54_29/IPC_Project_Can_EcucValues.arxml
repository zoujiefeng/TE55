AUTOSAR XML (schema 00047)
package /ETAS_Project/EcucModuleConfigurationValuess
  module config Can: implementation-config-variant=VARIANT-PRE-COMPILE
    CanConfigSet
      Can_Network_CanNodeNum_00 (CanController):
        CanRxProcessing = INTERRUPT
        CanControllerId = 0
        CanWakeupProcessing = INTERRUPT
        CanControllerBaseAddress = 0
        CanTxProcessing = INTERRUPT
        CanBusoffProcessing = INTERRUPT
        CanControllerActivation = true
        CanWakeupFunctionalityAPI = false
        CanWakeupSupport = false
        CanControllerDefaultBaudrate = CanBaudrate_CanNodeNum_00
        CanBaudrate_CanNodeNum_00 (CanControllerBaudrateConfig):
          CanControllerBaudRate = 1000
          CanControllerBaudRateConfigID = 1
          CanControllerSeg1 = 10
          CanControllerSyncJumpWidth = 0
          CanControllerSeg2 = 0
          CanControllerPropSeg = 0
      Can_Network_CanNodeNum_01 (CanController):
        CanRxProcessing = INTERRUPT
        CanControllerId = 1
        CanWakeupProcessing = INTERRUPT
        CanControllerBaseAddress = 0
        CanTxProcessing = INTERRUPT
        CanBusoffProcessing = INTERRUPT
        CanControllerActivation = true
        CanWakeupFunctionalityAPI = false
        CanWakeupSupport = false
        CanControllerDefaultBaudrate = CanBaudrate_CanNodeNum_01
        CanBaudrate_CanNodeNum_01 (CanControllerBaudrateConfig):
          CanControllerBaudRate = 500
          CanControllerBaudRateConfigID = 1
          CanControllerSeg1 = 10
          CanControllerSyncJumpWidth = 0
          CanControllerSeg2 = 0
          CanControllerPropSeg = 0
      94 x CanHardwareObject, all with CanObjectType=RECEIVE:
        Can_HwObject_CanNodeNum_00_Rx_A: CanHandleType=FULL, CanObjectId=0, CanHwObjectCount=1, CanIdType=STANDARD, CanControllerRef=Can_Network_CanNodeNum_00
          CanHwFilter: CanHwFilterMask=2047, CanHwFilterCode=818
        Can_HwObject_CanNodeNum_00_Rx_B: CanHandleType=FULL, CanObjectId=1, CanHwObjectCount=1, CanIdType=STANDARD, CanControllerRef=Can_Network_CanNodeNum_00
          CanHwFilter: CanHwFilterMask=2047, CanHwFilterCode=819
        Can_HwObject_CanNodeNum_00_Rx_C: CanHandleType=FULL, CanObjectId=2, CanHwObjectCount=1, CanIdType=STANDARD, CanControllerRef=Can_Network_CanNodeNum_00
          CanHwFilter: CanHwFilterMask=2047, CanHwFilterCode=791
        Can_HwObject_CanNodeNum_01_Rx_A: CanHandleType=BASIC, CanObjectId=3, CanHwObjectCount=5, CanIdType=STANDARD, CanControllerRef=Can_Network_CanNodeNum_01
          CanHwFilter: CanHwFilterMask=1920, CanHwFilterCode=1408
        Can_HwObject_CanNodeNum_01_Rx_B: CanHandleType=FULL, CanObjectId=4, CanHwObjectCount=1, CanIdType=EXTENDED, CanControllerRef=Can_Network_CanNodeNum_01
          CanHwFilter: CanHwFilterMask=2047, CanHwFilterCode=417018865
        Can_HwObject_CanNodeNum_01_Rx_C: CanHandleType=FULL, CanObjectId=5, CanHwObjectCount=1, CanIdType=EXTENDED, CanControllerRef=Can_Network_CanNodeNum_01
          CanHwFilter: CanHwFilterMask=2047, CanHwFilterCode=417001457
        Can_HwObject_CanNodeNum_01_Rx_01: CanHandleType=FULL, CanObjectId=6, CanHwObjectCount=1, CanIdType=EXTENDED, CanControllerRef=Can_Network_CanNodeNum_01
          CanHwFilter: CanHwFilterMask=2047, CanHwFilterCode=82837872
        Can_HwObject_CanNodeNum_01_Rx_02: CanHandleType=FULL, CanObjectId=7, CanHwObjectCount=1, CanIdType=EXTENDED, CanControllerRef=Can_Network_CanNodeNum_01
          CanHwFilter: CanHwFilterMask=2047, CanHwFilterCode=113246544
        Can_HwObject_CanNodeNum_01_Rx_03: CanHandleType=FULL, CanObjectId=8, CanHwObjectCount=1, CanIdType=EXTENDED, CanControllerRef=Can_Network_CanNodeNum_01
          CanHwFilter: CanHwFilterMask=2047, CanHwFilterCode=200016306
        Can_HwObject_CanNodeNum_01_Rx_04: CanHandleType=FULL, CanObjectId=9, CanHwObjectCount=1, CanIdType=EXTENDED, CanControllerRef=Can_Network_CanNodeNum_01
          CanHwFilter: CanHwFilterMask=2047, CanHwFilterCode=500000003
        Can_HwObject_CanNodeNum_01_Rx_05: CanHandleType=FULL, CanObjectId=10, CanHwObjectCount=1, CanIdType=EXTENDED, CanControllerRef=Can_Network_CanNodeNum_01
          CanHwFilter: CanHwFilterMask=2047, CanHwFilterCode=500000004
        Can_HwObject_CanNodeNum_01_Rx_06: CanHandleType=FULL, CanObjectId=11, CanHwObjectCount=1, CanIdType=EXTENDED, CanControllerRef=Can_Network_CanNodeNum_01
          CanHwFilter: CanHwFilterMask=2047, CanHwFilterCode=500000005
        Can_HwObject_CanNodeNum_01_Rx_07: CanHandleType=FULL, CanObjectId=12, CanHwObjectCount=1, CanIdType=EXTENDED, CanControllerRef=Can_Network_CanNodeNum_01
          CanHwFilter: CanHwFilterMask=2047, CanHwFilterCode=500000006
        Can_HwObject_CanNodeNum_01_Rx_08: CanHandleType=FULL, CanObjectId=13, CanHwObjectCount=1, CanIdType=EXTENDED, CanControllerRef=Can_Network_CanNodeNum_01
          CanHwFilter: CanHwFilterMask=2047, CanHwFilterCode=500000007
        Can_HwObject_CanNodeNum_01_Rx_09: CanHandleType=FULL, CanObjectId=14, CanHwObjectCount=1, CanIdType=EXTENDED, CanControllerRef=Can_Network_CanNodeNum_01
          CanHwFilter: CanHwFilterMask=2047, CanHwFilterCode=500000008
        Can_HwObject_CanNodeNum_01_Rx_10: CanHandleType=FULL, CanObjectId=15, CanHwObjectCount=1, CanIdType=EXTENDED, CanControllerRef=Can_Network_CanNodeNum_01
          CanHwFilter: CanHwFilterMask=2047, CanHwFilterCode=500000009
        Can_HwObject_CanNodeNum_01_Rx_11: CanHandleType=FULL, CanObjectId=16, CanHwObjectCount=1, CanIdType=EXTENDED, CanControllerRef=Can_Network_CanNodeNum_01
          CanHwFilter: CanHwFilterMask=2047, CanHwFilterCode=500000010
        Can_HwObject_CanNodeNum_01_Rx_12: CanHandleType=FULL, CanObjectId=17, CanHwObjectCount=1, CanIdType=EXTENDED, CanControllerRef=Can_Network_CanNodeNum_01
          CanHwFilter: CanHwFilterMask=2047, CanHwFilterCode=500000011
        Can_HwObject_CanNodeNum_01_Rx_13: CanHandleType=FULL, CanObjectId=18, CanHwObjectCount=1, CanIdType=EXTENDED, CanControllerRef=Can_Network_CanNodeNum_01
          CanHwFilter: CanHwFilterMask=2047, CanHwFilterCode=500000012
        Can_HwObject_CanNodeNum_01_Rx_14: CanHandleType=FULL, CanObjectId=19, CanHwObjectCount=1, CanIdType=EXTENDED, CanControllerRef=Can_Network_CanNodeNum_01
          CanHwFilter: CanHwFilterMask=2047, CanHwFilterCode=500000013
        Can_HwObject_CanNodeNum_01_Rx_15: CanHandleType=FULL, CanObjectId=20, CanHwObjectCount=1, CanIdType=EXTENDED, CanControllerRef=Can_Network_CanNodeNum_01
          CanHwFilter: CanHwFilterMask=2047, CanHwFilterCode=500000014
        Can_HwObject_CanNodeNum_01_Rx_16: CanHandleType=FULL, CanObjectId=21, CanHwObjectCount=1, CanIdType=EXTENDED, CanControllerRef=Can_Network_CanNodeNum_01
          CanHwFilter: CanHwFilterMask=2047, CanHwFilterCode=500000015
        Can_HwObject_CanNodeNum_01_Rx_17: CanHandleType=FULL, CanObjectId=22, CanHwObjectCount=1, CanIdType=EXTENDED, CanControllerRef=Can_Network_CanNodeNum_01
          CanHwFilter: CanHwFilterMask=2047, CanHwFilterCode=500000016
        Can_HwObject_CanNodeNum_01_Rx_18: CanHandleType=FULL, CanObjectId=23, CanHwObjectCount=1, CanIdType=EXTENDED, CanControllerRef=Can_Network_CanNodeNum_01
          CanHwFilter: CanHwFilterMask=2047, CanHwFilterCode=500000017
        Can_HwObject_CanNodeNum_01_Rx_19: CanHandleType=FULL, CanObjectId=24, CanHwObjectCount=1, CanIdType=EXTENDED, CanControllerRef=Can_Network_CanNodeNum_01
          CanHwFilter: CanHwFilterMask=2047, CanHwFilterCode=500000018
        Can_HwObject_CanNodeNum_01_Rx_20: CanHandleType=FULL, CanObjectId=25, CanHwObjectCount=1, CanIdType=EXTENDED, CanControllerRef=Can_Network_CanNodeNum_01
          CanHwFilter: CanHwFilterMask=2047, CanHwFilterCode=500000019
        Can_HwObject_CanNodeNum_01_Rx_21: CanHandleType=FULL, CanObjectId=26, CanHwObjectCount=1, CanIdType=EXTENDED, CanControllerRef=Can_Network_CanNodeNum_01
          CanHwFilter: CanHwFilterMask=2047, CanHwFilterCode=500000020
        Can_HwObject_CanNodeNum_01_Rx_22: CanHandleType=FULL, CanObjectId=27, CanHwObjectCount=1, CanIdType=EXTENDED, CanControllerRef=Can_Network_CanNodeNum_01
          CanHwFilter: CanHwFilterMask=2047, CanHwFilterCode=500000021
        Can_HwObject_CanNodeNum_01_Rx_23: CanHandleType=FULL, CanObjectId=28, CanHwObjectCount=1, CanIdType=EXTENDED, CanControllerRef=Can_Network_CanNodeNum_01
          CanHwFilter: CanHwFilterMask=2047, CanHwFilterCode=500000022
        Can_HwObject_CanNodeNum_01_Rx_24: CanHandleType=FULL, CanObjectId=29, CanHwObjectCount=1, CanIdType=EXTENDED, CanControllerRef=Can_Network_CanNodeNum_01
          CanHwFilter: CanHwFilterMask=2047, CanHwFilterCode=500000023
        Can_HwObject_CanNodeNum_01_Rx_25: CanHandleType=FULL, CanObjectId=30, CanHwObjectCount=1, CanIdType=EXTENDED, CanControllerRef=Can_Network_CanNodeNum_01
          CanHwFilter: CanHwFilterMask=2047, CanHwFilterCode=500000024
        Can_HwObject_CanNodeNum_01_Rx_26: CanHandleType=FULL, CanObjectId=31, CanHwObjectCount=1, CanIdType=EXTENDED, CanControllerRef=Can_Network_CanNodeNum_01
          CanHwFilter: CanHwFilterMask=2047, CanHwFilterCode=500000025
        Can_HwObject_CanNodeNum_01_Rx_27: CanHandleType=FULL, CanObjectId=32, CanHwObjectCount=1, CanIdType=EXTENDED, CanControllerRef=Can_Network_CanNodeNum_01
          CanHwFilter: CanHwFilterMask=2047, CanHwFilterCode=500000026
        Can_HwObject_CanNodeNum_01_Rx_28: CanHandleType=FULL, CanObjectId=33, CanHwObjectCount=1, CanIdType=EXTENDED, CanControllerRef=Can_Network_CanNodeNum_01
          CanHwFilter: CanHwFilterMask=2047, CanHwFilterCode=500000027
        Can_HwObject_CanNodeNum_01_Rx_29: CanHandleType=FULL, CanObjectId=34, CanHwObjectCount=1, CanIdType=EXTENDED, CanControllerRef=Can_Network_CanNodeNum_01
          CanHwFilter: CanHwFilterMask=2047, CanHwFilterCode=500000028
        Can_HwObject_CanNodeNum_01_Rx_30: CanHandleType=FULL, CanObjectId=35, CanHwObjectCount=1, CanIdType=EXTENDED, CanControllerRef=Can_Network_CanNodeNum_01
          CanHwFilter: CanHwFilterMask=2047, CanHwFilterCode=500000029
        Can_HwObject_CanNodeNum_01_Rx_31: CanHandleType=FULL, CanObjectId=36, CanHwObjectCount=1, CanIdType=EXTENDED, CanControllerRef=Can_Network_CanNodeNum_01
          CanHwFilter: CanHwFilterMask=2047, CanHwFilterCode=500000030
        Can_HwObject_CanNodeNum_01_Rx_32: CanHandleType=FULL, CanObjectId=37, CanHwObjectCount=1, CanIdType=EXTENDED, CanControllerRef=Can_Network_CanNodeNum_01
          CanHwFilter: CanHwFilterMask=2047, CanHwFilterCode=500000031
        Can_HwObject_CanNodeNum_01_Rx_33: CanHandleType=FULL, CanObjectId=38, CanHwObjectCount=1, CanIdType=EXTENDED, CanControllerRef=Can_Network_CanNodeNum_01
          CanHwFilter: CanHwFilterMask=2047, CanHwFilterCode=500000032
        Can_HwObject_CanNodeNum_01_Rx_34: CanHandleType=FULL, CanObjectId=39, CanHwObjectCount=1, CanIdType=EXTENDED, CanControllerRef=Can_Network_CanNodeNum_01
          CanHwFilter: CanHwFilterMask=2047, CanHwFilterCode=500000033
        Can_HwObject_CanNodeNum_01_Rx_35: CanHandleType=FULL, CanObjectId=40, CanHwObjectCount=1, CanIdType=EXTENDED, CanControllerRef=Can_Network_CanNodeNum_01
          CanHwFilter: CanHwFilterMask=2047, CanHwFilterCode=500000034
        Can_HwObject_CanNodeNum_01_Rx_36: CanHandleType=FULL, CanObjectId=41, CanHwObjectCount=1, CanIdType=EXTENDED, CanControllerRef=Can_Network_CanNodeNum_01
          CanHwFilter: CanHwFilterMask=2047, CanHwFilterCode=500000035
        Can_HwObject_CanNodeNum_01_Rx_37: CanHandleType=FULL, CanObjectId=42, CanHwObjectCount=1, CanIdType=EXTENDED, CanControllerRef=Can_Network_CanNodeNum_01
          CanHwFilter: CanHwFilterMask=2047, CanHwFilterCode=500000036
        Can_HwObject_CanNodeNum_01_Rx_38: CanHandleType=FULL, CanObjectId=43, CanHwObjectCount=1, CanIdType=EXTENDED, CanControllerRef=Can_Network_CanNodeNum_01
          CanHwFilter: CanHwFilterMask=2047, CanHwFilterCode=500000037
        Can_HwObject_CanNodeNum_01_Rx_39: CanHandleType=FULL, CanObjectId=44, CanHwObjectCount=1, CanIdType=EXTENDED, CanControllerRef=Can_Network_CanNodeNum_01
          CanHwFilter: CanHwFilterMask=2047, CanHwFilterCode=500000038
        Can_HwObject_CanNodeNum_01_Rx_40: CanHandleType=FULL, CanObjectId=45, CanHwObjectCount=1, CanIdType=EXTENDED, CanControllerRef=Can_Network_CanNodeNum_01
          CanHwFilter: CanHwFilterMask=2047, CanHwFilterCode=500000039
        Can_HwObject_CanNodeNum_02_Rx_A: CanHwObjectCount=5, CanHandleType=BASIC, CanIdType=STANDARD, CanObjectId=46, CanControllerRef=Can_Network_CanNodeNum_02
          CanHwFilter: CanHwFilterCode=1408, CanHwFilterMask=1920
        Can_HwObject_CanNodeNum_02_Rx_B: CanHwObjectCount=1, CanHandleType=FULL, CanIdType=STANDARD, CanObjectId=47, CanControllerRef=Can_Network_CanNodeNum_02
          CanHwFilter: CanHwFilterCode=2015, CanHwFilterMask=2047
        Can_HwObject_CanNodeNum_02_Rx_C: CanHwObjectCount=1, CanHandleType=FULL, CanIdType=STANDARD, CanObjectId=48, CanControllerRef=Can_Network_CanNodeNum_02
          CanHwFilter: CanHwFilterCode=2019, CanHwFilterMask=2047
        Can_HwObject_CanNodeNum_02_Rx_01: CanHwObjectCount=1, CanHandleType=FULL, CanIdType=EXTENDED, CanObjectId=49, CanControllerRef=Can_Network_CanNodeNum_02
          CanHwFilter: CanHwFilterCode=202056266, CanHwFilterMask=2047
        Can_HwObject_CanNodeNum_02_Rx_02: CanHwObjectCount=1, CanHandleType=FULL, CanIdType=EXTENDED, CanObjectId=50, CanControllerRef=Can_Network_CanNodeNum_02
          CanHwFilter: CanHwFilterCode=418591562, CanHwFilterMask=2047
        Can_HwObject_CanNodeNum_02_Rx_03: CanHwObjectCount=1, CanHandleType=FULL, CanIdType=EXTENDED, CanObjectId=51, CanControllerRef=Can_Network_CanNodeNum_02
          CanHwFilter: CanHwFilterCode=418591553, CanHwFilterMask=2047
        Can_HwObject_CanNodeNum_02_Rx_04: CanHwObjectCount=1, CanHandleType=FULL, CanIdType=EXTENDED, CanObjectId=52, CanControllerRef=Can_Network_CanNodeNum_02
          CanHwFilter: CanHwFilterCode=418591558, CanHwFilterMask=2047
        Can_HwObject_CanNodeNum_02_Rx_05: CanHwObjectCount=1, CanHandleType=FULL, CanIdType=EXTENDED, CanObjectId=53, CanControllerRef=Can_Network_CanNodeNum_02
          CanHwFilter: CanHwFilterCode=500000048, CanHwFilterMask=2047
        Can_HwObject_CanNodeNum_02_Rx_06: CanHwObjectCount=1, CanHandleType=FULL, CanIdType=EXTENDED, CanObjectId=54, CanControllerRef=Can_Network_CanNodeNum_02
          CanHwFilter: CanHwFilterCode=500000049, CanHwFilterMask=2047
        Can_HwObject_CanNodeNum_02_Rx_07: CanHwObjectCount=1, CanHandleType=FULL, CanIdType=EXTENDED, CanObjectId=55, CanControllerRef=Can_Network_CanNodeNum_02
          CanHwFilter: CanHwFilterCode=500000050, CanHwFilterMask=2047
        Can_HwObject_CanNodeNum_02_Rx_08: CanHwObjectCount=1, CanHandleType=FULL, CanIdType=EXTENDED, CanObjectId=56, CanControllerRef=Can_Network_CanNodeNum_02
          CanHwFilter: CanHwFilterCode=500000051, CanHwFilterMask=2047
        Can_HwObject_CanNodeNum_02_Rx_09: CanHwObjectCount=1, CanHandleType=FULL, CanIdType=EXTENDED, CanObjectId=57, CanControllerRef=Can_Network_CanNodeNum_02
          CanHwFilter: CanHwFilterCode=500000052, CanHwFilterMask=2047
        Can_HwObject_CanNodeNum_02_Rx_10: CanHwObjectCount=1, CanHandleType=FULL, CanIdType=EXTENDED, CanObjectId=58, CanControllerRef=Can_Network_CanNodeNum_02
          CanHwFilter: CanHwFilterCode=500000053, CanHwFilterMask=2047
        Can_HwObject_CanNodeNum_02_Rx_11: CanHwObjectCount=1, CanHandleType=FULL, CanIdType=EXTENDED, CanObjectId=59, CanControllerRef=Can_Network_CanNodeNum_02
          CanHwFilter: CanHwFilterCode=500000054, CanHwFilterMask=2047
        Can_HwObject_CanNodeNum_02_Rx_12: CanHwObjectCount=1, CanHandleType=FULL, CanIdType=EXTENDED, CanObjectId=60, CanControllerRef=Can_Network_CanNodeNum_02
          CanHwFilter: CanHwFilterCode=500000055, CanHwFilterMask=2047
        Can_HwObject_CanNodeNum_02_Rx_13: CanHwObjectCount=1, CanHandleType=FULL, CanIdType=EXTENDED, CanObjectId=61, CanControllerRef=Can_Network_CanNodeNum_02
          CanHwFilter: CanHwFilterCode=500000056, CanHwFilterMask=2047
        Can_HwObject_CanNodeNum_02_Rx_14: CanHwObjectCount=1, CanHandleType=FULL, CanIdType=EXTENDED, CanObjectId=62, CanControllerRef=Can_Network_CanNodeNum_02
          CanHwFilter: CanHwFilterCode=500000057, CanHwFilterMask=2047
        Can_HwObject_CanNodeNum_02_Rx_15: CanHwObjectCount=1, CanHandleType=FULL, CanIdType=EXTENDED, CanObjectId=63, CanControllerRef=Can_Network_CanNodeNum_02
          CanHwFilter: CanHwFilterCode=500000058, CanHwFilterMask=2047
        Can_HwObject_CanNodeNum_02_Rx_16: CanHwObjectCount=1, CanHandleType=FULL, CanIdType=EXTENDED, CanObjectId=64, CanControllerRef=Can_Network_CanNodeNum_02
          CanHwFilter: CanHwFilterCode=500000059, CanHwFilterMask=2047
        Can_HwObject_CanNodeNum_02_Rx_17: CanHwObjectCount=1, CanHandleType=FULL, CanIdType=EXTENDED, CanObjectId=65, CanControllerRef=Can_Network_CanNodeNum_02
          CanHwFilter: CanHwFilterCode=500000060, CanHwFilterMask=2047
        Can_HwObject_CanNodeNum_02_Rx_18: CanHwObjectCount=1, CanHandleType=FULL, CanIdType=EXTENDED, CanObjectId=66, CanControllerRef=Can_Network_CanNodeNum_02
          CanHwFilter: CanHwFilterCode=500000061, CanHwFilterMask=2047
        Can_HwObject_CanNodeNum_02_Rx_19: CanHwObjectCount=1, CanHandleType=FULL, CanIdType=EXTENDED, CanObjectId=67, CanControllerRef=Can_Network_CanNodeNum_02
          CanHwFilter: CanHwFilterCode=500000062, CanHwFilterMask=2047
        Can_HwObject_CanNodeNum_02_Rx_20: CanHwObjectCount=1, CanHandleType=FULL, CanIdType=EXTENDED, CanObjectId=68, CanControllerRef=Can_Network_CanNodeNum_02
          CanHwFilter: CanHwFilterCode=500000063, CanHwFilterMask=2047
        Can_HwObject_CanNodeNum_02_Rx_21: CanHwObjectCount=1, CanHandleType=FULL, CanIdType=EXTENDED, CanObjectId=69, CanControllerRef=Can_Network_CanNodeNum_02
          CanHwFilter: CanHwFilterCode=500000064, CanHwFilterMask=2047
        Can_HwObject_CanNodeNum_02_Rx_22: CanHwObjectCount=1, CanHandleType=FULL, CanIdType=EXTENDED, CanObjectId=70, CanControllerRef=Can_Network_CanNodeNum_02
          CanHwFilter: CanHwFilterCode=500000065, CanHwFilterMask=2047
        Can_HwObject_CanNodeNum_02_Rx_23: CanHwObjectCount=1, CanHandleType=FULL, CanIdType=EXTENDED, CanObjectId=71, CanControllerRef=Can_Network_CanNodeNum_02
          CanHwFilter: CanHwFilterCode=500000066, CanHwFilterMask=2047
        Can_HwObject_CanNodeNum_02_Rx_24: CanHwObjectCount=1, CanHandleType=FULL, CanIdType=EXTENDED, CanObjectId=72, CanControllerRef=Can_Network_CanNodeNum_02
          CanHwFilter: CanHwFilterCode=500000067, CanHwFilterMask=2047
        Can_HwObject_CanNodeNum_02_Rx_25: CanHwObjectCount=1, CanHandleType=FULL, CanIdType=EXTENDED, CanObjectId=73, CanControllerRef=Can_Network_CanNodeNum_02
          CanHwFilter: CanHwFilterCode=500000069, CanHwFilterMask=2047
        Can_HwObject_CanNodeNum_02_Rx_26: CanHwObjectCount=1, CanHandleType=FULL, CanIdType=EXTENDED, CanObjectId=74, CanControllerRef=Can_Network_CanNodeNum_02
          CanHwFilter: CanHwFilterCode=500000070, CanHwFilterMask=2047
        Can_HwObject_CanNodeNum_02_Rx_27: CanHwObjectCount=1, CanHandleType=FULL, CanIdType=EXTENDED, CanObjectId=75, CanControllerRef=Can_Network_CanNodeNum_02
          CanHwFilter: CanHwFilterCode=500000071, CanHwFilterMask=2047
        Can_HwObject_CanNodeNum_02_Rx_28: CanHwObjectCount=1, CanHandleType=FULL, CanIdType=EXTENDED, CanObjectId=76, CanControllerRef=Can_Network_CanNodeNum_02
          CanHwFilter: CanHwFilterCode=500000072, CanHwFilterMask=2047
        Can_HwObject_CanNodeNum_02_Rx_29: CanHwObjectCount=1, CanHandleType=FULL, CanIdType=EXTENDED, CanObjectId=77, CanControllerRef=Can_Network_CanNodeNum_02
          CanHwFilter: CanHwFilterCode=500000073, CanHwFilterMask=2047
        Can_HwObject_CanNodeNum_02_Rx_30: CanHwObjectCount=1, CanHandleType=FULL, CanIdType=EXTENDED, CanObjectId=78, CanControllerRef=Can_Network_CanNodeNum_02
          CanHwFilter: CanHwFilterCode=500000074, CanHwFilterMask=2047
        Can_HwObject_CanNodeNum_02_Rx_31: CanHwObjectCount=1, CanHandleType=FULL, CanIdType=EXTENDED, CanObjectId=79, CanControllerRef=Can_Network_CanNodeNum_02
          CanHwFilter: CanHwFilterCode=500000075, CanHwFilterMask=2047
        Can_HwObject_CanNodeNum_02_Rx_32: CanHwObjectCount=1, CanHandleType=FULL, CanIdType=EXTENDED, CanObjectId=80, CanControllerRef=Can_Network_CanNodeNum_02
          CanHwFilter: CanHwFilterCode=500000076, CanHwFilterMask=2047
        Can_HwObject_CanNodeNum_02_Rx_33: CanHwObjectCount=1, CanHandleType=FULL, CanIdType=EXTENDED, CanObjectId=81, CanControllerRef=Can_Network_CanNodeNum_02
          CanHwFilter: CanHwFilterCode=500000077, CanHwFilterMask=2047
        Can_HwObject_CanNodeNum_02_Rx_34: CanHwObjectCount=1, CanHandleType=FULL, CanIdType=EXTENDED, CanObjectId=82, CanControllerRef=Can_Network_CanNodeNum_02
          CanHwFilter: CanHwFilterCode=500000078, CanHwFilterMask=2047
        Can_HwObject_CanNodeNum_02_Rx_35: CanHwObjectCount=1, CanHandleType=FULL, CanIdType=EXTENDED, CanObjectId=83, CanControllerRef=Can_Network_CanNodeNum_02
          CanHwFilter: CanHwFilterCode=500000079, CanHwFilterMask=2047
        Can_HwObject_CanNodeNum_02_Rx_36: CanHwObjectCount=1, CanHandleType=FULL, CanIdType=EXTENDED, CanObjectId=84, CanControllerRef=Can_Network_CanNodeNum_02
          CanHwFilter: CanHwFilterCode=500000080, CanHwFilterMask=2047
        Can_HwObject_CanNodeNum_02_Rx_37: CanHwObjectCount=1, CanHandleType=FULL, CanIdType=EXTENDED, CanObjectId=85, CanControllerRef=Can_Network_CanNodeNum_02
          CanHwFilter: CanHwFilterCode=500000081, CanHwFilterMask=2047
        Can_HwObject_CanNodeNum_02_Rx_38: CanHwObjectCount=1, CanHandleType=FULL, CanIdType=EXTENDED, CanObjectId=86, CanControllerRef=Can_Network_CanNodeNum_02
          CanHwFilter: CanHwFilterCode=500000082, CanHwFilterMask=2047
        Can_HwObject_CanNodeNum_02_Rx_39: CanHwObjectCount=1, CanHandleType=FULL, CanIdType=EXTENDED, CanObjectId=87, CanControllerRef=Can_Network_CanNodeNum_02
          CanHwFilter: CanHwFilterCode=500000083, CanHwFilterMask=2047
        Can_HwObject_CanNodeNum_02_Rx_40: CanHwObjectCount=1, CanHandleType=FULL, CanIdType=EXTENDED, CanObjectId=88, CanControllerRef=Can_Network_CanNodeNum_02
          CanHwFilter: CanHwFilterCode=500000084, CanHwFilterMask=2047
        Can_HwObject_CanNodeNum_03_Rx_A: CanHwObjectCount=5, CanHandleType=BASIC, CanIdType=STANDARD, CanObjectId=89, CanControllerRef=Can_Network_CanNodeNum_03
          CanHwFilter: CanHwFilterCode=1408, CanHwFilterMask=1920
        Can_HwObject_CanNodeNum_03_Rx_B: CanHwObjectCount=1, CanHandleType=FULL, CanIdType=EXTENDED, CanObjectId=90, CanControllerRef=Can_Network_CanNodeNum_03
          CanHwFilter: CanHwFilterCode=2015, CanHwFilterMask=2047
        Can_HwObject_CanNodeNum_03_Rx_C: CanHwObjectCount=1, CanHandleType=FULL, CanIdType=EXTENDED, CanObjectId=91, CanControllerRef=Can_Network_CanNodeNum_03
          CanHwFilter: CanHwFilterCode=2019, CanHwFilterMask=2047
        Can_HwObject_CanNodeNum_03_Rx_01: CanHwObjectCount=1, CanHandleType=FULL, CanIdType=STANDARD, CanObjectId=92, CanControllerRef=Can_Network_CanNodeNum_03
          CanHwFilter: CanHwFilterCode=513, CanHwFilterMask=2047
        Can_HwObject_CanNodeNum_03_Rx_02: CanHwObjectCount=1, CanHandleType=FULL, CanIdType=STANDARD, CanObjectId=93, CanControllerRef=Can_Network_CanNodeNum_03
          CanHwFilter: CanHwFilterCode=514, CanHwFilterMask=2047
      Can_Network_CanNodeNum_02 (CanController):
        CanWakeupFunctionalityAPI = 0
        CanBusoffProcessing = INTERRUPT
        CanControllerActivation = true
        CanControllerBaseAddress = 0
        CanControllerId = 2
        CanRxProcessing = INTERRUPT
        CanTxProcessing = INTERRUPT
        CanWakeupProcessing = INTERRUPT
        CanWakeupSupport = false
        CanControllerDefaultBaudrate = CanBaudrate_CanNodeNum_02
        CanBaudrate_CanNodeNum_02 (CanControllerBaudrateConfig):
          CanControllerBaudRateConfigID = 1
          CanControllerBaudRate = 500
          CanControllerPropSeg = 0
          CanControllerSeg1 = 10
          CanControllerSeg2 = 0
          CanControllerSyncJumpWidth = 0
      Can_Network_CanNodeNum_03 (CanController):
        CanWakeupFunctionalityAPI = 0
        CanBusoffProcessing = INTERRUPT
        CanControllerActivation = true
        CanControllerBaseAddress = 0
        CanControllerId = 3
        CanRxProcessing = INTERRUPT
        CanTxProcessing = INTERRUPT
        CanWakeupProcessing = INTERRUPT
        CanWakeupSupport = false
        CanControllerDefaultBaudrate = CanBaudrate_CanNodeNum_03
        CanBaudrate_CanNodeNum_03 (CanControllerBaudrateConfig):
          CanControllerBaudRateConfigID = 1
          CanControllerBaudRate = 1000
          CanControllerPropSeg = 0
          CanControllerSeg1 = 10
          CanControllerSeg2 = 0
          CanControllerSyncJumpWidth = 0
      133 x CanHardwareObject:
        Can_HwObject_CanNodeNum_03_Rx_03: CanHwObjectCount=1, CanHandleType=FULL, CanIdType=EXTENDED, CanObjectType=RECEIVE, CanObjectId=94, CanControllerRef=Can_Network_CanNodeNum_03
          CanHwFilter: CanHwFilterCode=521, CanHwFilterMask=2047
        Can_HwObject_CanNodeNum_03_Rx_04: CanHwObjectCount=1, CanHandleType=FULL, CanIdType=EXTENDED, CanObjectType=RECEIVE, CanObjectId=95, CanControllerRef=Can_Network_CanNodeNum_03
          CanHwFilter: CanHwFilterCode=528, CanHwFilterMask=2047
        Can_HwObject_CanNodeNum_03_Rx_05: CanHwObjectCount=1, CanHandleType=FULL, CanIdType=EXTENDED, CanObjectType=RECEIVE, CanObjectId=96, CanControllerRef=Can_Network_CanNodeNum_03
          CanHwFilter: CanHwFilterCode=500000068, CanHwFilterMask=2047
        Can_HwObject_CanNodeNum_03_Rx_06: CanHwObjectCount=1, CanHandleType=FULL, CanIdType=EXTENDED, CanObjectType=RECEIVE, CanObjectId=97, CanControllerRef=Can_Network_CanNodeNum_03
          CanHwFilter: CanHwFilterCode=500000003, CanHwFilterMask=2047
        Can_HwObject_CanNodeNum_03_Rx_07: CanHwObjectCount=1, CanHandleType=FULL, CanIdType=EXTENDED, CanObjectType=RECEIVE, CanObjectId=98, CanControllerRef=Can_Network_CanNodeNum_03
          CanHwFilter: CanHwFilterCode=500000001, CanHwFilterMask=2047
        Can_HwObject_CanNodeNum_03_Rx_08: CanHwObjectCount=1, CanHandleType=FULL, CanIdType=EXTENDED, CanObjectType=RECEIVE, CanObjectId=99, CanControllerRef=Can_Network_CanNodeNum_03
          CanHwFilter: CanHwFilterCode=500000092, CanHwFilterMask=2047
        Can_HwObject_CanNodeNum_03_Rx_09: CanHwObjectCount=1, CanHandleType=FULL, CanIdType=EXTENDED, CanObjectType=RECEIVE, CanObjectId=100, CanControllerRef=Can_Network_CanNodeNum_03
          CanHwFilter: CanHwFilterCode=500000093, CanHwFilterMask=2047
        Can_HwObject_CanNodeNum_03_Rx_10: CanHwObjectCount=1, CanHandleType=FULL, CanIdType=EXTENDED, CanObjectType=RECEIVE, CanObjectId=101, CanControllerRef=Can_Network_CanNodeNum_03
          CanHwFilter: CanHwFilterCode=500000094, CanHwFilterMask=2047
        Can_HwObject_CanNodeNum_03_Rx_11: CanHwObjectCount=1, CanHandleType=FULL, CanIdType=EXTENDED, CanObjectType=RECEIVE, CanObjectId=102, CanControllerRef=Can_Network_CanNodeNum_03
          CanHwFilter: CanHwFilterCode=500000095, CanHwFilterMask=2047
        Can_HwObject_CanNodeNum_03_Rx_12: CanHwObjectCount=1, CanHandleType=FULL, CanIdType=EXTENDED, CanObjectType=RECEIVE, CanObjectId=103, CanControllerRef=Can_Network_CanNodeNum_03
          CanHwFilter: CanHwFilterCode=500000096, CanHwFilterMask=2047
        Can_HwObject_CanNodeNum_03_Rx_13: CanHwObjectCount=1, CanHandleType=FULL, CanIdType=EXTENDED, CanObjectType=RECEIVE, CanObjectId=104, CanControllerRef=Can_Network_CanNodeNum_03
          CanHwFilter: CanHwFilterCode=500000097, CanHwFilterMask=2047
        Can_HwObject_CanNodeNum_03_Rx_14: CanHwObjectCount=1, CanHandleType=FULL, CanIdType=EXTENDED, CanObjectType=RECEIVE, CanObjectId=105, CanControllerRef=Can_Network_CanNodeNum_03
          CanHwFilter: CanHwFilterCode=500000098, CanHwFilterMask=2047
        Can_HwObject_CanNodeNum_03_Rx_15: CanHwObjectCount=1, CanHandleType=FULL, CanIdType=EXTENDED, CanObjectType=RECEIVE, CanObjectId=106, CanControllerRef=Can_Network_CanNodeNum_03
          CanHwFilter: CanHwFilterCode=500000099, CanHwFilterMask=2047
        Can_HwObject_CanNodeNum_03_Rx_16: CanHwObjectCount=1, CanHandleType=FULL, CanIdType=EXTENDED, CanObjectType=RECEIVE, CanObjectId=107, CanControllerRef=Can_Network_CanNodeNum_03
          CanHwFilter: CanHwFilterCode=500000100, CanHwFilterMask=2047
        Can_HwObject_CanNodeNum_03_Rx_17: CanHwObjectCount=1, CanHandleType=FULL, CanIdType=EXTENDED, CanObjectType=RECEIVE, CanObjectId=108, CanControllerRef=Can_Network_CanNodeNum_03
          CanHwFilter: CanHwFilterCode=500000101, CanHwFilterMask=2047
        Can_HwObject_CanNodeNum_03_Rx_18: CanHwObjectCount=1, CanHandleType=FULL, CanIdType=EXTENDED, CanObjectType=RECEIVE, CanObjectId=109, CanControllerRef=Can_Network_CanNodeNum_03
          CanHwFilter: CanHwFilterCode=500000102, CanHwFilterMask=2047
        Can_HwObject_CanNodeNum_03_Rx_19: CanHwObjectCount=1, CanHandleType=FULL, CanIdType=EXTENDED, CanObjectType=RECEIVE, CanObjectId=110, CanControllerRef=Can_Network_CanNodeNum_03
          CanHwFilter: CanHwFilterCode=500000103, CanHwFilterMask=2047
        Can_HwObject_CanNodeNum_03_Rx_20: CanHwObjectCount=1, CanHandleType=FULL, CanIdType=EXTENDED, CanObjectType=RECEIVE, CanObjectId=111, CanControllerRef=Can_Network_CanNodeNum_03
          CanHwFilter: CanHwFilterCode=500000104, CanHwFilterMask=2047
        Can_HwObject_CanNodeNum_03_Rx_21: CanHwObjectCount=1, CanHandleType=FULL, CanIdType=EXTENDED, CanObjectType=RECEIVE, CanObjectId=112, CanControllerRef=Can_Network_CanNodeNum_03
          CanHwFilter: CanHwFilterCode=500000105, CanHwFilterMask=2047
        Can_HwObject_CanNodeNum_03_Rx_22: CanHwObjectCount=1, CanHandleType=FULL, CanIdType=EXTENDED, CanObjectType=RECEIVE, CanObjectId=113, CanControllerRef=Can_Network_CanNodeNum_03
          CanHwFilter: CanHwFilterCode=500000106, CanHwFilterMask=2047
        Can_HwObject_CanNodeNum_03_Rx_23: CanHwObjectCount=1, CanHandleType=FULL, CanIdType=EXTENDED, CanObjectType=RECEIVE, CanObjectId=114, CanControllerRef=Can_Network_CanNodeNum_03
          CanHwFilter: CanHwFilterCode=500000107, CanHwFilterMask=2047
        Can_HwObject_CanNodeNum_03_Rx_24: CanHwObjectCount=1, CanHandleType=FULL, CanIdType=EXTENDED, CanObjectType=RECEIVE, CanObjectId=115, CanControllerRef=Can_Network_CanNodeNum_03
          CanHwFilter: CanHwFilterCode=500000108, CanHwFilterMask=2047
        Can_HwObject_CanNodeNum_03_Rx_25: CanHwObjectCount=1, CanHandleType=FULL, CanIdType=EXTENDED, CanObjectType=RECEIVE, CanObjectId=116, CanControllerRef=Can_Network_CanNodeNum_03
          CanHwFilter: CanHwFilterCode=500000109, CanHwFilterMask=2047
        Can_HwObject_CanNodeNum_03_Rx_26: CanHwObjectCount=1, CanHandleType=FULL, CanIdType=EXTENDED, CanObjectType=RECEIVE, CanObjectId=117, CanControllerRef=Can_Network_CanNodeNum_03
          CanHwFilter: CanHwFilterCode=500000110, CanHwFilterMask=2047
        Can_HwObject_CanNodeNum_03_Rx_27: CanHwObjectCount=1, CanHandleType=FULL, CanIdType=EXTENDED, CanObjectType=RECEIVE, CanObjectId=118, CanControllerRef=Can_Network_CanNodeNum_03
          CanHwFilter: CanHwFilterCode=500000111, CanHwFilterMask=2047
        Can_HwObject_CanNodeNum_03_Rx_28: CanHwObjectCount=1, CanHandleType=FULL, CanIdType=EXTENDED, CanObjectType=RECEIVE, CanObjectId=119, CanControllerRef=Can_Network_CanNodeNum_03
          CanHwFilter: CanHwFilterCode=500000112, CanHwFilterMask=2047
        Can_HwObject_CanNodeNum_03_Rx_29: CanHwObjectCount=1, CanHandleType=FULL, CanIdType=EXTENDED, CanObjectType=RECEIVE, CanObjectId=120, CanControllerRef=Can_Network_CanNodeNum_03
          CanHwFilter: CanHwFilterCode=500000113, CanHwFilterMask=2047
        Can_HwObject_CanNodeNum_03_Rx_30: CanHwObjectCount=1, CanHandleType=FULL, CanIdType=EXTENDED, CanObjectType=RECEIVE, CanObjectId=121, CanControllerRef=Can_Network_CanNodeNum_03
          CanHwFilter: CanHwFilterCode=500000114, CanHwFilterMask=2047
        Can_HwObject_CanNodeNum_03_Rx_31: CanHwObjectCount=1, CanHandleType=FULL, CanIdType=EXTENDED, CanObjectType=RECEIVE, CanObjectId=122, CanControllerRef=Can_Network_CanNodeNum_03
          CanHwFilter: CanHwFilterCode=500000115, CanHwFilterMask=2047
        Can_HwObject_CanNodeNum_03_Rx_32: CanHwObjectCount=1, CanHandleType=FULL, CanIdType=EXTENDED, CanObjectType=RECEIVE, CanObjectId=123, CanControllerRef=Can_Network_CanNodeNum_03
          CanHwFilter: CanHwFilterCode=500000116, CanHwFilterMask=2047
        Can_HwObject_CanNodeNum_03_Rx_33: CanHwObjectCount=1, CanHandleType=FULL, CanIdType=EXTENDED, CanObjectType=RECEIVE, CanObjectId=124, CanControllerRef=Can_Network_CanNodeNum_03
          CanHwFilter: CanHwFilterCode=500000117, CanHwFilterMask=2047
        Can_HwObject_CanNodeNum_03_Rx_34: CanHwObjectCount=1, CanHandleType=FULL, CanIdType=EXTENDED, CanObjectType=RECEIVE, CanObjectId=125, CanControllerRef=Can_Network_CanNodeNum_03
          CanHwFilter: CanHwFilterCode=500000118, CanHwFilterMask=2047
        Can_HwObject_CanNodeNum_03_Rx_35: CanHwObjectCount=1, CanHandleType=FULL, CanIdType=EXTENDED, CanObjectType=RECEIVE, CanObjectId=126, CanControllerRef=Can_Network_CanNodeNum_03
          CanHwFilter: CanHwFilterCode=500000119, CanHwFilterMask=2047
        Can_HwObject_CanNodeNum_03_Rx_36: CanHwObjectCount=1, CanHandleType=FULL, CanIdType=EXTENDED, CanObjectType=RECEIVE, CanObjectId=127, CanControllerRef=Can_Network_CanNodeNum_03
          CanHwFilter: CanHwFilterCode=500000120, CanHwFilterMask=2047
        Can_HwObject_CanNodeNum_03_Rx_37: CanHwObjectCount=1, CanHandleType=FULL, CanIdType=EXTENDED, CanObjectType=RECEIVE, CanObjectId=128, CanControllerRef=Can_Network_CanNodeNum_03
          CanHwFilter: CanHwFilterCode=500000121, CanHwFilterMask=2047
        Can_HwObject_CanNodeNum_03_Rx_38: CanHwObjectCount=1, CanHandleType=FULL, CanIdType=EXTENDED, CanObjectType=RECEIVE, CanObjectId=129, CanControllerRef=Can_Network_CanNodeNum_03
          CanHwFilter: CanHwFilterCode=500000122, CanHwFilterMask=2047
        Can_HwObject_CanNodeNum_03_Rx_39: CanHwObjectCount=1, CanHandleType=FULL, CanIdType=EXTENDED, CanObjectType=RECEIVE, CanObjectId=130, CanControllerRef=Can_Network_CanNodeNum_03
          CanHwFilter: CanHwFilterCode=500000123, CanHwFilterMask=2047
        Can_HwObject_CanNodeNum_03_Rx_40: CanHwObjectCount=1, CanHandleType=FULL, CanIdType=EXTENDED, CanObjectType=RECEIVE, CanObjectId=131, CanControllerRef=Can_Network_CanNodeNum_03
          CanHwFilter: CanHwFilterCode=500000124, CanHwFilterMask=2047
        Can_HwObject_CanNodeNum_00_Tx_A: CanHandleType=FULL, CanObjectId=132, CanObjectType=TRANSMIT, CanHwObjectCount=1, CanIdType=STANDARD, CanControllerRef=Can_Network_CanNodeNum_00
        Can_HwObject_CanNodeNum_00_Tx_B: CanHandleType=FULL, CanObjectId=133, CanObjectType=TRANSMIT, CanHwObjectCount=1, CanIdType=STANDARD, CanControllerRef=Can_Network_CanNodeNum_00
        Can_HwObject_CanNodeNum_00_Tx_C: CanHandleType=FULL, CanObjectId=134, CanObjectType=TRANSMIT, CanHwObjectCount=1, CanIdType=STANDARD, CanControllerRef=Can_Network_CanNodeNum_00
        Can_HwObject_CanNodeNum_00_Tx_D: CanHandleType=FULL, CanObjectId=135, CanObjectType=TRANSMIT, CanHwObjectCount=1, CanIdType=STANDARD, CanControllerRef=Can_Network_CanNodeNum_00
        Can_HwObject_CanNodeNum_00_Tx_E: CanHandleType=FULL, CanObjectId=136, CanObjectType=TRANSMIT, CanHwObjectCount=1, CanIdType=STANDARD, CanControllerRef=Can_Network_CanNodeNum_00
        Can_HwObject_CanNodeNum_00_Tx_F: CanHandleType=FULL, CanObjectId=137, CanObjectType=TRANSMIT, CanHwObjectCount=1, CanIdType=STANDARD, CanControllerRef=Can_Network_CanNodeNum_00
        Can_HwObject_CanNodeNum_00_Tx_G: CanHandleType=FULL, CanObjectId=138, CanObjectType=TRANSMIT, CanHwObjectCount=1, CanIdType=STANDARD, CanControllerRef=Can_Network_CanNodeNum_00
        Can_HwObject_CanNodeNum_00_Tx_H: CanHandleType=FULL, CanObjectId=139, CanObjectType=TRANSMIT, CanHwObjectCount=1, CanIdType=STANDARD, CanControllerRef=Can_Network_CanNodeNum_00
        Can_HwObject_CanNodeNum_01_Tx_A: CanHandleType=FULL, CanObjectId=140, CanObjectType=TRANSMIT, CanHwObjectCount=1, CanIdType=STANDARD, CanControllerRef=Can_Network_CanNodeNum_01
        Can_HwObject_CanNodeNum_01_Tx_B: CanHandleType=FULL, CanObjectId=141, CanObjectType=TRANSMIT, CanHwObjectCount=1, CanIdType=EXTENDED, CanControllerRef=Can_Network_CanNodeNum_01
        Can_HwObject_CanNodeNum_01_Tx_Basic: CanHandleType=BASIC, CanObjectId=142, CanObjectType=TRANSMIT, CanHwObjectCount=4, CanIdType=EXTENDED, CanControllerRef=Can_Network_CanNodeNum_01
        Can_HwObject_CanNodeNum_01_Tx_01: CanHandleType=FULL, CanObjectId=143, CanObjectType=TRANSMIT, CanHwObjectCount=1, CanIdType=EXTENDED, CanControllerRef=Can_Network_CanNodeNum_01
        Can_HwObject_CanNodeNum_01_Tx_02: CanHandleType=FULL, CanObjectId=144, CanObjectType=TRANSMIT, CanHwObjectCount=1, CanIdType=EXTENDED, CanControllerRef=Can_Network_CanNodeNum_01
        Can_HwObject_CanNodeNum_01_Tx_03: CanHandleType=FULL, CanObjectId=145, CanObjectType=TRANSMIT, CanHwObjectCount=1, CanIdType=EXTENDED, CanControllerRef=Can_Network_CanNodeNum_01
        Can_HwObject_CanNodeNum_01_Tx_04: CanHandleType=FULL, CanObjectId=146, CanObjectType=TRANSMIT, CanHwObjectCount=1, CanIdType=EXTENDED, CanControllerRef=Can_Network_CanNodeNum_01
        Can_HwObject_CanNodeNum_01_Tx_05: CanHandleType=FULL, CanObjectId=147, CanObjectType=TRANSMIT, CanHwObjectCount=1, CanIdType=EXTENDED, CanControllerRef=Can_Network_CanNodeNum_01
        Can_HwObject_CanNodeNum_01_Tx_06: CanHandleType=FULL, CanObjectId=148, CanObjectType=TRANSMIT, CanHwObjectCount=1, CanIdType=EXTENDED, CanControllerRef=Can_Network_CanNodeNum_01
        Can_HwObject_CanNodeNum_01_Tx_07: CanHandleType=FULL, CanObjectId=149, CanObjectType=TRANSMIT, CanHwObjectCount=1, CanIdType=EXTENDED, CanControllerRef=Can_Network_CanNodeNum_01
        Can_HwObject_CanNodeNum_01_Tx_08: CanHandleType=FULL, CanObjectId=150, CanObjectType=TRANSMIT, CanHwObjectCount=1, CanIdType=EXTENDED, CanControllerRef=Can_Network_CanNodeNum_01
        Can_HwObject_CanNodeNum_01_Tx_09: CanHandleType=FULL, CanObjectId=151, CanObjectType=TRANSMIT, CanHwObjectCount=1, CanIdType=EXTENDED, CanControllerRef=Can_Network_CanNodeNum_01
        Can_HwObject_CanNodeNum_01_Tx_10: CanHandleType=FULL, CanObjectId=152, CanObjectType=TRANSMIT, CanHwObjectCount=1, CanIdType=EXTENDED, CanControllerRef=Can_Network_CanNodeNum_01
        Can_HwObject_CanNodeNum_01_Tx_11: CanHandleType=FULL, CanObjectId=153, CanObjectType=TRANSMIT, CanHwObjectCount=1, CanIdType=EXTENDED, CanControllerRef=Can_Network_CanNodeNum_01
        Can_HwObject_CanNodeNum_01_Tx_12: CanHandleType=FULL, CanObjectId=154, CanObjectType=TRANSMIT, CanHwObjectCount=1, CanIdType=EXTENDED, CanControllerRef=Can_Network_CanNodeNum_01
        Can_HwObject_CanNodeNum_01_Tx_13: CanHandleType=FULL, CanObjectId=155, CanObjectType=TRANSMIT, CanHwObjectCount=1, CanIdType=EXTENDED, CanControllerRef=Can_Network_CanNodeNum_01
        Can_HwObject_CanNodeNum_01_Tx_14: CanHandleType=FULL, CanObjectId=156, CanObjectType=TRANSMIT, CanHwObjectCount=1, CanIdType=EXTENDED, CanControllerRef=Can_Network_CanNodeNum_01
        Can_HwObject_CanNodeNum_01_Tx_15: CanHandleType=FULL, CanObjectId=157, CanObjectType=TRANSMIT, CanHwObjectCount=1, CanIdType=EXTENDED, CanControllerRef=Can_Network_CanNodeNum_01
        Can_HwObject_CanNodeNum_01_Tx_16: CanHandleType=FULL, CanObjectId=158, CanObjectType=TRANSMIT, CanHwObjectCount=1, CanIdType=EXTENDED, CanControllerRef=Can_Network_CanNodeNum_01
        Can_HwObject_CanNodeNum_01_Tx_17: CanHandleType=FULL, CanObjectId=159, CanObjectType=TRANSMIT, CanHwObjectCount=1, CanIdType=EXTENDED, CanControllerRef=Can_Network_CanNodeNum_01
        Can_HwObject_CanNodeNum_01_Tx_18: CanHandleType=FULL, CanObjectId=160, CanObjectType=TRANSMIT, CanHwObjectCount=1, CanIdType=EXTENDED, CanControllerRef=Can_Network_CanNodeNum_01
        Can_HwObject_CanNodeNum_01_Tx_19: CanHandleType=FULL, CanObjectId=161, CanObjectType=TRANSMIT, CanHwObjectCount=1, CanIdType=EXTENDED, CanControllerRef=Can_Network_CanNodeNum_01
        Can_HwObject_CanNodeNum_01_Tx_20: CanHandleType=FULL, CanObjectId=162, CanObjectType=TRANSMIT, CanHwObjectCount=1, CanIdType=EXTENDED, CanControllerRef=Can_Network_CanNodeNum_01
        Can_HwObject_CanNodeNum_01_Tx_21: CanHandleType=FULL, CanObjectId=163, CanObjectType=TRANSMIT, CanHwObjectCount=1, CanIdType=EXTENDED, CanControllerRef=Can_Network_CanNodeNum_01
        Can_HwObject_CanNodeNum_01_Tx_22: CanHandleType=FULL, CanObjectId=164, CanObjectType=TRANSMIT, CanHwObjectCount=1, CanIdType=EXTENDED, CanControllerRef=Can_Network_CanNodeNum_01
        Can_HwObject_CanNodeNum_01_Tx_23: CanHandleType=FULL, CanObjectId=165, CanObjectType=TRANSMIT, CanHwObjectCount=1, CanIdType=EXTENDED, CanControllerRef=Can_Network_CanNodeNum_01
        Can_HwObject_CanNodeNum_01_Tx_24: CanHandleType=FULL, CanObjectId=166, CanObjectType=TRANSMIT, CanHwObjectCount=1, CanIdType=EXTENDED, CanControllerRef=Can_Network_CanNodeNum_01
        Can_HwObject_CanNodeNum_01_Tx_25: CanHandleType=FULL, CanObjectId=167, CanObjectType=TRANSMIT, CanHwObjectCount=1, CanIdType=EXTENDED, CanControllerRef=Can_Network_CanNodeNum_01
        Can_HwObject_CanNodeNum_01_Tx_26: CanHandleType=FULL, CanObjectId=168, CanObjectType=TRANSMIT, CanHwObjectCount=1, CanIdType=EXTENDED, CanControllerRef=Can_Network_CanNodeNum_01
        Can_HwObject_CanNodeNum_02_Tx_A: CanHandleType=FULL, CanObjectId=169, CanObjectType=TRANSMIT, CanHwObjectCount=1, CanIdType=STANDARD, CanControllerRef=Can_Network_CanNodeNum_02
        Can_HwObject_CanNodeNum_02_Tx_B: CanHandleType=FULL, CanObjectId=170, CanObjectType=TRANSMIT, CanHwObjectCount=1, CanIdType=STANDARD, CanControllerRef=Can_Network_CanNodeNum_02
        Can_HwObject_CanNodeNum_02_Tx_Basic: CanHandleType=BASIC, CanObjectId=171, CanObjectType=TRANSMIT, CanHwObjectCount=4, CanIdType=STANDARD, CanControllerRef=Can_Network_CanNodeNum_02
        Can_HwObject_CanNodeNum_02_Tx_01: CanHwObjectCount=1, CanHandleType=FULL, CanIdType=EXTENDED, CanObjectType=TRANSMIT, CanObjectId=172, CanControllerRef=Can_Network_CanNodeNum_02
        Can_HwObject_CanNodeNum_02_Tx_02: CanHwObjectCount=1, CanHandleType=FULL, CanIdType=EXTENDED, CanObjectType=TRANSMIT, CanObjectId=173, CanControllerRef=Can_Network_CanNodeNum_02
        Can_HwObject_CanNodeNum_02_Tx_03: CanHwObjectCount=1, CanHandleType=FULL, CanIdType=EXTENDED, CanObjectType=TRANSMIT, CanObjectId=174, CanControllerRef=Can_Network_CanNodeNum_02
        Can_HwObject_CanNodeNum_02_Tx_04: CanHwObjectCount=1, CanHandleType=FULL, CanIdType=EXTENDED, CanObjectType=TRANSMIT, CanObjectId=175, CanControllerRef=Can_Network_CanNodeNum_02
        Can_HwObject_CanNodeNum_02_Tx_05: CanHwObjectCount=1, CanHandleType=FULL, CanIdType=EXTENDED, CanObjectType=TRANSMIT, CanObjectId=176, CanControllerRef=Can_Network_CanNodeNum_02
        Can_HwObject_CanNodeNum_02_Tx_06: CanHwObjectCount=1, CanHandleType=FULL, CanIdType=EXTENDED, CanObjectType=TRANSMIT, CanObjectId=177, CanControllerRef=Can_Network_CanNodeNum_02
        Can_HwObject_CanNodeNum_02_Tx_07: CanHwObjectCount=1, CanHandleType=FULL, CanIdType=EXTENDED, CanObjectType=TRANSMIT, CanObjectId=178, CanControllerRef=Can_Network_CanNodeNum_02
        Can_HwObject_CanNodeNum_02_Tx_08: CanHwObjectCount=1, CanHandleType=FULL, CanIdType=EXTENDED, CanObjectType=TRANSMIT, CanObjectId=179, CanControllerRef=Can_Network_CanNodeNum_02
        Can_HwObject_CanNodeNum_02_Tx_09: CanHwObjectCount=1, CanHandleType=FULL, CanIdType=EXTENDED, CanObjectType=TRANSMIT, CanObjectId=180, CanControllerRef=Can_Network_CanNodeNum_02
        Can_HwObject_CanNodeNum_02_Tx_10: CanHwObjectCount=1, CanHandleType=FULL, CanIdType=EXTENDED, CanObjectType=TRANSMIT, CanObjectId=181, CanControllerRef=Can_Network_CanNodeNum_02
        Can_HwObject_CanNodeNum_02_Tx_11: CanHwObjectCount=1, CanHandleType=FULL, CanIdType=EXTENDED, CanObjectType=TRANSMIT, CanObjectId=182, CanControllerRef=Can_Network_CanNodeNum_02
        Can_HwObject_CanNodeNum_02_Tx_12: CanHwObjectCount=1, CanHandleType=FULL, CanIdType=EXTENDED, CanObjectType=TRANSMIT, CanObjectId=183, CanControllerRef=Can_Network_CanNodeNum_02
        Can_HwObject_CanNodeNum_02_Tx_13: CanHwObjectCount=1, CanHandleType=FULL, CanIdType=EXTENDED, CanObjectType=TRANSMIT, CanObjectId=184, CanControllerRef=Can_Network_CanNodeNum_02
        Can_HwObject_CanNodeNum_02_Tx_14: CanHwObjectCount=1, CanHandleType=FULL, CanIdType=EXTENDED, CanObjectType=TRANSMIT, CanObjectId=185, CanControllerRef=Can_Network_CanNodeNum_02
        Can_HwObject_CanNodeNum_02_Tx_15: CanHwObjectCount=1, CanHandleType=FULL, CanIdType=EXTENDED, CanObjectType=TRANSMIT, CanObjectId=186, CanControllerRef=Can_Network_CanNodeNum_02
        Can_HwObject_CanNodeNum_02_Tx_16: CanHwObjectCount=1, CanHandleType=FULL, CanIdType=EXTENDED, CanObjectType=TRANSMIT, CanObjectId=187, CanControllerRef=Can_Network_CanNodeNum_02
        Can_HwObject_CanNodeNum_02_Tx_17: CanHwObjectCount=1, CanHandleType=FULL, CanIdType=EXTENDED, CanObjectType=TRANSMIT, CanObjectId=188, CanControllerRef=Can_Network_CanNodeNum_02
        Can_HwObject_CanNodeNum_02_Tx_18: CanHwObjectCount=1, CanHandleType=FULL, CanIdType=EXTENDED, CanObjectType=TRANSMIT, CanObjectId=189, CanControllerRef=Can_Network_CanNodeNum_02
        Can_HwObject_CanNodeNum_02_Tx_19: CanHwObjectCount=1, CanHandleType=FULL, CanIdType=EXTENDED, CanObjectType=TRANSMIT, CanObjectId=190, CanControllerRef=Can_Network_CanNodeNum_02
        Can_HwObject_CanNodeNum_02_Tx_20: CanHwObjectCount=1, CanHandleType=FULL, CanIdType=EXTENDED, CanObjectType=TRANSMIT, CanObjectId=191, CanControllerRef=Can_Network_CanNodeNum_02
        Can_HwObject_CanNodeNum_02_Tx_21: CanHwObjectCount=1, CanHandleType=FULL, CanIdType=EXTENDED, CanObjectType=TRANSMIT, CanObjectId=192, CanControllerRef=Can_Network_CanNodeNum_02
        Can_HwObject_CanNodeNum_02_Tx_22: CanHwObjectCount=1, CanHandleType=FULL, CanIdType=EXTENDED, CanObjectType=TRANSMIT, CanObjectId=193, CanControllerRef=Can_Network_CanNodeNum_02
        Can_HwObject_CanNodeNum_02_Tx_23: CanHwObjectCount=1, CanHandleType=FULL, CanIdType=EXTENDED, CanObjectType=TRANSMIT, CanObjectId=194, CanControllerRef=Can_Network_CanNodeNum_02
        Can_HwObject_CanNodeNum_02_Tx_24: CanHwObjectCount=1, CanHandleType=FULL, CanIdType=EXTENDED, CanObjectType=TRANSMIT, CanObjectId=195, CanControllerRef=Can_Network_CanNodeNum_02
        Can_HwObject_CanNodeNum_02_Tx_25: CanHwObjectCount=1, CanHandleType=FULL, CanIdType=EXTENDED, CanObjectType=TRANSMIT, CanObjectId=196, CanControllerRef=Can_Network_CanNodeNum_02
        Can_HwObject_CanNodeNum_02_Tx_26: CanHwObjectCount=1, CanHandleType=FULL, CanIdType=EXTENDED, CanObjectType=TRANSMIT, CanObjectId=197, CanControllerRef=Can_Network_CanNodeNum_02
        Can_HwObject_CanNodeNum_03_Tx_A: CanHandleType=FULL, CanObjectId=198, CanObjectType=TRANSMIT, CanHwObjectCount=1, CanIdType=STANDARD, CanControllerRef=Can_Network_CanNodeNum_03
        Can_HwObject_CanNodeNum_03_Tx_B: CanHandleType=FULL, CanObjectId=199, CanObjectType=TRANSMIT, CanHwObjectCount=1, CanIdType=EXTENDED, CanControllerRef=Can_Network_CanNodeNum_03
        Can_HwObject_CanNodeNum_03_Tx_Basic: CanHandleType=BASIC, CanObjectId=200, CanObjectType=TRANSMIT, CanHwObjectCount=4, CanIdType=STANDARD, CanControllerRef=Can_Network_CanNodeNum_03
        Can_HwObject_CanNodeNum_03_Tx_01: CanHwObjectCount=1, CanHandleType=FULL, CanIdType=EXTENDED, CanObjectType=TRANSMIT, CanObjectId=201, CanControllerRef=Can_Network_CanNodeNum_03
        Can_HwObject_CanNodeNum_03_Tx_02: CanHwObjectCount=1, CanHandleType=FULL, CanIdType=STANDARD, CanObjectType=TRANSMIT, CanObjectId=202, CanControllerRef=Can_Network_CanNodeNum_03
        Can_HwObject_CanNodeNum_03_Tx_03: CanHwObjectCount=1, CanHandleType=FULL, CanIdType=EXTENDED, CanObjectType=TRANSMIT, CanObjectId=203, CanControllerRef=Can_Network_CanNodeNum_03
        Can_HwObject_CanNodeNum_03_Tx_04: CanHwObjectCount=1, CanHandleType=FULL, CanIdType=STANDARD, CanObjectType=TRANSMIT, CanObjectId=204, CanControllerRef=Can_Network_CanNodeNum_03
        Can_HwObject_CanNodeNum_03_Tx_05: CanHwObjectCount=1, CanHandleType=FULL, CanIdType=STANDARD, CanObjectType=TRANSMIT, CanObjectId=205, CanControllerRef=Can_Network_CanNodeNum_03
        Can_HwObject_CanNodeNum_03_Tx_06: CanHwObjectCount=1, CanHandleType=FULL, CanIdType=STANDARD, CanObjectType=TRANSMIT, CanObjectId=206, CanControllerRef=Can_Network_CanNodeNum_03
        Can_HwObject_CanNodeNum_03_Tx_07: CanHwObjectCount=1, CanHandleType=FULL, CanIdType=EXTENDED, CanObjectType=TRANSMIT, CanObjectId=207, CanControllerRef=Can_Network_CanNodeNum_03
        Can_HwObject_CanNodeNum_03_Tx_08: CanHwObjectCount=1, CanHandleType=FULL, CanIdType=EXTENDED, CanObjectType=TRANSMIT, CanObjectId=208, CanControllerRef=Can_Network_CanNodeNum_03
        Can_HwObject_CanNodeNum_03_Tx_09: CanHwObjectCount=1, CanHandleType=FULL, CanIdType=EXTENDED, CanObjectType=TRANSMIT, CanObjectId=209, CanControllerRef=Can_Network_CanNodeNum_03
        Can_HwObject_CanNodeNum_03_Tx_10: CanHwObjectCount=1, CanHandleType=FULL, CanIdType=EXTENDED, CanObjectType=TRANSMIT, CanObjectId=210, CanControllerRef=Can_Network_CanNodeNum_03
        Can_HwObject_CanNodeNum_03_Tx_11: CanHwObjectCount=1, CanHandleType=FULL, CanIdType=EXTENDED, CanObjectType=TRANSMIT, CanObjectId=211, CanControllerRef=Can_Network_CanNodeNum_03
        Can_HwObject_CanNodeNum_03_Tx_12: CanHwObjectCount=1, CanHandleType=FULL, CanIdType=EXTENDED, CanObjectType=TRANSMIT, CanObjectId=212, CanControllerRef=Can_Network_CanNodeNum_03
        Can_HwObject_CanNodeNum_03_Tx_13: CanHwObjectCount=1, CanHandleType=FULL, CanIdType=EXTENDED, CanObjectType=TRANSMIT, CanObjectId=213, CanControllerRef=Can_Network_CanNodeNum_03
        Can_HwObject_CanNodeNum_03_Tx_14: CanHwObjectCount=1, CanHandleType=FULL, CanIdType=EXTENDED, CanObjectType=TRANSMIT, CanObjectId=214, CanControllerRef=Can_Network_CanNodeNum_03
        Can_HwObject_CanNodeNum_03_Tx_15: CanHwObjectCount=1, CanHandleType=FULL, CanIdType=EXTENDED, CanObjectType=TRANSMIT, CanObjectId=215, CanControllerRef=Can_Network_CanNodeNum_03
        Can_HwObject_CanNodeNum_03_Tx_16: CanHwObjectCount=1, CanHandleType=FULL, CanIdType=EXTENDED, CanObjectType=TRANSMIT, CanObjectId=216, CanControllerRef=Can_Network_CanNodeNum_03
        Can_HwObject_CanNodeNum_03_Tx_17: CanHwObjectCount=1, CanHandleType=FULL, CanIdType=EXTENDED, CanObjectType=TRANSMIT, CanObjectId=217, CanControllerRef=Can_Network_CanNodeNum_03
        Can_HwObject_CanNodeNum_03_Tx_18: CanHwObjectCount=1, CanHandleType=FULL, CanIdType=EXTENDED, CanObjectType=TRANSMIT, CanObjectId=218, CanControllerRef=Can_Network_CanNodeNum_03
        Can_HwObject_CanNodeNum_03_Tx_19: CanHwObjectCount=1, CanHandleType=FULL, CanIdType=EXTENDED, CanObjectType=TRANSMIT, CanObjectId=219, CanControllerRef=Can_Network_CanNodeNum_03
        Can_HwObject_CanNodeNum_03_Tx_20: CanHwObjectCount=1, CanHandleType=FULL, CanIdType=EXTENDED, CanObjectType=TRANSMIT, CanObjectId=220, CanControllerRef=Can_Network_CanNodeNum_03
        Can_HwObject_CanNodeNum_03_Tx_21: CanHwObjectCount=1, CanHandleType=FULL, CanIdType=EXTENDED, CanObjectType=TRANSMIT, CanObjectId=221, CanControllerRef=Can_Network_CanNodeNum_03
        Can_HwObject_CanNodeNum_03_Tx_22: CanHwObjectCount=1, CanHandleType=FULL, CanIdType=EXTENDED, CanObjectType=TRANSMIT, CanObjectId=222, CanControllerRef=Can_Network_CanNodeNum_03
        Can_HwObject_CanNodeNum_03_Tx_23: CanHwObjectCount=1, CanHandleType=FULL, CanIdType=EXTENDED, CanObjectType=TRANSMIT, CanObjectId=223, CanControllerRef=Can_Network_CanNodeNum_03
        Can_HwObject_CanNodeNum_03_Tx_24: CanHwObjectCount=1, CanHandleType=FULL, CanIdType=EXTENDED, CanObjectType=TRANSMIT, CanObjectId=224, CanControllerRef=Can_Network_CanNodeNum_03
        Can_HwObject_CanNodeNum_03_Tx_25: CanHwObjectCount=1, CanHandleType=FULL, CanIdType=EXTENDED, CanObjectType=TRANSMIT, CanObjectId=225, CanControllerRef=Can_Network_CanNodeNum_03
        Can_HwObject_CanNodeNum_03_Tx_26: CanHwObjectCount=1, CanHandleType=FULL, CanIdType=EXTENDED, CanObjectType=TRANSMIT, CanObjectId=226, CanControllerRef=Can_Network_CanNodeNum_03
    CanGeneral:
      CanIndex = 0
      CanMultiplexedTransmission = false
      CanMainFunctionModePeriod = 0.001
      CanVersionInfoApi = false
      CanMainFunctionBusoffPeriod = 0.001
      CanDevErrorDetection = true
      CanPublicIcomSupport = false
      CanTimeoutDuration = 1
