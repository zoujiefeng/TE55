AUTOSAR XML (schema 00047)
package /ETAS_Project/EcucModuleConfigurationValuess
  module config CanIf: implementation-config-variant=VARIANT-PRE-COMPILE
    CanIfCtrlDrvCfg: CanIfRbCtrlDrvPrefix=Can_17_McmCanConf_CanHardwareObject, CanIfCtrlDrvNameRef=CanGeneral, CanIfCtrlDrvInitHohConfigRef=CanIfInitHohCfg
      4 x CanIfCtrlCfg:
        CanIf_CanNodeNum_00: CanIfCtrlWakeupSupport=false, CanIfCtrlCanCtrlRef=Can_Network_CanNodeNum_00
        CanIf_CanNodeNum_01: CanIfCtrlWakeupSupport=false, CanIfCtrlCanCtrlRef=Can_Network_CanNodeNum_01
        CanIf_CanNodeNum_02: CanIfCtrlWakeupSupport=0, CanIfCtrlId=2, CanIfCtrlCanCtrlRef=Can_Network_CanNodeNum_02
        CanIf_CanNodeNum_03: CanIfCtrlWakeupSupport=0, CanIfCtrlId=3, CanIfCtrlCanCtrlRef=Can_Network_CanNodeNum_03
    CanIfInitCfg: CanIfInitCfgSet=0
      3 x CanIfRxPduCfg, all with CanIfRxPduDlc=0, CanIfRxPduReadData=false, CanIfRxPduReadNotifyStatus=true:
        CanIf_XcpPdu_CanNodeNum_00_Rx_Broadcast: CanIfRxPduUserRxIndicationUL=XCP, CanIfRxPduCanId=818, CanIfRxPduCanIdType=STANDARD_NO_FD_CAN, CanIfRxPduUserRxIndicationName=Xcp_CanIfRxIndication, CanIfRxPduRef=XcpPdu_CanIf2Xcp_CanNodeNum_00_Rx_Broadcast, CanIfRxPduHrhIdRef=CanIf_HwRxHandle_CanNodeNum_00_Rx_A
        CanIf_XcpPdu_CanNodeNum_00_Rx_Cmd: CanIfRxPduUserRxIndicationUL=XCP, CanIfRxPduCanId=819, CanIfRxPduCanIdType=STANDARD_NO_FD_CAN, CanIfRxPduUserRxIndicationName=Xcp_CanIfRxIndication, CanIfRxPduRef=XcpPdu_CanIf2Xcp_CanNodeNum_00_Rx_Cmd, CanIfRxPduHrhIdRef=CanIf_HwRxHandle_CanNodeNum_00_Rx_B
        CanIf_CcpPdu_CanNodeNum_00_Rx_Cro: CanIfRxPduUserRxIndicationUL=CDD, CanIfRxPduCanId=791, CanIfRxPduCanIdType=STANDARD_CAN, CanIfRxPduUserRxIndicationName=Ccp_RxIndication_CRO, CanIfRxPduRef=CcpPdu_CanIf2Cdd_CanNodeNum_00_Rx_Cro, CanIfRxPduHrhIdRef=CanIf_HwRxHandle_CanNodeNum_00_Rx_C
      CanIf_XcpPdu_CanNodeNum_00_Tx_Daq0 (CanIfTxPduCfg):
        CanIfTxPduUserTxConfirmationName = Xcp_CanIfTxConfirmation
        CanIfTxPduReadNotifyStatus = false
        CanIfTxPduUserTxConfirmationUL = XCP
        CanIfTxPduCanId = 1912
        CanIfTxPduCanIdType = STANDARD_CAN
        CanIfTxPduTruncation = false
        CanIfTxPduType = STATIC
        CanIfTxPduRef = XcpPdu_Xcp2CanIf_CanNodeNum_00_Tx_Daq0
        CanIfTxPduBufferRef = CanIf_Buffer_CanNodeNum_00_Tx_A
      CanIf_Buffer_CanNodeNum_00_Tx_A (CanIfBufferCfg): CanIfBufferSize=0, CanIfBufferHthRef=CanIf_HwTxHandle_CanNodeNum_00_Tx_A
      CanIf_Buffer_CanNodeNum_00_Tx_B (CanIfBufferCfg): CanIfBufferSize=0, CanIfBufferHthRef=CanIf_HwTxHandle_CanNodeNum_00_Tx_B
      CanIfInitHohCfg
        4 x CanIfHrhCfg:
          CanIf_HwRxHandle_CanNodeNum_00_Rx_A: CanIfHrhIdSymRef=Can_HwObject_CanNodeNum_00_Rx_A, CanIfHrhCanCtrlIdRef=CanIf_CanNodeNum_00
          CanIf_HwRxHandle_CanNodeNum_00_Rx_B: CanIfHrhIdSymRef=Can_HwObject_CanNodeNum_00_Rx_B, CanIfHrhCanCtrlIdRef=CanIf_CanNodeNum_00
          CanIf_HwRxHandle_CanNodeNum_00_Rx_C: CanIfHrhIdSymRef=Can_HwObject_CanNodeNum_00_Rx_C, CanIfHrhCanCtrlIdRef=CanIf_CanNodeNum_00
          CanIf_HwRxHandle_CanNodeNum_01_Rx_A: CanIfHrhIdSymRef=Can_HwObject_CanNodeNum_01_Rx_A, CanIfHrhCanCtrlIdRef=CanIf_CanNodeNum_01
            CanIfHrhRangeCfg: CanIfHrhRangeRxPduLowerCanId=1408, CanIfHrhRangeRxPduUpperCanId=1535, CanIfHrhRangeRxPduRangeCanIdType=STANDARD
        9 x CanIfHthCfg:
          CanIf_HwTxHandle_CanNodeNum_00_Tx_A: CanIfHthCanCtrlIdRef=CanIf_CanNodeNum_00, CanIfHthIdSymRef=Can_HwObject_CanNodeNum_00_Tx_A
          CanIf_HwTxHandle_CanNodeNum_00_Tx_B: CanIfHthCanCtrlIdRef=CanIf_CanNodeNum_00, CanIfHthIdSymRef=Can_HwObject_CanNodeNum_00_Tx_B
          CanIf_HwTxHandle_CanNodeNum_00_Tx_C: CanIfHthCanCtrlIdRef=CanIf_CanNodeNum_00, CanIfHthIdSymRef=Can_HwObject_CanNodeNum_00_Tx_C
          CanIf_HwTxHandle_CanNodeNum_00_Tx_D: CanIfHthCanCtrlIdRef=CanIf_CanNodeNum_00, CanIfHthIdSymRef=Can_HwObject_CanNodeNum_00_Tx_D
          CanIf_HwTxHandle_CanNodeNum_00_Tx_E: CanIfHthCanCtrlIdRef=CanIf_CanNodeNum_00, CanIfHthIdSymRef=Can_HwObject_CanNodeNum_00_Tx_E
          CanIf_HwTxHandle_CanNodeNum_00_Tx_F: CanIfHthCanCtrlIdRef=CanIf_CanNodeNum_00, CanIfHthIdSymRef=Can_HwObject_CanNodeNum_00_Tx_F
          CanIf_HwTxHandle_CanNodeNum_00_Tx_G: CanIfHthCanCtrlIdRef=CanIf_CanNodeNum_00, CanIfHthIdSymRef=Can_HwObject_CanNodeNum_00_Tx_G
          CanIf_HwTxHandle_CanNodeNum_00_Tx_H: CanIfHthCanCtrlIdRef=CanIf_CanNodeNum_00, CanIfHthIdSymRef=Can_HwObject_CanNodeNum_00_Tx_H
          CanIf_HwTxHandle_CanNodeNum_01_Tx_A: CanIfHthCanCtrlIdRef=CanIf_CanNodeNum_01, CanIfHthIdSymRef=Can_HwObject_CanNodeNum_01_Tx_A
        CanIf_HwRxHandle_CanNodeNum_01_Rx_B (CanIfHrhCfg): CanIfHrhIdSymRef=Can_HwObject_CanNodeNum_01_Rx_B, CanIfHrhCanCtrlIdRef=CanIf_CanNodeNum_01
        CanIf_HwRxHandle_CanNodeNum_01_Rx_C (CanIfHrhCfg): CanIfHrhIdSymRef=Can_HwObject_CanNodeNum_01_Rx_C, CanIfHrhCanCtrlIdRef=CanIf_CanNodeNum_01
        CanIf_HwTxHandle_CanNodeNum_01_Tx_B (CanIfHthCfg): CanIfHthCanCtrlIdRef=CanIf_CanNodeNum_01, CanIfHthIdSymRef=Can_HwObject_CanNodeNum_01_Tx_B
        26 x CanIfHrhCfg, all with CanIfHrhCanCtrlIdRef=CanIf_CanNodeNum_01:
          CanIf_HwRxHandle_CanNodeNum_01_Rx_{01..26}: CanIfHrhIdSymRef=Can_HwObject_CanNodeNum_01_Rx_{01..26}
        24 x CanIfHthCfg, all with CanIfHthCanCtrlIdRef=CanIf_CanNodeNum_01:
          CanIf_HwTxHandle_CanNodeNum_01_Tx_Basic: CanIfHthIdSymRef=Can_HwObject_CanNodeNum_01_Tx_Basic
          CanIf_HwTxHandle_CanNodeNum_01_Tx_{01..23}: CanIfHthIdSymRef=Can_HwObject_CanNodeNum_01_Tx_{01..23}
        CanIf_HwRxHandle_CanNodeNum_01_Rx_27 (CanIfHrhCfg): CanIfHrhIdSymRef=Can_HwObject_CanNodeNum_01_Rx_27, CanIfHrhCanCtrlIdRef=CanIf_CanNodeNum_01
        CanIf_HwRxHandle_CanNodeNum_01_Rx_28 (CanIfHrhCfg): CanIfHrhIdSymRef=Can_HwObject_CanNodeNum_01_Rx_28, CanIfHrhCanCtrlIdRef=CanIf_CanNodeNum_01
        57 x CanIfHthCfg:
          CanIf_HwTxHandle_CanNodeNum_01_Tx_{24..26}: CanIfHthCanCtrlIdRef=CanIf_CanNodeNum_01, CanIfHthIdSymRef=Can_HwObject_CanNodeNum_01_Tx_{24..26}
          CanIf_HwTxHandle_CanNodeNum_02_Tx_Basic: CanIfHthCanCtrlIdRef=CanIf_CanNodeNum_02, CanIfHthIdSymRef=Can_HwObject_CanNodeNum_02_Tx_Basic
          CanIf_HwTxHandle_CanNodeNum_02_Tx_{01..26}: CanIfHthCanCtrlIdRef=CanIf_CanNodeNum_02, CanIfHthIdSymRef=Can_HwObject_CanNodeNum_02_Tx_{01..26}
          CanIf_HwTxHandle_CanNodeNum_03_Tx_Basic: CanIfHthCanCtrlIdRef=CanIf_CanNodeNum_03, CanIfHthIdSymRef=Can_HwObject_CanNodeNum_03_Tx_Basic
          CanIf_HwTxHandle_CanNodeNum_03_Tx_{01..26}: CanIfHthCanCtrlIdRef=CanIf_CanNodeNum_03, CanIfHthIdSymRef=Can_HwObject_CanNodeNum_03_Tx_{01..26}
        92 x CanIfHrhCfg:
          CanIf_HwRxHandle_CanNodeNum_01_Rx_{29..40}: CanIfHrhIdSymRef=Can_HwObject_CanNodeNum_01_Rx_{29..40}, CanIfHrhCanCtrlIdRef=CanIf_CanNodeNum_01
          CanIf_HwRxHandle_CanNodeNum_02_Rx_{01..40}: CanIfHrhCanCtrlIdRef=CanIf_CanNodeNum_02, CanIfHrhIdSymRef=Can_HwObject_CanNodeNum_02_Rx_{01..40}
          CanIf_HwRxHandle_CanNodeNum_03_Rx_{01..40}: CanIfHrhCanCtrlIdRef=CanIf_CanNodeNum_03, CanIfHrhIdSymRef=Can_HwObject_CanNodeNum_03_Rx_{01..40}
      CanIf_CanNmPdu_CanNodeNum_01_Rx_RIPC (CanIfRxPduCfg):
        CanIfRxPduUserRxIndicationUL = CAN_NM
        CanIfRxPduDlc = 8
        CanIfRxPduCanIdType = STANDARD_CAN
        CanIfRxPduReadData = false
        CanIfRxPduReadNotifyStatus = true
        CanIfRxPduUserRxIndicationName = CanNm_RxIndication
        CanIfRxPduRef = CanNmPdu_CanIf2CanNm_CanNodeNum_01_RIPC
        CanIfRxPduHrhIdRef = CanIf_HwRxHandle_CanNodeNum_01_Rx_A
        CanIfRxPduCanIdRange: CanIfRxPduCanIdRangeLowerCanId=1408, CanIfRxPduCanIdRangeUpperCanId=1535
      8 x CanIfTxPduCfg, all with CanIfTxPduReadNotifyStatus=false, CanIfTxPduCanIdType=STANDARD_CAN, CanIfTxPduTruncation=false, CanIfTxPduType=STATIC:
        CanIf_XcpPdu_CanNodeNum_00_Tx_Daq1: CanIfTxPduUserTxConfirmationName=Xcp_CanIfTxConfirmation, CanIfTxPduUserTxConfirmationUL=XCP, CanIfTxPduCanId=1913, CanIfTxPduRef=XcpPdu_Xcp2CanIf_CanNodeNum_00_Tx_Daq1, CanIfTxPduBufferRef=CanIf_Buffer_CanNodeNum_00_Tx_B
        CanIf_XcpPdu_CanNodeNum_00_Tx_Daq2: CanIfTxPduUserTxConfirmationName=Xcp_CanIfTxConfirmation, CanIfTxPduUserTxConfirmationUL=XCP, CanIfTxPduCanId=1914, CanIfTxPduRef=XcpPdu_Xcp2CanIf_CanNodeNum_00_Tx_Daq2, CanIfTxPduBufferRef=CanIf_Buffer_CanNodeNum_00_Tx_C
        CanIf_XcpPdu_CanNodeNum_00_Tx_Res: CanIfTxPduUserTxConfirmationName=Xcp_CanIfTxConfirmation, CanIfTxPduUserTxConfirmationUL=XCP, CanIfTxPduCanId=1911, CanIfTxPduRef=XcpPdu_Xcp2CanIf_CanNodeNum_00_Tx_Res, CanIfTxPduBufferRef=CanIf_Buffer_CanNodeNum_00_Tx_D
        CanIf_CcpPdu_CanNodeNum_00_Tx_Daq0: CanIfTxPduUserTxConfirmationName=Ccp_TxConfirmation_1ms, CanIfTxPduUserTxConfirmationUL=CDD, CanIfTxPduCanId=534, CanIfTxPduRef=CcpPdu_Cdd2CanIf_CanNodeNum_00_Tx_Daq0, CanIfTxPduBufferRef=CanIf_Buffer_CanNodeNum_00_Tx_E
        CanIf_CcpPdu_CanNodeNum_00_Tx_Daq1: CanIfTxPduUserTxConfirmationName=Ccp_TxConfirmation_100us, CanIfTxPduUserTxConfirmationUL=CDD, CanIfTxPduCanId=533, CanIfTxPduRef=CcpPdu_Cdd2CanIf_CanNodeNum_00_Tx_Daq1, CanIfTxPduBufferRef=CanIf_Buffer_CanNodeNum_00_Tx_F
        CanIf_CcpPdu_CanNodeNum_00_Tx_Daq2: CanIfTxPduUserTxConfirmationName=Ccp_TxConfirmation_10ms, CanIfTxPduUserTxConfirmationUL=CDD, CanIfTxPduCanId=535, CanIfTxPduRef=CcpPdu_Cdd2CanIf_CanNodeNum_00_Tx_Daq2, CanIfTxPduBufferRef=CanIf_Buffer_CanNodeNum_00_Tx_G
        CanIf_CcpPdu_CanNodeNum_00_Tx_Dto: CanIfTxPduUserTxConfirmationName=Ccp_TxConfirmation_DTO, CanIfTxPduUserTxConfirmationUL=CDD, CanIfTxPduCanId=792, CanIfTxPduRef=CcpPdu_Cdd2CanIf_CanNodeNum_00_Tx_Dto, CanIfTxPduBufferRef=CanIf_Buffer_CanNodeNum_00_Tx_H
        CanIf_CanNmPdu_CanNodeNum_01_Tx_IPC: CanIfTxPduUserTxConfirmationName=CanNm_TxConfirmation, CanIfTxPduUserTxConfirmationUL=CAN_NM, CanIfTxPduCanId=1434, CanIfTxPduRef=CanNmPdu_CanNm2CanIf_CanNodeNum_01_IPC, CanIfTxPduBufferRef=CanIf_Buffer_CanNodeNum_01_Tx_A
      7 x CanIfBufferCfg, all with CanIfBufferSize=0:
        CanIf_Buffer_CanNodeNum_00_Tx_C: CanIfBufferHthRef=CanIf_HwTxHandle_CanNodeNum_00_Tx_C
        CanIf_Buffer_CanNodeNum_00_Tx_D: CanIfBufferHthRef=CanIf_HwTxHandle_CanNodeNum_00_Tx_D
        CanIf_Buffer_CanNodeNum_00_Tx_E: CanIfBufferHthRef=CanIf_HwTxHandle_CanNodeNum_00_Tx_E
        CanIf_Buffer_CanNodeNum_00_Tx_F: CanIfBufferHthRef=CanIf_HwTxHandle_CanNodeNum_00_Tx_F
        CanIf_Buffer_CanNodeNum_00_Tx_G: CanIfBufferHthRef=CanIf_HwTxHandle_CanNodeNum_00_Tx_G
        CanIf_Buffer_CanNodeNum_00_Tx_H: CanIfBufferHthRef=CanIf_HwTxHandle_CanNodeNum_00_Tx_H
        CanIf_Buffer_CanNodeNum_01_Tx_A: CanIfBufferHthRef=CanIf_HwTxHandle_CanNodeNum_01_Tx_A
      CanIf_DcmPdu_CanNodeNum_01_Rx_FunRequest (CanIfRxPduCfg):
        CanIfRxPduUserRxIndicationUL = CAN_TP
        CanIfRxPduDlc = 8
        CanIfRxPduCanId = 417071098
        CanIfRxPduCanIdType = STANDARD_CAN
        CanIfRxPduReadData = false
        CanIfRxPduReadNotifyStatus = true
        CanIfRxPduRef = DcmPdu_CanIf2CanTp_CanNodeNum_01_FunRequest
        CanIfRxPduHrhIdRef = CanIf_HwRxHandle_CanNodeNum_01_Rx_B
      CanIf_DcmPdu_CanNodeNum_01_Rx_PhyRequest (CanIfRxPduCfg):
        CanIfRxPduUserRxIndicationUL = CAN_TP
        CanIfRxPduDlc = 8
        CanIfRxPduCanId = 416952570
        CanIfRxPduCanIdType = STANDARD_CAN
        CanIfRxPduReadData = false
        CanIfRxPduReadNotifyStatus = true
        CanIfRxPduRef = DcmPdu_CanIf2CanTp_CanNodeNum_01_PhyRequest
        CanIfRxPduHrhIdRef = CanIf_HwRxHandle_CanNodeNum_01_Rx_C
      CanIf_DcmPdu_CanNodeNum_01_Tx_PhyResponse (CanIfTxPduCfg):
        CanIfTxPduReadNotifyStatus = false
        CanIfTxPduUserTxConfirmationUL = CAN_TP
        CanIfTxPduCanId = 417004080
        CanIfTxPduCanIdType = STANDARD_CAN
        CanIfTxPduTruncation = false
        CanIfTxPduType = STATIC
        CanIfTxPduRef = DcmPdu_CanTp2CanIf_CanNodeNum_01_PhyResponse
        CanIfTxPduBufferRef = CanIf_Buffer_CanNodeNum_01_Tx_B
      CanIf_CanPdu_CanNodeNum_01_TxBasic_01 (CanIfTxPduCfg):
        CanIfTxPduUserTxConfirmationName = PduR_CanIfTxConfirmation
        CanIfTxPduReadNotifyStatus = false
        CanIfTxPduUserTxConfirmationUL = PDUR
        CanIfTxPduCanIdType = EXTENDED_CAN
        CanIfTxPduTruncation = false
        CanIfTxPduType = DYNAMIC
        CanIfTxPduCanId = 486507394
        CanIfTxPduRef = CanPdu_PduR2CanIf_CanNodeNum_01_TxBasic_01
        CanIfTxPduBufferRef = CanIf_Buffer_CanNodeNum_01_Tx_Basic
      CanIf_Buffer_CanNodeNum_01_Tx_B (CanIfBufferCfg): CanIfBufferSize=0, CanIfBufferHthRef=CanIf_HwTxHandle_CanNodeNum_01_Tx_B
      CanIf_Buffer_CanNodeNum_01_Tx_Basic (CanIfBufferCfg): CanIfBufferSize=30, CanIfBufferHthRef=CanIf_HwTxHandle_CanNodeNum_01_Tx_Basic
      26 x CanIfRxPduCfg, all with CanIfRxPduUserRxIndicationUL=PDUR, CanIfRxPduDlc=8, CanIfRxPduCanIdType=EXTENDED_CAN, CanIfRxPduReadData=false, CanIfRxPduReadNotifyStatus=true, CanIfRxPduUserRxIndicationName=PduR_CanIfRxIndication:
        CanIf_CanPdu_CanNodeNum_01_Rx_01: CanIfRxPduCanId=418848305, CanIfRxPduRef=CanPdu_CanIf2PduR_CanNodeNum_01_Rx_01, CanIfRxPduHrhIdRef=CanIf_HwRxHandle_CanNodeNum_01_Rx_01
        CanIf_CanPdu_CanNodeNum_01_Rx_02: CanIfRxPduCanId=418393649, CanIfRxPduRef=CanPdu_CanIf2PduR_CanNodeNum_01_Rx_02, CanIfRxPduHrhIdRef=CanIf_HwRxHandle_CanNodeNum_01_Rx_02
        CanIf_CanPdu_CanNodeNum_01_Rx_03: CanIfRxPduCanId=418328113, CanIfRxPduRef=CanPdu_CanIf2PduR_CanNodeNum_01_Rx_03, CanIfRxPduHrhIdRef=CanIf_HwRxHandle_CanNodeNum_01_Rx_03
        CanIf_CanPdu_CanNodeNum_01_Rx_04: CanIfRxPduCanId=418721841, CanIfRxPduRef=CanPdu_CanIf2PduR_CanNodeNum_01_Rx_04, CanIfRxPduHrhIdRef=CanIf_HwRxHandle_CanNodeNum_01_Rx_04
        CanIf_CanPdu_CanNodeNum_01_Rx_05: CanIfRxPduCanId=419343920, CanIfRxPduRef=CanPdu_CanIf2PduR_CanNodeNum_01_Rx_05, CanIfRxPduHrhIdRef=CanIf_HwRxHandle_CanNodeNum_01_Rx_05
        CanIf_CanPdu_CanNodeNum_01_Rx_06: CanIfRxPduCanId=419343922, CanIfRxPduRef=CanPdu_CanIf2PduR_CanNodeNum_01_Rx_06, CanIfRxPduHrhIdRef=CanIf_HwRxHandle_CanNodeNum_01_Rx_06
        CanIf_CanPdu_CanNodeNum_01_Rx_07: CanIfRxPduCanId=500000006, CanIfRxPduRef=CanPdu_CanIf2PduR_CanNodeNum_01_Rx_07, CanIfRxPduHrhIdRef=CanIf_HwRxHandle_CanNodeNum_01_Rx_07
        CanIf_CanPdu_CanNodeNum_01_Rx_08: CanIfRxPduCanId=500000007, CanIfRxPduRef=CanPdu_CanIf2PduR_CanNodeNum_01_Rx_08, CanIfRxPduHrhIdRef=CanIf_HwRxHandle_CanNodeNum_01_Rx_08
        CanIf_CanPdu_CanNodeNum_01_Rx_09: CanIfRxPduCanId=500000008, CanIfRxPduRef=CanPdu_CanIf2PduR_CanNodeNum_01_Rx_09, CanIfRxPduHrhIdRef=CanIf_HwRxHandle_CanNodeNum_01_Rx_09
        CanIf_CanPdu_CanNodeNum_01_Rx_10: CanIfRxPduCanId=500000009, CanIfRxPduRef=CanPdu_CanIf2PduR_CanNodeNum_01_Rx_10, CanIfRxPduHrhIdRef=CanIf_HwRxHandle_CanNodeNum_01_Rx_10
        CanIf_CanPdu_CanNodeNum_01_Rx_11: CanIfRxPduCanId=500000010, CanIfRxPduRef=CanPdu_CanIf2PduR_CanNodeNum_01_Rx_11, CanIfRxPduHrhIdRef=CanIf_HwRxHandle_CanNodeNum_01_Rx_11
        CanIf_CanPdu_CanNodeNum_01_Rx_12: CanIfRxPduCanId=500000011, CanIfRxPduRef=CanPdu_CanIf2PduR_CanNodeNum_01_Rx_12, CanIfRxPduHrhIdRef=CanIf_HwRxHandle_CanNodeNum_01_Rx_12
        CanIf_CanPdu_CanNodeNum_01_Rx_13: CanIfRxPduCanId=500000012, CanIfRxPduRef=CanPdu_CanIf2PduR_CanNodeNum_01_Rx_13, CanIfRxPduHrhIdRef=CanIf_HwRxHandle_CanNodeNum_01_Rx_13
        CanIf_CanPdu_CanNodeNum_01_Rx_14: CanIfRxPduCanId=500000013, CanIfRxPduRef=CanPdu_CanIf2PduR_CanNodeNum_01_Rx_14, CanIfRxPduHrhIdRef=CanIf_HwRxHandle_CanNodeNum_01_Rx_14
        CanIf_CanPdu_CanNodeNum_01_Rx_15: CanIfRxPduCanId=500000014, CanIfRxPduRef=CanPdu_CanIf2PduR_CanNodeNum_01_Rx_15, CanIfRxPduHrhIdRef=CanIf_HwRxHandle_CanNodeNum_01_Rx_15
        CanIf_CanPdu_CanNodeNum_01_Rx_16: CanIfRxPduCanId=500000015, CanIfRxPduRef=CanPdu_CanIf2PduR_CanNodeNum_01_Rx_16, CanIfRxPduHrhIdRef=CanIf_HwRxHandle_CanNodeNum_01_Rx_16
        CanIf_CanPdu_CanNodeNum_01_Rx_17: CanIfRxPduCanId=500000016, CanIfRxPduRef=CanPdu_CanIf2PduR_CanNodeNum_01_Rx_17, CanIfRxPduHrhIdRef=CanIf_HwRxHandle_CanNodeNum_01_Rx_17
        CanIf_CanPdu_CanNodeNum_01_Rx_18: CanIfRxPduCanId=500000017, CanIfRxPduRef=CanPdu_CanIf2PduR_CanNodeNum_01_Rx_18, CanIfRxPduHrhIdRef=CanIf_HwRxHandle_CanNodeNum_01_Rx_18
        CanIf_CanPdu_CanNodeNum_01_Rx_19: CanIfRxPduCanId=500000018, CanIfRxPduRef=CanPdu_CanIf2PduR_CanNodeNum_01_Rx_19, CanIfRxPduHrhIdRef=CanIf_HwRxHandle_CanNodeNum_01_Rx_19
        CanIf_CanPdu_CanNodeNum_01_Rx_20: CanIfRxPduCanId=500000019, CanIfRxPduRef=CanPdu_CanIf2PduR_CanNodeNum_01_Rx_20, CanIfRxPduHrhIdRef=CanIf_HwRxHandle_CanNodeNum_01_Rx_20
        CanIf_CanPdu_CanNodeNum_01_Rx_21: CanIfRxPduCanId=500000020, CanIfRxPduRef=CanPdu_CanIf2PduR_CanNodeNum_01_Rx_21, CanIfRxPduHrhIdRef=CanIf_HwRxHandle_CanNodeNum_01_Rx_21
        CanIf_CanPdu_CanNodeNum_01_Rx_22: CanIfRxPduCanId=500000021, CanIfRxPduRef=CanPdu_CanIf2PduR_CanNodeNum_01_Rx_22, CanIfRxPduHrhIdRef=CanIf_HwRxHandle_CanNodeNum_01_Rx_22
        CanIf_CanPdu_CanNodeNum_01_Rx_23: CanIfRxPduCanId=500000022, CanIfRxPduRef=CanPdu_CanIf2PduR_CanNodeNum_01_Rx_23, CanIfRxPduHrhIdRef=CanIf_HwRxHandle_CanNodeNum_01_Rx_23
        CanIf_CanPdu_CanNodeNum_01_Rx_24: CanIfRxPduCanId=500000023, CanIfRxPduRef=CanPdu_CanIf2PduR_CanNodeNum_01_Rx_24, CanIfRxPduHrhIdRef=CanIf_HwRxHandle_CanNodeNum_01_Rx_24
        CanIf_CanPdu_CanNodeNum_01_Rx_25: CanIfRxPduCanId=500000024, CanIfRxPduRef=CanPdu_CanIf2PduR_CanNodeNum_01_Rx_25, CanIfRxPduHrhIdRef=CanIf_HwRxHandle_CanNodeNum_01_Rx_25
        CanIf_CanPdu_CanNodeNum_01_Rx_26: CanIfRxPduCanId=500000025, CanIfRxPduRef=CanPdu_CanIf2PduR_CanNodeNum_01_Rx_26, CanIfRxPduHrhIdRef=CanIf_HwRxHandle_CanNodeNum_01_Rx_26
      26 x CanIfTxPduCfg, all with CanIfTxPduUserTxConfirmationName=PduR_CanIfTxConfirmation, CanIfTxPduReadNotifyStatus=false, CanIfTxPduUserTxConfirmationUL=PDUR, CanIfTxPduCanIdType=EXTENDED_CAN, CanIfTxPduTruncation=false, CanIfTxPduType=DYNAMIC:
        CanIf_CanPdu_CanNodeNum_01_TxBasic_02: CanIfTxPduCanId=419355266, CanIfTxPduRef=CanPdu_PduR2CanIf_CanNodeNum_01_TxBasic_02, CanIfTxPduBufferRef=CanIf_Buffer_CanNodeNum_01_Tx_Basic
        CanIf_CanPdu_CanNodeNum_01_TxBasic_03: CanIfTxPduCanId=486507395, CanIfTxPduRef=CanPdu_PduR2CanIf_CanNodeNum_01_TxBasic_03, CanIfTxPduBufferRef=CanIf_Buffer_CanNodeNum_01_Tx_Basic
        CanIf_CanPdu_CanNodeNum_01_TxBasic_04: CanIfTxPduCanId=419355267, CanIfTxPduRef=CanPdu_PduR2CanIf_CanNodeNum_01_TxBasic_04, CanIfTxPduBufferRef=CanIf_Buffer_CanNodeNum_01_Tx_Basic
        CanIf_CanPdu_CanNodeNum_01_TxBasic_05: CanIfTxPduCanId=419355184, CanIfTxPduRef=CanPdu_PduR2CanIf_CanNodeNum_01_TxBasic_05, CanIfTxPduBufferRef=CanIf_Buffer_CanNodeNum_01_Tx_Basic
        CanIf_CanPdu_CanNodeNum_01_TxBasic_06: CanIfTxPduCanId=419355274, CanIfTxPduRef=CanPdu_PduR2CanIf_CanNodeNum_01_TxBasic_06, CanIfTxPduBufferRef=CanIf_Buffer_CanNodeNum_01_Tx_Basic
        CanIf_CanPdu_CanNodeNum_01_TxBasic_07: CanIfTxPduCanId=419355275, CanIfTxPduRef=CanPdu_PduR2CanIf_CanNodeNum_01_TxBasic_07, CanIfTxPduBufferRef=CanIf_Buffer_CanNodeNum_01_Tx_Basic
        CanIf_CanPdu_CanNodeNum_01_TxBasic_08: CanIfTxPduCanId=419351279, CanIfTxPduRef=CanPdu_PduR2CanIf_CanNodeNum_01_TxBasic_08, CanIfTxPduBufferRef=CanIf_Buffer_CanNodeNum_01_Tx_Basic
        CanIf_CanPdu_CanNodeNum_01_TxBasic_09: CanIfTxPduCanId=418185090, CanIfTxPduRef=CanPdu_PduR2CanIf_CanNodeNum_01_TxBasic_09, CanIfTxPduBufferRef=CanIf_Buffer_CanNodeNum_01_Tx_Basic
        CanIf_CanPdu_CanNodeNum_01_TxBasic_10: CanIfTxPduCanId=418119554, CanIfTxPduRef=CanPdu_PduR2CanIf_CanNodeNum_01_TxBasic_10, CanIfTxPduBufferRef=CanIf_Buffer_CanNodeNum_01_Tx_Basic
        CanIf_CanPdu_CanNodeNum_01_TxBasic_11: CanIfTxPduCanId=419351171, CanIfTxPduRef=CanPdu_PduR2CanIf_CanNodeNum_01_TxBasic_11, CanIfTxPduBufferRef=CanIf_Buffer_CanNodeNum_01_Tx_Basic
        CanIf_CanPdu_CanNodeNum_01_TxBasic_12: CanIfTxPduCanId=418185091, CanIfTxPduRef=CanPdu_PduR2CanIf_CanNodeNum_01_TxBasic_12, CanIfTxPduBufferRef=CanIf_Buffer_CanNodeNum_01_Tx_Basic
        CanIf_CanPdu_CanNodeNum_01_TxBasic_13: CanIfTxPduCanId=418119555, CanIfTxPduRef=CanPdu_PduR2CanIf_CanNodeNum_01_TxBasic_13, CanIfTxPduBufferRef=CanIf_Buffer_CanNodeNum_01_Tx_Basic
        CanIf_CanPdu_CanNodeNum_01_TxBasic_14: CanIfTxPduCanId=419351088, CanIfTxPduRef=CanPdu_PduR2CanIf_CanNodeNum_01_TxBasic_14, CanIfTxPduBufferRef=CanIf_Buffer_CanNodeNum_01_Tx_Basic
        CanIf_CanPdu_CanNodeNum_01_TxBasic_15: CanIfTxPduCanId=418185099, CanIfTxPduRef=CanPdu_PduR2CanIf_CanNodeNum_01_TxBasic_15, CanIfTxPduBufferRef=CanIf_Buffer_CanNodeNum_01_Tx_Basic
        CanIf_CanPdu_CanNodeNum_01_TxBasic_16: CanIfTxPduCanId=418119563, CanIfTxPduRef=CanPdu_PduR2CanIf_CanNodeNum_01_TxBasic_16, CanIfTxPduBufferRef=CanIf_Buffer_CanNodeNum_01_Tx_Basic
        CanIf_CanPdu_CanNodeNum_01_TxBasic_17: CanIfTxPduCanId=419351086, CanIfTxPduRef=CanPdu_PduR2CanIf_CanNodeNum_01_TxBasic_17, CanIfTxPduBufferRef=CanIf_Buffer_CanNodeNum_01_Tx_Basic
        CanIf_CanPdu_CanNodeNum_01_TxBasic_18: CanIfTxPduCanId=418185098, CanIfTxPduRef=CanPdu_PduR2CanIf_CanNodeNum_01_TxBasic_18, CanIfTxPduBufferRef=CanIf_Buffer_CanNodeNum_01_Tx_Basic
        CanIf_CanPdu_CanNodeNum_01_TxBasic_19: CanIfTxPduCanId=418119562, CanIfTxPduRef=CanPdu_PduR2CanIf_CanNodeNum_01_TxBasic_19, CanIfTxPduBufferRef=CanIf_Buffer_CanNodeNum_01_Tx_Basic
        CanIf_CanPdu_CanNodeNum_01_TxBasic_20: CanIfTxPduCanId=419351070, CanIfTxPduRef=CanPdu_PduR2CanIf_CanNodeNum_01_TxBasic_20, CanIfTxPduBufferRef=CanIf_Buffer_CanNodeNum_01_Tx_Basic
        CanIf_CanPdu_CanNodeNum_01_TxBasic_21: CanIfTxPduCanId=418185008, CanIfTxPduRef=CanPdu_PduR2CanIf_CanNodeNum_01_TxBasic_20, CanIfTxPduBufferRef=CanIf_Buffer_CanNodeNum_01_Tx_Basic
        CanIf_CanPdu_CanNodeNum_01_TxBasic_22: CanIfTxPduCanId=418119472, CanIfTxPduRef=CanPdu_PduR2CanIf_CanNodeNum_01_TxBasic_20, CanIfTxPduBufferRef=CanIf_Buffer_CanNodeNum_01_Tx_Basic
        CanIf_CanPdu_CanNodeNum_01_Tx_01: CanIfTxPduCanId=418840862, CanIfTxPduRef=CanPdu_PduR2CanIf_CanNodeNum_01_Tx_01, CanIfTxPduBufferRef=CanIf_Buffer_CanNodeNum_01_Tx_01
        CanIf_CanPdu_CanNodeNum_01_Tx_02: CanIfTxPduCanId=418841118, CanIfTxPduRef=CanPdu_PduR2CanIf_CanNodeNum_01_Tx_02, CanIfTxPduBufferRef=CanIf_Buffer_CanNodeNum_01_Tx_02
        CanIf_CanPdu_CanNodeNum_01_Tx_03: CanIfTxPduCanId=418841374, CanIfTxPduRef=CanPdu_PduR2CanIf_CanNodeNum_01_Tx_03, CanIfTxPduBufferRef=CanIf_Buffer_CanNodeNum_01_Tx_03
        CanIf_CanPdu_CanNodeNum_01_Tx_04: CanIfTxPduCanId=418841630, CanIfTxPduRef=CanPdu_PduR2CanIf_CanNodeNum_01_Tx_04, CanIfTxPduBufferRef=CanIf_Buffer_CanNodeNum_01_Tx_04
        CanIf_CanPdu_CanNodeNum_01_Tx_05: CanIfTxPduCanId=217448750, CanIfTxPduRef=CanPdu_PduR2CanIf_CanNodeNum_01_Tx_05, CanIfTxPduBufferRef=CanIf_Buffer_CanNodeNum_01_Tx_05
      CanIf_Buffer_CanNodeNum_01_Tx_01 (CanIfBufferCfg): CanIfBufferSize=0, CanIfBufferHthRef=CanIf_HwTxHandle_CanNodeNum_01_Tx_01
      CanIf_CanPdu_CanNodeNum_01_Tx_06 (CanIfTxPduCfg):
        CanIfTxPduUserTxConfirmationName = PduR_CanIfTxConfirmation
        CanIfTxPduReadNotifyStatus = false
        CanIfTxPduUserTxConfirmationUL = PDUR
        CanIfTxPduCanId = 217449006
        CanIfTxPduCanIdType = EXTENDED_CAN
        CanIfTxPduTruncation = false
        CanIfTxPduType = DYNAMIC
        CanIfTxPduRef = CanPdu_PduR2CanIf_CanNodeNum_01_Tx_06
        CanIfTxPduBufferRef = CanIf_Buffer_CanNodeNum_01_Tx_06
      CanIf_Buffer_CanNodeNum_01_Tx_02 (CanIfBufferCfg): CanIfBufferSize=0, CanIfBufferHthRef=CanIf_HwTxHandle_CanNodeNum_01_Tx_02
      CanIf_Buffer_CanNodeNum_01_Tx_03 (CanIfBufferCfg): CanIfBufferSize=0, CanIfBufferHthRef=CanIf_HwTxHandle_CanNodeNum_01_Tx_03
      CanIf_CanPdu_CanNodeNum_01_Tx_07 (CanIfTxPduCfg):
        CanIfTxPduUserTxConfirmationName = PduR_CanIfTxConfirmation
        CanIfTxPduReadNotifyStatus = false
        CanIfTxPduUserTxConfirmationUL = PDUR
        CanIfTxPduCanId = 419373360
        CanIfTxPduCanIdType = EXTENDED_CAN
        CanIfTxPduTruncation = false
        CanIfTxPduType = DYNAMIC
        CanIfTxPduRef = CanPdu_PduR2CanIf_CanNodeNum_01_Tx_07
        CanIfTxPduBufferRef = CanIf_Buffer_CanNodeNum_01_Tx_07
      CanIf_Buffer_CanNodeNum_01_Tx_04 (CanIfBufferCfg): CanIfBufferSize=0, CanIfBufferHthRef=CanIf_HwTxHandle_CanNodeNum_01_Tx_04
      CanIf_CanPdu_CanNodeNum_01_Tx_08 (CanIfTxPduCfg):
        CanIfTxPduUserTxConfirmationName = PduR_CanIfTxConfirmation
        CanIfTxPduReadNotifyStatus = false
        CanIfTxPduUserTxConfirmationUL = PDUR
        CanIfTxPduCanId = 419373616
        CanIfTxPduCanIdType = EXTENDED_CAN
        CanIfTxPduTruncation = false
        CanIfTxPduType = DYNAMIC
        CanIfTxPduRef = CanPdu_PduR2CanIf_CanNodeNum_01_Tx_08
        CanIfTxPduBufferRef = CanIf_Buffer_CanNodeNum_01_Tx_08
      CanIf_Buffer_CanNodeNum_01_Tx_05 (CanIfBufferCfg): CanIfBufferSize=0, CanIfBufferHthRef=CanIf_HwTxHandle_CanNodeNum_01_Tx_05
      CanIf_CanPdu_CanNodeNum_01_Tx_09 (CanIfTxPduCfg):
        CanIfTxPduUserTxConfirmationName = PduR_CanIfTxConfirmation
        CanIfTxPduReadNotifyStatus = false
        CanIfTxPduUserTxConfirmationUL = PDUR
        CanIfTxPduCanId = 520000008
        CanIfTxPduCanIdType = EXTENDED_CAN
        CanIfTxPduTruncation = false
        CanIfTxPduType = DYNAMIC
        CanIfTxPduRef = CanPdu_PduR2CanIf_CanNodeNum_01_Tx_09
        CanIfTxPduBufferRef = CanIf_Buffer_CanNodeNum_01_Tx_09
      CanIf_Buffer_CanNodeNum_01_Tx_06 (CanIfBufferCfg): CanIfBufferSize=0, CanIfBufferHthRef=CanIf_HwTxHandle_CanNodeNum_01_Tx_06
      CanIf_CanPdu_CanNodeNum_01_Tx_10 (CanIfTxPduCfg):
        CanIfTxPduUserTxConfirmationName = PduR_CanIfTxConfirmation
        CanIfTxPduReadNotifyStatus = false
        CanIfTxPduUserTxConfirmationUL = PDUR
        CanIfTxPduCanId = 520000009
        CanIfTxPduCanIdType = EXTENDED_CAN
        CanIfTxPduTruncation = false
        CanIfTxPduType = DYNAMIC
        CanIfTxPduRef = CanPdu_PduR2CanIf_CanNodeNum_01_Tx_10
        CanIfTxPduBufferRef = CanIf_Buffer_CanNodeNum_01_Tx_10
      CanIf_Buffer_CanNodeNum_01_Tx_07 (CanIfBufferCfg): CanIfBufferSize=0, CanIfBufferHthRef=CanIf_HwTxHandle_CanNodeNum_01_Tx_07
      CanIf_CanPdu_CanNodeNum_01_Tx_11 (CanIfTxPduCfg):
        CanIfTxPduUserTxConfirmationName = PduR_CanIfTxConfirmation
        CanIfTxPduReadNotifyStatus = false
        CanIfTxPduUserTxConfirmationUL = PDUR
        CanIfTxPduCanId = 520000010
        CanIfTxPduCanIdType = EXTENDED_CAN
        CanIfTxPduTruncation = false
        CanIfTxPduType = DYNAMIC
        CanIfTxPduRef = CanPdu_PduR2CanIf_CanNodeNum_01_Tx_11
        CanIfTxPduBufferRef = CanIf_Buffer_CanNodeNum_01_Tx_11
      CanIf_Buffer_CanNodeNum_01_Tx_08 (CanIfBufferCfg): CanIfBufferSize=0, CanIfBufferHthRef=CanIf_HwTxHandle_CanNodeNum_01_Tx_08
      CanIf_CanPdu_CanNodeNum_01_Tx_12 (CanIfTxPduCfg):
        CanIfTxPduUserTxConfirmationName = PduR_CanIfTxConfirmation
        CanIfTxPduReadNotifyStatus = false
        CanIfTxPduUserTxConfirmationUL = PDUR
        CanIfTxPduCanId = 520000011
        CanIfTxPduCanIdType = EXTENDED_CAN
        CanIfTxPduTruncation = false
        CanIfTxPduType = DYNAMIC
        CanIfTxPduRef = CanPdu_PduR2CanIf_CanNodeNum_01_Tx_12
        CanIfTxPduBufferRef = CanIf_Buffer_CanNodeNum_01_Tx_12
      CanIf_Buffer_CanNodeNum_01_Tx_09 (CanIfBufferCfg): CanIfBufferSize=0, CanIfBufferHthRef=CanIf_HwTxHandle_CanNodeNum_01_Tx_09
      CanIf_Buffer_CanNodeNum_01_Tx_10 (CanIfBufferCfg): CanIfBufferSize=0, CanIfBufferHthRef=CanIf_HwTxHandle_CanNodeNum_01_Tx_10
      CanIf_CanPdu_CanNodeNum_01_Tx_13 (CanIfTxPduCfg):
        CanIfTxPduUserTxConfirmationName = PduR_CanIfTxConfirmation
        CanIfTxPduReadNotifyStatus = false
        CanIfTxPduUserTxConfirmationUL = PDUR
        CanIfTxPduCanId = 520000012
        CanIfTxPduCanIdType = EXTENDED_CAN
        CanIfTxPduTruncation = false
        CanIfTxPduType = DYNAMIC
        CanIfTxPduRef = CanPdu_PduR2CanIf_CanNodeNum_01_Tx_13
        CanIfTxPduBufferRef = CanIf_Buffer_CanNodeNum_01_Tx_13
      CanIf_Buffer_CanNodeNum_01_Tx_11 (CanIfBufferCfg): CanIfBufferSize=0, CanIfBufferHthRef=CanIf_HwTxHandle_CanNodeNum_01_Tx_11
      CanIf_CanPdu_CanNodeNum_01_Tx_14 (CanIfTxPduCfg):
        CanIfTxPduUserTxConfirmationName = PduR_CanIfTxConfirmation
        CanIfTxPduReadNotifyStatus = false
        CanIfTxPduUserTxConfirmationUL = PDUR
        CanIfTxPduCanId = 520000013
        CanIfTxPduCanIdType = EXTENDED_CAN
        CanIfTxPduTruncation = false
        CanIfTxPduType = DYNAMIC
        CanIfTxPduRef = CanPdu_PduR2CanIf_CanNodeNum_01_Tx_14
        CanIfTxPduBufferRef = CanIf_Buffer_CanNodeNum_01_Tx_14
      CanIf_Buffer_CanNodeNum_01_Tx_12 (CanIfBufferCfg): CanIfBufferSize=0, CanIfBufferHthRef=CanIf_HwTxHandle_CanNodeNum_01_Tx_12
      CanIf_CanPdu_CanNodeNum_01_Tx_15 (CanIfTxPduCfg):
        CanIfTxPduUserTxConfirmationName = PduR_CanIfTxConfirmation
        CanIfTxPduReadNotifyStatus = false
        CanIfTxPduUserTxConfirmationUL = PDUR
        CanIfTxPduCanId = 520000014
        CanIfTxPduCanIdType = EXTENDED_CAN
        CanIfTxPduTruncation = false
        CanIfTxPduType = DYNAMIC
        CanIfTxPduRef = CanPdu_PduR2CanIf_CanNodeNum_01_Tx_15
        CanIfTxPduBufferRef = CanIf_Buffer_CanNodeNum_01_Tx_15
      CanIf_Buffer_CanNodeNum_01_Tx_13 (CanIfBufferCfg): CanIfBufferSize=0, CanIfBufferHthRef=CanIf_HwTxHandle_CanNodeNum_01_Tx_13
      CanIf_CanPdu_CanNodeNum_01_Tx_16 (CanIfTxPduCfg):
        CanIfTxPduUserTxConfirmationName = PduR_CanIfTxConfirmation
        CanIfTxPduReadNotifyStatus = false
        CanIfTxPduUserTxConfirmationUL = PDUR
        CanIfTxPduCanId = 520000015
        CanIfTxPduCanIdType = EXTENDED_CAN
        CanIfTxPduTruncation = false
        CanIfTxPduType = DYNAMIC
        CanIfTxPduRef = CanPdu_PduR2CanIf_CanNodeNum_01_Tx_16
        CanIfTxPduBufferRef = CanIf_Buffer_CanNodeNum_01_Tx_16
      CanIf_Buffer_CanNodeNum_01_Tx_14 (CanIfBufferCfg): CanIfBufferSize=0, CanIfBufferHthRef=CanIf_HwTxHandle_CanNodeNum_01_Tx_14
      CanIf_CanPdu_CanNodeNum_01_Tx_17 (CanIfTxPduCfg):
        CanIfTxPduUserTxConfirmationName = PduR_CanIfTxConfirmation
        CanIfTxPduReadNotifyStatus = false
        CanIfTxPduUserTxConfirmationUL = PDUR
        CanIfTxPduCanId = 520000016
        CanIfTxPduCanIdType = EXTENDED_CAN
        CanIfTxPduTruncation = false
        CanIfTxPduType = DYNAMIC
        CanIfTxPduRef = CanPdu_PduR2CanIf_CanNodeNum_01_Tx_17
        CanIfTxPduBufferRef = CanIf_Buffer_CanNodeNum_01_Tx_17
      CanIf_Buffer_CanNodeNum_01_Tx_15 (CanIfBufferCfg): CanIfBufferSize=0, CanIfBufferHthRef=CanIf_HwTxHandle_CanNodeNum_01_Tx_15
      CanIf_CanPdu_CanNodeNum_01_Tx_18 (CanIfTxPduCfg):
        CanIfTxPduUserTxConfirmationName = PduR_CanIfTxConfirmation
        CanIfTxPduReadNotifyStatus = false
        CanIfTxPduUserTxConfirmationUL = PDUR
        CanIfTxPduCanId = 520000017
        CanIfTxPduCanIdType = EXTENDED_CAN
        CanIfTxPduTruncation = false
        CanIfTxPduType = DYNAMIC
        CanIfTxPduRef = CanPdu_PduR2CanIf_CanNodeNum_01_Tx_18
        CanIfTxPduBufferRef = CanIf_Buffer_CanNodeNum_01_Tx_18
      CanIf_Buffer_CanNodeNum_01_Tx_16 (CanIfBufferCfg): CanIfBufferSize=0, CanIfBufferHthRef=CanIf_HwTxHandle_CanNodeNum_01_Tx_16
      CanIf_CanPdu_CanNodeNum_01_Tx_19 (CanIfTxPduCfg):
        CanIfTxPduUserTxConfirmationName = PduR_CanIfTxConfirmation
        CanIfTxPduReadNotifyStatus = false
        CanIfTxPduUserTxConfirmationUL = PDUR
        CanIfTxPduCanId = 520000018
        CanIfTxPduCanIdType = EXTENDED_CAN
        CanIfTxPduTruncation = false
        CanIfTxPduType = DYNAMIC
        CanIfTxPduRef = CanPdu_PduR2CanIf_CanNodeNum_01_Tx_19
        CanIfTxPduBufferRef = CanIf_Buffer_CanNodeNum_01_Tx_19
      CanIf_Buffer_CanNodeNum_01_Tx_17 (CanIfBufferCfg): CanIfBufferSize=0, CanIfBufferHthRef=CanIf_HwTxHandle_CanNodeNum_01_Tx_17
      CanIf_CanPdu_CanNodeNum_01_Tx_20 (CanIfTxPduCfg):
        CanIfTxPduUserTxConfirmationName = PduR_CanIfTxConfirmation
        CanIfTxPduReadNotifyStatus = false
        CanIfTxPduUserTxConfirmationUL = PDUR
        CanIfTxPduCanId = 520000019
        CanIfTxPduCanIdType = EXTENDED_CAN
        CanIfTxPduTruncation = false
        CanIfTxPduType = DYNAMIC
        CanIfTxPduRef = CanPdu_PduR2CanIf_CanNodeNum_01_Tx_20
        CanIfTxPduBufferRef = CanIf_Buffer_CanNodeNum_01_Tx_20
      3 x CanIfBufferCfg, all with CanIfBufferSize=0:
        CanIf_Buffer_CanNodeNum_01_Tx_{18..20}: CanIfBufferHthRef=CanIf_HwTxHandle_CanNodeNum_01_Tx_{18..20}
      CanIf_CanPdu_CanNodeNum_01_Tx_21 (CanIfTxPduCfg):
        CanIfTxPduUserTxConfirmationName = PduR_CanIfTxConfirmation
        CanIfTxPduReadNotifyStatus = false
        CanIfTxPduUserTxConfirmationUL = PDUR
        CanIfTxPduCanId = 520000020
        CanIfTxPduCanIdType = EXTENDED_CAN
        CanIfTxPduTruncation = false
        CanIfTxPduType = DYNAMIC
        CanIfTxPduRef = CanPdu_PduR2CanIf_CanNodeNum_01_Tx_21
        CanIfTxPduBufferRef = CanIf_Buffer_CanNodeNum_01_Tx_21
      CanIf_Buffer_CanNodeNum_01_Tx_21 (CanIfBufferCfg): CanIfBufferSize=0, CanIfBufferHthRef=CanIf_HwTxHandle_CanNodeNum_01_Tx_21
      CanIf_CanPdu_CanNodeNum_01_Tx_22 (CanIfTxPduCfg):
        CanIfTxPduUserTxConfirmationName = PduR_CanIfTxConfirmation
        CanIfTxPduReadNotifyStatus = false
        CanIfTxPduUserTxConfirmationUL = PDUR
        CanIfTxPduCanId = 520000021
        CanIfTxPduCanIdType = EXTENDED_CAN
        CanIfTxPduTruncation = false
        CanIfTxPduType = DYNAMIC
        CanIfTxPduRef = CanPdu_PduR2CanIf_CanNodeNum_01_Tx_22
        CanIfTxPduBufferRef = CanIf_Buffer_CanNodeNum_01_Tx_22
      CanIf_Buffer_CanNodeNum_01_Tx_22 (CanIfBufferCfg): CanIfBufferSize=0, CanIfBufferHthRef=CanIf_HwTxHandle_CanNodeNum_01_Tx_22
      CanIf_CanPdu_CanNodeNum_01_Tx_23 (CanIfTxPduCfg):
        CanIfTxPduUserTxConfirmationName = PduR_CanIfTxConfirmation
        CanIfTxPduReadNotifyStatus = false
        CanIfTxPduUserTxConfirmationUL = PDUR
        CanIfTxPduCanId = 520000022
        CanIfTxPduCanIdType = EXTENDED_CAN
        CanIfTxPduTruncation = false
        CanIfTxPduType = DYNAMIC
        CanIfTxPduRef = CanPdu_PduR2CanIf_CanNodeNum_01_Tx_23
        CanIfTxPduBufferRef = CanIf_Buffer_CanNodeNum_01_Tx_23
      CanIf_Buffer_CanNodeNum_01_Tx_23 (CanIfBufferCfg): CanIfBufferSize=0, CanIfBufferHthRef=CanIf_HwTxHandle_CanNodeNum_01_Tx_23
      CanIf_CanPdu_CanNodeNum_01_Rx_27 (CanIfRxPduCfg):
        CanIfRxPduUserRxIndicationUL = PDUR
        CanIfRxPduDlc = 8
        CanIfRxPduCanId = 500000026
        CanIfRxPduCanIdType = EXTENDED_CAN
        CanIfRxPduReadData = false
        CanIfRxPduReadNotifyStatus = true
        CanIfRxPduUserRxIndicationName = PduR_CanIfRxIndication
        CanIfRxPduRef = CanPdu_CanIf2PduR_CanNodeNum_01_Rx_27
        CanIfRxPduHrhIdRef = CanIf_HwRxHandle_CanNodeNum_01_Rx_27
      CanIf_CanPdu_CanNodeNum_01_Rx_28 (CanIfRxPduCfg):
        CanIfRxPduUserRxIndicationUL = PDUR
        CanIfRxPduDlc = 8
        CanIfRxPduCanId = 500000027
        CanIfRxPduCanIdType = EXTENDED_CAN
        CanIfRxPduReadData = false
        CanIfRxPduReadNotifyStatus = true
        CanIfRxPduUserRxIndicationName = PduR_CanIfRxIndication
        CanIfRxPduRef = CanPdu_CanIf2PduR_CanNodeNum_01_Rx_28
        CanIfRxPduHrhIdRef = CanIf_HwRxHandle_CanNodeNum_01_Rx_28
      5 x CanIfTxPduCfg, all with CanIfTxPduUserTxConfirmationName=PduR_CanIfTxConfirmation, CanIfTxPduReadNotifyStatus=false, CanIfTxPduUserTxConfirmationUL=PDUR, CanIfTxPduCanIdType=EXTENDED_CAN, CanIfTxPduTruncation=false, CanIfTxPduType=DYNAMIC:
        CanIf_CanPdu_CanNodeNum_01_Tx_24: CanIfTxPduCanId=520000023, CanIfTxPduBufferRef=CanIf_Buffer_CanNodeNum_01_Tx_24, CanIfTxPduRef=CanPdu_PduR2CanIf_CanNodeNum_01_Tx_24
        CanIf_CanPdu_CanNodeNum_01_Tx_25: CanIfTxPduCanId=520000024, CanIfTxPduBufferRef=CanIf_Buffer_CanNodeNum_01_Tx_25, CanIfTxPduRef=CanPdu_PduR2CanIf_CanNodeNum_01_Tx_25
        CanIf_CanPdu_CanNodeNum_01_Tx_25_00: CanIfTxPduCanId=520000025, CanIfTxPduBufferRef=CanIf_Buffer_CanNodeNum_01_Tx_25, CanIfTxPduRef=CanPdu_PduR2CanIf_CanNodeNum_01_Tx_25_00
        CanIf_CanPdu_CanNodeNum_01_Tx_25_01: CanIfTxPduCanId=520000026, CanIfTxPduBufferRef=CanIf_Buffer_CanNodeNum_01_Tx_25, CanIfTxPduRef=CanPdu_PduR2CanIf_CanNodeNum_01_Tx_25_01
        CanIf_CanPdu_CanNodeNum_01_Tx_26: CanIfTxPduCanId=520000027, CanIfTxPduBufferRef=CanIf_Buffer_CanNodeNum_01_Tx_26, CanIfTxPduRef=CanPdu_PduR2CanIf_CanNodeNum_01_Tx_26
      57 x CanIfBufferCfg:
        CanIf_Buffer_CanNodeNum_01_Tx_24: CanIfBufferSize=0, CanIfBufferHthRef=CanIf_HwTxHandle_CanNodeNum_01_Tx_24
        CanIf_Buffer_CanNodeNum_01_Tx_25: CanIfBufferSize=10, CanIfBufferHthRef=CanIf_HwTxHandle_CanNodeNum_01_Tx_25
        CanIf_Buffer_CanNodeNum_01_Tx_26: CanIfBufferSize=0, CanIfBufferHthRef=CanIf_HwTxHandle_CanNodeNum_01_Tx_26
        CanIf_Buffer_CanNodeNum_02_Tx_Basic: CanIfBufferSize=10, CanIfBufferHthRef=CanIf_HwTxHandle_CanNodeNum_02_Tx_Basic
        CanIf_Buffer_CanNodeNum_02_Tx_{01..26}: CanIfBufferSize=0, CanIfBufferHthRef=CanIf_HwTxHandle_CanNodeNum_02_Tx_{01..26}
        CanIf_Buffer_CanNodeNum_03_Tx_Basic: CanIfBufferSize=10, CanIfBufferHthRef=CanIf_HwTxHandle_CanNodeNum_03_Tx_Basic
        CanIf_Buffer_CanNodeNum_03_Tx_{01..26}: CanIfBufferSize=0, CanIfBufferHthRef=CanIf_HwTxHandle_CanNodeNum_03_Tx_{01..26}
      92 x CanIfTxPduCfg, all with CanIfTxPduUserTxConfirmationName=PduR_CanIfTxConfirmation, CanIfTxPduUserTxConfirmationUL=PDUR, CanIfTxPduTruncation=false, CanIfTxPduType=STATIC:
        CanIf_CanPdu_CanNodeNum_02_TxBasic_01: CanIfTxPduReadNotifyStatus=false, CanIfTxPduCanIdType=STANDARD_CAN, CanIfTxPduCanId=1793, CanIfTxPduRef=CanPdu_PduR2CanIf_CanNodeNum_02_TxBasic_01, CanIfTxPduBufferRef=CanIf_Buffer_CanNodeNum_02_Tx_Basic
        CanIf_CanPdu_CanNodeNum_02_TxBasic_02: CanIfTxPduReadNotifyStatus=false, CanIfTxPduCanIdType=STANDARD_CAN, CanIfTxPduCanId=1794, CanIfTxPduRef=CanPdu_PduR2CanIf_CanNodeNum_02_TxBasic_02, CanIfTxPduBufferRef=CanIf_Buffer_CanNodeNum_02_Tx_Basic
        CanIf_CanPdu_CanNodeNum_02_TxBasic_03: CanIfTxPduReadNotifyStatus=false, CanIfTxPduCanIdType=STANDARD_CAN, CanIfTxPduCanId=1795, CanIfTxPduRef=CanPdu_PduR2CanIf_CanNodeNum_02_TxBasic_03, CanIfTxPduBufferRef=CanIf_Buffer_CanNodeNum_02_Tx_Basic
        CanIf_CanPdu_CanNodeNum_02_TxBasic_04: CanIfTxPduReadNotifyStatus=false, CanIfTxPduCanIdType=STANDARD_CAN, CanIfTxPduCanId=1796, CanIfTxPduRef=CanPdu_PduR2CanIf_CanNodeNum_02_TxBasic_04, CanIfTxPduBufferRef=CanIf_Buffer_CanNodeNum_02_Tx_Basic
        CanIf_CanPdu_CanNodeNum_02_TxBasic_05: CanIfTxPduReadNotifyStatus=false, CanIfTxPduCanIdType=STANDARD_CAN, CanIfTxPduCanId=1797, CanIfTxPduRef=CanPdu_PduR2CanIf_CanNodeNum_02_TxBasic_05, CanIfTxPduBufferRef=CanIf_Buffer_CanNodeNum_02_Tx_Basic
        CanIf_CanPdu_CanNodeNum_02_TxBasic_06: CanIfTxPduReadNotifyStatus=false, CanIfTxPduCanIdType=STANDARD_CAN, CanIfTxPduCanId=1798, CanIfTxPduRef=CanPdu_PduR2CanIf_CanNodeNum_02_TxBasic_06, CanIfTxPduBufferRef=CanIf_Buffer_CanNodeNum_02_Tx_Basic
        CanIf_CanPdu_CanNodeNum_02_TxBasic_07: CanIfTxPduReadNotifyStatus=false, CanIfTxPduCanIdType=STANDARD_CAN, CanIfTxPduCanId=1799, CanIfTxPduRef=CanPdu_PduR2CanIf_CanNodeNum_02_TxBasic_07, CanIfTxPduBufferRef=CanIf_Buffer_CanNodeNum_02_Tx_Basic
        CanIf_CanPdu_CanNodeNum_02_TxBasic_08: CanIfTxPduReadNotifyStatus=false, CanIfTxPduCanIdType=STANDARD_CAN, CanIfTxPduCanId=1800, CanIfTxPduRef=CanPdu_PduR2CanIf_CanNodeNum_02_TxBasic_08, CanIfTxPduBufferRef=CanIf_Buffer_CanNodeNum_02_Tx_Basic
        CanIf_CanPdu_CanNodeNum_02_TxBasic_09: CanIfTxPduReadNotifyStatus=false, CanIfTxPduCanIdType=STANDARD_CAN, CanIfTxPduCanId=1801, CanIfTxPduRef=CanPdu_PduR2CanIf_CanNodeNum_02_TxBasic_09, CanIfTxPduBufferRef=CanIf_Buffer_CanNodeNum_02_Tx_Basic
        CanIf_CanPdu_CanNodeNum_02_TxBasic_10: CanIfTxPduReadNotifyStatus=false, CanIfTxPduCanIdType=STANDARD_CAN, CanIfTxPduCanId=1808, CanIfTxPduRef=CanPdu_PduR2CanIf_CanNodeNum_02_TxBasic_10, CanIfTxPduBufferRef=CanIf_Buffer_CanNodeNum_02_Tx_Basic
        CanIf_CanPdu_CanNodeNum_02_TxBasic_11: CanIfTxPduReadNotifyStatus=false, CanIfTxPduCanIdType=STANDARD_CAN, CanIfTxPduCanId=1809, CanIfTxPduRef=CanPdu_PduR2CanIf_CanNodeNum_02_TxBasic_11, CanIfTxPduBufferRef=CanIf_Buffer_CanNodeNum_02_Tx_Basic
        CanIf_CanPdu_CanNodeNum_02_TxBasic_12: CanIfTxPduReadNotifyStatus=false, CanIfTxPduCanIdType=STANDARD_CAN, CanIfTxPduCanId=1810, CanIfTxPduRef=CanPdu_PduR2CanIf_CanNodeNum_02_TxBasic_12, CanIfTxPduBufferRef=CanIf_Buffer_CanNodeNum_02_Tx_Basic
        CanIf_CanPdu_CanNodeNum_02_TxBasic_13: CanIfTxPduReadNotifyStatus=false, CanIfTxPduCanIdType=STANDARD_CAN, CanIfTxPduCanId=1811, CanIfTxPduRef=CanPdu_PduR2CanIf_CanNodeNum_02_TxBasic_13, CanIfTxPduBufferRef=CanIf_Buffer_CanNodeNum_02_Tx_Basic
        CanIf_CanPdu_CanNodeNum_02_TxBasic_14: CanIfTxPduReadNotifyStatus=false, CanIfTxPduCanIdType=STANDARD_CAN, CanIfTxPduCanId=1812, CanIfTxPduRef=CanPdu_PduR2CanIf_CanNodeNum_02_TxBasic_14, CanIfTxPduBufferRef=CanIf_Buffer_CanNodeNum_02_Tx_Basic
        CanIf_CanPdu_CanNodeNum_02_TxBasic_15: CanIfTxPduReadNotifyStatus=false, CanIfTxPduCanIdType=STANDARD_CAN, CanIfTxPduCanId=1813, CanIfTxPduRef=CanPdu_PduR2CanIf_CanNodeNum_02_TxBasic_15, CanIfTxPduBufferRef=CanIf_Buffer_CanNodeNum_02_Tx_Basic
        CanIf_CanPdu_CanNodeNum_02_TxBasic_16: CanIfTxPduReadNotifyStatus=false, CanIfTxPduCanIdType=STANDARD_CAN, CanIfTxPduCanId=1814, CanIfTxPduRef=CanPdu_PduR2CanIf_CanNodeNum_02_TxBasic_16, CanIfTxPduBufferRef=CanIf_Buffer_CanNodeNum_02_Tx_Basic
        CanIf_CanPdu_CanNodeNum_02_TxBasic_17: CanIfTxPduReadNotifyStatus=false, CanIfTxPduCanIdType=STANDARD_CAN, CanIfTxPduCanId=1815, CanIfTxPduRef=CanPdu_PduR2CanIf_CanNodeNum_02_TxBasic_17, CanIfTxPduBufferRef=CanIf_Buffer_CanNodeNum_02_Tx_Basic
        CanIf_CanPdu_CanNodeNum_02_TxBasic_18: CanIfTxPduReadNotifyStatus=false, CanIfTxPduCanIdType=STANDARD_CAN, CanIfTxPduCanId=1816, CanIfTxPduRef=CanPdu_PduR2CanIf_CanNodeNum_02_TxBasic_18, CanIfTxPduBufferRef=CanIf_Buffer_CanNodeNum_02_Tx_Basic
        CanIf_CanPdu_CanNodeNum_02_TxBasic_19: CanIfTxPduReadNotifyStatus=false, CanIfTxPduCanIdType=STANDARD_CAN, CanIfTxPduCanId=1817, CanIfTxPduRef=CanPdu_PduR2CanIf_CanNodeNum_02_TxBasic_19, CanIfTxPduBufferRef=CanIf_Buffer_CanNodeNum_02_Tx_Basic
        CanIf_CanPdu_CanNodeNum_02_TxBasic_20: CanIfTxPduReadNotifyStatus=false, CanIfTxPduCanIdType=STANDARD_CAN, CanIfTxPduCanId=1824, CanIfTxPduRef=CanPdu_PduR2CanIf_CanNodeNum_02_TxBasic_20, CanIfTxPduBufferRef=CanIf_Buffer_CanNodeNum_02_Tx_Basic
        CanIf_CanPdu_CanNodeNum_02_Tx_01: CanIfTxPduReadNotifyStatus=0, CanIfTxPduCanIdType=EXTENDED_CAN, CanIfTxPduCanId=218039048, CanIfTxPduBufferRef=CanIf_Buffer_CanNodeNum_02_Tx_01, CanIfTxPduRef=CanPdu_PduR2CanIf_CanNodeNum_02_Tx_01
        CanIf_CanPdu_CanNodeNum_02_Tx_02: CanIfTxPduReadNotifyStatus=0, CanIfTxPduCanIdType=EXTENDED_CAN, CanIfTxPduCanId=218038280, CanIfTxPduBufferRef=CanIf_Buffer_CanNodeNum_02_Tx_02, CanIfTxPduRef=CanPdu_PduR2CanIf_CanNodeNum_02_Tx_02
        CanIf_CanPdu_CanNodeNum_02_Tx_03: CanIfTxPduReadNotifyStatus=0, CanIfTxPduCanIdType=EXTENDED_CAN, CanIfTxPduCanId=218038536, CanIfTxPduBufferRef=CanIf_Buffer_CanNodeNum_02_Tx_03, CanIfTxPduRef=CanPdu_PduR2CanIf_CanNodeNum_02_Tx_03
        CanIf_CanPdu_CanNodeNum_02_Tx_04: CanIfTxPduReadNotifyStatus=0, CanIfTxPduCanIdType=EXTENDED_CAN, CanIfTxPduCanId=218038792, CanIfTxPduBufferRef=CanIf_Buffer_CanNodeNum_02_Tx_04, CanIfTxPduRef=CanPdu_PduR2CanIf_CanNodeNum_02_Tx_04
        CanIf_CanPdu_CanNodeNum_02_Tx_05: CanIfTxPduReadNotifyStatus=0, CanIfTxPduCanIdType=EXTENDED_CAN, CanIfTxPduCanId=218039049, CanIfTxPduBufferRef=CanIf_Buffer_CanNodeNum_02_Tx_05, CanIfTxPduRef=CanPdu_PduR2CanIf_CanNodeNum_02_Tx_05
        CanIf_CanPdu_CanNodeNum_02_Tx_06: CanIfTxPduReadNotifyStatus=0, CanIfTxPduCanIdType=EXTENDED_CAN, CanIfTxPduCanId=520000033, CanIfTxPduBufferRef=CanIf_Buffer_CanNodeNum_02_Tx_06, CanIfTxPduRef=CanPdu_PduR2CanIf_CanNodeNum_02_Tx_06
        CanIf_CanPdu_CanNodeNum_02_Tx_07: CanIfTxPduReadNotifyStatus=0, CanIfTxPduCanIdType=EXTENDED_CAN, CanIfTxPduCanId=520000034, CanIfTxPduBufferRef=CanIf_Buffer_CanNodeNum_02_Tx_07, CanIfTxPduRef=CanPdu_PduR2CanIf_CanNodeNum_02_Tx_07
        CanIf_CanPdu_CanNodeNum_02_Tx_08: CanIfTxPduReadNotifyStatus=0, CanIfTxPduCanIdType=EXTENDED_CAN, CanIfTxPduCanId=520000035, CanIfTxPduBufferRef=CanIf_Buffer_CanNodeNum_02_Tx_08, CanIfTxPduRef=CanPdu_PduR2CanIf_CanNodeNum_02_Tx_08
        CanIf_CanPdu_CanNodeNum_02_Tx_09: CanIfTxPduReadNotifyStatus=0, CanIfTxPduCanIdType=EXTENDED_CAN, CanIfTxPduCanId=520000036, CanIfTxPduBufferRef=CanIf_Buffer_CanNodeNum_02_Tx_09, CanIfTxPduRef=CanPdu_PduR2CanIf_CanNodeNum_02_Tx_09
        CanIf_CanPdu_CanNodeNum_02_Tx_10: CanIfTxPduReadNotifyStatus=0, CanIfTxPduCanIdType=EXTENDED_CAN, CanIfTxPduCanId=520000037, CanIfTxPduBufferRef=CanIf_Buffer_CanNodeNum_02_Tx_10, CanIfTxPduRef=CanPdu_PduR2CanIf_CanNodeNum_02_Tx_10
        CanIf_CanPdu_CanNodeNum_02_Tx_11: CanIfTxPduReadNotifyStatus=0, CanIfTxPduCanIdType=EXTENDED_CAN, CanIfTxPduCanId=520000038, CanIfTxPduBufferRef=CanIf_Buffer_CanNodeNum_02_Tx_11, CanIfTxPduRef=CanPdu_PduR2CanIf_CanNodeNum_02_Tx_11
        CanIf_CanPdu_CanNodeNum_02_Tx_12: CanIfTxPduReadNotifyStatus=0, CanIfTxPduCanIdType=EXTENDED_CAN, CanIfTxPduCanId=520000039, CanIfTxPduBufferRef=CanIf_Buffer_CanNodeNum_02_Tx_12, CanIfTxPduRef=CanPdu_PduR2CanIf_CanNodeNum_02_Tx_12
        CanIf_CanPdu_CanNodeNum_02_Tx_13: CanIfTxPduReadNotifyStatus=0, CanIfTxPduCanIdType=EXTENDED_CAN, CanIfTxPduCanId=520000040, CanIfTxPduBufferRef=CanIf_Buffer_CanNodeNum_02_Tx_13, CanIfTxPduRef=CanPdu_PduR2CanIf_CanNodeNum_02_Tx_13
        CanIf_CanPdu_CanNodeNum_02_Tx_14: CanIfTxPduReadNotifyStatus=0, CanIfTxPduCanIdType=EXTENDED_CAN, CanIfTxPduCanId=520000041, CanIfTxPduBufferRef=CanIf_Buffer_CanNodeNum_02_Tx_14, CanIfTxPduRef=CanPdu_PduR2CanIf_CanNodeNum_02_Tx_14
        CanIf_CanPdu_CanNodeNum_02_Tx_15: CanIfTxPduReadNotifyStatus=0, CanIfTxPduCanIdType=EXTENDED_CAN, CanIfTxPduCanId=520000042, CanIfTxPduBufferRef=CanIf_Buffer_CanNodeNum_02_Tx_15, CanIfTxPduRef=CanPdu_PduR2CanIf_CanNodeNum_02_Tx_15
        CanIf_CanPdu_CanNodeNum_02_Tx_16: CanIfTxPduReadNotifyStatus=0, CanIfTxPduCanIdType=EXTENDED_CAN, CanIfTxPduCanId=520000043, CanIfTxPduBufferRef=CanIf_Buffer_CanNodeNum_02_Tx_16, CanIfTxPduRef=CanPdu_PduR2CanIf_CanNodeNum_02_Tx_16
        CanIf_CanPdu_CanNodeNum_02_Tx_17: CanIfTxPduReadNotifyStatus=0, CanIfTxPduCanIdType=EXTENDED_CAN, CanIfTxPduCanId=520000044, CanIfTxPduBufferRef=CanIf_Buffer_CanNodeNum_02_Tx_17, CanIfTxPduRef=CanPdu_PduR2CanIf_CanNodeNum_02_Tx_17
        CanIf_CanPdu_CanNodeNum_02_Tx_18: CanIfTxPduReadNotifyStatus=0, CanIfTxPduCanIdType=EXTENDED_CAN, CanIfTxPduCanId=520000045, CanIfTxPduBufferRef=CanIf_Buffer_CanNodeNum_02_Tx_18, CanIfTxPduRef=CanPdu_PduR2CanIf_CanNodeNum_02_Tx_18
        CanIf_CanPdu_CanNodeNum_02_Tx_19: CanIfTxPduReadNotifyStatus=0, CanIfTxPduCanIdType=EXTENDED_CAN, CanIfTxPduCanId=520000046, CanIfTxPduBufferRef=CanIf_Buffer_CanNodeNum_02_Tx_19, CanIfTxPduRef=CanPdu_PduR2CanIf_CanNodeNum_02_Tx_19
        CanIf_CanPdu_CanNodeNum_02_Tx_20: CanIfTxPduReadNotifyStatus=0, CanIfTxPduCanIdType=EXTENDED_CAN, CanIfTxPduCanId=520000047, CanIfTxPduBufferRef=CanIf_Buffer_CanNodeNum_02_Tx_20, CanIfTxPduRef=CanPdu_PduR2CanIf_CanNodeNum_02_Tx_20
        CanIf_CanPdu_CanNodeNum_02_Tx_21: CanIfTxPduReadNotifyStatus=0, CanIfTxPduCanIdType=EXTENDED_CAN, CanIfTxPduCanId=520000048, CanIfTxPduBufferRef=CanIf_Buffer_CanNodeNum_02_Tx_21, CanIfTxPduRef=CanPdu_PduR2CanIf_CanNodeNum_02_Tx_21
        CanIf_CanPdu_CanNodeNum_02_Tx_22: CanIfTxPduReadNotifyStatus=0, CanIfTxPduCanIdType=EXTENDED_CAN, CanIfTxPduCanId=520000049, CanIfTxPduBufferRef=CanIf_Buffer_CanNodeNum_02_Tx_22, CanIfTxPduRef=CanPdu_PduR2CanIf_CanNodeNum_02_Tx_22
        CanIf_CanPdu_CanNodeNum_02_Tx_23: CanIfTxPduReadNotifyStatus=0, CanIfTxPduCanIdType=EXTENDED_CAN, CanIfTxPduCanId=520000050, CanIfTxPduBufferRef=CanIf_Buffer_CanNodeNum_02_Tx_23, CanIfTxPduRef=CanPdu_PduR2CanIf_CanNodeNum_02_Tx_23
        CanIf_CanPdu_CanNodeNum_02_Tx_24: CanIfTxPduReadNotifyStatus=0, CanIfTxPduCanIdType=EXTENDED_CAN, CanIfTxPduCanId=520000051, CanIfTxPduBufferRef=CanIf_Buffer_CanNodeNum_02_Tx_24, CanIfTxPduRef=CanPdu_PduR2CanIf_CanNodeNum_02_Tx_24
        CanIf_CanPdu_CanNodeNum_02_Tx_25: CanIfTxPduReadNotifyStatus=0, CanIfTxPduCanIdType=EXTENDED_CAN, CanIfTxPduCanId=520000052, CanIfTxPduBufferRef=CanIf_Buffer_CanNodeNum_02_Tx_25, CanIfTxPduRef=CanPdu_PduR2CanIf_CanNodeNum_02_Tx_25
        CanIf_CanPdu_CanNodeNum_02_Tx_26: CanIfTxPduReadNotifyStatus=0, CanIfTxPduCanIdType=EXTENDED_CAN, CanIfTxPduCanId=520000053, CanIfTxPduBufferRef=CanIf_Buffer_CanNodeNum_02_Tx_26, CanIfTxPduRef=CanPdu_PduR2CanIf_CanNodeNum_02_Tx_26
        CanIf_CanPdu_CanNodeNum_03_TxBasic_01: CanIfTxPduReadNotifyStatus=false, CanIfTxPduCanIdType=STANDARD_CAN, CanIfTxPduCanId=1793, CanIfTxPduRef=CanPdu_PduR2CanIf_CanNodeNum_03_TxBasic_01, CanIfTxPduBufferRef=CanIf_Buffer_CanNodeNum_03_Tx_Basic
        CanIf_CanPdu_CanNodeNum_03_TxBasic_02: CanIfTxPduReadNotifyStatus=false, CanIfTxPduCanIdType=STANDARD_CAN, CanIfTxPduCanId=1794, CanIfTxPduRef=CanPdu_PduR2CanIf_CanNodeNum_03_TxBasic_02, CanIfTxPduBufferRef=CanIf_Buffer_CanNodeNum_03_Tx_Basic
        CanIf_CanPdu_CanNodeNum_03_TxBasic_03: CanIfTxPduReadNotifyStatus=false, CanIfTxPduCanIdType=STANDARD_CAN, CanIfTxPduCanId=1795, CanIfTxPduRef=CanPdu_PduR2CanIf_CanNodeNum_03_TxBasic_03, CanIfTxPduBufferRef=CanIf_Buffer_CanNodeNum_03_Tx_Basic
        CanIf_CanPdu_CanNodeNum_03_TxBasic_04: CanIfTxPduReadNotifyStatus=false, CanIfTxPduCanIdType=STANDARD_CAN, CanIfTxPduCanId=1796, CanIfTxPduRef=CanPdu_PduR2CanIf_CanNodeNum_03_TxBasic_04, CanIfTxPduBufferRef=CanIf_Buffer_CanNodeNum_03_Tx_Basic
        CanIf_CanPdu_CanNodeNum_03_TxBasic_05: CanIfTxPduReadNotifyStatus=false, CanIfTxPduCanIdType=STANDARD_CAN, CanIfTxPduCanId=1797, CanIfTxPduRef=CanPdu_PduR2CanIf_CanNodeNum_03_TxBasic_05, CanIfTxPduBufferRef=CanIf_Buffer_CanNodeNum_03_Tx_Basic
        CanIf_CanPdu_CanNodeNum_03_TxBasic_06: CanIfTxPduReadNotifyStatus=false, CanIfTxPduCanIdType=STANDARD_CAN, CanIfTxPduCanId=1798, CanIfTxPduRef=CanPdu_PduR2CanIf_CanNodeNum_03_TxBasic_06, CanIfTxPduBufferRef=CanIf_Buffer_CanNodeNum_03_Tx_Basic
        CanIf_CanPdu_CanNodeNum_03_TxBasic_07: CanIfTxPduReadNotifyStatus=false, CanIfTxPduCanIdType=STANDARD_CAN, CanIfTxPduCanId=1799, CanIfTxPduRef=CanPdu_PduR2CanIf_CanNodeNum_03_TxBasic_07, CanIfTxPduBufferRef=CanIf_Buffer_CanNodeNum_03_Tx_Basic
        CanIf_CanPdu_CanNodeNum_03_TxBasic_08: CanIfTxPduReadNotifyStatus=false, CanIfTxPduCanIdType=STANDARD_CAN, CanIfTxPduCanId=1800, CanIfTxPduRef=CanPdu_PduR2CanIf_CanNodeNum_03_TxBasic_08, CanIfTxPduBufferRef=CanIf_Buffer_CanNodeNum_03_Tx_Basic
        CanIf_CanPdu_CanNodeNum_03_TxBasic_09: CanIfTxPduReadNotifyStatus=false, CanIfTxPduCanIdType=STANDARD_CAN, CanIfTxPduCanId=1801, CanIfTxPduRef=CanPdu_PduR2CanIf_CanNodeNum_03_TxBasic_09, CanIfTxPduBufferRef=CanIf_Buffer_CanNodeNum_03_Tx_Basic
        CanIf_CanPdu_CanNodeNum_03_TxBasic_10: CanIfTxPduReadNotifyStatus=false, CanIfTxPduCanIdType=STANDARD_CAN, CanIfTxPduCanId=1808, CanIfTxPduRef=CanPdu_PduR2CanIf_CanNodeNum_03_TxBasic_10, CanIfTxPduBufferRef=CanIf_Buffer_CanNodeNum_03_Tx_Basic
        CanIf_CanPdu_CanNodeNum_03_TxBasic_11: CanIfTxPduReadNotifyStatus=false, CanIfTxPduCanIdType=STANDARD_CAN, CanIfTxPduCanId=1809, CanIfTxPduRef=CanPdu_PduR2CanIf_CanNodeNum_03_TxBasic_11, CanIfTxPduBufferRef=CanIf_Buffer_CanNodeNum_03_Tx_Basic
        CanIf_CanPdu_CanNodeNum_03_TxBasic_12: CanIfTxPduReadNotifyStatus=false, CanIfTxPduCanIdType=STANDARD_CAN, CanIfTxPduCanId=1810, CanIfTxPduRef=CanPdu_PduR2CanIf_CanNodeNum_03_TxBasic_12, CanIfTxPduBufferRef=CanIf_Buffer_CanNodeNum_03_Tx_Basic
        CanIf_CanPdu_CanNodeNum_03_TxBasic_13: CanIfTxPduReadNotifyStatus=false, CanIfTxPduCanIdType=STANDARD_CAN, CanIfTxPduCanId=1811, CanIfTxPduRef=CanPdu_PduR2CanIf_CanNodeNum_03_TxBasic_13, CanIfTxPduBufferRef=CanIf_Buffer_CanNodeNum_03_Tx_Basic
        CanIf_CanPdu_CanNodeNum_03_TxBasic_14: CanIfTxPduReadNotifyStatus=false, CanIfTxPduCanIdType=STANDARD_CAN, CanIfTxPduCanId=1812, CanIfTxPduRef=CanPdu_PduR2CanIf_CanNodeNum_03_TxBasic_14, CanIfTxPduBufferRef=CanIf_Buffer_CanNodeNum_03_Tx_Basic
        CanIf_CanPdu_CanNodeNum_03_TxBasic_15: CanIfTxPduReadNotifyStatus=false, CanIfTxPduCanIdType=STANDARD_CAN, CanIfTxPduCanId=1813, CanIfTxPduRef=CanPdu_PduR2CanIf_CanNodeNum_03_TxBasic_15, CanIfTxPduBufferRef=CanIf_Buffer_CanNodeNum_03_Tx_Basic
        CanIf_CanPdu_CanNodeNum_03_TxBasic_16: CanIfTxPduReadNotifyStatus=false, CanIfTxPduCanIdType=STANDARD_CAN, CanIfTxPduCanId=1814, CanIfTxPduRef=CanPdu_PduR2CanIf_CanNodeNum_03_TxBasic_16, CanIfTxPduBufferRef=CanIf_Buffer_CanNodeNum_03_Tx_Basic
        CanIf_CanPdu_CanNodeNum_03_TxBasic_17: CanIfTxPduReadNotifyStatus=false, CanIfTxPduCanIdType=STANDARD_CAN, CanIfTxPduCanId=1815, CanIfTxPduRef=CanPdu_PduR2CanIf_CanNodeNum_03_TxBasic_17, CanIfTxPduBufferRef=CanIf_Buffer_CanNodeNum_03_Tx_Basic
        CanIf_CanPdu_CanNodeNum_03_TxBasic_18: CanIfTxPduReadNotifyStatus=false, CanIfTxPduCanIdType=STANDARD_CAN, CanIfTxPduCanId=1816, CanIfTxPduRef=CanPdu_PduR2CanIf_CanNodeNum_03_TxBasic_18, CanIfTxPduBufferRef=CanIf_Buffer_CanNodeNum_03_Tx_Basic
        CanIf_CanPdu_CanNodeNum_03_TxBasic_19: CanIfTxPduReadNotifyStatus=false, CanIfTxPduCanIdType=STANDARD_CAN, CanIfTxPduCanId=1817, CanIfTxPduRef=CanPdu_PduR2CanIf_CanNodeNum_03_TxBasic_19, CanIfTxPduBufferRef=CanIf_Buffer_CanNodeNum_03_Tx_Basic
        CanIf_CanPdu_CanNodeNum_03_TxBasic_20: CanIfTxPduReadNotifyStatus=false, CanIfTxPduCanIdType=STANDARD_CAN, CanIfTxPduCanId=1824, CanIfTxPduRef=CanPdu_PduR2CanIf_CanNodeNum_03_TxBasic_20, CanIfTxPduBufferRef=CanIf_Buffer_CanNodeNum_03_Tx_Basic
        CanIf_CanPdu_CanNodeNum_03_Tx_01: CanIfTxPduReadNotifyStatus=0, CanIfTxPduCanIdType=STANDARD_CAN, CanIfTxPduCanId=769, CanIfTxPduBufferRef=CanIf_Buffer_CanNodeNum_03_Tx_01, CanIfTxPduRef=CanPdu_PduR2CanIf_CanNodeNum_03_Tx_01
        CanIf_CanPdu_CanNodeNum_03_Tx_02: CanIfTxPduReadNotifyStatus=0, CanIfTxPduCanIdType=STANDARD_CAN, CanIfTxPduCanId=770, CanIfTxPduBufferRef=CanIf_Buffer_CanNodeNum_03_Tx_02, CanIfTxPduRef=CanPdu_PduR2CanIf_CanNodeNum_03_Tx_02
        CanIf_CanPdu_CanNodeNum_03_Tx_03: CanIfTxPduReadNotifyStatus=0, CanIfTxPduCanIdType=STANDARD_CAN, CanIfTxPduCanId=771, CanIfTxPduBufferRef=CanIf_Buffer_CanNodeNum_03_Tx_03, CanIfTxPduRef=CanPdu_PduR2CanIf_CanNodeNum_03_Tx_03
        CanIf_CanPdu_CanNodeNum_03_Tx_04: CanIfTxPduReadNotifyStatus=0, CanIfTxPduCanIdType=STANDARD_CAN, CanIfTxPduCanId=772, CanIfTxPduBufferRef=CanIf_Buffer_CanNodeNum_03_Tx_04, CanIfTxPduRef=CanPdu_PduR2CanIf_CanNodeNum_03_Tx_04
        CanIf_CanPdu_CanNodeNum_03_Tx_05: CanIfTxPduReadNotifyStatus=0, CanIfTxPduCanIdType=STANDARD_CAN, CanIfTxPduCanId=773, CanIfTxPduBufferRef=CanIf_Buffer_CanNodeNum_03_Tx_05, CanIfTxPduRef=CanPdu_PduR2CanIf_CanNodeNum_03_Tx_05
        CanIf_CanPdu_CanNodeNum_03_Tx_06: CanIfTxPduReadNotifyStatus=0, CanIfTxPduCanIdType=STANDARD_CAN, CanIfTxPduCanId=774, CanIfTxPduBufferRef=CanIf_Buffer_CanNodeNum_03_Tx_06, CanIfTxPduRef=CanPdu_PduR2CanIf_CanNodeNum_03_Tx_06
        CanIf_CanPdu_CanNodeNum_03_Tx_07: CanIfTxPduReadNotifyStatus=0, CanIfTxPduCanIdType=STANDARD_CAN, CanIfTxPduCanId=775, CanIfTxPduBufferRef=CanIf_Buffer_CanNodeNum_03_Tx_07, CanIfTxPduRef=CanPdu_PduR2CanIf_CanNodeNum_03_Tx_07
        CanIf_CanPdu_CanNodeNum_03_Tx_08: CanIfTxPduReadNotifyStatus=0, CanIfTxPduCanIdType=STANDARD_CAN, CanIfTxPduCanId=776, CanIfTxPduBufferRef=CanIf_Buffer_CanNodeNum_03_Tx_08, CanIfTxPduRef=CanPdu_PduR2CanIf_CanNodeNum_03_Tx_08
        CanIf_CanPdu_CanNodeNum_03_Tx_09: CanIfTxPduReadNotifyStatus=0, CanIfTxPduCanIdType=STANDARD_CAN, CanIfTxPduCanId=777, CanIfTxPduBufferRef=CanIf_Buffer_CanNodeNum_03_Tx_09, CanIfTxPduRef=CanPdu_PduR2CanIf_CanNodeNum_03_Tx_09
        CanIf_CanPdu_CanNodeNum_03_Tx_10: CanIfTxPduReadNotifyStatus=0, CanIfTxPduCanIdType=STANDARD_CAN, CanIfTxPduCanId=784, CanIfTxPduBufferRef=CanIf_Buffer_CanNodeNum_03_Tx_10, CanIfTxPduRef=CanPdu_PduR2CanIf_CanNodeNum_03_Tx_10
        CanIf_CanPdu_CanNodeNum_03_Tx_11: CanIfTxPduReadNotifyStatus=0, CanIfTxPduCanIdType=STANDARD_CAN, CanIfTxPduCanId=785, CanIfTxPduBufferRef=CanIf_Buffer_CanNodeNum_03_Tx_11, CanIfTxPduRef=CanPdu_PduR2CanIf_CanNodeNum_03_Tx_11
        CanIf_CanPdu_CanNodeNum_03_Tx_12: CanIfTxPduReadNotifyStatus=0, CanIfTxPduCanIdType=STANDARD_CAN, CanIfTxPduCanId=786, CanIfTxPduBufferRef=CanIf_Buffer_CanNodeNum_03_Tx_12, CanIfTxPduRef=CanPdu_PduR2CanIf_CanNodeNum_03_Tx_12
        CanIf_CanPdu_CanNodeNum_03_Tx_13: CanIfTxPduReadNotifyStatus=0, CanIfTxPduCanIdType=STANDARD_CAN, CanIfTxPduCanId=787, CanIfTxPduBufferRef=CanIf_Buffer_CanNodeNum_03_Tx_13, CanIfTxPduRef=CanPdu_PduR2CanIf_CanNodeNum_03_Tx_13
        CanIf_CanPdu_CanNodeNum_03_Tx_14: CanIfTxPduReadNotifyStatus=0, CanIfTxPduCanIdType=STANDARD_CAN, CanIfTxPduCanId=788, CanIfTxPduBufferRef=CanIf_Buffer_CanNodeNum_03_Tx_14, CanIfTxPduRef=CanPdu_PduR2CanIf_CanNodeNum_03_Tx_14
        CanIf_CanPdu_CanNodeNum_03_Tx_15: CanIfTxPduReadNotifyStatus=0, CanIfTxPduCanIdType=STANDARD_CAN, CanIfTxPduCanId=789, CanIfTxPduBufferRef=CanIf_Buffer_CanNodeNum_03_Tx_15, CanIfTxPduRef=CanPdu_PduR2CanIf_CanNodeNum_03_Tx_15
        CanIf_CanPdu_CanNodeNum_03_Tx_16: CanIfTxPduReadNotifyStatus=0, CanIfTxPduCanIdType=STANDARD_CAN, CanIfTxPduCanId=790, CanIfTxPduBufferRef=CanIf_Buffer_CanNodeNum_03_Tx_16, CanIfTxPduRef=CanPdu_PduR2CanIf_CanNodeNum_03_Tx_16
        CanIf_CanPdu_CanNodeNum_03_Tx_17: CanIfTxPduReadNotifyStatus=0, CanIfTxPduCanIdType=STANDARD_CAN, CanIfTxPduCanId=791, CanIfTxPduBufferRef=CanIf_Buffer_CanNodeNum_03_Tx_17, CanIfTxPduRef=CanPdu_PduR2CanIf_CanNodeNum_03_Tx_17
        CanIf_CanPdu_CanNodeNum_03_Tx_18: CanIfTxPduReadNotifyStatus=0, CanIfTxPduCanIdType=STANDARD_CAN, CanIfTxPduCanId=792, CanIfTxPduBufferRef=CanIf_Buffer_CanNodeNum_03_Tx_18, CanIfTxPduRef=CanPdu_PduR2CanIf_CanNodeNum_03_Tx_18
        CanIf_CanPdu_CanNodeNum_03_Tx_19: CanIfTxPduReadNotifyStatus=0, CanIfTxPduCanIdType=STANDARD_CAN, CanIfTxPduCanId=793, CanIfTxPduBufferRef=CanIf_Buffer_CanNodeNum_03_Tx_19, CanIfTxPduRef=CanPdu_PduR2CanIf_CanNodeNum_03_Tx_19
        CanIf_CanPdu_CanNodeNum_03_Tx_20: CanIfTxPduReadNotifyStatus=0, CanIfTxPduCanIdType=STANDARD_CAN, CanIfTxPduCanId=800, CanIfTxPduBufferRef=CanIf_Buffer_CanNodeNum_03_Tx_20, CanIfTxPduRef=CanPdu_PduR2CanIf_CanNodeNum_03_Tx_20
        CanIf_CanPdu_CanNodeNum_03_Tx_21: CanIfTxPduReadNotifyStatus=0, CanIfTxPduCanIdType=STANDARD_CAN, CanIfTxPduCanId=801, CanIfTxPduBufferRef=CanIf_Buffer_CanNodeNum_03_Tx_21, CanIfTxPduRef=CanPdu_PduR2CanIf_CanNodeNum_03_Tx_21
        CanIf_CanPdu_CanNodeNum_03_Tx_22: CanIfTxPduReadNotifyStatus=0, CanIfTxPduCanIdType=STANDARD_CAN, CanIfTxPduCanId=802, CanIfTxPduBufferRef=CanIf_Buffer_CanNodeNum_03_Tx_22, CanIfTxPduRef=CanPdu_PduR2CanIf_CanNodeNum_03_Tx_22
        CanIf_CanPdu_CanNodeNum_03_Tx_23: CanIfTxPduReadNotifyStatus=0, CanIfTxPduCanIdType=STANDARD_CAN, CanIfTxPduCanId=803, CanIfTxPduBufferRef=CanIf_Buffer_CanNodeNum_03_Tx_23, CanIfTxPduRef=CanPdu_PduR2CanIf_CanNodeNum_03_Tx_23
        CanIf_CanPdu_CanNodeNum_03_Tx_24: CanIfTxPduReadNotifyStatus=0, CanIfTxPduCanIdType=STANDARD_CAN, CanIfTxPduCanId=804, CanIfTxPduBufferRef=CanIf_Buffer_CanNodeNum_03_Tx_24, CanIfTxPduRef=CanPdu_PduR2CanIf_CanNodeNum_03_Tx_24
        CanIf_CanPdu_CanNodeNum_03_Tx_25: CanIfTxPduReadNotifyStatus=0, CanIfTxPduCanIdType=STANDARD_CAN, CanIfTxPduCanId=805, CanIfTxPduBufferRef=CanIf_Buffer_CanNodeNum_03_Tx_25, CanIfTxPduRef=CanPdu_PduR2CanIf_CanNodeNum_03_Tx_25
        CanIf_CanPdu_CanNodeNum_03_Tx_26: CanIfTxPduReadNotifyStatus=0, CanIfTxPduCanIdType=STANDARD_CAN, CanIfTxPduCanId=806, CanIfTxPduBufferRef=CanIf_Buffer_CanNodeNum_03_Tx_26, CanIfTxPduRef=CanPdu_PduR2CanIf_CanNodeNum_03_Tx_26
      92 x CanIfRxPduCfg, all with CanIfRxPduUserRxIndicationUL=PDUR, CanIfRxPduDlc=8, CanIfRxPduReadNotifyStatus=true, CanIfRxPduUserRxIndicationName=PduR_CanIfRxIndication:
        CanIf_CanPdu_CanNodeNum_01_Rx_29: CanIfRxPduCanId=500000028, CanIfRxPduCanIdType=EXTENDED_CAN, CanIfRxPduReadData=false, CanIfRxPduRef=CanPdu_CanIf2PduR_CanNodeNum_01_Rx_29, CanIfRxPduHrhIdRef=CanIf_HwRxHandle_CanNodeNum_01_Rx_29
        CanIf_CanPdu_CanNodeNum_01_Rx_30: CanIfRxPduCanId=500000029, CanIfRxPduCanIdType=EXTENDED_CAN, CanIfRxPduReadData=false, CanIfRxPduRef=CanPdu_CanIf2PduR_CanNodeNum_01_Rx_30, CanIfRxPduHrhIdRef=CanIf_HwRxHandle_CanNodeNum_01_Rx_30
        CanIf_CanPdu_CanNodeNum_01_Rx_31: CanIfRxPduCanId=500000030, CanIfRxPduCanIdType=EXTENDED_CAN, CanIfRxPduReadData=false, CanIfRxPduRef=CanPdu_CanIf2PduR_CanNodeNum_01_Rx_31, CanIfRxPduHrhIdRef=CanIf_HwRxHandle_CanNodeNum_01_Rx_31
        CanIf_CanPdu_CanNodeNum_01_Rx_32: CanIfRxPduCanId=500000031, CanIfRxPduCanIdType=EXTENDED_CAN, CanIfRxPduReadData=false, CanIfRxPduRef=CanPdu_CanIf2PduR_CanNodeNum_01_Rx_32, CanIfRxPduHrhIdRef=CanIf_HwRxHandle_CanNodeNum_01_Rx_32
        CanIf_CanPdu_CanNodeNum_01_Rx_33: CanIfRxPduCanId=500000032, CanIfRxPduCanIdType=EXTENDED_CAN, CanIfRxPduReadData=false, CanIfRxPduRef=CanPdu_CanIf2PduR_CanNodeNum_01_Rx_33, CanIfRxPduHrhIdRef=CanIf_HwRxHandle_CanNodeNum_01_Rx_33
        CanIf_CanPdu_CanNodeNum_01_Rx_34: CanIfRxPduCanId=500000033, CanIfRxPduCanIdType=EXTENDED_CAN, CanIfRxPduReadData=false, CanIfRxPduRef=CanPdu_CanIf2PduR_CanNodeNum_01_Rx_34, CanIfRxPduHrhIdRef=CanIf_HwRxHandle_CanNodeNum_01_Rx_34
        CanIf_CanPdu_CanNodeNum_01_Rx_35: CanIfRxPduCanId=500000034, CanIfRxPduCanIdType=EXTENDED_CAN, CanIfRxPduReadData=false, CanIfRxPduRef=CanPdu_CanIf2PduR_CanNodeNum_01_Rx_35, CanIfRxPduHrhIdRef=CanIf_HwRxHandle_CanNodeNum_01_Rx_35
        CanIf_CanPdu_CanNodeNum_01_Rx_36: CanIfRxPduCanId=500000035, CanIfRxPduCanIdType=EXTENDED_CAN, CanIfRxPduReadData=false, CanIfRxPduRef=CanPdu_CanIf2PduR_CanNodeNum_01_Rx_36, CanIfRxPduHrhIdRef=CanIf_HwRxHandle_CanNodeNum_01_Rx_36
        CanIf_CanPdu_CanNodeNum_01_Rx_37: CanIfRxPduCanId=500000036, CanIfRxPduCanIdType=EXTENDED_CAN, CanIfRxPduReadData=false, CanIfRxPduRef=CanPdu_CanIf2PduR_CanNodeNum_01_Rx_37, CanIfRxPduHrhIdRef=CanIf_HwRxHandle_CanNodeNum_01_Rx_37
        CanIf_CanPdu_CanNodeNum_01_Rx_38: CanIfRxPduCanId=500000037, CanIfRxPduCanIdType=EXTENDED_CAN, CanIfRxPduReadData=false, CanIfRxPduRef=CanPdu_CanIf2PduR_CanNodeNum_01_Rx_38, CanIfRxPduHrhIdRef=CanIf_HwRxHandle_CanNodeNum_01_Rx_38
        CanIf_CanPdu_CanNodeNum_01_Rx_39: CanIfRxPduCanId=500000038, CanIfRxPduCanIdType=EXTENDED_CAN, CanIfRxPduReadData=false, CanIfRxPduRef=CanPdu_CanIf2PduR_CanNodeNum_01_Rx_39, CanIfRxPduHrhIdRef=CanIf_HwRxHandle_CanNodeNum_01_Rx_39
        CanIf_CanPdu_CanNodeNum_01_Rx_40: CanIfRxPduCanId=500000039, CanIfRxPduCanIdType=EXTENDED_CAN, CanIfRxPduReadData=false, CanIfRxPduRef=CanPdu_CanIf2PduR_CanNodeNum_01_Rx_40, CanIfRxPduHrhIdRef=CanIf_HwRxHandle_CanNodeNum_01_Rx_40
        CanIf_CanPdu_CanNodeNum_02_Rx_01: CanIfRxPduReadData=0, CanIfRxPduCanIdType=EXTENDED_CAN, CanIfRxPduCanId=218040528, CanIfRxPduHrhIdRef=CanIf_HwRxHandle_CanNodeNum_02_Rx_01, CanIfRxPduRef=CanPdu_CanIf2PduR_CanNodeNum_02_Rx_01
        CanIf_CanPdu_CanNodeNum_02_Rx_02: CanIfRxPduReadData=0, CanIfRxPduCanIdType=EXTENDED_CAN, CanIfRxPduCanId=218040272, CanIfRxPduHrhIdRef=CanIf_HwRxHandle_CanNodeNum_02_Rx_02, CanIfRxPduRef=CanPdu_CanIf2PduR_CanNodeNum_02_Rx_02
        CanIf_CanPdu_CanNodeNum_02_Rx_03: CanIfRxPduReadData=0, CanIfRxPduCanIdType=EXTENDED_CAN, CanIfRxPduCanId=218040016, CanIfRxPduHrhIdRef=CanIf_HwRxHandle_CanNodeNum_02_Rx_03, CanIfRxPduRef=CanPdu_CanIf2PduR_CanNodeNum_02_Rx_03
        CanIf_CanPdu_CanNodeNum_02_Rx_04: CanIfRxPduReadData=0, CanIfRxPduCanIdType=EXTENDED_CAN, CanIfRxPduCanId=500000043, CanIfRxPduHrhIdRef=CanIf_HwRxHandle_CanNodeNum_02_Rx_04, CanIfRxPduRef=CanPdu_CanIf2PduR_CanNodeNum_02_Rx_04
        CanIf_CanPdu_CanNodeNum_02_Rx_05: CanIfRxPduReadData=0, CanIfRxPduCanIdType=EXTENDED_CAN, CanIfRxPduCanId=500000044, CanIfRxPduHrhIdRef=CanIf_HwRxHandle_CanNodeNum_02_Rx_05, CanIfRxPduRef=CanPdu_CanIf2PduR_CanNodeNum_02_Rx_05
        CanIf_CanPdu_CanNodeNum_02_Rx_06: CanIfRxPduReadData=0, CanIfRxPduCanIdType=EXTENDED_CAN, CanIfRxPduCanId=500000045, CanIfRxPduHrhIdRef=CanIf_HwRxHandle_CanNodeNum_02_Rx_06, CanIfRxPduRef=CanPdu_CanIf2PduR_CanNodeNum_02_Rx_06
        CanIf_CanPdu_CanNodeNum_02_Rx_07: CanIfRxPduReadData=0, CanIfRxPduCanIdType=EXTENDED_CAN, CanIfRxPduCanId=500000046, CanIfRxPduHrhIdRef=CanIf_HwRxHandle_CanNodeNum_02_Rx_07, CanIfRxPduRef=CanPdu_CanIf2PduR_CanNodeNum_02_Rx_07
        CanIf_CanPdu_CanNodeNum_02_Rx_08: CanIfRxPduReadData=0, CanIfRxPduCanIdType=EXTENDED_CAN, CanIfRxPduCanId=500000047, CanIfRxPduHrhIdRef=CanIf_HwRxHandle_CanNodeNum_02_Rx_08, CanIfRxPduRef=CanPdu_CanIf2PduR_CanNodeNum_02_Rx_08
        CanIf_CanPdu_CanNodeNum_02_Rx_09: CanIfRxPduReadData=0, CanIfRxPduCanIdType=EXTENDED_CAN, CanIfRxPduCanId=500000048, CanIfRxPduHrhIdRef=CanIf_HwRxHandle_CanNodeNum_02_Rx_09, CanIfRxPduRef=CanPdu_CanIf2PduR_CanNodeNum_02_Rx_09
        CanIf_CanPdu_CanNodeNum_02_Rx_10: CanIfRxPduReadData=0, CanIfRxPduCanIdType=EXTENDED_CAN, CanIfRxPduCanId=500000049, CanIfRxPduHrhIdRef=CanIf_HwRxHandle_CanNodeNum_02_Rx_10, CanIfRxPduRef=CanPdu_CanIf2PduR_CanNodeNum_02_Rx_10
        CanIf_CanPdu_CanNodeNum_02_Rx_11: CanIfRxPduReadData=0, CanIfRxPduCanIdType=EXTENDED_CAN, CanIfRxPduCanId=500000050, CanIfRxPduHrhIdRef=CanIf_HwRxHandle_CanNodeNum_02_Rx_11, CanIfRxPduRef=CanPdu_CanIf2PduR_CanNodeNum_02_Rx_11
        CanIf_CanPdu_CanNodeNum_02_Rx_12: CanIfRxPduReadData=0, CanIfRxPduCanIdType=EXTENDED_CAN, CanIfRxPduCanId=500000051, CanIfRxPduHrhIdRef=CanIf_HwRxHandle_CanNodeNum_02_Rx_12, CanIfRxPduRef=CanPdu_CanIf2PduR_CanNodeNum_02_Rx_12
        CanIf_CanPdu_CanNodeNum_02_Rx_13: CanIfRxPduReadData=0, CanIfRxPduCanIdType=EXTENDED_CAN, CanIfRxPduCanId=500000052, CanIfRxPduHrhIdRef=CanIf_HwRxHandle_CanNodeNum_02_Rx_13, CanIfRxPduRef=CanPdu_CanIf2PduR_CanNodeNum_02_Rx_13
        CanIf_CanPdu_CanNodeNum_02_Rx_14: CanIfRxPduReadData=0, CanIfRxPduCanIdType=EXTENDED_CAN, CanIfRxPduCanId=500000053, CanIfRxPduHrhIdRef=CanIf_HwRxHandle_CanNodeNum_02_Rx_14, CanIfRxPduRef=CanPdu_CanIf2PduR_CanNodeNum_02_Rx_14
        CanIf_CanPdu_CanNodeNum_02_Rx_15: CanIfRxPduReadData=0, CanIfRxPduCanIdType=EXTENDED_CAN, CanIfRxPduCanId=500000054, CanIfRxPduHrhIdRef=CanIf_HwRxHandle_CanNodeNum_02_Rx_15, CanIfRxPduRef=CanPdu_CanIf2PduR_CanNodeNum_02_Rx_15
        CanIf_CanPdu_CanNodeNum_02_Rx_16: CanIfRxPduReadData=0, CanIfRxPduCanIdType=EXTENDED_CAN, CanIfRxPduCanId=500000055, CanIfRxPduHrhIdRef=CanIf_HwRxHandle_CanNodeNum_02_Rx_16, CanIfRxPduRef=CanPdu_CanIf2PduR_CanNodeNum_02_Rx_16
        CanIf_CanPdu_CanNodeNum_02_Rx_17: CanIfRxPduReadData=0, CanIfRxPduCanIdType=EXTENDED_CAN, CanIfRxPduCanId=500000056, CanIfRxPduHrhIdRef=CanIf_HwRxHandle_CanNodeNum_02_Rx_17, CanIfRxPduRef=CanPdu_CanIf2PduR_CanNodeNum_02_Rx_17
        CanIf_CanPdu_CanNodeNum_02_Rx_18: CanIfRxPduReadData=0, CanIfRxPduCanIdType=EXTENDED_CAN, CanIfRxPduCanId=500000057, CanIfRxPduHrhIdRef=CanIf_HwRxHandle_CanNodeNum_02_Rx_18, CanIfRxPduRef=CanPdu_CanIf2PduR_CanNodeNum_02_Rx_18
        CanIf_CanPdu_CanNodeNum_02_Rx_19: CanIfRxPduReadData=0, CanIfRxPduCanIdType=EXTENDED_CAN, CanIfRxPduCanId=500000058, CanIfRxPduHrhIdRef=CanIf_HwRxHandle_CanNodeNum_02_Rx_19, CanIfRxPduRef=CanPdu_CanIf2PduR_CanNodeNum_02_Rx_19
        CanIf_CanPdu_CanNodeNum_02_Rx_20: CanIfRxPduReadData=0, CanIfRxPduCanIdType=EXTENDED_CAN, CanIfRxPduCanId=500000059, CanIfRxPduHrhIdRef=CanIf_HwRxHandle_CanNodeNum_02_Rx_20, CanIfRxPduRef=CanPdu_CanIf2PduR_CanNodeNum_02_Rx_20
        CanIf_CanPdu_CanNodeNum_02_Rx_21: CanIfRxPduReadData=0, CanIfRxPduCanIdType=EXTENDED_CAN, CanIfRxPduCanId=500000060, CanIfRxPduHrhIdRef=CanIf_HwRxHandle_CanNodeNum_02_Rx_21, CanIfRxPduRef=CanPdu_CanIf2PduR_CanNodeNum_02_Rx_21
        CanIf_CanPdu_CanNodeNum_02_Rx_22: CanIfRxPduReadData=0, CanIfRxPduCanIdType=EXTENDED_CAN, CanIfRxPduCanId=500000061, CanIfRxPduHrhIdRef=CanIf_HwRxHandle_CanNodeNum_02_Rx_22, CanIfRxPduRef=CanPdu_CanIf2PduR_CanNodeNum_02_Rx_22
        CanIf_CanPdu_CanNodeNum_02_Rx_23: CanIfRxPduReadData=0, CanIfRxPduCanIdType=EXTENDED_CAN, CanIfRxPduCanId=500000062, CanIfRxPduHrhIdRef=CanIf_HwRxHandle_CanNodeNum_02_Rx_23, CanIfRxPduRef=CanPdu_CanIf2PduR_CanNodeNum_02_Rx_23
        CanIf_CanPdu_CanNodeNum_02_Rx_24: CanIfRxPduReadData=0, CanIfRxPduCanIdType=EXTENDED_CAN, CanIfRxPduCanId=500000063, CanIfRxPduHrhIdRef=CanIf_HwRxHandle_CanNodeNum_02_Rx_24, CanIfRxPduRef=CanPdu_CanIf2PduR_CanNodeNum_02_Rx_24
        CanIf_CanPdu_CanNodeNum_02_Rx_25: CanIfRxPduReadData=0, CanIfRxPduCanIdType=EXTENDED_CAN, CanIfRxPduCanId=500000064, CanIfRxPduHrhIdRef=CanIf_HwRxHandle_CanNodeNum_02_Rx_25, CanIfRxPduRef=CanPdu_CanIf2PduR_CanNodeNum_02_Rx_25
        CanIf_CanPdu_CanNodeNum_02_Rx_26: CanIfRxPduReadData=0, CanIfRxPduCanIdType=EXTENDED_CAN, CanIfRxPduCanId=500000065, CanIfRxPduHrhIdRef=CanIf_HwRxHandle_CanNodeNum_02_Rx_26, CanIfRxPduRef=CanPdu_CanIf2PduR_CanNodeNum_02_Rx_26
        CanIf_CanPdu_CanNodeNum_02_Rx_27: CanIfRxPduReadData=0, CanIfRxPduCanIdType=EXTENDED_CAN, CanIfRxPduCanId=500000066, CanIfRxPduHrhIdRef=CanIf_HwRxHandle_CanNodeNum_02_Rx_27, CanIfRxPduRef=CanPdu_CanIf2PduR_CanNodeNum_02_Rx_27
        CanIf_CanPdu_CanNodeNum_02_Rx_28: CanIfRxPduReadData=0, CanIfRxPduCanIdType=EXTENDED_CAN, CanIfRxPduCanId=500000067, CanIfRxPduHrhIdRef=CanIf_HwRxHandle_CanNodeNum_02_Rx_28, CanIfRxPduRef=CanPdu_CanIf2PduR_CanNodeNum_02_Rx_28
        CanIf_CanPdu_CanNodeNum_02_Rx_29: CanIfRxPduReadData=0, CanIfRxPduCanIdType=EXTENDED_CAN, CanIfRxPduCanId=500000068, CanIfRxPduHrhIdRef=CanIf_HwRxHandle_CanNodeNum_02_Rx_29, CanIfRxPduRef=CanPdu_CanIf2PduR_CanNodeNum_02_Rx_29
        CanIf_CanPdu_CanNodeNum_02_Rx_30: CanIfRxPduReadData=0, CanIfRxPduCanIdType=EXTENDED_CAN, CanIfRxPduCanId=500000069, CanIfRxPduHrhIdRef=CanIf_HwRxHandle_CanNodeNum_02_Rx_30, CanIfRxPduRef=CanPdu_CanIf2PduR_CanNodeNum_02_Rx_30
        CanIf_CanPdu_CanNodeNum_02_Rx_31: CanIfRxPduReadData=0, CanIfRxPduCanIdType=EXTENDED_CAN, CanIfRxPduCanId=500000070, CanIfRxPduHrhIdRef=CanIf_HwRxHandle_CanNodeNum_02_Rx_31, CanIfRxPduRef=CanPdu_CanIf2PduR_CanNodeNum_02_Rx_31
        CanIf_CanPdu_CanNodeNum_02_Rx_32: CanIfRxPduReadData=0, CanIfRxPduCanIdType=EXTENDED_CAN, CanIfRxPduCanId=500000071, CanIfRxPduHrhIdRef=CanIf_HwRxHandle_CanNodeNum_02_Rx_32, CanIfRxPduRef=CanPdu_CanIf2PduR_CanNodeNum_02_Rx_32
        CanIf_CanPdu_CanNodeNum_02_Rx_33: CanIfRxPduReadData=0, CanIfRxPduCanIdType=EXTENDED_CAN, CanIfRxPduCanId=500000072, CanIfRxPduHrhIdRef=CanIf_HwRxHandle_CanNodeNum_02_Rx_33, CanIfRxPduRef=CanPdu_CanIf2PduR_CanNodeNum_02_Rx_33
        CanIf_CanPdu_CanNodeNum_02_Rx_34: CanIfRxPduReadData=0, CanIfRxPduCanIdType=EXTENDED_CAN, CanIfRxPduCanId=500000073, CanIfRxPduHrhIdRef=CanIf_HwRxHandle_CanNodeNum_02_Rx_34, CanIfRxPduRef=CanPdu_CanIf2PduR_CanNodeNum_02_Rx_34
        CanIf_CanPdu_CanNodeNum_02_Rx_35: CanIfRxPduReadData=0, CanIfRxPduCanIdType=EXTENDED_CAN, CanIfRxPduCanId=500000074, CanIfRxPduHrhIdRef=CanIf_HwRxHandle_CanNodeNum_02_Rx_35, CanIfRxPduRef=CanPdu_CanIf2PduR_CanNodeNum_02_Rx_35
        CanIf_CanPdu_CanNodeNum_02_Rx_36: CanIfRxPduReadData=0, CanIfRxPduCanIdType=EXTENDED_CAN, CanIfRxPduCanId=500000075, CanIfRxPduHrhIdRef=CanIf_HwRxHandle_CanNodeNum_02_Rx_36, CanIfRxPduRef=CanPdu_CanIf2PduR_CanNodeNum_02_Rx_36
        CanIf_CanPdu_CanNodeNum_02_Rx_37: CanIfRxPduReadData=0, CanIfRxPduCanIdType=EXTENDED_CAN, CanIfRxPduCanId=500000076, CanIfRxPduHrhIdRef=CanIf_HwRxHandle_CanNodeNum_02_Rx_37, CanIfRxPduRef=CanPdu_CanIf2PduR_CanNodeNum_02_Rx_37
        CanIf_CanPdu_CanNodeNum_02_Rx_38: CanIfRxPduReadData=0, CanIfRxPduCanIdType=EXTENDED_CAN, CanIfRxPduCanId=500000077, CanIfRxPduHrhIdRef=CanIf_HwRxHandle_CanNodeNum_02_Rx_38, CanIfRxPduRef=CanPdu_CanIf2PduR_CanNodeNum_02_Rx_38
        CanIf_CanPdu_CanNodeNum_02_Rx_39: CanIfRxPduReadData=0, CanIfRxPduCanIdType=EXTENDED_CAN, CanIfRxPduCanId=500000078, CanIfRxPduHrhIdRef=CanIf_HwRxHandle_CanNodeNum_02_Rx_39, CanIfRxPduRef=CanPdu_CanIf2PduR_CanNodeNum_02_Rx_39
        CanIf_CanPdu_CanNodeNum_02_Rx_40: CanIfRxPduReadData=0, CanIfRxPduCanIdType=EXTENDED_CAN, CanIfRxPduCanId=500000079, CanIfRxPduHrhIdRef=CanIf_HwRxHandle_CanNodeNum_02_Rx_40, CanIfRxPduRef=CanPdu_CanIf2PduR_CanNodeNum_02_Rx_40
        CanIf_CanPdu_CanNodeNum_03_Rx_01: CanIfRxPduReadData=0, CanIfRxPduCanIdType=STANDARD_CAN, CanIfRxPduCanId=960, CanIfRxPduHrhIdRef=CanIf_HwRxHandle_CanNodeNum_03_Rx_01, CanIfRxPduRef=CanPdu_CanIf2PduR_CanNodeNum_03_Rx_01
        CanIf_CanPdu_CanNodeNum_03_Rx_02: CanIfRxPduReadData=0, CanIfRxPduCanIdType=STANDARD_CAN, CanIfRxPduCanId=961, CanIfRxPduHrhIdRef=CanIf_HwRxHandle_CanNodeNum_03_Rx_02, CanIfRxPduRef=CanPdu_CanIf2PduR_CanNodeNum_03_Rx_02
        CanIf_CanPdu_CanNodeNum_03_Rx_03: CanIfRxPduReadData=0, CanIfRxPduCanIdType=STANDARD_CAN, CanIfRxPduCanId=962, CanIfRxPduHrhIdRef=CanIf_HwRxHandle_CanNodeNum_03_Rx_03, CanIfRxPduRef=CanPdu_CanIf2PduR_CanNodeNum_03_Rx_03
        CanIf_CanPdu_CanNodeNum_03_Rx_04: CanIfRxPduReadData=0, CanIfRxPduCanIdType=STANDARD_CAN, CanIfRxPduCanId=963, CanIfRxPduHrhIdRef=CanIf_HwRxHandle_CanNodeNum_03_Rx_04, CanIfRxPduRef=CanPdu_CanIf2PduR_CanNodeNum_03_Rx_04
        CanIf_CanPdu_CanNodeNum_03_Rx_05: CanIfRxPduReadData=0, CanIfRxPduCanIdType=STANDARD_CAN, CanIfRxPduCanId=853, CanIfRxPduHrhIdRef=CanIf_HwRxHandle_CanNodeNum_03_Rx_05, CanIfRxPduRef=CanPdu_CanIf2PduR_CanNodeNum_03_Rx_05
        CanIf_CanPdu_CanNodeNum_03_Rx_06: CanIfRxPduReadData=0, CanIfRxPduCanIdType=STANDARD_CAN, CanIfRxPduCanId=854, CanIfRxPduHrhIdRef=CanIf_HwRxHandle_CanNodeNum_03_Rx_06, CanIfRxPduRef=CanPdu_CanIf2PduR_CanNodeNum_03_Rx_06
        CanIf_CanPdu_CanNodeNum_03_Rx_07: CanIfRxPduReadData=0, CanIfRxPduCanIdType=STANDARD_CAN, CanIfRxPduCanId=855, CanIfRxPduHrhIdRef=CanIf_HwRxHandle_CanNodeNum_03_Rx_07, CanIfRxPduRef=CanPdu_CanIf2PduR_CanNodeNum_03_Rx_07
        CanIf_CanPdu_CanNodeNum_03_Rx_08: CanIfRxPduReadData=0, CanIfRxPduCanIdType=STANDARD_CAN, CanIfRxPduCanId=856, CanIfRxPduHrhIdRef=CanIf_HwRxHandle_CanNodeNum_03_Rx_08, CanIfRxPduRef=CanPdu_CanIf2PduR_CanNodeNum_03_Rx_08
        CanIf_CanPdu_CanNodeNum_03_Rx_09: CanIfRxPduReadData=0, CanIfRxPduCanIdType=STANDARD_CAN, CanIfRxPduCanId=857, CanIfRxPduHrhIdRef=CanIf_HwRxHandle_CanNodeNum_03_Rx_09, CanIfRxPduRef=CanPdu_CanIf2PduR_CanNodeNum_03_Rx_09
        CanIf_CanPdu_CanNodeNum_03_Rx_10: CanIfRxPduReadData=0, CanIfRxPduCanIdType=STANDARD_CAN, CanIfRxPduCanId=864, CanIfRxPduHrhIdRef=CanIf_HwRxHandle_CanNodeNum_03_Rx_10, CanIfRxPduRef=CanPdu_CanIf2PduR_CanNodeNum_03_Rx_10
        CanIf_CanPdu_CanNodeNum_03_Rx_11: CanIfRxPduReadData=0, CanIfRxPduCanIdType=STANDARD_CAN, CanIfRxPduCanId=865, CanIfRxPduHrhIdRef=CanIf_HwRxHandle_CanNodeNum_03_Rx_11, CanIfRxPduRef=CanPdu_CanIf2PduR_CanNodeNum_03_Rx_11
        CanIf_CanPdu_CanNodeNum_03_Rx_12: CanIfRxPduReadData=0, CanIfRxPduCanIdType=STANDARD_CAN, CanIfRxPduCanId=866, CanIfRxPduHrhIdRef=CanIf_HwRxHandle_CanNodeNum_03_Rx_12, CanIfRxPduRef=CanPdu_CanIf2PduR_CanNodeNum_03_Rx_12
        CanIf_CanPdu_CanNodeNum_03_Rx_13: CanIfRxPduReadData=0, CanIfRxPduCanIdType=STANDARD_CAN, CanIfRxPduCanId=867, CanIfRxPduHrhIdRef=CanIf_HwRxHandle_CanNodeNum_03_Rx_13, CanIfRxPduRef=CanPdu_CanIf2PduR_CanNodeNum_03_Rx_13
        CanIf_CanPdu_CanNodeNum_03_Rx_14: CanIfRxPduReadData=0, CanIfRxPduCanIdType=STANDARD_CAN, CanIfRxPduCanId=868, CanIfRxPduHrhIdRef=CanIf_HwRxHandle_CanNodeNum_03_Rx_14, CanIfRxPduRef=CanPdu_CanIf2PduR_CanNodeNum_03_Rx_14
        CanIf_CanPdu_CanNodeNum_03_Rx_15: CanIfRxPduReadData=0, CanIfRxPduCanIdType=STANDARD_CAN, CanIfRxPduCanId=869, CanIfRxPduHrhIdRef=CanIf_HwRxHandle_CanNodeNum_03_Rx_15, CanIfRxPduRef=CanPdu_CanIf2PduR_CanNodeNum_03_Rx_15
        CanIf_CanPdu_CanNodeNum_03_Rx_16: CanIfRxPduReadData=0, CanIfRxPduCanIdType=STANDARD_CAN, CanIfRxPduCanId=870, CanIfRxPduHrhIdRef=CanIf_HwRxHandle_CanNodeNum_03_Rx_16, CanIfRxPduRef=CanPdu_CanIf2PduR_CanNodeNum_03_Rx_16
        CanIf_CanPdu_CanNodeNum_03_Rx_17: CanIfRxPduReadData=0, CanIfRxPduCanIdType=STANDARD_CAN, CanIfRxPduCanId=871, CanIfRxPduHrhIdRef=CanIf_HwRxHandle_CanNodeNum_03_Rx_17, CanIfRxPduRef=CanPdu_CanIf2PduR_CanNodeNum_03_Rx_17
        CanIf_CanPdu_CanNodeNum_03_Rx_18: CanIfRxPduReadData=0, CanIfRxPduCanIdType=STANDARD_CAN, CanIfRxPduCanId=872, CanIfRxPduHrhIdRef=CanIf_HwRxHandle_CanNodeNum_03_Rx_18, CanIfRxPduRef=CanPdu_CanIf2PduR_CanNodeNum_03_Rx_18
        CanIf_CanPdu_CanNodeNum_03_Rx_19: CanIfRxPduReadData=0, CanIfRxPduCanIdType=STANDARD_CAN, CanIfRxPduCanId=873, CanIfRxPduHrhIdRef=CanIf_HwRxHandle_CanNodeNum_03_Rx_19, CanIfRxPduRef=CanPdu_CanIf2PduR_CanNodeNum_03_Rx_19
        CanIf_CanPdu_CanNodeNum_03_Rx_20: CanIfRxPduReadData=0, CanIfRxPduCanIdType=STANDARD_CAN, CanIfRxPduCanId=880, CanIfRxPduHrhIdRef=CanIf_HwRxHandle_CanNodeNum_03_Rx_20, CanIfRxPduRef=CanPdu_CanIf2PduR_CanNodeNum_03_Rx_20
        CanIf_CanPdu_CanNodeNum_03_Rx_21: CanIfRxPduReadData=0, CanIfRxPduCanIdType=STANDARD_CAN, CanIfRxPduCanId=881, CanIfRxPduHrhIdRef=CanIf_HwRxHandle_CanNodeNum_03_Rx_21, CanIfRxPduRef=CanPdu_CanIf2PduR_CanNodeNum_03_Rx_21
        CanIf_CanPdu_CanNodeNum_03_Rx_22: CanIfRxPduReadData=0, CanIfRxPduCanIdType=STANDARD_CAN, CanIfRxPduCanId=882, CanIfRxPduHrhIdRef=CanIf_HwRxHandle_CanNodeNum_03_Rx_22, CanIfRxPduRef=CanPdu_CanIf2PduR_CanNodeNum_03_Rx_22
        CanIf_CanPdu_CanNodeNum_03_Rx_23: CanIfRxPduReadData=0, CanIfRxPduCanIdType=STANDARD_CAN, CanIfRxPduCanId=883, CanIfRxPduHrhIdRef=CanIf_HwRxHandle_CanNodeNum_03_Rx_23, CanIfRxPduRef=CanPdu_CanIf2PduR_CanNodeNum_03_Rx_23
        CanIf_CanPdu_CanNodeNum_03_Rx_24: CanIfRxPduReadData=0, CanIfRxPduCanIdType=STANDARD_CAN, CanIfRxPduCanId=884, CanIfRxPduHrhIdRef=CanIf_HwRxHandle_CanNodeNum_03_Rx_24, CanIfRxPduRef=CanPdu_CanIf2PduR_CanNodeNum_03_Rx_24
        CanIf_CanPdu_CanNodeNum_03_Rx_25: CanIfRxPduReadData=0, CanIfRxPduCanIdType=STANDARD_CAN, CanIfRxPduCanId=885, CanIfRxPduHrhIdRef=CanIf_HwRxHandle_CanNodeNum_03_Rx_25, CanIfRxPduRef=CanPdu_CanIf2PduR_CanNodeNum_03_Rx_25
        CanIf_CanPdu_CanNodeNum_03_Rx_26: CanIfRxPduReadData=0, CanIfRxPduCanIdType=STANDARD_CAN, CanIfRxPduCanId=886, CanIfRxPduHrhIdRef=CanIf_HwRxHandle_CanNodeNum_03_Rx_26, CanIfRxPduRef=CanPdu_CanIf2PduR_CanNodeNum_03_Rx_26
        CanIf_CanPdu_CanNodeNum_03_Rx_27: CanIfRxPduReadData=0, CanIfRxPduCanIdType=STANDARD_CAN, CanIfRxPduCanId=887, CanIfRxPduHrhIdRef=CanIf_HwRxHandle_CanNodeNum_03_Rx_27, CanIfRxPduRef=CanPdu_CanIf2PduR_CanNodeNum_03_Rx_27
        CanIf_CanPdu_CanNodeNum_03_Rx_28: CanIfRxPduReadData=0, CanIfRxPduCanIdType=STANDARD_CAN, CanIfRxPduCanId=888, CanIfRxPduHrhIdRef=CanIf_HwRxHandle_CanNodeNum_03_Rx_28, CanIfRxPduRef=CanPdu_CanIf2PduR_CanNodeNum_03_Rx_28
        CanIf_CanPdu_CanNodeNum_03_Rx_29: CanIfRxPduReadData=0, CanIfRxPduCanIdType=STANDARD_CAN, CanIfRxPduCanId=889, CanIfRxPduHrhIdRef=CanIf_HwRxHandle_CanNodeNum_03_Rx_29, CanIfRxPduRef=CanPdu_CanIf2PduR_CanNodeNum_03_Rx_29
        CanIf_CanPdu_CanNodeNum_03_Rx_30: CanIfRxPduReadData=0, CanIfRxPduCanIdType=STANDARD_CAN, CanIfRxPduCanId=896, CanIfRxPduHrhIdRef=CanIf_HwRxHandle_CanNodeNum_03_Rx_30, CanIfRxPduRef=CanPdu_CanIf2PduR_CanNodeNum_03_Rx_30
        CanIf_CanPdu_CanNodeNum_03_Rx_31: CanIfRxPduReadData=0, CanIfRxPduCanIdType=STANDARD_CAN, CanIfRxPduCanId=897, CanIfRxPduHrhIdRef=CanIf_HwRxHandle_CanNodeNum_03_Rx_31, CanIfRxPduRef=CanPdu_CanIf2PduR_CanNodeNum_03_Rx_31
        CanIf_CanPdu_CanNodeNum_03_Rx_32: CanIfRxPduReadData=0, CanIfRxPduCanIdType=STANDARD_CAN, CanIfRxPduCanId=898, CanIfRxPduHrhIdRef=CanIf_HwRxHandle_CanNodeNum_03_Rx_32, CanIfRxPduRef=CanPdu_CanIf2PduR_CanNodeNum_03_Rx_32
        CanIf_CanPdu_CanNodeNum_03_Rx_33: CanIfRxPduReadData=0, CanIfRxPduCanIdType=STANDARD_CAN, CanIfRxPduCanId=899, CanIfRxPduHrhIdRef=CanIf_HwRxHandle_CanNodeNum_03_Rx_33, CanIfRxPduRef=CanPdu_CanIf2PduR_CanNodeNum_03_Rx_33
        CanIf_CanPdu_CanNodeNum_03_Rx_34: CanIfRxPduReadData=0, CanIfRxPduCanIdType=STANDARD_CAN, CanIfRxPduCanId=900, CanIfRxPduHrhIdRef=CanIf_HwRxHandle_CanNodeNum_03_Rx_34, CanIfRxPduRef=CanPdu_CanIf2PduR_CanNodeNum_03_Rx_34
        CanIf_CanPdu_CanNodeNum_03_Rx_35: CanIfRxPduReadData=0, CanIfRxPduCanIdType=STANDARD_CAN, CanIfRxPduCanId=901, CanIfRxPduHrhIdRef=CanIf_HwRxHandle_CanNodeNum_03_Rx_35, CanIfRxPduRef=CanPdu_CanIf2PduR_CanNodeNum_03_Rx_35
        CanIf_CanPdu_CanNodeNum_03_Rx_36: CanIfRxPduReadData=0, CanIfRxPduCanIdType=STANDARD_CAN, CanIfRxPduCanId=902, CanIfRxPduHrhIdRef=CanIf_HwRxHandle_CanNodeNum_03_Rx_36, CanIfRxPduRef=CanPdu_CanIf2PduR_CanNodeNum_03_Rx_36
        CanIf_CanPdu_CanNodeNum_03_Rx_37: CanIfRxPduReadData=0, CanIfRxPduCanIdType=STANDARD_CAN, CanIfRxPduCanId=903, CanIfRxPduHrhIdRef=CanIf_HwRxHandle_CanNodeNum_03_Rx_37, CanIfRxPduRef=CanPdu_CanIf2PduR_CanNodeNum_03_Rx_37
        CanIf_CanPdu_CanNodeNum_03_Rx_38: CanIfRxPduReadData=0, CanIfRxPduCanIdType=STANDARD_CAN, CanIfRxPduCanId=904, CanIfRxPduHrhIdRef=CanIf_HwRxHandle_CanNodeNum_03_Rx_38, CanIfRxPduRef=CanPdu_CanIf2PduR_CanNodeNum_03_Rx_38
        CanIf_CanPdu_CanNodeNum_03_Rx_39: CanIfRxPduReadData=0, CanIfRxPduCanIdType=STANDARD_CAN, CanIfRxPduCanId=905, CanIfRxPduHrhIdRef=CanIf_HwRxHandle_CanNodeNum_03_Rx_39, CanIfRxPduRef=CanPdu_CanIf2PduR_CanNodeNum_03_Rx_39
        CanIf_CanPdu_CanNodeNum_03_Rx_40: CanIfRxPduReadData=0, CanIfRxPduCanIdType=STANDARD_CAN, CanIfRxPduCanId=912, CanIfRxPduHrhIdRef=CanIf_HwRxHandle_CanNodeNum_03_Rx_40, CanIfRxPduRef=CanPdu_CanIf2PduR_CanNodeNum_03_Rx_40
    CanIfPublicCfg:
      CanIfPublicWakeupCheckValidSupport = false
      CanIfPublicDevErrorDetect = true
      CanIfPublicErrorPassiveSupport = false
      CanIfPublicBusoffRecoveryfromRxIndication = false
      CanIfPublicTxBuffering = true
      CanIfPublicReadTxPduNotifyStatusApi = true
      CanIfPublicVersionInfoApi = false
      CanIfPublicCanIfLiteConfiguration = false
      CanIfPublicTxConfirmPollingSupport = false
      CanIfTxOfflineActiveSupport = false
      CanIfPublicCancelTransmitSupport = false
      CanIfPublicReadRxPduNotifyStatusApi = true
      CanIfWakeupSupport = false
      CanIfTriggerTransmitSupport = false
      CanIfPublicSetDynamicTxIdApi = true
      CanIfPublicMultipleDrvSupport = false
      CanIfPublicPnSupport = false
      CanIfPublicReadRxPduDataApi = false
      CanIfPublicUserTpTxInOfflineMode = false
      CanIfPublicCddHeaderFile = CanIf_Cdd
      CanIfRbCalibrationSupport: CanIfRbCalibration=false
    CanIfPrivateCfg: CanIfPrivateDlcCheck=false
