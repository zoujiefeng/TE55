ASAP2_VERSION 1 3
/begin PROJECT D_TC387_PLATFORM_0_0 "D_TC387_PLATFORM_0_0"
/begin HEADER "" VERSION "5210.00" PROJECT_NO D0 /end HEADER
/begin MODULE D_TC387_PLATFORM_0_0 "Invt"
/begin MOD_COMMON "" DEPOSIT ABSOLUTE ALIGNMENT_BYTE 1 ALIGNMENT_WORD 2 ALIGNMENT_LONG 4 ALIGNMENT_FLOAT32_IEEE 4 ALIGNMENT_FLOAT64_IEEE 8 BYTE_ORDER MSB_LAST /end MOD_COMMON
/begin RECORD_LAYOUT DATA_RECORD_UBYTE FNC_VALUES 1 UBYTE ROW_DIR DIRECT /end RECORD_LAYOUT
/begin RECORD_LAYOUT DATA_RECORD_UWORD FNC_VALUES 1 UWORD ROW_DIR DIRECT /end RECORD_LAYOUT
/begin RECORD_LAYOUT DATA_RECORD_SWORD FNC_VALUES 1 SWORD ROW_DIR DIRECT /end RECORD_LAYOUT
/begin RECORD_LAYOUT DATA_RECORD_ULONG FNC_VALUES 1 ULONG ROW_DIR DIRECT /end RECORD_LAYOUT
/begin RECORD_LAYOUT DATA_RECORD_SLONG FNC_VALUES 1 SLONG ROW_DIR DIRECT /end RECORD_LAYOUT
/begin RECORD_LAYOUT DATA_RECORD_FLOAT32_IEEE FNC_VALUES 1 FLOAT32_IEEE ROW_DIR DIRECT /end RECORD_LAYOUT
/begin RECORD_LAYOUT AXIS_PTS_X_UBYTE_VEMS AXIS_PTS_X 1 UBYTE INDEX_INCR DIRECT /end RECORD_LAYOUT
/begin CHARACTERISTIC BSW_ku16CCPReinitTriggerC "Spare" VALUE 0x0000 DATA_RECORD_UWORD 2621.4 F_0v04_p1_8 1 2622.4 /end CHARACTERISTIC
/begin CHARACTERISTIC CLPCke_b_CAPM_CommandDBC_Enable "..." VALUE 0x0000 DATA_RECORD_UBYTE 1 Bool_ON_OFF 0 1 BIT_MASK 0x01 /end CHARACTERISTIC
/begin CHARACTERISTIC FDMAie_b_ForceEngineStop_ob "..." VALUE 0x0000 DATA_RECORD_UBYTE 1 Bool_ON_OFF 0 1 BIT_MASK 0x01 /end CHARACTERISTIC
/begin CHARACTERISTIC FDMAie_b_ForceEngineStop_ov "..." VALUE 0x0000 DATA_RECORD_UBYTE 1 Bool_ON_OFF 0 1 BIT_MASK 0x01 /end CHARACTERISTIC
/begin CHARACTERISTIC FDMAie_b_ForceNeutralGear_ob "..." VALUE 0x0000 DATA_RECORD_UBYTE 1 Bool_ON_OFF 0 1 BIT_MASK 0x01 /end CHARACTERISTIC
/begin CHARACTERISTIC FDMAie_b_ForceNeutralGear_ov "..." VALUE 0x0000 DATA_RECORD_UBYTE 1 Bool_ON_OFF 0 1 BIT_MASK 0x01 /end CHARACTERISTIC
/begin CHARACTERISTIC GMAIN_CCPbBenchTestOnC "Tx MSG activation" VALUE 0x0000 DATA_RECORD_UBYTE 1 Bool_ON_OFF 0 1 BIT_MASK 0x01 /end CHARACTERISTIC
/begin CHARACTERISTIC GMAIN_HARDBenchOnC "HARD activation" VALUE 0x0000 DATA_RECORD_UBYTE 1 Bool_ON_OFF 0 1 BIT_MASK 0x01 /end CHARACTERISTIC
/begin CHARACTERISTIC GMAIN_MSGRxBenchOnC "Rx MSG activation" VALUE 0x0000 DATA_RECORD_UBYTE 1 Bool_ON_OFF 0 1 BIT_MASK 0x01 /end CHARACTERISTIC
/begin CHARACTERISTIC GMAIN_MSGTxBenchOnC "Tx MSG activation" VALUE 0x0000 DATA_RECORD_UBYTE 1 Bool_ON_OFF 0 1 BIT_MASK 0x01 /end CHARACTERISTIC
/begin CHARACTERISTIC GMAIN_MSGbBenchTestOnC "Tx MSG activation" VALUE 0x0000 DATA_RECORD_UBYTE 1 Bool_ON_OFF 0 1 BIT_MASK 0x01 /end CHARACTERISTIC
/begin CHARACTERISTIC GMAIN_MSGbDbgFrameOnC "Tx MSG activation" VALUE 0x0000 DATA_RECORD_UBYTE 1 Bool_ON_OFF 0 1 BIT_MASK 0x01 /end CHARACTERISTIC
/begin CHARACTERISTIC GMAIN_MSGu8PwModFiltCntC "Spare" VALUE 0x0000 DATA_RECORD_UBYTE 255 I_1 0 255 /end CHARACTERISTIC
/begin CHARACTERISTIC GMAIN_TCUbHilTestOnC "Tx MSG activation" VALUE 0x0000 DATA_RECORD_UBYTE 1 Bool_ON_OFF 0 1 BIT_MASK 0x01 /end CHARACTERISTIC
/begin CHARACTERISTIC GMAIN_TCUs16GcuMotTorqC "Spare" VALUE 0x0000 DATA_RECORD_SWORD 65535 I_1 -32768 32767 /end CHARACTERISTIC
/begin CHARACTERISTIC GMAIN_TCUs16McuMotTorqC "Spare" VALUE 0x0000 DATA_RECORD_SWORD 65535 I_1 -32768 32767 /end CHARACTERISTIC
/begin CHARACTERISTIC GMAIN_TCUu16OilPresVoltC "Spare" VALUE 0x0000 DATA_RECORD_UWORD 65.535 F_0v001_p0_42 0 65.535 /end CHARACTERISTIC
/begin CHARACTERISTIC GMAIN_TCUu16OilTempC "Spare" VALUE 0x0000 DATA_RECORD_UWORD 65.535 F_0v001_p0_42 0 65.535 /end CHARACTERISTIC
/begin CHARACTERISTIC GMAIN_TCUu32GcuMotSpeedC "Spare" VALUE 0x0000 DATA_RECORD_ULONG 4294967295 F_1_m20000_35 -20000 4294947295 /end CHARACTERISTIC
/begin CHARACTERISTIC GMAIN_TCUu32McuMotSpeedC "Spare" VALUE 0x0000 DATA_RECORD_ULONG 4294967295 F_1_m20000_35 -20000 4294947295 /end CHARACTERISTIC
/begin CHARACTERISTIC GMAIN_TCUu8GcuTempC "Spare" VALUE 0x0000 DATA_RECORD_UBYTE 255 F_1_m40_29 -40 215 /end CHARACTERISTIC
/begin CHARACTERISTIC GMAIN_TCUu8McuTempC "Spare" VALUE 0x0000 DATA_RECORD_UBYTE 255 F_1_m40_29 -40 215 /end CHARACTERISTIC
/begin CHARACTERISTIC GMAIN_TSTBenchOnC "TST activation" VALUE 0x0000 DATA_RECORD_UBYTE 1 Bool_ON_OFF 0 1 BIT_MASK 0x01 /end CHARACTERISTIC
/begin CHARACTERISTIC GMAIN_VSIBenchOnWriteDataC "Bench VSI write datas" VALUE 0x0000 DATA_RECORD_UBYTE 1 Bool_ON_OFF 0 1 BIT_MASK 0x01 /end CHARACTERISTIC
/begin CHARACTERISTIC GMAIN_VSIBenchOnWriteEmergSwC "Bench VSI write EmergencySW" VALUE 0x0000 DATA_RECORD_UBYTE 1 Bool_ON_OFF 0 1 BIT_MASK 0x01 /end CHARACTERISTIC
/begin CHARACTERISTIC GMAIN_bBldcBenchOnC "..." VALUE 0x0000 DATA_RECORD_UBYTE 1 Bool_ON_OFF 0 1 BIT_MASK 0x01 /end CHARACTERISTIC
/begin CHARACTERISTIC GMAIN_bMSGRxToutBenchOnC "COM MSG Rx activation" VALUE 0x0000 DATA_RECORD_UBYTE 1 Bool_ON_OFF 0 1 BIT_MASK 0x01 /end CHARACTERISTIC
/begin CHARACTERISTIC GMAIN_bTcuStuckFlagTestOnC "..." VALUE 0x0000 DATA_RECORD_UBYTE 1 Bool_ON_OFF 0 1 BIT_MASK 0x01 /end CHARACTERISTIC
/begin CHARACTERISTIC GMAIN_f32AccPosClrSSTimC "Spare" VALUE 0x0000 DATA_RECORD_FLOAT32_IEEE 3.402823466E+038 F_1_p0_40 -3.402823466E+038 3.402823466E+038 /end CHARACTERISTIC
/begin CHARACTERISTIC GMAIN_f32AntiSlopExitSpdC "Spare" VALUE 0x0000 DATA_RECORD_FLOAT32_IEEE 3.402823466E+038 F_1_p0_44 -3.402823466E+038 3.402823466E+038 /end CHARACTERISTIC
/begin CHARACTERISTIC GMAIN_f32AntiSsGapDrtGainC "Spare" VALUE 0x0000 DATA_RECORD_FLOAT32_IEEE 3.402823466E+038 F_1_p0_4 -3.402823466E+038 3.402823466E+038 /end CHARACTERISTIC
/begin CHARACTERISTIC GMAIN_f32AntiSsValidTrqC "Spare" VALUE 0x0000 DATA_RECORD_FLOAT32_IEEE 3.402823466E+038 F_1_p0_39 -3.402823466E+038 3.402823466E+038 /end CHARACTERISTIC
/begin CHARACTERISTIC GMAIN_f32BldcDebugDutyC "Spare" VALUE 0x0000 DATA_RECORD_FLOAT32_IEEE 3.402823466E+038 F_1_p0_39 -3.402823466E+038 3.402823466E+038 /end CHARACTERISTIC
/begin CHARACTERISTIC GMAIN_f32BldcStuckDutyC "Spare" VALUE 0x0000 DATA_RECORD_FLOAT32_IEEE 3.402823466E+038 F_1_p0_4 -3.402823466E+038 3.402823466E+038 /end CHARACTERISTIC
/begin CHARACTERISTIC GMAIN_f32BrakDeratGainC "Spare" VALUE 0x0000 DATA_RECORD_FLOAT32_IEEE 3.402823466E+038 F_1_p0_4 -3.402823466E+038 3.402823466E+038 /end CHARACTERISTIC
/begin CHARACTERISTIC GMAIN_f32BrakPedPosHighC "Spare" VALUE 0x0000 DATA_RECORD_FLOAT32_IEEE 3.402823466E+038 F_1_p0_40 -3.402823466E+038 3.402823466E+038 /end CHARACTERISTIC
/begin CHARACTERISTIC GMAIN_f32BrakPedalPosLowC "Spare" VALUE 0x0000 DATA_RECORD_FLOAT32_IEEE 3.402823466E+038 F_1_p0_40 -3.402823466E+038 3.402823466E+038 /end CHARACTERISTIC
/begin CHARACTERISTIC GMAIN_f32OcAutophsGainC "Spare" VALUE 0x0000 DATA_RECORD_FLOAT32_IEEE 3.402823466E+038 F_1_p0_4 -3.402823466E+038 3.402823466E+038 /end CHARACTERISTIC
/begin CHARACTERISTIC GMAIN_f32OcAutophsOffstC "Spare" VALUE 0x0000 DATA_RECORD_FLOAT32_IEEE 3.402823466E+038 F_1_p0_4 -3.402823466E+038 3.402823466E+038 /end CHARACTERISTIC
/begin CHARACTERISTIC GMAIN_f32PowerdownVoltC "Spare" VALUE 0x0000 DATA_RECORD_FLOAT32_IEEE 3.402823466E+038 F_1_p0_4 -3.402823466E+038 3.402823466E+038 /end CHARACTERISTIC
/begin CHARACTERISTIC GMAIN_f32PwmFreqHighThrdC "Spare" VALUE 0x0000 DATA_RECORD_FLOAT32_IEEE 3.402823466E+038 F_1_p0_48 -3.402823466E+038 3.402823466E+038 /end CHARACTERISTIC
/begin CHARACTERISTIC GMAIN_f32PwmMaxDutyPhysC "Spare" VALUE 0x0000 DATA_RECORD_FLOAT32_IEEE 3.402823466E+038 F_1_p0_4 -3.402823466E+038 3.402823466E+038 /end CHARACTERISTIC
/begin CHARACTERISTIC GMAIN_f32PwmMinDutyPhysC "Spare" VALUE 0x0000 DATA_RECORD_FLOAT32_IEEE 3.402823466E+038 F_1_p0_4 -3.402823466E+038 3.402823466E+038 /end CHARACTERISTIC
/begin CHARACTERISTIC GMAIN_f32PwmRatioReduceC "Spare" VALUE 0x0000 DATA_RECORD_FLOAT32_IEEE 3.402823466E+038 F_1_p0_48 -3.402823466E+038 3.402823466E+038 /end CHARACTERISTIC
/begin CHARACTERISTIC GMAIN_f32RandomFrecMecaSpdMaxC "Spare" VALUE 0x0000 DATA_RECORD_FLOAT32_IEEE 3.402823466E+038 F_1_p0_44 -3.402823466E+038 3.402823466E+038 /end CHARACTERISTIC
/begin CHARACTERISTIC GMAIN_f32RandomFrecMecaSpdMinC "Spare" VALUE 0x0000 DATA_RECORD_FLOAT32_IEEE 3.402823466E+038 F_1_p0_44 -3.402823466E+038 3.402823466E+038 /end CHARACTERISTIC
/begin CHARACTERISTIC GMAIN_f32SlopOrRoadSpdDiffC "Spare" VALUE 0x0000 DATA_RECORD_FLOAT32_IEEE 3.402823466E+038 F_1_p0_44 -3.402823466E+038 3.402823466E+038 /end CHARACTERISTIC
/begin CHARACTERISTIC GMAIN_f32UvwOvCurrThdC "Spare" VALUE 0x0000 DATA_RECORD_FLOAT32_IEEE 3.402823466E+038 F_1_p0_48 -3.402823466E+038 3.402823466E+038 /end CHARACTERISTIC
/begin CHARACTERISTIC GMAIN_f32VsiPwmPeriodC "Spare" VALUE 0x0000 DATA_RECORD_FLOAT32_IEEE 3.402823466E+038 F_1000000_p0_49 -3.402823466E+038 3.402823466E+038 /end CHARACTERISTIC
/begin CHARACTERISTIC GMAIN_ku16PwmPerdInitValC "GMAIN_ku16PwmPerdInitValC" VALUE 0x0000 DATA_RECORD_UWORD 65535 I_1 0 65535 /end CHARACTERISTIC
/begin CHARACTERISTIC GMAIN_ku16SpdReadyEstConfirmC "Spare" VALUE 0x0000 DATA_RECORD_UWORD 65535 F_1_p0_4 0 65535 /end CHARACTERISTIC
/begin CHARACTERISTIC GMAIN_s32CurHardDelayC "Spare" VALUE 0x0000 DATA_RECORD_SLONG 4294967295 F_1_p0_4 -2147483648 2147483647 /end CHARACTERISTIC
/begin CHARACTERISTIC GMAIN_s32ResHardDelayC "Spare" VALUE 0x0000 DATA_RECORD_SLONG 4294967295 F_1_p0_4 -2147483648 2147483647 /end CHARACTERISTIC
/begin CHARACTERISTIC GMAIN_s32SampleDelayC "Spare" VALUE 0x0000 DATA_RECORD_SLONG 4294967295 F_1_p0_4 -2147483648 2147483647 /end CHARACTERISTIC
/begin CHARACTERISTIC GMAIN_u16AntiSsChkTimC "Spare" VALUE 0x0000 DATA_RECORD_UWORD 65535 F_1_p0_4 0 65535 /end CHARACTERISTIC
/begin CHARACTERISTIC GMAIN_u16AntiSsEnaBrakTimC "Spare" VALUE 0x0000 DATA_RECORD_UWORD 65535 F_1_p0_51 0 65535 /end CHARACTERISTIC
/begin CHARACTERISTIC GMAIN_u16AntiSsGapTimC "Spare" VALUE 0x0000 DATA_RECORD_UWORD 65535 F_1_p0_51 0 65535 /end CHARACTERISTIC
/begin CHARACTERISTIC GMAIN_u16BrakRelsDelayC "Spare" VALUE 0x0000 DATA_RECORD_UWORD 65535 F_1_p0_51 0 65535 /end CHARACTERISTIC
/begin CHARACTERISTIC GMAIN_u16DetectSpdTestC "Spare" VALUE 0x0000 DATA_RECORD_UWORD 65535 F_1_p0_44 0 65535 /end CHARACTERISTIC
/begin CHARACTERISTIC GMAIN_u16FpgaFltClrTimoutC "Spare" VALUE 0x0000 DATA_RECORD_UWORD 65535 F_1_p0_4 0 65535 /end CHARACTERISTIC
/begin CHARACTERISTIC GMAIN_u16IdqDeltaCntMaxC "Spare" VALUE 0x0000 DATA_RECORD_UWORD 65535 F_1_p0_4 0 65535 /end CHARACTERISTIC
/begin CHARACTERISTIC GMAIN_u16OverBhvThdC "Spare" VALUE 0x0000 DATA_RECORD_UWORD 65535 F_1_p0_48 0 65535 /end CHARACTERISTIC
/begin CHARACTERISTIC GMAIN_u16PwmRatioPerd0C "Spare" VALUE 0x0000 DATA_RECORD_UWORD 2621.4 F_0v04_p1_52 1 2622.4 /end CHARACTERISTIC
/begin CHARACTERISTIC GMAIN_u16PwmRatioPerd1C "Spare" VALUE 0x0000 DATA_RECORD_UWORD 2621.4 F_0v04_p1_52 1 2622.4 /end CHARACTERISTIC
/begin CHARACTERISTIC GMAIN_u16PwmRatioPerd2C "Spare" VALUE 0x0000 DATA_RECORD_UWORD 2621.4 F_0v04_p1_52 1 2622.4 /end CHARACTERISTIC
/begin CHARACTERISTIC GMAIN_u16PwmRatioPerd3C "Spare" VALUE 0x0000 DATA_RECORD_UWORD 2621.4 F_0v04_p1_52 1 2622.4 /end CHARACTERISTIC
/begin CHARACTERISTIC GMAIN_u16RandomFrecMaxC "Spare" VALUE 0x0000 DATA_RECORD_UWORD 65535 F_1_p0_51 0 65535 /end CHARACTERISTIC
/begin CHARACTERISTIC GMAIN_u16SlopSlideTim1C "Spare" VALUE 0x0000 DATA_RECORD_UWORD 65535 F_1_p0_51 0 65535 /end CHARACTERISTIC
/begin CHARACTERISTIC GMAIN_u16SlopSlideTim2C "Spare" VALUE 0x0000 DATA_RECORD_UWORD 65535 F_1_p0_51 0 65535 /end CHARACTERISTIC
/begin CHARACTERISTIC GMAIN_u16SlopSlideTimoutC "Spare" VALUE 0x0000 DATA_RECORD_UWORD 65535 F_1_p0_51 0 65535 /end CHARACTERISTIC
/begin CHARACTERISTIC GMAIN_u16SlopSpdConfirmC "Spare" VALUE 0x0000 DATA_RECORD_UWORD 65535 F_1_p0_4 0 65535 /end CHARACTERISTIC
/begin CHARACTERISTIC GMAIN_u16StuckRecoverTimeStepC "Spare" VALUE 0x0000 DATA_RECORD_UWORD 65535 F_1_p0_51 0 65535 /end CHARACTERISTIC
/begin CHARACTERISTIC GMAIN_u16StuckSpdThresholdC "Spare" VALUE 0x0000 DATA_RECORD_UWORD 65535 F_1_p0_44 0 65535 /end CHARACTERISTIC
/begin CHARACTERISTIC GMAIN_u16StuckTimeThresholdC "Spare" VALUE 0x0000 DATA_RECORD_UWORD 65535 F_1_p0_51 0 65535 /end CHARACTERISTIC
/begin CHARACTERISTIC GMAIN_u32VSICntCkreqESMStartedC "GMAIN_u32VSICntCkreqESMStartedC" VALUE 0x0000 DATA_RECORD_ULONG 4294967295 I_1 0 4294967295 /end CHARACTERISTIC
/begin CHARACTERISTIC GMAIN_u32VSICntCkreqVSIStartedC "GMAIN_u32VSICntCkreqVSIStartedC" VALUE 0x0000 DATA_RECORD_ULONG 4294967295 I_1 0 4294967295 /end CHARACTERISTIC
/begin CHARACTERISTIC GMosSWOverCurrentTestOnC "..." VALUE 0x0000 DATA_RECORD_UBYTE 1 Bool_ON_OFF 0 1 BIT_MASK 0x01 /end CHARACTERISTIC
/begin CHARACTERISTIC GRTE_bCCPDrvOverCurrentTestOnC "..." VALUE 0x0000 DATA_RECORD_UBYTE 1 Bool_ON_OFF 0 1 BIT_MASK 0x01 /end CHARACTERISTIC
/begin CHARACTERISTIC GRTE_bCCPDrvOverTempTestOnC "..." VALUE 0x0000 DATA_RECORD_UBYTE 1 Bool_ON_OFF 0 1 BIT_MASK 0x01 /end CHARACTERISTIC
/begin CHARACTERISTIC GRTE_bCCPDrvOverVoltageTestOnC "..." VALUE 0x0000 DATA_RECORD_UBYTE 1 Bool_ON_OFF 0 1 BIT_MASK 0x01 /end CHARACTERISTIC
/begin CHARACTERISTIC GRTE_bCCPDrvUnderVoltageTestOnC "..." VALUE 0x0000 DATA_RECORD_UBYTE 1 Bool_ON_OFF 0 1 BIT_MASK 0x01 /end CHARACTERISTIC
/begin CHARACTERISTIC GRTE_bCCPHALOrderInvalidTestOnC "..." VALUE 0x0000 DATA_RECORD_UBYTE 1 Bool_ON_OFF 0 1 BIT_MASK 0x01 /end CHARACTERISTIC
/begin CHARACTERISTIC GRTE_bCCPHALOverVoltTestOnC "..." VALUE 0x0000 DATA_RECORD_UBYTE 1 Bool_ON_OFF 0 1 BIT_MASK 0x01 /end CHARACTERISTIC
/begin CHARACTERISTIC GRTE_bCCPHALUndefinedTestOnC "..." VALUE 0x0000 DATA_RECORD_UBYTE 1 Bool_ON_OFF 0 1 BIT_MASK 0x01 /end CHARACTERISTIC
/begin CHARACTERISTIC GRTE_bCCPHALUnderVoltTestOnC "..." VALUE 0x0000 DATA_RECORD_UBYTE 1 Bool_ON_OFF 0 1 BIT_MASK 0x01 /end CHARACTERISTIC
/begin CHARACTERISTIC GRTE_bCCPPhasePerfTestOnC "..." VALUE 0x0000 DATA_RECORD_UBYTE 1 Bool_ON_OFF 0 1 BIT_MASK 0x01 /end CHARACTERISTIC
/begin CHARACTERISTIC GRTE_bCCPPhaseShortHighTestOnC "..." VALUE 0x0000 DATA_RECORD_UBYTE 1 Bool_ON_OFF 0 1 BIT_MASK 0x01 /end CHARACTERISTIC
/begin CHARACTERISTIC GRTE_bCCPPhaseShortLowTestOnC "..." VALUE 0x0000 DATA_RECORD_UBYTE 1 Bool_ON_OFF 0 1 BIT_MASK 0x01 /end CHARACTERISTIC
/begin CHARACTERISTIC GRTE_bCCPSwOverCurrentTestOnC "..." VALUE 0x0000 DATA_RECORD_UBYTE 1 Bool_ON_OFF 0 1 BIT_MASK 0x01 /end CHARACTERISTIC
/begin CHARACTERISTIC GRTE_bCCPbTcuStuckFlagTestOnC "..." VALUE 0x0000 DATA_RECORD_UBYTE 1 Bool_ON_OFF 0 1 BIT_MASK 0x01 /end CHARACTERISTIC
/begin CHARACTERISTIC MAIN_CCPbBenchTestOnC "Tx MSG activation" VALUE 0x0000 DATA_RECORD_UBYTE 1 Bool_ON_OFF 0 1 BIT_MASK 0x01 /end CHARACTERISTIC
/begin CHARACTERISTIC MAIN_HARDBenchOnC "HARD activation" VALUE 0x0000 DATA_RECORD_UBYTE 1 Bool_ON_OFF 0 1 BIT_MASK 0x01 /end CHARACTERISTIC
/begin CHARACTERISTIC MAIN_MSGRxBenchOnC "Rx MSG activation" VALUE 0x0000 DATA_RECORD_UBYTE 1 Bool_ON_OFF 0 1 BIT_MASK 0x01 /end CHARACTERISTIC
/begin CHARACTERISTIC MAIN_MSGTxBenchOnC "Tx MSG activation" VALUE 0x0000 DATA_RECORD_UBYTE 1 Bool_ON_OFF 0 1 BIT_MASK 0x01 /end CHARACTERISTIC
/begin CHARACTERISTIC MAIN_MSGbBenchTestOnC "Tx MSG activation" VALUE 0x0000 DATA_RECORD_UBYTE 1 Bool_ON_OFF 0 1 BIT_MASK 0x01 /end CHARACTERISTIC
/begin CHARACTERISTIC MAIN_MSGbDbgFrameOnC "Tx MSG activation" VALUE 0x0000 DATA_RECORD_UBYTE 1 Bool_ON_OFF 0 1 BIT_MASK 0x01 /end CHARACTERISTIC
/begin CHARACTERISTIC MAIN_MSGu8PwModFiltCntC "Spare" VALUE 0x0000 DATA_RECORD_UBYTE 255 I_1 0 255 /end CHARACTERISTIC
/begin CHARACTERISTIC MAIN_SampleSequenceEnC "Tx MSG activation" VALUE 0x0000 DATA_RECORD_UBYTE 1 Bool_ON_OFF 0 1 BIT_MASK 0x01 /end CHARACTERISTIC
/begin CHARACTERISTIC MAIN_TCUbHilTestOnC "Tx MSG activation" VALUE 0x0000 DATA_RECORD_UBYTE 1 Bool_ON_OFF 0 1 BIT_MASK 0x01 /end CHARACTERISTIC
/begin CHARACTERISTIC MAIN_TCUs16GcuMotTorqC "Spare" VALUE 0x0000 DATA_RECORD_SWORD 65535 I_1 -32768 32767 /end CHARACTERISTIC
/begin CHARACTERISTIC MAIN_TCUs16McuMotTorqC "Spare" VALUE 0x0000 DATA_RECORD_SWORD 65535 I_1 -32768 32767 /end CHARACTERISTIC
/begin CHARACTERISTIC MAIN_TCUu16OilPresVoltC "Spare" VALUE 0x0000 DATA_RECORD_UWORD 65.535 F_0v001_p0_42 0 65.535 /end CHARACTERISTIC
/begin CHARACTERISTIC MAIN_TCUu16OilTempC "Spare" VALUE 0x0000 DATA_RECORD_UWORD 65.535 F_0v001_p0_42 0 65.535 /end CHARACTERISTIC
/begin CHARACTERISTIC MAIN_TCUu32GcuMotSpeedC "Spare" VALUE 0x0000 DATA_RECORD_ULONG 4294967295 F_1_m20000_35 -20000 4294947295 /end CHARACTERISTIC
/begin CHARACTERISTIC MAIN_TCUu32McuMotSpeedC "Spare" VALUE 0x0000 DATA_RECORD_ULONG 4294967295 F_1_m20000_35 -20000 4294947295 /end CHARACTERISTIC
/begin CHARACTERISTIC MAIN_TCUu8GcuTempC "Spare" VALUE 0x0000 DATA_RECORD_UBYTE 255 F_1_m40_29 -40 215 /end CHARACTERISTIC
/begin CHARACTERISTIC MAIN_TCUu8McuTempC "Spare" VALUE 0x0000 DATA_RECORD_UBYTE 255 F_1_m40_29 -40 215 /end CHARACTERISTIC
/begin CHARACTERISTIC MAIN_TSTBenchOnC "TST activation" VALUE 0x0000 DATA_RECORD_UBYTE 1 Bool_ON_OFF 0 1 BIT_MASK 0x01 /end CHARACTERISTIC
/begin CHARACTERISTIC MAIN_VSIBenchOnWriteDataC "Bench VSI write datas" VALUE 0x0000 DATA_RECORD_UBYTE 1 Bool_ON_OFF 0 1 BIT_MASK 0x01 /end CHARACTERISTIC
/begin CHARACTERISTIC MAIN_VSIBenchOnWriteEmergSwC "Bench VSI write EmergencySW" VALUE 0x0000 DATA_RECORD_UBYTE 1 Bool_ON_OFF 0 1 BIT_MASK 0x01 /end CHARACTERISTIC
/begin CHARACTERISTIC MAIN_bBldcBenchOnC "..." VALUE 0x0000 DATA_RECORD_UBYTE 1 Bool_ON_OFF 0 1 BIT_MASK 0x01 /end CHARACTERISTIC
/begin CHARACTERISTIC MAIN_bMSGRxToutBenchOnC "COM MSG Rx activation" VALUE 0x0000 DATA_RECORD_UBYTE 1 Bool_ON_OFF 0 1 BIT_MASK 0x01 /end CHARACTERISTIC
/begin CHARACTERISTIC MAIN_bTcuStuckFlagTestOnC "..." VALUE 0x0000 DATA_RECORD_UBYTE 1 Bool_ON_OFF 0 1 BIT_MASK 0x01 /end CHARACTERISTIC
/begin CHARACTERISTIC MAIN_f32AccPosClrSSTimC "Spare" VALUE 0x0000 DATA_RECORD_FLOAT32_IEEE 3.402823466E+038 F_1_p0_40 -3.402823466E+038 3.402823466E+038 /end CHARACTERISTIC
/begin CHARACTERISTIC MAIN_f32AntiSlopExitSpdC "Spare" VALUE 0x0000 DATA_RECORD_FLOAT32_IEEE 3.402823466E+038 F_1_p0_44 -3.402823466E+038 3.402823466E+038 /end CHARACTERISTIC
/begin CHARACTERISTIC MAIN_f32AntiSsGapDrtGainC "Spare" VALUE 0x0000 DATA_RECORD_FLOAT32_IEEE 3.402823466E+038 F_1_p0_4 -3.402823466E+038 3.402823466E+038 /end CHARACTERISTIC
/begin CHARACTERISTIC MAIN_f32AntiSsValidTrqC "Spare" VALUE 0x0000 DATA_RECORD_FLOAT32_IEEE 3.402823466E+038 F_1_p0_39 -3.402823466E+038 3.402823466E+038 /end CHARACTERISTIC
/begin CHARACTERISTIC MAIN_f32BldcDebugDutyC "Spare" VALUE 0x0000 DATA_RECORD_FLOAT32_IEEE 3.402823466E+038 F_1_p0_39 -3.402823466E+038 3.402823466E+038 /end CHARACTERISTIC
/begin CHARACTERISTIC MAIN_f32BldcStuckDutyC "Spare" VALUE 0x0000 DATA_RECORD_FLOAT32_IEEE 3.402823466E+038 F_1_p0_4 -3.402823466E+038 3.402823466E+038 /end CHARACTERISTIC
/begin CHARACTERISTIC MAIN_f32BrakDeratGainC "Spare" VALUE 0x0000 DATA_RECORD_FLOAT32_IEEE 3.402823466E+038 F_1_p0_4 -3.402823466E+038 3.402823466E+038 /end CHARACTERISTIC
/begin CHARACTERISTIC MAIN_f32BrakPedPosHighC "Spare" VALUE 0x0000 DATA_RECORD_FLOAT32_IEEE 3.402823466E+038 F_1_p0_40 -3.402823466E+038 3.402823466E+038 /end CHARACTERISTIC
/begin CHARACTERISTIC MAIN_f32BrakPedalPosLowC "Spare" VALUE 0x0000 DATA_RECORD_FLOAT32_IEEE 3.402823466E+038 F_1_p0_40 -3.402823466E+038 3.402823466E+038 /end CHARACTERISTIC
/begin CHARACTERISTIC MAIN_f32OcAutophsGainC "Spare" VALUE 0x0000 DATA_RECORD_FLOAT32_IEEE 3.402823466E+038 F_1_p0_4 -3.402823466E+038 3.402823466E+038 /end CHARACTERISTIC
/begin CHARACTERISTIC MAIN_f32OcAutophsOffstC "Spare" VALUE 0x0000 DATA_RECORD_FLOAT32_IEEE 3.402823466E+038 F_1_p0_4 -3.402823466E+038 3.402823466E+038 /end CHARACTERISTIC
/begin CHARACTERISTIC MAIN_f32PowerdownVoltC "Spare" VALUE 0x0000 DATA_RECORD_FLOAT32_IEEE 3.402823466E+038 F_1_p0_4 -3.402823466E+038 3.402823466E+038 /end CHARACTERISTIC
/begin CHARACTERISTIC MAIN_f32PwmFreqHighThrdC "Spare" VALUE 0x0000 DATA_RECORD_FLOAT32_IEEE 3.402823466E+038 F_1_p0_48 -3.402823466E+038 3.402823466E+038 /end CHARACTERISTIC
/begin CHARACTERISTIC MAIN_f32PwmMaxDutyPhysC "Spare" VALUE 0x0000 DATA_RECORD_FLOAT32_IEEE 3.402823466E+038 F_1_p0_4 -3.402823466E+038 3.402823466E+038 /end CHARACTERISTIC
/begin CHARACTERISTIC MAIN_f32PwmMinDutyPhysC "Spare" VALUE 0x0000 DATA_RECORD_FLOAT32_IEEE 3.402823466E+038 F_1_p0_4 -3.402823466E+038 3.402823466E+038 /end CHARACTERISTIC
/begin CHARACTERISTIC MAIN_f32PwmRatioReduceC "Spare" VALUE 0x0000 DATA_RECORD_FLOAT32_IEEE 3.402823466E+038 F_1_p0_48 -3.402823466E+038 3.402823466E+038 /end CHARACTERISTIC
/begin CHARACTERISTIC MAIN_f32RandomFrecMecaSpdMaxC "Spare" VALUE 0x0000 DATA_RECORD_FLOAT32_IEEE 3.402823466E+038 F_1_p0_44 -3.402823466E+038 3.402823466E+038 /end CHARACTERISTIC
/begin CHARACTERISTIC MAIN_f32RandomFrecMecaSpdMinC "Spare" VALUE 0x0000 DATA_RECORD_FLOAT32_IEEE 3.402823466E+038 F_1_p0_44 -3.402823466E+038 3.402823466E+038 /end CHARACTERISTIC
/begin CHARACTERISTIC MAIN_f32SlopOrRoadSpdDiffC "Spare" VALUE 0x0000 DATA_RECORD_FLOAT32_IEEE 3.402823466E+038 F_1_p0_44 -3.402823466E+038 3.402823466E+038 /end CHARACTERISTIC
/begin CHARACTERISTIC MAIN_f32UvwOvCurrThdC "Spare" VALUE 0x0000 DATA_RECORD_FLOAT32_IEEE 3.402823466E+038 F_1_p0_48 -3.402823466E+038 3.402823466E+038 /end CHARACTERISTIC
/begin CHARACTERISTIC MAIN_f32VsiPwmPeriodC "Spare" VALUE 0x0000 DATA_RECORD_FLOAT32_IEEE 3.402823466E+038 F_1000000_p0_49 -3.402823466E+038 3.402823466E+038 /end CHARACTERISTIC
/begin CHARACTERISTIC MAIN_ku16PwmPerdInitValC "MAIN_ku16PwmPerdInitValC" VALUE 0x0000 DATA_RECORD_UWORD 65535 I_1 0 65535 /end CHARACTERISTIC
/begin CHARACTERISTIC MAIN_ku16SpdReadyEstConfirmC "Spare" VALUE 0x0000 DATA_RECORD_UWORD 65535 F_1_p0_4 0 65535 /end CHARACTERISTIC
/begin CHARACTERISTIC MAIN_s32CurHardDelayC "Spare" VALUE 0x0000 DATA_RECORD_SLONG 4294967295 F_1_p0_4 -2147483648 2147483647 /end CHARACTERISTIC
/begin CHARACTERISTIC MAIN_s32ResHardDelayC "Spare" VALUE 0x0000 DATA_RECORD_SLONG 4294967295 F_1_p0_4 -2147483648 2147483647 /end CHARACTERISTIC
/begin CHARACTERISTIC MAIN_s32SampleDelayC "Spare" VALUE 0x0000 DATA_RECORD_SLONG 4294967295 F_1_p0_4 -2147483648 2147483647 /end CHARACTERISTIC
/begin CHARACTERISTIC MAIN_u16AntiSsChkTimC "Spare" VALUE 0x0000 DATA_RECORD_UWORD 65535 F_1_p0_4 0 65535 /end CHARACTERISTIC
/begin CHARACTERISTIC MAIN_u16AntiSsEnaBrakTimC "Spare" VALUE 0x0000 DATA_RECORD_UWORD 65535 F_1_p0_51 0 65535 /end CHARACTERISTIC
/begin CHARACTERISTIC MAIN_u16AntiSsGapTimC "Spare" VALUE 0x0000 DATA_RECORD_UWORD 65535 F_1_p0_51 0 65535 /end CHARACTERISTIC
/begin CHARACTERISTIC MAIN_u16BrakRelsDelayC "Spare" VALUE 0x0000 DATA_RECORD_UWORD 65535 F_1_p0_51 0 65535 /end CHARACTERISTIC
/begin CHARACTERISTIC MAIN_u16DetectSpdTestC "Spare" VALUE 0x0000 DATA_RECORD_UWORD 65535 F_1_p0_44 0 65535 /end CHARACTERISTIC
/begin CHARACTERISTIC MAIN_u16FpgaFltClrTimoutC "Spare" VALUE 0x0000 DATA_RECORD_UWORD 65535 F_1_p0_4 0 65535 /end CHARACTERISTIC
/begin CHARACTERISTIC MAIN_u16IdqDeltaCntMaxC "Spare" VALUE 0x0000 DATA_RECORD_UWORD 65535 F_1_p0_4 0 65535 /end CHARACTERISTIC
/begin CHARACTERISTIC MAIN_u16OverBhvThdC "Spare" VALUE 0x0000 DATA_RECORD_UWORD 65535 F_1_p0_48 0 65535 /end CHARACTERISTIC
/begin CHARACTERISTIC MAIN_u16PwmRatioPerd0C "Spare" VALUE 0x0000 DATA_RECORD_UWORD 2621.4 F_0v04_p1_52 1 2622.4 /end CHARACTERISTIC
/begin CHARACTERISTIC MAIN_u16PwmRatioPerd1C "Spare" VALUE 0x0000 DATA_RECORD_UWORD 2621.4 F_0v04_p1_52 1 2622.4 /end CHARACTERISTIC
/begin CHARACTERISTIC MAIN_u16PwmRatioPerd2C "Spare" VALUE 0x0000 DATA_RECORD_UWORD 2621.4 F_0v04_p1_52 1 2622.4 /end CHARACTERISTIC
/begin CHARACTERISTIC MAIN_u16PwmRatioPerd3C "Spare" VALUE 0x0000 DATA_RECORD_UWORD 2621.4 F_0v04_p1_52 1 2622.4 /end CHARACTERISTIC
/begin CHARACTERISTIC MAIN_u16RandomFrecMaxC "Spare" VALUE 0x0000 DATA_RECORD_UWORD 65535 F_1_p0_51 0 65535 /end CHARACTERISTIC
/begin CHARACTERISTIC MAIN_u16SlopSlideTim1C "Spare" VALUE 0x0000 DATA_RECORD_UWORD 65535 F_1_p0_51 0 65535 /end CHARACTERISTIC
/begin CHARACTERISTIC MAIN_u16SlopSlideTim2C "Spare" VALUE 0x0000 DATA_RECORD_UWORD 65535 F_1_p0_51 0 65535 /end CHARACTERISTIC
/begin CHARACTERISTIC MAIN_u16SlopSlideTimoutC "Spare" VALUE 0x0000 DATA_RECORD_UWORD 65535 F_1_p0_51 0 65535 /end CHARACTERISTIC
/begin CHARACTERISTIC MAIN_u16SlopSpdConfirmC "Spare" VALUE 0x0000 DATA_RECORD_UWORD 65535 F_1_p0_4 0 65535 /end CHARACTERISTIC
/begin CHARACTERISTIC MAIN_u16StuckRecoverTimeStepC "Spare" VALUE 0x0000 DATA_RECORD_UWORD 65535 F_1_p0_51 0 65535 /end CHARACTERISTIC
/begin CHARACTERISTIC MAIN_u16StuckSpdThresholdC "Spare" VALUE 0x0000 DATA_RECORD_UWORD 65535 F_1_p0_44 0 65535 /end CHARACTERISTIC
/begin CHARACTERISTIC MAIN_u16StuckTimeThresholdC "Spare" VALUE 0x0000 DATA_RECORD_UWORD 65535 F_1_p0_51 0 65535 /end CHARACTERISTIC
/begin CHARACTERISTIC MAIN_u32VSICntCkreqESMStartedC "MAIN_u32VSICntCkreqESMStartedC" VALUE 0x0000 DATA_RECORD_ULONG 4294967295 I_1 0 4294967295 /end CHARACTERISTIC
/begin CHARACTERISTIC MAIN_u32VSICntCkreqVSIStartedC "MAIN_u32VSICntCkreqVSIStartedC" VALUE 0x0000 DATA_RECORD_ULONG 4294967295 I_1 0 4294967295 /end CHARACTERISTIC
/begin CHARACTERISTIC MosSWOverCurrentTestOnC "..." VALUE 0x0000 DATA_RECORD_UBYTE 1 Bool_ON_OFF 0 1 BIT_MASK 0x01 /end CHARACTERISTIC
/begin CHARACTERISTIC RES_bGenerateSyncPosC "Enable generation of the SyncPos signal" VALUE 0x0000 DATA_RECORD_UBYTE 1 Bool_ON_OFF 0 1 BIT_MASK 0x01 /end CHARACTERISTIC
/begin CHARACTERISTIC RES_u16ExcitDelayC "Resolver excitation delay" VALUE 0x0000 DATA_RECORD_UWORD 6553.5 F_0v1_p0_70 0 6553.5 /end CHARACTERISTIC
/begin CHARACTERISTIC RES_u16SyncDelay2C "Delay time between the failing eadg of the CS to the generation of SyncPos signal" VALUE 0x0000 DATA_RECORD_UWORD 6553.5 F_0v1_p0_70 0 6553.5 /end CHARACTERISTIC
/begin CHARACTERISTIC RES_u16SyncDelayC "Delay time between the failing eadg of the CS to the generation of SyncPos signal" VALUE 0x0000 DATA_RECORD_UWORD 6553.5 F_0v1_p0_70 0 6553.5 /end CHARACTERISTIC
/begin CHARACTERISTIC RES_u16VSICkreqPeriodDefC "Resolver default value for VSI Ckreq period" VALUE 0x0000 DATA_RECORD_UWORD 6553.5 F_0v1_p0_70 0 6553.5 /end CHARACTERISTIC
/begin CHARACTERISTIC RES_u8ExcitDutyPercentC "Resolver excitation duty cycle value" VALUE 0x0000 DATA_RECORD_UBYTE 255 F_1_p0_40 0 255 /end CHARACTERISTIC
/begin CHARACTERISTIC RES_u8SyncDutyPercentC "Resolver excitation duty cycle value" VALUE 0x0000 DATA_RECORD_UBYTE 255 F_1_p0_40 0 255 /end CHARACTERISTIC
/begin CHARACTERISTIC RSTSRV_ku16ConsecutiveRstMaxNbC "RSTSRV_ku16ConsecutiveRstMaxNbC" VALUE 0x0000 DATA_RECORD_UWORD 65535 I_1 0 65535 /end CHARACTERISTIC
/begin CHARACTERISTIC RTE_bCCPDrvOverCurrentTestOnC "..." VALUE 0x0000 DATA_RECORD_UBYTE 1 Bool_ON_OFF 0 1 BIT_MASK 0x01 /end CHARACTERISTIC
/begin CHARACTERISTIC RTE_bCCPDrvOverTempTestOnC "..." VALUE 0x0000 DATA_RECORD_UBYTE 1 Bool_ON_OFF 0 1 BIT_MASK 0x01 /end CHARACTERISTIC
/begin CHARACTERISTIC RTE_bCCPDrvOverVoltageTestOnC "..." VALUE 0x0000 DATA_RECORD_UBYTE 1 Bool_ON_OFF 0 1 BIT_MASK 0x01 /end CHARACTERISTIC
/begin CHARACTERISTIC RTE_bCCPDrvUnderVoltageTestOnC "..." VALUE 0x0000 DATA_RECORD_UBYTE 1 Bool_ON_OFF 0 1 BIT_MASK 0x01 /end CHARACTERISTIC
/begin CHARACTERISTIC RTE_bCCPHALOrderInvalidTestOnC "..." VALUE 0x0000 DATA_RECORD_UBYTE 1 Bool_ON_OFF 0 1 BIT_MASK 0x01 /end CHARACTERISTIC
/begin CHARACTERISTIC RTE_bCCPHALOverVoltTestOnC "..." VALUE 0x0000 DATA_RECORD_UBYTE 1 Bool_ON_OFF 0 1 BIT_MASK 0x01 /end CHARACTERISTIC
/begin CHARACTERISTIC RTE_bCCPHALUndefinedTestOnC "..." VALUE 0x0000 DATA_RECORD_UBYTE 1 Bool_ON_OFF 0 1 BIT_MASK 0x01 /end CHARACTERISTIC
/begin CHARACTERISTIC RTE_bCCPHALUnderVoltTestOnC "..." VALUE 0x0000 DATA_RECORD_UBYTE 1 Bool_ON_OFF 0 1 BIT_MASK 0x01 /end CHARACTERISTIC
/begin CHARACTERISTIC RTE_bCCPPhasePerfTestOnC "..." VALUE 0x0000 DATA_RECORD_UBYTE 1 Bool_ON_OFF 0 1 BIT_MASK 0x01 /end CHARACTERISTIC
/begin CHARACTERISTIC RTE_bCCPPhaseShortHighTestOnC "..." VALUE 0x0000 DATA_RECORD_UBYTE 1 Bool_ON_OFF 0 1 BIT_MASK 0x01 /end CHARACTERISTIC
/begin CHARACTERISTIC RTE_bCCPPhaseShortLowTestOnC "..." VALUE 0x0000 DATA_RECORD_UBYTE 1 Bool_ON_OFF 0 1 BIT_MASK 0x01 /end CHARACTERISTIC
/begin CHARACTERISTIC RTE_bCCPSwOverCurrentTestOnC "..." VALUE 0x0000 DATA_RECORD_UBYTE 1 Bool_ON_OFF 0 1 BIT_MASK 0x01 /end CHARACTERISTIC
/begin CHARACTERISTIC RTE_bCCPbTcuStuckFlagTestOnC "..." VALUE 0x0000 DATA_RECORD_UBYTE 1 Bool_ON_OFF 0 1 BIT_MASK 0x01 /end CHARACTERISTIC
/begin CHARACTERISTIC RTMTSK_ku8TaskId "RTMTSK_ku8TaskId" VALUE 0x0000 DATA_RECORD_UBYTE 255 I_1 0 255 /end CHARACTERISTIC
/begin CHARACTERISTIC SBC_bServiceDisableC "Spare" VALUE 0x0000 DATA_RECORD_UBYTE 1 Bool_ON_OFF 0 1 BIT_MASK 0x01 /end CHARACTERISTIC
/begin CHARACTERISTIC SBC_f32RecoverThresholdC "Spare" VALUE 0x0000 DATA_RECORD_FLOAT32_IEEE 3.402823466E+038 F_1_p0_4 -3.402823466E+038 3.402823466E+038 /end CHARACTERISTIC
/begin CHARACTERISTIC SBC_f32UnderVolHighThresholdC "Spare" VALUE 0x0000 DATA_RECORD_FLOAT32_IEEE 3.402823466E+038 F_1_p0_4 -3.402823466E+038 3.402823466E+038 /end CHARACTERISTIC
/begin CHARACTERISTIC SBC_f32UnderVolLowThresholdC "Spare" VALUE 0x0000 DATA_RECORD_FLOAT32_IEEE 3.402823466E+038 F_1_p0_4 -3.402823466E+038 3.402823466E+038 /end CHARACTERISTIC
/begin CHARACTERISTIC TCFCke_b_CCPM_CommandDBC_Enable "..." VALUE 0x0000 DATA_RECORD_UBYTE 1 Bool_ON_OFF 0 1 BIT_MASK 0x01 /end CHARACTERISTIC
/begin MEASUREMENT APSSve_Pct_AccPedPos "..." SWORD F_0v1_p0_2 1 2 -3276.8 3276.7 ECU_ADDRESS 0x0 /end MEASUREMENT
/begin MEASUREMENT BPPDve_b_BrakeSwitchActive "..." UBYTE I_1 1 2 0 255 ECU_ADDRESS 0x0 /end MEASUREMENT
/begin MEASUREMENT CACEve_b_IgnitionOn "..." UBYTE Bool_ON_OFF 1 2 0 1 BIT_MASK 0x01 ECU_ADDRESS 0x0 /end MEASUREMENT
/begin MEASUREMENT CANDve_Cnt_DiagCounts "..." UWORD F_1_p0_4 1 2 0 65535 ECU_ADDRESS 0x0 /end MEASUREMENT
/begin MEASUREMENT CANDve_Cnt_DiagFails "..." UWORD F_1_p0_4 1 2 0 65535 ECU_ADDRESS 0x0 /end MEASUREMENT
/begin MEASUREMENT CANDve_b_ATFailure "..." UBYTE I_1 1 2 0 255 ECU_ADDRESS 0x0 /end MEASUREMENT
/begin MEASUREMENT CANDve_e_VCU_InvalidDataVld "..." UBYTE I_1 1 2 0 255 ECU_ADDRESS 0x0 /end MEASUREMENT
/begin MEASUREMENT CANDve_y_HTCU_Fault "..." UBYTE I_1 1 2 0 255 ECU_ADDRESS 0x0 /end MEASUREMENT
/begin MEASUREMENT CANDve_y_HTCU_State "..." UBYTE I_1 1 2 0 255 ECU_ADDRESS 0x0 /end MEASUREMENT
/begin MEASUREMENT CANDve_y_ID_Status "..." UBYTE I_1 1 2 0 255 ECU_ADDRESS 0x0 /end MEASUREMENT
/begin MEASUREMENT CANDve_y_Progress "..." UBYTE I_1 1 2 0 255 ECU_ADDRESS 0x0 /end MEASUREMENT
/begin MEASUREMENT CANDve_y_Status "..." UBYTE I_1 1 2 0 255 ECU_ADDRESS 0x0 /end MEASUREMENT
/begin MEASUREMENT CANDve_y_VCUFAULT_DiagCounts "..." UWORD F_1_p0_4 1 2 0 65535 ECU_ADDRESS 0x0 /end MEASUREMENT
/begin MEASUREMENT CANDve_y_VCUFAULT_DiagFails "..." UWORD F_1_p0_4 1 2 0 65535 ECU_ADDRESS 0x0 /end MEASUREMENT
/begin MEASUREMENT CANDve_y_VCUFAULT_Progress "..." UBYTE I_1 1 2 0 255 ECU_ADDRESS 0x0 /end MEASUREMENT
/begin MEASUREMENT CANDve_y_VCUFAULT_Status "..." UBYTE I_1 1 2 0 255 ECU_ADDRESS 0x0 /end MEASUREMENT
/begin MEASUREMENT CANEve_b_ProdTestModeActive "..." UBYTE I_1 1 2 0 255 ECU_ADDRESS 0x0 /end MEASUREMENT
/begin MEASUREMENT CANEve_y_BSWDiagBcmCANFault "..." UBYTE I_1 1 2 0 255 ECU_ADDRESS 0x0 /end MEASUREMENT
/begin MEASUREMENT CANEve_y_BSWDiagEmsCANFault "..." UBYTE I_1 1 2 0 255 ECU_ADDRESS 0x0 /end MEASUREMENT
/begin MEASUREMENT CANEve_y_BSWDiagGcuCANFault "..." UBYTE I_1 1 2 0 255 ECU_ADDRESS 0x0 /end MEASUREMENT
/begin MEASUREMENT CANEve_y_BSWDiagIpbCANFault "..." UBYTE I_1 1 2 0 255 ECU_ADDRESS 0x0 /end MEASUREMENT
/begin MEASUREMENT CANEve_y_BSWDiagIviCANFault "..." UBYTE I_1 1 2 0 255 ECU_ADDRESS 0x0 /end MEASUREMENT
/begin MEASUREMENT CANEve_y_BSWDiagPdcmCANFault "..." UBYTE I_1 1 2 0 255 ECU_ADDRESS 0x0 /end MEASUREMENT
/begin MEASUREMENT CANEve_y_BSWDiagTboxCANFault "..." UBYTE I_1 1 2 0 255 ECU_ADDRESS 0x0 /end MEASUREMENT
/begin MEASUREMENT CCAPve_M_EstClchTrnsfTrq "..." SWORD F_0v03125_p0_13 1 2 -1024 1023.96875 ECU_ADDRESS 0x0 /end MEASUREMENT
/begin MEASUREMENT CCAPve_M_InstantaneousCapabilityOdd "..." SWORD F_0v03125_p0_13 1 2 -1024 1023.96875 ECU_ADDRESS 0x0 /end MEASUREMENT
/begin MEASUREMENT CCAPve_M_OddClutchMaxTransferTorque "..." SWORD F_0v03125_p0_13 1 2 -1024 1023.96875 ECU_ADDRESS 0x0 /end MEASUREMENT
/begin MEASUREMENT CCAPve_T_EvenClutchTemp "..." SWORD F_0v0625_p0_14 1 2 -2048 2047.9375 ECU_ADDRESS 0x0 /end MEASUREMENT
/begin MEASUREMENT CCAPve_T_OddClutchTemp "..." SWORD F_0v0625_p0_14 1 2 -2048 2047.9375 ECU_ADDRESS 0x0 /end MEASUREMENT
/begin MEASUREMENT CCAPve_e_ClutchState "..." UBYTE I_1 1 2 0 255 ECU_ADDRESS 0x0 /end MEASUREMENT
/begin MEASUREMENT CCAPve_e_EvenClutchState "..." UBYTE I_1 1 2 0 255 ECU_ADDRESS 0x0 /end MEASUREMENT
/begin MEASUREMENT CCAPve_e_OddClutchState "..." UBYTE I_1 1 2 0 255 ECU_ADDRESS 0x0 /end MEASUREMENT
/begin MEASUREMENT CCAPve_p_ReturnSpringEven "..." SWORD F_1_p0_4 1 2 -32768 32767 ECU_ADDRESS 0x0 /end MEASUREMENT
/begin MEASUREMENT CCAPve_p_ReturnSpringOdd "..." SWORD F_1_p0_4 1 2 -32768 32767 ECU_ADDRESS 0x0 /end MEASUREMENT
/begin MEASUREMENT CLCOve_M_CurrentTorqueMargin "..." SWORD F_0v03125_p0_13 1 2 -1024 1023.96875 ECU_ADDRESS 0x0 /end MEASUREMENT
/begin MEASUREMENT CLCOve_M_EvenDesiredClutchTrq "..." SWORD F_0v03125_p0_13 1 2 -1024 1023.96875 ECU_ADDRESS 0x0 /end MEASUREMENT
/begin MEASUREMENT CLCOve_M_OddDesiredClutchTrq "..." SWORD F_0v03125_p0_13 1 2 -1024 1023.96875 ECU_ADDRESS 0x0 /end MEASUREMENT
/begin MEASUREMENT CLCOve_b_EvenClutchOpenReq "..." UBYTE I_1 1 2 0 255 ECU_ADDRESS 0x0 /end MEASUREMENT
/begin MEASUREMENT CLCOve_b_OddClutchOpenReq "..." UBYTE I_1 1 2 0 255 ECU_ADDRESS 0x0 /end MEASUREMENT
/begin MEASUREMENT CLCOve_b_OddClutchSlipDetected "..." UBYTE Bool_ON_OFF 1 2 0 1 BIT_MASK 0x01 ECU_ADDRESS 0x0 /end MEASUREMENT
/begin MEASUREMENT CLCOve_e_EvenActualClutchState "..." UBYTE I_1 1 2 0 255 ECU_ADDRESS 0x0 /end MEASUREMENT
/begin MEASUREMENT CLCOve_e_EvenClutchProgress "..." UBYTE I_1 1 2 0 255 ECU_ADDRESS 0x0 /end MEASUREMENT
/begin MEASUREMENT CLCOve_e_OddActualClutchState "..." UBYTE I_1 1 2 0 255 ECU_ADDRESS 0x0 /end MEASUREMENT
/begin MEASUREMENT CLCOve_e_OddClutchProgress "..." UBYTE I_1 1 2 0 255 ECU_ADDRESS 0x0 /end MEASUREMENT
/begin MEASUREMENT CLPCve_Cf_PressureToTorqueEven "..." UWORD F_1_p0_4 1 2 0 65535 ECU_ADDRESS 0x0 /end MEASUREMENT
/begin MEASUREMENT CLPCve_Cf_PressureToTorqueOdd "..." UWORD F_1_p0_4 1 2 0 65535 ECU_ADDRESS 0x0 /end MEASUREMENT
/begin MEASUREMENT CLPCve_Cnt_CAPM_CommandDBC "..." UBYTE I_1 1 2 0 255 ECU_ADDRESS 0x0 /end MEASUREMENT
/begin MEASUREMENT CLPCve_DC_CAPM_SpeedControllerPressureCompensation_IRV "..." SWORD F_0v00390625_p0_16 1 2 -128 127.9960938 ECU_ADDRESS 0x0 /end MEASUREMENT
/begin MEASUREMENT CLPCve_I_CAPM "..." SWORD F_0v03125_p0_13 1 2 -1024 1023.96875 ECU_ADDRESS 0x0 /end MEASUREMENT
/begin MEASUREMENT CLPCve_I_CAPM_CompletePhase "..." SWORD F_0v03125_p0_13 1 2 -1024 1023.96875 ECU_ADDRESS 0x0 /end MEASUREMENT
/begin MEASUREMENT CLPCve_I_CAPM_IRV "..." SWORD F_0v03125_p0_13 1 2 -1024 1023.96875 ECU_ADDRESS 0x0 /end MEASUREMENT
/begin MEASUREMENT CLPCve_I_CAP_ReducedMaxCurrent "..." SWORD F_0v03125_p0_13 1 2 -1024 1023.96875 ECU_ADDRESS 0x0 /end MEASUREMENT
/begin MEASUREMENT CLPCve_P_CAPM_IRV "..." FLOAT32_IEEE I_1 1 2 -3.402823466E+038 3.402823466E+038 ECU_ADDRESS 0x0 /end MEASUREMENT
/begin MEASUREMENT CLPCve_Pct_CAPMPS_DC_Actual "..." SWORD F_0v1_p0_2 1 2 -3276.8 3276.7 ECU_ADDRESS 0x0 /end MEASUREMENT
/begin MEASUREMENT CLPCve_Pct_CAPM_DC "..." SWORD F_0v1_p0_2 1 2 -3276.8 3276.7 ECU_ADDRESS 0x0 /end MEASUREMENT
/begin MEASUREMENT CLPCve_Pct_CAPM_DC_DBC "..." SWORD F_0v1_p0_2 1 2 -3276.8 3276.7 ECU_ADDRESS 0x0 /end MEASUREMENT
/begin MEASUREMENT CLPCve_Pct_CAPM_DC_IRV "..." SWORD F_0v1_p0_2 1 2 -3276.8 3276.7 ECU_ADDRESS 0x0 /end MEASUREMENT
/begin MEASUREMENT CLPCve_Pct_C_Pct_CAP_Data "..." SWORD F_0v1_p0_2 1 2 -3276.8 3276.7 ECU_ADDRESS 0x0 /end MEASUREMENT
/begin MEASUREMENT CLPCve_b_AdaptKissPointActive "..." UBYTE Bool_ON_OFF 1 2 0 1 BIT_MASK 0x01 ECU_ADDRESS 0x0 /end MEASUREMENT
/begin MEASUREMENT CLPCve_b_AdaptionFinished "..." UBYTE Bool_ON_OFF 1 2 0 1 BIT_MASK 0x01 ECU_ADDRESS 0x0 /end MEASUREMENT
/begin MEASUREMENT CLPCve_b_CAPM_DC_SaturatedHigh_IRV "..." UBYTE Bool_ON_OFF 1 2 0 1 BIT_MASK 0x01 ECU_ADDRESS 0x0 /end MEASUREMENT
/begin MEASUREMENT CLPCve_b_CAPM_DC_SaturatedLow_IRV "..." UBYTE Bool_ON_OFF 1 2 0 1 BIT_MASK 0x01 ECU_ADDRESS 0x0 /end MEASUREMENT
/begin MEASUREMENT CLPCve_b_CAP_TooCloseToOverCurrent "..." UBYTE I_1 1 2 0 255 ECU_ADDRESS 0x0 /end MEASUREMENT
/begin MEASUREMENT CLPCve_b_ClutchControlActive "..." UBYTE I_1 1 2 0 255 ECU_ADDRESS 0x0 /end MEASUREMENT
/begin MEASUREMENT CLPCve_b_DisableCAP "..." UBYTE Bool_ON_OFF 1 2 0 1 BIT_MASK 0x01 ECU_ADDRESS 0x0 /end MEASUREMENT
/begin MEASUREMENT CLPCve_b_DisengageComplete "..." UBYTE I_1 1 2 0 255 ECU_ADDRESS 0x0 /end MEASUREMENT
/begin MEASUREMENT CLPCve_b_InGearComplete "..." UBYTE I_1 1 2 0 255 ECU_ADDRESS 0x0 /end MEASUREMENT
/begin MEASUREMENT CLPCve_b_KneePoint_FirstDone "..." UBYTE Bool_ON_OFF 1 2 0 1 BIT_MASK 0x01 ECU_ADDRESS 0x0 /end MEASUREMENT
/begin MEASUREMENT CLPCve_b_NewKissPointAdaptionPointFound "..." UBYTE Bool_ON_OFF 1 2 0 1 BIT_MASK 0x01 ECU_ADDRESS 0x0 /end MEASUREMENT
/begin MEASUREMENT CLPCve_b_PrepareComplete "..." UBYTE I_1 1 2 0 255 ECU_ADDRESS 0x0 /end MEASUREMENT
/begin MEASUREMENT CLPCve_b_SpeedControllerActive_IRV "..." UBYTE Bool_ON_OFF 1 2 0 1 BIT_MASK 0x01 ECU_ADDRESS 0x0 /end MEASUREMENT
/begin MEASUREMENT CLPCve_e_CAP_DID_Enabled "..." UBYTE I_1 1 2 0 255 ECU_ADDRESS 0x0 /end MEASUREMENT
/begin MEASUREMENT CLPCve_e_CAP_DID_EnabledIndication "..." UBYTE I_1 1 2 0 255 ECU_ADDRESS 0x0 /end MEASUREMENT
/begin MEASUREMENT CLPCve_e_NegativeResponseCode_IRV "..." UBYTE I_1 1 2 0 255 ECU_ADDRESS 0x0 /end MEASUREMENT
/begin MEASUREMENT CLPCve_n_CAPM_IRV "..." SWORD F_1_p0_4 1 2 -32768 32767 ECU_ADDRESS 0x0 /end MEASUREMENT
/begin MEASUREMENT CLPCve_n_CAPM_Overrequest_IRV "..." SWORD F_1_p0_4 1 2 -32768 32767 ECU_ADDRESS 0x0 /end MEASUREMENT
/begin MEASUREMENT CLPCve_n_CAPM_SpeedTgtDBC "..." SWORD F_1_p0_4 1 2 -32768 32767 ECU_ADDRESS 0x0 /end MEASUREMENT
/begin MEASUREMENT CLPCve_n_C_n_CAP_Data "..." SWORD F_1_p0_4 1 2 -32768 32767 ECU_ADDRESS 0x0 /end MEASUREMENT
/begin MEASUREMENT CLPCve_p_CAPM_PressTgtDBC "..." UWORD F_1_p0_4 1 2 0 65535 ECU_ADDRESS 0x0 /end MEASUREMENT
/begin MEASUREMENT CLPCve_p_C_p_CAP_Data "..." UWORD F_1_p0_4 1 2 0 65535 ECU_ADDRESS 0x0 /end MEASUREMENT
/begin MEASUREMENT CLPCve_p_ClutchPresReq "..." SWORD F_1_p0_4 1 2 -32768 32767 ECU_ADDRESS 0x0 /end MEASUREMENT
/begin MEASUREMENT CLPCve_p_ClutchTarget "..." UWORD F_0v03125_p0_13 1 2 0 2047.96875 ECU_ADDRESS 0x0 /end MEASUREMENT
/begin MEASUREMENT CLPCve_p_EvenClutchPresReq "..." SWORD F_1_p0_4 1 2 -32768 32767 ECU_ADDRESS 0x0 /end MEASUREMENT
/begin MEASUREMENT CLPCve_p_KissPoint "..." SWORD F_0v015625_p0_17 1 2 -512 511.984375 ECU_ADDRESS 0x0 /end MEASUREMENT
/begin MEASUREMENT CLPCve_p_KneePoint_Stored "..." SWORD F_0v15625_p0_18 1 2 -5120 5119.84375 ECU_ADDRESS 0x0 /end MEASUREMENT
/begin MEASUREMENT CLPCve_p_LastEstimatedKisspoint_IRV "..." SWORD F_1_p0_4 1 2 -32768 32767 ECU_ADDRESS 0x0 /end MEASUREMENT
/begin MEASUREMENT CLPCve_p_OddClutchPresReq "..." SWORD F_1_p0_4 1 2 -32768 32767 ECU_ADDRESS 0x0 /end MEASUREMENT
/begin MEASUREMENT CLPCve_p_OddMaxAllowedClutchOilPress "..." SWORD F_1_p0_4 1 2 -32768 32767 ECU_ADDRESS 0x0 /end MEASUREMENT
/begin MEASUREMENT CLPCve_p_PressureKneePoint "..." SWORD F_1_p0_4 1 2 -32768 32767 ECU_ADDRESS 0x0 /end MEASUREMENT
/begin MEASUREMENT CLPCve_r_CAP_Y "..." UWORD F_0v0000305176_p0_19 1 2 0 1.999969482 ECU_ADDRESS 0x0 /end MEASUREMENT
/begin MEASUREMENT CLPCve_r_CAP_Y_IRV "..." UWORD F_0v1_p0_2 1 2 0 6553.5 ECU_ADDRESS 0x0 /end MEASUREMENT
/begin MEASUREMENT CWTDve_T_EngineCoolant "..." SWORD F_0v0625_p0_14 1 2 -2048 2047.9375 ECU_ADDRESS 0x0 /end MEASUREMENT
/begin MEASUREMENT CWTDve_e_EngineCoolantVld "..." UBYTE I_1 1 2 0 255 ECU_ADDRESS 0x0 /end MEASUREMENT
/begin MEASUREMENT Core0_Asw100msStartTime "..." ULONG F_0v01_p0_20 1 2 0 42949672.95 ECU_ADDRESS 0x0 /end MEASUREMENT
/begin MEASUREMENT Core0_Asw100msStopTime "..." ULONG F_0v01_p0_20 1 2 0 42949672.95 ECU_ADDRESS 0x0 /end MEASUREMENT
/begin MEASUREMENT Core0_Asw100msTotalTime "..." ULONG F_0v01_p0_20 1 2 0 42949672.95 ECU_ADDRESS 0x0 /end MEASUREMENT
/begin MEASUREMENT Core0_Asw10msStartTime "..." ULONG F_0v01_p0_20 1 2 0 42949672.95 ECU_ADDRESS 0x0 /end MEASUREMENT
/begin MEASUREMENT Core0_Asw10msStopTime "..." ULONG F_0v01_p0_20 1 2 0 42949672.95 ECU_ADDRESS 0x0 /end MEASUREMENT
/begin MEASUREMENT Core0_Asw10msTotalTime "..." ULONG F_0v01_p0_20 1 2 0 42949672.95 ECU_ADDRESS 0x0 /end MEASUREMENT
/begin MEASUREMENT Core0_Bsw100msStartTime "..." ULONG F_0v01_p0_20 1 2 0 42949672.95 ECU_ADDRESS 0x0 /end MEASUREMENT
/begin MEASUREMENT Core0_Bsw100msStopTime "..." ULONG F_0v01_p0_20 1 2 0 42949672.95 ECU_ADDRESS 0x0 /end MEASUREMENT
/begin MEASUREMENT Core0_Bsw100msTotalTime "..." ULONG F_0v01_p0_20 1 2 0 42949672.95 ECU_ADDRESS 0x0 /end MEASUREMENT
/begin MEASUREMENT Core0_Bsw10msStartTime "..." ULONG F_0v01_p0_20 1 2 0 42949672.95 ECU_ADDRESS 0x0 /end MEASUREMENT
/begin MEASUREMENT Core0_Bsw10msStopTime "..." ULONG F_0v01_p0_20 1 2 0 42949672.95 ECU_ADDRESS 0x0 /end MEASUREMENT
/begin MEASUREMENT Core0_Bsw10msTotalTime "..." ULONG F_0v01_p0_20 1 2 0 42949672.95 ECU_ADDRESS 0x0 /end MEASUREMENT
/begin MEASUREMENT Core0_Bsw1msStartTime "..." ULONG F_0v01_p0_20 1 2 0 42949672.95 ECU_ADDRESS 0x0 /end MEASUREMENT
/begin MEASUREMENT Core0_Bsw1msStopTime "..." ULONG F_0v01_p0_20 1 2 0 42949672.95 ECU_ADDRESS 0x0 /end MEASUREMENT
/begin MEASUREMENT Core0_Bsw1msTotalTime "..." ULONG F_0v01_p0_20 1 2 0 42949672.95 ECU_ADDRESS 0x0 /end MEASUREMENT
/begin MEASUREMENT Core0_Bsw50msStartTime "..." ULONG F_0v01_p0_20 1 2 0 42949672.95 ECU_ADDRESS 0x0 /end MEASUREMENT
/begin MEASUREMENT Core0_Bsw50msStopTime "..." ULONG F_0v01_p0_20 1 2 0 42949672.95 ECU_ADDRESS 0x0 /end MEASUREMENT
/begin MEASUREMENT Core0_Bsw50msTotalTime "..." ULONG F_0v01_p0_20 1 2 0 42949672.95 ECU_ADDRESS 0x0 /end MEASUREMENT
/begin MEASUREMENT Core0_WdgCurTime "..." ULONG F_0v01_p0_20 1 2 0 42949672.95 ECU_ADDRESS 0x0 /end MEASUREMENT
/begin MEASUREMENT Core0_WdgLastTime "..." ULONG F_0v01_p0_20 1 2 0 42949672.95 ECU_ADDRESS 0x0 /end MEASUREMENT
/begin MEASUREMENT Core0_WdgTotalTime "..." ULONG F_0v01_p0_20 1 2 0 42949672.95 ECU_ADDRESS 0x0 /end MEASUREMENT
/begin MEASUREMENT Core1_Asw10msStartTime "..." ULONG F_0v01_p0_20 1 2 0 42949672.95 ECU_ADDRESS 0x0 /end MEASUREMENT
/begin MEASUREMENT Core1_Asw10msStopTime "..." ULONG F_0v01_p0_20 1 2 0 42949672.95 ECU_ADDRESS 0x0 /end MEASUREMENT
/begin MEASUREMENT Core1_Asw10msTotalTime "..." ULONG F_0v01_p0_20 1 2 0 42949672.95 ECU_ADDRESS 0x0 /end MEASUREMENT
/begin MEASUREMENT Core1_Asw1msStartTime "..." ULONG F_0v01_p0_20 1 2 0 42949672.95 ECU_ADDRESS 0x0 /end MEASUREMENT
/begin MEASUREMENT Core1_Asw1msStopTime "..." ULONG F_0v01_p0_20 1 2 0 42949672.95 ECU_ADDRESS 0x0 /end MEASUREMENT
/begin MEASUREMENT Core1_Asw1msTotalTime "..." ULONG F_0v01_p0_20 1 2 0 42949672.95 ECU_ADDRESS 0x0 /end MEASUREMENT
/begin MEASUREMENT Core1_Asw5msStartTime "..." ULONG F_0v01_p0_20 1 2 0 42949672.95 ECU_ADDRESS 0x0 /end MEASUREMENT
/begin MEASUREMENT Core1_Asw5msStopTime "..." ULONG F_0v01_p0_20 1 2 0 42949672.95 ECU_ADDRESS 0x0 /end MEASUREMENT
/begin MEASUREMENT Core1_Asw5msTotalTime "..." ULONG F_0v01_p0_20 1 2 0 42949672.95 ECU_ADDRESS 0x0 /end MEASUREMENT
/begin MEASUREMENT Core1_Bsw10msStartTime "..." ULONG F_0v01_p0_20 1 2 0 42949672.95 ECU_ADDRESS 0x0 /end MEASUREMENT
/begin MEASUREMENT Core1_Bsw10msStopTime "..." ULONG F_0v01_p0_20 1 2 0 42949672.95 ECU_ADDRESS 0x0 /end MEASUREMENT
/begin MEASUREMENT Core1_Bsw10msTotalTime "..." ULONG F_0v01_p0_20 1 2 0 42949672.95 ECU_ADDRESS 0x0 /end MEASUREMENT
/begin MEASUREMENT Core2_Asw10msStartTime "..." ULONG F_0v01_p0_20 1 2 0 42949672.95 ECU_ADDRESS 0x0 /end MEASUREMENT
/begin MEASUREMENT Core2_Asw10msStopTime "..." ULONG F_0v01_p0_20 1 2 0 42949672.95 ECU_ADDRESS 0x0 /end MEASUREMENT
/begin MEASUREMENT Core2_Asw10msTotalTime "..." ULONG F_0v01_p0_20 1 2 0 42949672.95 ECU_ADDRESS 0x0 /end MEASUREMENT
/begin MEASUREMENT Core2_Asw1msStartTime "..." ULONG F_0v01_p0_20 1 2 0 42949672.95 ECU_ADDRESS 0x0 /end MEASUREMENT
/begin MEASUREMENT Core2_Asw1msStopTime "..." ULONG F_0v01_p0_20 1 2 0 42949672.95 ECU_ADDRESS 0x0 /end MEASUREMENT
/begin MEASUREMENT Core2_Asw1msTotalTime "..." ULONG F_0v01_p0_20 1 2 0 42949672.95 ECU_ADDRESS 0x0 /end MEASUREMENT
/begin MEASUREMENT Core2_Bsw10msStartTime "..." ULONG F_0v01_p0_20 1 2 0 42949672.95 ECU_ADDRESS 0x0 /end MEASUREMENT
/begin MEASUREMENT Core2_Bsw10msStopTime "..." ULONG F_0v01_p0_20 1 2 0 42949672.95 ECU_ADDRESS 0x0 /end MEASUREMENT
/begin MEASUREMENT Core2_Bsw10msTotalTime "..." ULONG F_0v01_p0_20 1 2 0 42949672.95 ECU_ADDRESS 0x0 /end MEASUREMENT
/begin MEASUREMENT DGPSte_e_Gear "..." SWORD F_0v0009765625_p0_22 1 2 -32 31.99902344 ECU_ADDRESS 0x0 /end MEASUREMENT
/begin MEASUREMENT DGPSve_n_LaunchTargetSpeed "..." SWORD F_1_p0_4 1 2 -32768 32767 ECU_ADDRESS 0x0 /end MEASUREMENT
/begin MEASUREMENT DPSCve_e_VehicleActState "..." UBYTE I_1 1 2 0 255 ECU_ADDRESS 0x0 /end MEASUREMENT
/begin MEASUREMENT DRSPve_e_RangeSelPos "..." UBYTE I_1 1 2 0 255 ECU_ADDRESS 0x0 /end MEASUREMENT
/begin MEASUREMENT EMS_EngActualFlwTorque "..." UWORD F_0v125_m100_24 1 2 -100 8091.875 ECU_ADDRESS 0x0 /end MEASUREMENT
/begin MEASUREMENT EMS_EngFlywh "..." UWORD F_0v1_m350_25 1 2 -350 6203.5 ECU_ADDRESS 0x0 /end MEASUREMENT
/begin MEASUREMENT EMS_EngRunningStatus "..." UBYTE I_1 1 2 0 255 ECU_ADDRESS 0x0 /end MEASUREMENT
/begin MEASUREMENT EMS_EngSpd "..." UWORD F_0v125_p0_26 1 2 0 8191.875 ECU_ADDRESS 0x0 /end MEASUREMENT
/begin MEASUREMENT EMS_EngSpdValid "..." UBYTE I_1 1 2 0 255 ECU_ADDRESS 0x0 /end MEASUREMENT
/begin MEASUREMENT EOL1_CCP_control_DC "..." UWORD F_1_p0_4 1 2 0 65535 ECU_ADDRESS 0x0 /end MEASUREMENT
/begin MEASUREMENT EOL1_CCP_control_Enable "..." UBYTE I_1 1 2 0 255 ECU_ADDRESS 0x0 /end MEASUREMENT
/begin MEASUREMENT EOL1_CCP_control_flow "..." UWORD F_1_p0_4 1 2 0 65535 ECU_ADDRESS 0x0 /end MEASUREMENT
/begin MEASUREMENT EOL1_CCP_control_speed "..." UWORD F_1_p0_4 1 2 0 65535 ECU_ADDRESS 0x0 /end MEASUREMENT
/begin MEASUREMENT EOL2_CAP_control_DC "..." UWORD F_1_p0_4 1 2 0 65535 ECU_ADDRESS 0x0 /end MEASUREMENT
/begin MEASUREMENT EOL2_CAP_control_Enable "..." UBYTE I_1 1 2 0 255 ECU_ADDRESS 0x0 /end MEASUREMENT
/begin MEASUREMENT EOL2_CAP_control_pres "..." UWORD F_1_p0_4 1 2 0 65535 ECU_ADDRESS 0x0 /end MEASUREMENT
/begin MEASUREMENT EOL2_CAP_control_speed "..." UWORD F_1_p0_4 1 2 0 65535 ECU_ADDRESS 0x0 /end MEASUREMENT
/begin MEASUREMENT EOL3_CAP_DC "..." UWORD F_1_p0_4 1 2 0 65535 ECU_ADDRESS 0x0 /end MEASUREMENT
/begin MEASUREMENT EOL3_CAP_current "..." UWORD F_1_p0_4 1 2 0 65535 ECU_ADDRESS 0x0 /end MEASUREMENT
/begin MEASUREMENT EOL3_CAP_speed "..." UWORD F_1_p0_4 1 2 0 65535 ECU_ADDRESS 0x0 /end MEASUREMENT
/begin MEASUREMENT EOL4_CCP_DC "..." UWORD F_1_p0_4 1 2 0 65535 ECU_ADDRESS 0x0 /end MEASUREMENT
/begin MEASUREMENT EOL4_CCP_current "..." UWORD F_1_p0_4 1 2 0 65535 ECU_ADDRESS 0x0 /end MEASUREMENT
/begin MEASUREMENT EOL4_CCP_flow "..." UWORD F_1_p0_4 1 2 0 65535 ECU_ADDRESS 0x0 /end MEASUREMENT
/begin MEASUREMENT EOL4_CCP_speed "..." UWORD F_1_p0_4 1 2 0 65535 ECU_ADDRESS 0x0 /end MEASUREMENT
/begin MEASUREMENT EOL5_clutch_pressure "..." UWORD F_1_p0_4 1 2 0 65535 ECU_ADDRESS 0x0 /end MEASUREMENT
/begin MEASUREMENT EOL5_clutch_targetpressure "..." UWORD F_1_p0_4 1 2 0 65535 ECU_ADDRESS 0x0 /end MEASUREMENT
/begin MEASUREMENT EOL5_oil_temp "..." UBYTE I_1 1 2 0 255 ECU_ADDRESS 0x0 /end MEASUREMENT
/begin MEASUREMENT EPOSve_d2n_EngSpdAccel "..." SWORD F_0v25_p0_27 1 2 -8192 8191.75 ECU_ADDRESS 0x0 /end MEASUREMENT
/begin MEASUREMENT EPOSve_dn_EngSpdChangeRate "..." SWORD F_0v5_p0_28 1 2 -16384 16383.5 ECU_ADDRESS 0x0 /end MEASUREMENT
/begin MEASUREMENT EPOSve_e_EngSpdValidity "..." UBYTE I_1 1 2 0 255 ECU_ADDRESS 0x0 /end MEASUREMENT
/begin MEASUREMENT EPOSve_n_EngSpd "..." SWORD F_1_p0_4 1 2 -32768 32767 ECU_ADDRESS 0x0 /end MEASUREMENT
/begin MEASUREMENT EP_Tbox3_CoolantTemp "..." UBYTE F_1_m40_29 1 2 -40 215 ECU_ADDRESS 0x0 /end MEASUREMENT
/begin MEASUREMENT EP_Tbox3_CoolantTempValid "..." UBYTE I_1 1 2 0 255 ECU_ADDRESS 0x0 /end MEASUREMENT
/begin MEASUREMENT EP_Tbox3_WarmUpCycle "..." UBYTE I_1 1 2 0 255 ECU_ADDRESS 0x0 /end MEASUREMENT
/begin MEASUREMENT FDMAve_Cnt_DID_NoOfInputsDrivingFA_TKO "..." SWORD F_1_p0_4 1 2 -32768 32767 ECU_ADDRESS 0x0 /end MEASUREMENT
/begin MEASUREMENT FDMAve_b_AcceleratorStuckErrExt "..." UBYTE Bool_ON_OFF 1 2 0 1 BIT_MASK 0x01 ECU_ADDRESS 0x0 /end MEASUREMENT
/begin MEASUREMENT FDMAve_b_ForceAC_CompressorCpbyPrioHigh "..." UBYTE Bool_ON_OFF 1 2 0 1 BIT_MASK 0x01 ECU_ADDRESS 0x0 /end MEASUREMENT
/begin MEASUREMENT FDMAve_b_ForceAC_CompressorToOff "..." UBYTE Bool_ON_OFF 1 2 0 1 BIT_MASK 0x01 ECU_ADDRESS 0x0 /end MEASUREMENT
/begin MEASUREMENT FDMAve_b_ForceAC_LoadCompensationToOff "..." UBYTE Bool_ON_OFF 1 2 0 1 BIT_MASK 0x01 ECU_ADDRESS 0x0 /end MEASUREMENT
/begin MEASUREMENT FDMAve_b_ForceActiveDischarge "..." UBYTE Bool_ON_OFF 1 2 0 1 BIT_MASK 0x01 ECU_ADDRESS 0x0 /end MEASUREMENT
/begin MEASUREMENT FDMAve_b_ForceAirEstimationByMAP_SensorToOff "..." UBYTE Bool_ON_OFF 1 2 0 1 BIT_MASK 0x01 ECU_ADDRESS 0x0 /end MEASUREMENT
/begin MEASUREMENT FDMAve_b_ForceAntiJerkControlOff "..." UBYTE Bool_ON_OFF 1 2 0 1 BIT_MASK 0x01 ECU_ADDRESS 0x0 /end MEASUREMENT
/begin MEASUREMENT FDMAve_b_ForceBackupPowerModeToActive "..." UBYTE Bool_ON_OFF 1 2 0 1 BIT_MASK 0x01 ECU_ADDRESS 0x0 /end MEASUREMENT
/begin MEASUREMENT FDMAve_b_ForceBoostPressureControlToLowPressure "..." UBYTE Bool_ON_OFF 1 2 0 1 BIT_MASK 0x01 ECU_ADDRESS 0x0 /end MEASUREMENT
/begin MEASUREMENT FDMAve_b_ForceBoostPressureControlToLowPressureIRV "..." UBYTE Bool_ON_OFF 1 2 0 1 BIT_MASK 0x01 ECU_ADDRESS 0x0 /end MEASUREMENT
/begin MEASUREMENT FDMAve_b_ForceBoostTorqueOff "..." UBYTE Bool_ON_OFF 1 2 0 1 BIT_MASK 0x01 ECU_ADDRESS 0x0 /end MEASUREMENT
/begin MEASUREMENT FDMAve_b_ForceBrakeRegenerationTorqueOff "..." UBYTE Bool_ON_OFF 1 2 0 1 BIT_MASK 0x01 ECU_ADDRESS 0x0 /end MEASUREMENT
/begin MEASUREMENT FDMAve_b_ForceCCPCancleSpdLimit "..." UBYTE I_1 1 2 0 255 ECU_ADDRESS 0x0 /end MEASUREMENT
/begin MEASUREMENT FDMAve_b_ForceCamPositionToParked "..." UBYTE Bool_ON_OFF 1 2 0 1 BIT_MASK 0x01 ECU_ADDRESS 0x0 /end MEASUREMENT
/begin MEASUREMENT FDMAve_b_ForceCamPositionToParkedIRV "..." UBYTE Bool_ON_OFF 1 2 0 1 BIT_MASK 0x01 ECU_ADDRESS 0x0 /end MEASUREMENT
/begin MEASUREMENT FDMAve_b_ForceClutchOddOpen "..." UBYTE I_1 1 2 0 255 ECU_ADDRESS 0x0 /end MEASUREMENT
/begin MEASUREMENT FDMAve_b_ForceCoastRegenerationTorqueOff "..." UBYTE Bool_ON_OFF 1 2 0 1 BIT_MASK 0x01 ECU_ADDRESS 0x0 /end MEASUREMENT
/begin MEASUREMENT FDMAve_b_ForceContactorsOpen "..." UBYTE Bool_ON_OFF 1 2 0 1 BIT_MASK 0x01 ECU_ADDRESS 0x0 /end MEASUREMENT
/begin MEASUREMENT FDMAve_b_ForceCreepControlToOff "..." UBYTE Bool_ON_OFF 1 2 0 1 BIT_MASK 0x01 ECU_ADDRESS 0x0 /end MEASUREMENT
/begin MEASUREMENT FDMAve_b_ForceCruiseControlToOff "..." UBYTE Bool_ON_OFF 1 2 0 1 BIT_MASK 0x01 ECU_ADDRESS 0x0 /end MEASUREMENT
/begin MEASUREMENT FDMAve_b_ForceDCDC_BuckConversionOff "..." UBYTE Bool_ON_OFF 1 2 0 1 BIT_MASK 0x01 ECU_ADDRESS 0x0 /end MEASUREMENT
/begin MEASUREMENT FDMAve_b_ForceDCDC_ControlToDefault "..." UBYTE Bool_ON_OFF 1 2 0 1 BIT_MASK 0x01 ECU_ADDRESS 0x0 /end MEASUREMENT
/begin MEASUREMENT FDMAve_b_ForceEGR_ControlToOff "..." UBYTE Bool_ON_OFF 1 2 0 1 BIT_MASK 0x01 ECU_ADDRESS 0x0 /end MEASUREMENT
/begin MEASUREMENT FDMAve_b_ForceElectricLoadCompensationToOff "..." UBYTE Bool_ON_OFF 1 2 0 1 BIT_MASK 0x01 ECU_ADDRESS 0x0 /end MEASUREMENT
/begin MEASUREMENT FDMAve_b_ForceElectricThermostatControlToLowTemp "..." UBYTE Bool_ON_OFF 1 2 0 1 BIT_MASK 0x01 ECU_ADDRESS 0x0 /end MEASUREMENT
/begin MEASUREMENT FDMAve_b_ForceElectricThermostatToOff "..." UBYTE Bool_ON_OFF 1 2 0 1 BIT_MASK 0x01 ECU_ADDRESS 0x0 /end MEASUREMENT
/begin MEASUREMENT FDMAve_b_ForceElectricVacuumPumpOff "..." UBYTE Bool_ON_OFF 1 2 0 1 BIT_MASK 0x01 ECU_ADDRESS 0x0 /end MEASUREMENT
/begin MEASUREMENT FDMAve_b_ForceElectricVacuumPumpPulseMode "..." UBYTE Bool_ON_OFF 1 2 0 1 BIT_MASK 0x01 ECU_ADDRESS 0x0 /end MEASUREMENT
/begin MEASUREMENT FDMAve_b_ForceEngCoolantTempToEstimationModel "..." UBYTE Bool_ON_OFF 1 2 0 1 BIT_MASK 0x01 ECU_ADDRESS 0x0 /end MEASUREMENT
/begin MEASUREMENT FDMAve_b_ForceEngTransientLimOff "..." UBYTE Bool_ON_OFF 1 2 0 1 BIT_MASK 0x01 ECU_ADDRESS 0x0 /end MEASUREMENT
/begin MEASUREMENT FDMAve_b_ForceEngineRunning "..." UBYTE Bool_ON_OFF 1 2 0 1 BIT_MASK 0x01 ECU_ADDRESS 0x0 /end MEASUREMENT
/begin MEASUREMENT FDMAve_b_ForceEngineStop "..." UBYTE Bool_ON_OFF 1 2 0 1 BIT_MASK 0x01 ECU_ADDRESS 0x0 /end MEASUREMENT
/begin MEASUREMENT FDMAve_b_ForceEngineStopIRV "..." UBYTE Bool_ON_OFF 1 2 0 1 BIT_MASK 0x01 ECU_ADDRESS 0x0 /end MEASUREMENT
/begin MEASUREMENT FDMAve_b_ForceEngineTorqueFillOff "..." UBYTE Bool_ON_OFF 1 2 0 1 BIT_MASK 0x01 ECU_ADDRESS 0x0 /end MEASUREMENT
/begin MEASUREMENT FDMAve_b_ForceEngineTorqueReductionToMedium "..." UBYTE Bool_ON_OFF 1 2 0 1 BIT_MASK 0x01 ECU_ADDRESS 0x0 /end MEASUREMENT
/begin MEASUREMENT FDMAve_b_ForceEngineTorqueReductionToMediumIRV "..." UBYTE Bool_ON_OFF 1 2 0 1 BIT_MASK 0x01 ECU_ADDRESS 0x0 /end MEASUREMENT
/begin MEASUREMENT FDMAve_b_ForceFrntO2SnsrBnk1ToPrtctnMd "..." UBYTE Bool_ON_OFF 1 2 0 1 BIT_MASK 0x01 ECU_ADDRESS 0x0 /end MEASUREMENT
/begin MEASUREMENT FDMAve_b_ForceFuelControlToOpenLoop "..." UBYTE Bool_ON_OFF 1 2 0 1 BIT_MASK 0x01 ECU_ADDRESS 0x0 /end MEASUREMENT
/begin MEASUREMENT FDMAve_b_ForceFuelPressureActivationToOff "..." UBYTE Bool_ON_OFF 1 2 0 1 BIT_MASK 0x01 ECU_ADDRESS 0x0 /end MEASUREMENT
/begin MEASUREMENT FDMAve_b_ForceFuelPressureActivationToOffIRV "..." UBYTE Bool_ON_OFF 1 2 0 1 BIT_MASK 0x01 ECU_ADDRESS 0x0 /end MEASUREMENT
/begin MEASUREMENT FDMAve_b_ForceFuelRailPressureFeedbackExclusion "..." UBYTE Bool_ON_OFF 1 2 0 1 BIT_MASK 0x01 ECU_ADDRESS 0x0 /end MEASUREMENT
/begin MEASUREMENT FDMAve_b_ForceFuelRailPressureFeedbackExclusionIRV "..." UBYTE Bool_ON_OFF 1 2 0 1 BIT_MASK 0x01 ECU_ADDRESS 0x0 /end MEASUREMENT
/begin MEASUREMENT FDMAve_b_ForceGCUTrqToExclFromTransClutchPresTarget "..." UBYTE Bool_ON_OFF 1 2 0 1 BIT_MASK 0x01 ECU_ADDRESS 0x0 /end MEASUREMENT
/begin MEASUREMENT FDMAve_b_ForceGearRecommendationToOff "..." UBYTE Bool_ON_OFF 1 2 0 1 BIT_MASK 0x01 ECU_ADDRESS 0x0 /end MEASUREMENT
/begin MEASUREMENT FDMAve_b_ForceHVAC_ElectricHeaterOff "..." UBYTE Bool_ON_OFF 1 2 0 1 BIT_MASK 0x01 ECU_ADDRESS 0x0 /end MEASUREMENT
/begin MEASUREMENT FDMAve_b_ForceHVBattSOC_ControlOff "..." UBYTE Bool_ON_OFF 1 2 0 1 BIT_MASK 0x01 ECU_ADDRESS 0x0 /end MEASUREMENT
/begin MEASUREMENT FDMAve_b_ForceHiPressFuelPumpEnblToDisable "..." UBYTE Bool_ON_OFF 1 2 0 1 BIT_MASK 0x01 ECU_ADDRESS 0x0 /end MEASUREMENT
/begin MEASUREMENT FDMAve_b_ForceHiPressFuelPumpEnblToDisableIRV "..." UBYTE Bool_ON_OFF 1 2 0 1 BIT_MASK 0x01 ECU_ADDRESS 0x0 /end MEASUREMENT
/begin MEASUREMENT FDMAve_b_ForceIdleControlToElevatedMode "..." UBYTE Bool_ON_OFF 1 2 0 1 BIT_MASK 0x01 ECU_ADDRESS 0x0 /end MEASUREMENT
/begin MEASUREMENT FDMAve_b_ForceIgnitionToLowOctane "..." UBYTE Bool_ON_OFF 1 2 0 1 BIT_MASK 0x01 ECU_ADDRESS 0x0 /end MEASUREMENT
/begin MEASUREMENT FDMAve_b_ForceIgnitionToOff "..." UBYTE Bool_ON_OFF 1 2 0 1 BIT_MASK 0x01 ECU_ADDRESS 0x0 /end MEASUREMENT
/begin MEASUREMENT FDMAve_b_ForceIgnitionToOffIRV "..." UBYTE Bool_ON_OFF 1 2 0 1 BIT_MASK 0x01 ECU_ADDRESS 0x0 /end MEASUREMENT
/begin MEASUREMENT FDMAve_b_ForceIntelligentGeneratorControlToDefault "..." UBYTE Bool_ON_OFF 1 2 0 1 BIT_MASK 0x01 ECU_ADDRESS 0x0 /end MEASUREMENT
/begin MEASUREMENT FDMAve_b_ForceLftDrvnWhlSpdInfoExclusion "..." UBYTE I_1 1 2 0 255 ECU_ADDRESS 0x0 /end MEASUREMENT
/begin MEASUREMENT FDMAve_b_ForceLftNnDrvnWhlSpdInfoExclusion "..." UBYTE I_1 1 2 0 255 ECU_ADDRESS 0x0 /end MEASUREMENT
/begin MEASUREMENT FDMAve_b_ForceLongTermAdaptionToOff "..." UBYTE Bool_ON_OFF 1 2 0 1 BIT_MASK 0x01 ECU_ADDRESS 0x0 /end MEASUREMENT
/begin MEASUREMENT FDMAve_b_ForceNeutralGear "..." UBYTE Bool_ON_OFF 1 2 0 1 BIT_MASK 0x01 ECU_ADDRESS 0x0 /end MEASUREMENT
/begin MEASUREMENT FDMAve_b_ForceP1ElectricMotorToNeutral "..." UBYTE Bool_ON_OFF 1 2 0 1 BIT_MASK 0x01 ECU_ADDRESS 0x0 /end MEASUREMENT
/begin MEASUREMENT FDMAve_b_ForceP1ElectricTorqueReserveOff "..." UBYTE Bool_ON_OFF 1 2 0 1 BIT_MASK 0x01 ECU_ADDRESS 0x0 /end MEASUREMENT
/begin MEASUREMENT FDMAve_b_ForceP3MtrSpdInfoExclusion "..." UBYTE I_1 1 2 0 255 ECU_ADDRESS 0x0 /end MEASUREMENT
/begin MEASUREMENT FDMAve_b_ForcePF_ActiveRegenOff "..." UBYTE Bool_ON_OFF 1 2 0 1 BIT_MASK 0x01 ECU_ADDRESS 0x0 /end MEASUREMENT
/begin MEASUREMENT FDMAve_b_ForcePF_PrssrSnsrAdptnOff "..." UBYTE Bool_ON_OFF 1 2 0 1 BIT_MASK 0x01 ECU_ADDRESS 0x0 /end MEASUREMENT
/begin MEASUREMENT FDMAve_b_ForcePF_PrssrSnsrBasedSootEstOff "..." UBYTE Bool_ON_OFF 1 2 0 1 BIT_MASK 0x01 ECU_ADDRESS 0x0 /end MEASUREMENT
/begin MEASUREMENT FDMAve_b_ForcePowerModeLock "..." UBYTE Bool_ON_OFF 1 2 0 1 BIT_MASK 0x01 ECU_ADDRESS 0x0 /end MEASUREMENT
/begin MEASUREMENT FDMAve_b_ForcePowerSteeringCompensationToOff "..." UBYTE Bool_ON_OFF 1 2 0 1 BIT_MASK 0x01 ECU_ADDRESS 0x0 /end MEASUREMENT
/begin MEASUREMENT FDMAve_b_ForcePropModeCalcToExcludeVehSpd "..." UBYTE Bool_ON_OFF 1 2 0 1 BIT_MASK 0x01 ECU_ADDRESS 0x0 /end MEASUREMENT
/begin MEASUREMENT FDMAve_b_ForcePropulsionAllowedToNotAllowed "..." UBYTE Bool_ON_OFF 1 2 0 1 BIT_MASK 0x01 ECU_ADDRESS 0x0 /end MEASUREMENT
/begin MEASUREMENT FDMAve_b_ForcePurgeControlToOff "..." UBYTE Bool_ON_OFF 1 2 0 1 BIT_MASK 0x01 ECU_ADDRESS 0x0 /end MEASUREMENT
/begin MEASUREMENT FDMAve_b_ForceRearO2SensorFuelControlToOff "..." UBYTE Bool_ON_OFF 1 2 0 1 BIT_MASK 0x01 ECU_ADDRESS 0x0 /end MEASUREMENT
/begin MEASUREMENT FDMAve_b_ForceRghtDrvnWhlSpdInfoExclusion "..." UBYTE I_1 1 2 0 255 ECU_ADDRESS 0x0 /end MEASUREMENT
/begin MEASUREMENT FDMAve_b_ForceRghtNnDrvnWhlSpdInfoExclusion "..." UBYTE I_1 1 2 0 255 ECU_ADDRESS 0x0 /end MEASUREMENT
/begin MEASUREMENT FDMAve_b_ForceTCU_CreepTorqueControlToOff "..." UBYTE Bool_ON_OFF 1 2 0 1 BIT_MASK 0x01 ECU_ADDRESS 0x0 /end MEASUREMENT
/begin MEASUREMENT FDMAve_b_ForceThrottleMassAirFlowToDefaultAir "..." UBYTE Bool_ON_OFF 1 2 0 1 BIT_MASK 0x01 ECU_ADDRESS 0x0 /end MEASUREMENT
/begin MEASUREMENT FDMAve_b_ForceThrottleMassAirFlowToDefaultAirIRV "..." UBYTE Bool_ON_OFF 1 2 0 1 BIT_MASK 0x01 ECU_ADDRESS 0x0 /end MEASUREMENT
/begin MEASUREMENT FDMAve_b_ForceTransIOCControlToOff "..." UBYTE I_1 1 2 0 255 ECU_ADDRESS 0x0 /end MEASUREMENT
/begin MEASUREMENT FDMAve_b_ForceTransOilCoolingToSafeCoolingMode "..." UBYTE I_1 1 2 0 255 ECU_ADDRESS 0x0 /end MEASUREMENT
/begin MEASUREMENT FDMAve_b_ForceTransOilLubricationToSafeLubricationMode "..." UBYTE I_1 1 2 0 255 ECU_ADDRESS 0x0 /end MEASUREMENT
/begin MEASUREMENT FDMAve_b_ForceUnderHoodCoolingToHigh "..." UBYTE Bool_ON_OFF 1 2 0 1 BIT_MASK 0x01 ECU_ADDRESS 0x0 /end MEASUREMENT
/begin MEASUREMENT FDMAve_b_ForceVehicleSpeedInfoExclusion "..." UBYTE I_1 1 2 0 255 ECU_ADDRESS 0x0 /end MEASUREMENT
/begin MEASUREMENT FDMAve_b_LimitHV_BattSOC_CntrlAuthorityToLow "..." UBYTE Bool_ON_OFF 1 2 0 1 BIT_MASK 0x01 ECU_ADDRESS 0x0 /end MEASUREMENT
/begin MEASUREMENT FDMAve_b_LockoutEngineStateChange "..." UBYTE Bool_ON_OFF 1 2 0 1 BIT_MASK 0x01 ECU_ADDRESS 0x0 /end MEASUREMENT
/begin MEASUREMENT FDMAve_b_LockoutPropulsionSystemStart "..." UBYTE Bool_ON_OFF 1 2 0 1 BIT_MASK 0x01 ECU_ADDRESS 0x0 /end MEASUREMENT
/begin MEASUREMENT FDMAve_b_LockoutPropulsionSystemStartIRV "..." UBYTE Bool_ON_OFF 1 2 0 1 BIT_MASK 0x01 ECU_ADDRESS 0x0 /end MEASUREMENT
/begin MEASUREMENT FDMAve_b_LockoutSpdDepCntctrAfterrun "..." UBYTE Bool_ON_OFF 1 2 0 1 BIT_MASK 0x01 ECU_ADDRESS 0x0 /end MEASUREMENT
/begin MEASUREMENT FDMAve_b_LockoutStopStartEngineStateChange "..." UBYTE Bool_ON_OFF 1 2 0 1 BIT_MASK 0x01 ECU_ADDRESS 0x0 /end MEASUREMENT
/begin MEASUREMENT FDMAve_b_SetAccPedPosToZero "..." UBYTE Bool_ON_OFF 1 2 0 1 BIT_MASK 0x01 ECU_ADDRESS 0x0 /end MEASUREMENT
/begin MEASUREMENT FDMAve_b_SetAccPedPosToZeroIRV "..." UBYTE Bool_ON_OFF 1 2 0 1 BIT_MASK 0x01 ECU_ADDRESS 0x0 /end MEASUREMENT
/begin MEASUREMENT FDMAve_b_SetAutoTransIdleSpdRqstToNoRqst "..." UBYTE Bool_ON_OFF 1 2 0 1 BIT_MASK 0x01 ECU_ADDRESS 0x0 /end MEASUREMENT
/begin MEASUREMENT FDMAve_b_SetAutoTransTorqueRequestToNoRequest "..." UBYTE Bool_ON_OFF 1 2 0 1 BIT_MASK 0x01 ECU_ADDRESS 0x0 /end MEASUREMENT
/begin MEASUREMENT FDMAve_b_SetDCDC_ActualLoadDefaultVal "..." UBYTE Bool_ON_OFF 1 2 0 1 BIT_MASK 0x01 ECU_ADDRESS 0x0 /end MEASUREMENT
/begin MEASUREMENT FDMAve_b_SetDriversRequestToZero "..." UBYTE Bool_ON_OFF 1 2 0 1 BIT_MASK 0x01 ECU_ADDRESS 0x0 /end MEASUREMENT
/begin MEASUREMENT FDMAve_b_SetDriversRequestToZeroIRV "..." UBYTE Bool_ON_OFF 1 2 0 1 BIT_MASK 0x01 ECU_ADDRESS 0x0 /end MEASUREMENT
/begin MEASUREMENT FDMAve_b_SetESP_TCS_TorqueRequestToNoRequest "..." UBYTE Bool_ON_OFF 1 2 0 1 BIT_MASK 0x01 ECU_ADDRESS 0x0 /end MEASUREMENT
/begin MEASUREMENT FDMAve_b_SetFuelMassToZeroCylinder1 "..." UBYTE Bool_ON_OFF 1 2 0 1 BIT_MASK 0x01 ECU_ADDRESS 0x0 /end MEASUREMENT
/begin MEASUREMENT FDMAve_b_SetFuelMassToZeroCylinder1IRV "..." UBYTE Bool_ON_OFF 1 2 0 1 BIT_MASK 0x01 ECU_ADDRESS 0x0 /end MEASUREMENT
/begin MEASUREMENT FDMAve_b_SetFuelMassToZeroCylinder2 "..." UBYTE Bool_ON_OFF 1 2 0 1 BIT_MASK 0x01 ECU_ADDRESS 0x0 /end MEASUREMENT
/begin MEASUREMENT FDMAve_b_SetFuelMassToZeroCylinder2IRV "..." UBYTE Bool_ON_OFF 1 2 0 1 BIT_MASK 0x01 ECU_ADDRESS 0x0 /end MEASUREMENT
/begin MEASUREMENT FDMAve_b_SetFuelMassToZeroCylinder3 "..." UBYTE Bool_ON_OFF 1 2 0 1 BIT_MASK 0x01 ECU_ADDRESS 0x0 /end MEASUREMENT
/begin MEASUREMENT FDMAve_b_SetFuelMassToZeroCylinder3IRV "..." UBYTE Bool_ON_OFF 1 2 0 1 BIT_MASK 0x01 ECU_ADDRESS 0x0 /end MEASUREMENT
/begin MEASUREMENT FDMAve_b_SetFuelMassToZeroCylinder4 "..." UBYTE Bool_ON_OFF 1 2 0 1 BIT_MASK 0x01 ECU_ADDRESS 0x0 /end MEASUREMENT
/begin MEASUREMENT FDMAve_b_SetFuelMassToZeroCylinder4IRV "..." UBYTE Bool_ON_OFF 1 2 0 1 BIT_MASK 0x01 ECU_ADDRESS 0x0 /end MEASUREMENT
/begin MEASUREMENT FDMAve_b_SetHVBattElectricPowerLimToHalf "..." UBYTE Bool_ON_OFF 1 2 0 1 BIT_MASK 0x01 ECU_ADDRESS 0x0 /end MEASUREMENT
/begin MEASUREMENT FDMAve_b_SetHVBattElectricPowerLimToHalfIRV "..." UBYTE Bool_ON_OFF 1 2 0 1 BIT_MASK 0x01 ECU_ADDRESS 0x0 /end MEASUREMENT
/begin MEASUREMENT FDMAve_b_SetICETrqCapToSafeVal "..." UBYTE Bool_ON_OFF 1 2 0 1 BIT_MASK 0x01 ECU_ADDRESS 0x0 /end MEASUREMENT
/begin MEASUREMENT FDMAve_b_SetICETrqCapToSafeValIRV "..." UBYTE Bool_ON_OFF 1 2 0 1 BIT_MASK 0x01 ECU_ADDRESS 0x0 /end MEASUREMENT
/begin MEASUREMENT FDMAve_b_SetLoTempCoolantCircuitPumpFlowHigh "..." UBYTE Bool_ON_OFF 1 2 0 1 BIT_MASK 0x01 ECU_ADDRESS 0x0 /end MEASUREMENT
/begin MEASUREMENT FDMAve_b_SetMAT_ToTempBeforeThrottle "..." UBYTE Bool_ON_OFF 1 2 0 1 BIT_MASK 0x01 ECU_ADDRESS 0x0 /end MEASUREMENT
/begin MEASUREMENT FDMAve_b_SetP1ElectricMotorCapabilityToZero "..." UBYTE Bool_ON_OFF 1 2 0 1 BIT_MASK 0x01 ECU_ADDRESS 0x0 /end MEASUREMENT
/begin MEASUREMENT FDMAve_b_SetP3ElectricMotorCapabilityToZero "..." UBYTE Bool_ON_OFF 1 2 0 1 BIT_MASK 0x01 ECU_ADDRESS 0x0 /end MEASUREMENT
/begin MEASUREMENT FDMAve_b_SetShftLvrPstnToLstKnwnVal "..." UBYTE Bool_ON_OFF 1 2 0 1 BIT_MASK 0x01 ECU_ADDRESS 0x0 /end MEASUREMENT
/begin MEASUREMENT FDMAve_b_SetShftLvrPstnToN "..." UBYTE Bool_ON_OFF 1 2 0 1 BIT_MASK 0x01 ECU_ADDRESS 0x0 /end MEASUREMENT
/begin MEASUREMENT FDMAve_b_SetShftLvrPstnToP "..." UBYTE Bool_ON_OFF 1 2 0 1 BIT_MASK 0x01 ECU_ADDRESS 0x0 /end MEASUREMENT
/begin MEASUREMENT FDMAve_e_ETC_ControlMode "..." UBYTE I_1 1 2 0 255 ECU_ADDRESS 0x0 /end MEASUREMENT
/begin MEASUREMENT FMCU24_CAP_DC "..." UWORD F_1_p0_4 1 2 0 65535 ECU_ADDRESS 0x0 /end MEASUREMENT
/begin MEASUREMENT FMCU24_CAP_current "..." UWORD F_0v01_m327v68_32 1 2 -327.68 327.67 ECU_ADDRESS 0x0 /end MEASUREMENT
/begin MEASUREMENT FMCU24_CAP_speed "..." UWORD F_1_m32768_33 1 2 -32768 32767 ECU_ADDRESS 0x0 /end MEASUREMENT
/begin MEASUREMENT FMCU25_CCP_DC "..." UWORD F_0v1_m3276v8_34 1 2 -3276.8 3276.7 ECU_ADDRESS 0x0 /end MEASUREMENT
/begin MEASUREMENT FMCU25_CCP_current "..." UWORD F_0v01_m327v68_32 1 2 -327.68 327.67 ECU_ADDRESS 0x0 /end MEASUREMENT
/begin MEASUREMENT FMCU25_CCP_speed "..." UWORD F_1_m32768_33 1 2 -32768 32767 ECU_ADDRESS 0x0 /end MEASUREMENT
/begin MEASUREMENT FMCU26_clutch_pressure "..." UWORD F_0v03125_p0_13 1 2 0 2047.96875 ECU_ADDRESS 0x0 /end MEASUREMENT
/begin MEASUREMENT FMCU26_clutch_targetpressure "..." UWORD F_0v03125_p0_13 1 2 0 2047.96875 ECU_ADDRESS 0x0 /end MEASUREMENT
/begin MEASUREMENT FMCU26_oil_temp "..." UBYTE F_1_m40_29 1 2 -40 215 ECU_ADDRESS 0x0 /end MEASUREMENT
/begin MEASUREMENT FMCU8_HTCUFault "..." UBYTE I_1 1 2 0 255 ECU_ADDRESS 0x0 /end MEASUREMENT
/begin MEASUREMENT FMCU8_HTCULimphomeSts "..." UBYTE I_1 1 2 0 255 ECU_ADDRESS 0x0 /end MEASUREMENT
/begin MEASUREMENT FMCU8_OilTemp "..." UBYTE F_1_m40_29 1 2 -40 215 ECU_ADDRESS 0x0 /end MEASUREMENT
/begin MEASUREMENT GCU_ActualTorque "..." SWORD F_0v1_m310_36 1 2 -3586.8 2966.7 ECU_ADDRESS 0x0 /end MEASUREMENT
/begin MEASUREMENT GCU_GeneratorSpd "..." ULONG F_1_m20000_35 1 2 -20000 4294947295 ECU_ADDRESS 0x0 /end MEASUREMENT
/begin MEASUREMENT GCU_MotorTemp "..." UBYTE F_1_m40_29 1 2 -40 215 ECU_ADDRESS 0x0 /end MEASUREMENT
/begin MEASUREMENT GERCve_e_ActualGear "..." UBYTE I_1 1 2 0 255 ECU_ADDRESS 0x0 /end MEASUREMENT
/begin MEASUREMENT GERCve_r_TransP1SpdRatio "..." SWORD F_0v0009765625_p0_22 1 2 -32 31.99902344 ECU_ADDRESS 0x0 /end MEASUREMENT
/begin MEASUREMENT GERCve_r_TransP3SpdRatio "..." SWORD F_0v0009765625_p0_22 1 2 -32 31.99902344 ECU_ADDRESS 0x0 /end MEASUREMENT
/begin MEASUREMENT GSCHte_e_ShiftType "..." UBYTE I_1 1 2 0 255 ECU_ADDRESS 0x0 /end MEASUREMENT
/begin MEASUREMENT GSCHve_b_GearAvailable "..." UBYTE I_1 1 2 0 255 ECU_ADDRESS 0x0 /end MEASUREMENT
/begin MEASUREMENT GSCHve_b_ShiftToSameClutch "..." UBYTE I_1 1 2 0 255 ECU_ADDRESS 0x0 /end MEASUREMENT
/begin MEASUREMENT GSEQve_e_EvenClutchStateReq "..." UBYTE I_1 1 2 0 255 ECU_ADDRESS 0x0 /end MEASUREMENT
/begin MEASUREMENT GSEQve_e_OddClutchStateReq "..." UBYTE I_1 1 2 0 255 ECU_ADDRESS 0x0 /end MEASUREMENT
/begin MEASUREMENT GSEQve_e_ShiftType "..." UBYTE I_1 1 2 0 255 ECU_ADDRESS 0x0 /end MEASUREMENT
/begin MEASUREMENT GSEQve_e_SpdCntrlTrgtCltch "..." UBYTE I_1 1 2 0 255 ECU_ADDRESS 0x0 /end MEASUREMENT
/begin MEASUREMENT GW_IBCMIgnitionSt "..." UBYTE I_1 1 2 0 255 ECU_ADDRESS 0x0 /end MEASUREMENT
/begin MEASUREMENT HBSCve_Pct_HVBattSOC "..." SWORD F_0v1_p0_2 1 2 -3276.8 3276.7 ECU_ADDRESS 0x0 /end MEASUREMENT
/begin MEASUREMENT HETEve_M_P1TotalActuatorDmn "..." SWORD F_0v03125_p0_13 1 2 -1024 1023.96875 ECU_ADDRESS 0x0 /end MEASUREMENT
/begin MEASUREMENT HTCU_ATFailure "..." UBYTE I_1 1 2 0 255 ECU_ADDRESS 0x0 /end MEASUREMENT
/begin MEASUREMENT HTCU_CAP_DC "..." UWORD F_0v1_m3276v8_34 1 2 -3276.8 3276.7 ECU_ADDRESS 0x0 /end MEASUREMENT
/begin MEASUREMENT HTCU_CAP_DutyCycle "..." FLOAT32_IEEE I_1 1 2 -3.402823466E+038 3.402823466E+038 ECU_ADDRESS 0x0 /end MEASUREMENT
/begin MEASUREMENT HTCU_CCPSpd "..." UWORD F_1_m32768_33 1 2 -32768 32767 ECU_ADDRESS 0x0 /end MEASUREMENT
/begin MEASUREMENT HTCU_CCP_DutyCycle "..." FLOAT32_IEEE I_1 1 2 -3.402823466E+038 3.402823466E+038 ECU_ADDRESS 0x0 /end MEASUREMENT
/begin MEASUREMENT HTCU_ClutchActualTransferTorque "..." UWORD F_0v125_m100_24 1 2 -100 8091.875 ECU_ADDRESS 0x0 /end MEASUREMENT
/begin MEASUREMENT HTCU_Clutch_Progress "..." UBYTE I_1 1 2 0 255 ECU_ADDRESS 0x0 /end MEASUREMENT
/begin MEASUREMENT HTCU_ObdCLRReq "..." UBYTE I_1 1 2 0 255 ECU_ADDRESS 0x0 /end MEASUREMENT
/begin MEASUREMENT HTCU_P1_OverTempWarning "..." UBYTE I_1 1 2 0 255 ECU_ADDRESS 0x0 /end MEASUREMENT
/begin MEASUREMENT HTCU_P3_OverTempWarning "..." UBYTE I_1 1 2 0 255 ECU_ADDRESS 0x0 /end MEASUREMENT
/begin MEASUREMENT IPB_vehicleSpeed "..." UWORD F_0v05625_p0_62 1 2 0 3686.34375 ECU_ADDRESS 0x0 /end MEASUREMENT
/begin MEASUREMENT IPB_vehicleSpeedValid "..." UBYTE I_1 1 2 0 255 ECU_ADDRESS 0x0 /end MEASUREMENT
/begin MEASUREMENT IPB_wheelSpeedFL "..." UWORD F_0v05625_p0_62 1 2 0 3686.34375 ECU_ADDRESS 0x0 /end MEASUREMENT
/begin MEASUREMENT IPB_wheelSpeedFLValid "..." UBYTE I_1 1 2 0 255 ECU_ADDRESS 0x0 /end MEASUREMENT
/begin MEASUREMENT IPB_wheelSpeedFR "..." UWORD F_0v05625_p0_62 1 2 0 3686.34375 ECU_ADDRESS 0x0 /end MEASUREMENT
/begin MEASUREMENT IPB_wheelSpeedFRValid "..." UBYTE I_1 1 2 0 255 ECU_ADDRESS 0x0 /end MEASUREMENT
/begin MEASUREMENT IPB_wheelSpeedRL "..." UWORD F_0v05625_p0_62 1 2 0 3686.34375 ECU_ADDRESS 0x0 /end MEASUREMENT
/begin MEASUREMENT IPB_wheelSpeedRLValid "..." UBYTE I_1 1 2 0 255 ECU_ADDRESS 0x0 /end MEASUREMENT
/begin MEASUREMENT IPB_wheelSpeedRR "..." UWORD F_0v05625_p0_62 1 2 0 3686.34375 ECU_ADDRESS 0x0 /end MEASUREMENT
/begin MEASUREMENT IPB_wheelSpeedRRValid "..." UBYTE I_1 1 2 0 255 ECU_ADDRESS 0x0 /end MEASUREMENT
/begin MEASUREMENT LMSCve_dV_LubeFlow "..." SWORD F_0v007813_p0_63 1 2 -256.016384 256.008571 ECU_ADDRESS 0x0 /end MEASUREMENT
/begin MEASUREMENT LSIDve_Cnt_PID_30_Server_Data_IRV "..." UBYTE I_1 1 2 0 255 ECU_ADDRESS 0x0 /end MEASUREMENT
/begin MEASUREMENT LSIDve_NA_VIT_06_Server_Data_IRV "..." ULONG F_1_p0_4 1 2 0 4294967295 ECU_ADDRESS 0x0 /end MEASUREMENT
/begin MEASUREMENT MAIN_VSITxsPwmUl "MAIN_VSITxsPwmUl" UWORD F_0v0061035156_p0_43 1 2 0 399.9938965 ECU_ADDRESS 0x0 /end MEASUREMENT
/begin MEASUREMENT MAIN_VSITxsPwmUlOn "MAIN_VSITxsPwmUlOn" UBYTE Bool_ON_OFF 1 2 0 1 BIT_MASK 0x01 ECU_ADDRESS 0x0 /end MEASUREMENT
/begin MEASUREMENT MAIN_VSITxsPwmUr "MAIN_VSITxsPwmUr" UWORD F_0v0061035156_p0_43 1 2 0 399.9938965 ECU_ADDRESS 0x0 /end MEASUREMENT
/begin MEASUREMENT MAIN_VSITxsPwmUrOn "MAIN_VSITxsPwmUrOn" UBYTE Bool_ON_OFF 1 2 0 1 BIT_MASK 0x01 ECU_ADDRESS 0x0 /end MEASUREMENT
/begin MEASUREMENT MAIN_VSITxsPwmVl "MAIN_VSITxsPwmVl" UWORD F_0v0061035156_p0_43 1 2 0 399.9938965 ECU_ADDRESS 0x0 /end MEASUREMENT
/begin MEASUREMENT MAIN_VSITxsPwmVlOn "MAIN_VSITxsPwmVlOn" UBYTE Bool_ON_OFF 1 2 0 1 BIT_MASK 0x01 ECU_ADDRESS 0x0 /end MEASUREMENT
/begin MEASUREMENT MAIN_VSITxsPwmVr "MAIN_VSITxsPwmVr" UWORD F_0v0061035156_p0_43 1 2 0 399.9938965 ECU_ADDRESS 0x0 /end MEASUREMENT
/begin MEASUREMENT MAIN_VSITxsPwmVrOn "MAIN_VSITxsPwmVrOn" UBYTE Bool_ON_OFF 1 2 0 1 BIT_MASK 0x01 ECU_ADDRESS 0x0 /end MEASUREMENT
/begin MEASUREMENT MAIN_VSITxsPwmWl "MAIN_VSITxsPwmWl" UWORD F_0v0061035156_p0_43 1 2 0 399.9938965 ECU_ADDRESS 0x0 /end MEASUREMENT
/begin MEASUREMENT MAIN_VSITxsPwmWlOn "MAIN_VSITxsPwmWlOn" UBYTE Bool_ON_OFF 1 2 0 1 BIT_MASK 0x01 ECU_ADDRESS 0x0 /end MEASUREMENT
/begin MEASUREMENT MAIN_VSITxsPwmWr "MAIN_VSITxsPwmWr" UWORD F_0v0061035156_p0_43 1 2 0 399.9938965 ECU_ADDRESS 0x0 /end MEASUREMENT
/begin MEASUREMENT MAIN_VSITxsPwmWrOn "MAIN_VSITxsPwmWrOn" UBYTE Bool_ON_OFF 1 2 0 1 BIT_MASK 0x01 ECU_ADDRESS 0x0 /end MEASUREMENT
/begin MEASUREMENT MAIN_u16IuPositiveCnt "..." UWORD I_1 1 2 0 65535 ECU_ADDRESS 0x0 /end MEASUREMENT
/begin MEASUREMENT MAIN_u16IuPositiveSum "..." UWORD I_1 1 2 0 65535 ECU_ADDRESS 0x0 /end MEASUREMENT
/begin MEASUREMENT MAIN_u16MotorStallCnt "..." UWORD I_1 1 2 0 65535 ECU_ADDRESS 0x0 /end MEASUREMENT
/begin MEASUREMENT MAIN_u16OverVolHighDelay "MAIN_u16OverVolHighDelay" UWORD I_1 1 2 0 65535 ECU_ADDRESS 0x0 /end MEASUREMENT
/begin MEASUREMENT MAIN_u16OverVolLowDelay "MAIN_u16OverVolLowDelay" UWORD I_1 1 2 0 65535 ECU_ADDRESS 0x0 /end MEASUREMENT
/begin MEASUREMENT MAIN_u16OverVolMidDelay "MAIN_u16OverVolMidDelay" UWORD I_1 1 2 0 65535 ECU_ADDRESS 0x0 /end MEASUREMENT
/begin MEASUREMENT MAIN_u16PWMPeriodVal "MAIN_u16PWMPeriodVal" UWORD I_1 1 2 0 65535 ECU_ADDRESS 0x0 /end MEASUREMENT
/begin MEASUREMENT MAIN_u16RandomNum "MAIN_u16RandomNum" UWORD I_1 1 2 0 65535 ECU_ADDRESS 0x0 /end MEASUREMENT
/begin MEASUREMENT MAIN_u16ResCosADVal "MAIN_u16ResCosADVal" UWORD I_1 1 2 0 65535 ECU_ADDRESS 0x0 /end MEASUREMENT
/begin MEASUREMENT MAIN_u16ResSinADVal "MAIN_u16ResSinADVal" UWORD I_1 1 2 0 65535 ECU_ADDRESS 0x0 /end MEASUREMENT
/begin MEASUREMENT MAIN_u16SlopSlideTimCnt "..." UWORD I_1 1 2 0 65535 ECU_ADDRESS 0x0 /end MEASUREMENT
/begin MEASUREMENT MAIN_u16SlopSpdConfirmCnt "..." UWORD I_1 1 2 0 65535 ECU_ADDRESS 0x0 /end MEASUREMENT
/begin MEASUREMENT MAIN_u16SpdReadyEstCnt "..." UWORD I_1 1 2 0 65535 ECU_ADDRESS 0x0 /end MEASUREMENT
/begin MEASUREMENT MAIN_u16T12CntVal "MAIN_u16T12CntVal" UWORD I_1 1 2 0 65535 ECU_ADDRESS 0x0 /end MEASUREMENT
/begin MEASUREMENT MAIN_u16TeachInWrtDelayCnt "MAIN_u16TeachInWrtDelayCnt" UWORD I_1 1 2 0 65535 ECU_ADDRESS 0x0 /end MEASUREMENT
/begin MEASUREMENT MAIN_u16VadcBhv "MAIN_u16VadcBhv" UWORD I_1 1 2 0 65535 ECU_ADDRESS 0x0 /end MEASUREMENT
/begin MEASUREMENT MAIN_u16VadcPhaseCurU "MAIN_u16VadcPhaseCurU" UWORD I_1 1 2 0 65535 ECU_ADDRESS 0x0 /end MEASUREMENT
/begin MEASUREMENT MAIN_u16VadcPhaseCurV "MAIN_u16VadcPhaseCurV" UWORD I_1 1 2 0 65535 ECU_ADDRESS 0x0 /end MEASUREMENT
/begin MEASUREMENT MAIN_u16VadcPhaseCurW "MAIN_u16VadcPhaseCurW" UWORD I_1 1 2 0 65535 ECU_ADDRESS 0x0 /end MEASUREMENT
/begin MEASUREMENT MAIN_u32BldcDeltTime "..." ULONG F_0v01_p0_12 1 2 0 42949672.95 ECU_ADDRESS 0x0 /end MEASUREMENT
/begin MEASUREMENT MAIN_u32BldcPattnTreatCnt "..." ULONG I_1 1 2 0 4294967295 ECU_ADDRESS 0x0 /end MEASUREMENT
/begin MEASUREMENT MAIN_u32BldcPwmTreatCnt "..." ULONG I_1 1 2 0 4294967295 ECU_ADDRESS 0x0 /end MEASUREMENT
/begin MEASUREMENT MAIN_u32BldcTimStampA "..." ULONG I_1 1 2 0 4294967295 ECU_ADDRESS 0x0 /end MEASUREMENT
/begin MEASUREMENT MAIN_u32BldcTimStampB "..." ULONG I_1 1 2 0 4294967295 ECU_ADDRESS 0x0 /end MEASUREMENT
/begin MEASUREMENT MAIN_u32EmailCkreq "..." ULONG I_1 1 2 0 4294967295 ECU_ADDRESS 0x0 /end MEASUREMENT
/begin MEASUREMENT MAIN_u32EmailPosATimeStamp "..." ULONG I_1 1 2 0 4294967295 ECU_ADDRESS 0x0 /end MEASUREMENT
/begin MEASUREMENT MAIN_u32IuCycleTim "..." ULONG I_1 1 2 0 4294967295 ECU_ADDRESS 0x0 /end MEASUREMENT
/begin MEASUREMENT MAIN_u32PosATimeStamp "..." ULONG I_1 1 2 0 4294967295 ECU_ADDRESS 0x0 /end MEASUREMENT
/begin MEASUREMENT MAIN_u32PosBTimeStamp "..." ULONG I_1 1 2 0 4294967295 ECU_ADDRESS 0x0 /end MEASUREMENT
/begin MEASUREMENT MAIN_u32PosTreatCkreq "..." ULONG I_1 1 2 0 4294967295 ECU_ADDRESS 0x0 /end MEASUREMENT
/begin MEASUREMENT MAIN_u32PositionStartTime "..." ULONG F_0v01_p0_20 1 2 0 42949672.95 ECU_ADDRESS 0x0 /end MEASUREMENT
/begin MEASUREMENT MAIN_u32PositionStopTime "..." ULONG F_0v01_p0_20 1 2 0 42949672.95 ECU_ADDRESS 0x0 /end MEASUREMENT
/begin MEASUREMENT MAIN_u32PositionTotalTime "..." ULONG F_0v01_p0_20 1 2 0 42949672.95 ECU_ADDRESS 0x0 /end MEASUREMENT
/begin MEASUREMENT MAIN_u32Task100msC1StartTime "..." ULONG F_0v01_p0_20 1 2 0 42949672.95 ECU_ADDRESS 0x0 /end MEASUREMENT
/begin MEASUREMENT MAIN_u32Task100msC1StopTime "..." ULONG F_0v01_p0_20 1 2 0 42949672.95 ECU_ADDRESS 0x0 /end MEASUREMENT
/begin MEASUREMENT MAIN_u32Task100msC1TotalTime "..." ULONG F_0v01_p0_20 1 2 0 42949672.95 ECU_ADDRESS 0x0 /end MEASUREMENT
/begin MEASUREMENT MAIN_u32Task100msC2StartTime "..." ULONG F_0v01_p0_20 1 2 0 42949672.95 ECU_ADDRESS 0x0 /end MEASUREMENT
/begin MEASUREMENT MAIN_u32Task100msC2StopTime "..." ULONG F_0v01_p0_20 1 2 0 42949672.95 ECU_ADDRESS 0x0 /end MEASUREMENT
/begin MEASUREMENT MAIN_u32Task100msC2TotalTime "..." ULONG F_0v01_p0_20 1 2 0 42949672.95 ECU_ADDRESS 0x0 /end MEASUREMENT
/begin MEASUREMENT MAIN_u32Task10msC1StartTime "..." ULONG F_0v01_p0_20 1 2 0 42949672.95 ECU_ADDRESS 0x0 /end MEASUREMENT
/begin MEASUREMENT MAIN_u32Task10msC1StopTime "..." ULONG F_0v01_p0_20 1 2 0 42949672.95 ECU_ADDRESS 0x0 /end MEASUREMENT
/begin MEASUREMENT MAIN_u32Task10msC1TotalTime "..." ULONG F_0v01_p0_20 1 2 0 42949672.95 ECU_ADDRESS 0x0 /end MEASUREMENT
/begin MEASUREMENT MAIN_u32Task10msC2StartTime "..." ULONG F_0v01_p0_20 1 2 0 42949672.95 ECU_ADDRESS 0x0 /end MEASUREMENT
/begin MEASUREMENT MAIN_u32Task10msC2StopTime "..." ULONG F_0v01_p0_20 1 2 0 42949672.95 ECU_ADDRESS 0x0 /end MEASUREMENT
/begin MEASUREMENT MAIN_u32Task10msC2TotalTime "..." ULONG F_0v01_p0_20 1 2 0 42949672.95 ECU_ADDRESS 0x0 /end MEASUREMENT
/begin MEASUREMENT MAIN_u32Task1msC2StartTime "..." ULONG F_0v01_p0_20 1 2 0 42949672.95 ECU_ADDRESS 0x0 /end MEASUREMENT
/begin MEASUREMENT MAIN_u32Task1msC2StopTime "..." ULONG F_0v01_p0_20 1 2 0 42949672.95 ECU_ADDRESS 0x0 /end MEASUREMENT
/begin MEASUREMENT MAIN_u32Task1msC2TotalTime "..." ULONG F_0v01_p0_20 1 2 0 42949672.95 ECU_ADDRESS 0x0 /end MEASUREMENT
/begin MEASUREMENT MAIN_u32Task1msStartTime "..." ULONG F_0v01_p0_20 1 2 0 42949672.95 ECU_ADDRESS 0x0 /end MEASUREMENT
/begin MEASUREMENT MAIN_u32Task1msStopTime "..." ULONG F_0v01_p0_20 1 2 0 42949672.95 ECU_ADDRESS 0x0 /end MEASUREMENT
/begin MEASUREMENT MAIN_u32Task1msTotalTime "..." ULONG F_0v01_p0_20 1 2 0 42949672.95 ECU_ADDRESS 0x0 /end MEASUREMENT
/begin MEASUREMENT MAIN_u32Task200msC1StartTime "..." ULONG F_0v01_p0_20 1 2 0 42949672.95 ECU_ADDRESS 0x0 /end MEASUREMENT
/begin MEASUREMENT MAIN_u32Task200msC1StopTime "..." ULONG F_0v01_p0_20 1 2 0 42949672.95 ECU_ADDRESS 0x0 /end MEASUREMENT
/begin MEASUREMENT MAIN_u32Task200msC1TotalTime "..." ULONG F_0v01_p0_20 1 2 0 42949672.95 ECU_ADDRESS 0x0 /end MEASUREMENT
/begin MEASUREMENT MAIN_u32Task2msC2StartTime "..." ULONG F_0v01_p0_20 1 2 0 42949672.95 ECU_ADDRESS 0x0 /end MEASUREMENT
/begin MEASUREMENT MAIN_u32Task2msC2StopTime "..." ULONG F_0v01_p0_20 1 2 0 42949672.95 ECU_ADDRESS 0x0 /end MEASUREMENT
/begin MEASUREMENT MAIN_u32Task2msC2TotalTime "..." ULONG F_0v01_p0_20 1 2 0 42949672.95 ECU_ADDRESS 0x0 /end MEASUREMENT
/begin MEASUREMENT MAIN_u32Task2msStartTime "..." ULONG F_0v01_p0_20 1 2 0 42949672.95 ECU_ADDRESS 0x0 /end MEASUREMENT
/begin MEASUREMENT MAIN_u32Task2msStopTime "..." ULONG F_0v01_p0_20 1 2 0 42949672.95 ECU_ADDRESS 0x0 /end MEASUREMENT
/begin MEASUREMENT MAIN_u32Task2msTotalTime "..." ULONG F_0v01_p0_20 1 2 0 42949672.95 ECU_ADDRESS 0x0 /end MEASUREMENT
/begin MEASUREMENT MAIN_u32Task5msC2StartTime "..." ULONG F_0v01_p0_20 1 2 0 42949672.95 ECU_ADDRESS 0x0 /end MEASUREMENT
/begin MEASUREMENT MAIN_u32Task5msC2StopTime "..." ULONG F_0v01_p0_20 1 2 0 42949672.95 ECU_ADDRESS 0x0 /end MEASUREMENT
/begin MEASUREMENT MAIN_u32Task5msC2TotalTime "..." ULONG F_0v01_p0_20 1 2 0 42949672.95 ECU_ADDRESS 0x0 /end MEASUREMENT
/begin MEASUREMENT MAIN_u32Task5msStartTime "..." ULONG F_0v01_p0_20 1 2 0 42949672.95 ECU_ADDRESS 0x0 /end MEASUREMENT
/begin MEASUREMENT MAIN_u32Task5msStopTime "..." ULONG F_0v01_p0_20 1 2 0 42949672.95 ECU_ADDRESS 0x0 /end MEASUREMENT
/begin MEASUREMENT MAIN_u32Task5msTotalTime "..." ULONG F_0v01_p0_20 1 2 0 42949672.95 ECU_ADDRESS 0x0 /end MEASUREMENT
/begin MEASUREMENT MAIN_u32TestVar2 "MAIN_u32TestVar2" ULONG I_1 1 2 0 4294967295 ECU_ADDRESS 0x0 /end MEASUREMENT
/begin MEASUREMENT MAIN_u32TestVar4 "MAIN_u32TestVar4" ULONG I_1 1 2 0 4294967295 ECU_ADDRESS 0x0 /end MEASUREMENT
/begin MEASUREMENT MAIN_u32WaitValueVSISafeTreatment "Additional wait value for VSISafeTreatment function (debug)" ULONG F_0v055_p0_53 1 2 0 236223201.2 ECU_ADDRESS 0x0 /end MEASUREMENT
/begin MEASUREMENT MAIN_u32WaitValueVSITreatment "Additional wait value for VSITreatment function (debug)" ULONG F_0v02_p0_54 1 2 0 85899345.9 ECU_ADDRESS 0x0 /end MEASUREMENT
/begin MEASUREMENT MAIN_u8BldcFaultLevel "MAIN_u8BldcFaultLevel" UBYTE I_1 1 2 0 255 ECU_ADDRESS 0x0 /end MEASUREMENT
/begin MEASUREMENT MAIN_u8BldcHallStt "MAIN_u8BldcHallStt" UBYTE I_1 1 2 0 255 ECU_ADDRESS 0x0 /end MEASUREMENT
/begin MEASUREMENT MAIN_u8BldcHallSttPre "MAIN_u8BldcHallSttPre" UBYTE I_1 1 2 0 255 ECU_ADDRESS 0x0 /end MEASUREMENT
/begin MEASUREMENT MAIN_u8BldcMotDir "MAIN_u8BldcMotDir" UBYTE I_1 1 2 0 255 ECU_ADDRESS 0x0 /end MEASUREMENT
/begin MEASUREMENT MAIN_u8ErrCodNum "MAIN_u8ErrCodNum" UBYTE I_1 1 2 0 255 ECU_ADDRESS 0x0 /end MEASUREMENT
/begin MEASUREMENT MAIN_u8ErrCodRdIdx "MAIN_u8ErrCodRdIdx" UBYTE I_1 1 2 0 255 ECU_ADDRESS 0x0 /end MEASUREMENT
/begin MEASUREMENT MAIN_u8ErrCodWrIdx "MAIN_u8ErrCodWrIdx" UBYTE I_1 1 2 0 255 ECU_ADDRESS 0x0 /end MEASUREMENT
/begin MEASUREMENT MAIN_u8FaultSum "..." UBYTE I_1 1 2 0 255 ECU_ADDRESS 0x0 /end MEASUREMENT
/begin MEASUREMENT MAIN_u8OcState "MAIN_u8OcState" UBYTE I_1 1 2 0 255 ECU_ADDRESS 0x0 /end MEASUREMENT
/begin MEASUREMENT MAIN_u8OcStsRptDelayCnt "MAIN_u8OcStsRptDelayCnt" UBYTE I_1 1 2 0 255 ECU_ADDRESS 0x0 /end MEASUREMENT
/begin MEASUREMENT MAIN_u8OverVolIndex "MAIN_u8OverVolIndex" UBYTE I_1 1 2 0 255 ECU_ADDRESS 0x0 /end MEASUREMENT
/begin MEASUREMENT MAIN_u8PrevGearPos "..." UBYTE I_1 1 2 0 255 ECU_ADDRESS 0x0 /end MEASUREMENT
/begin MEASUREMENT MAIN_u8TcFaultCodeL3 "MAIN_u8TcFaultCodeL3" UBYTE I_1 1 2 0 255 ECU_ADDRESS 0x0 /end MEASUREMENT
/begin MEASUREMENT MAIN_u8TcFaultCodeL5 "MAIN_u8TcFaultCodeL5" UBYTE I_1 1 2 0 255 ECU_ADDRESS 0x0 /end MEASUREMENT
/begin MEASUREMENT MAIN_u8TestVar1 "MAIN_u8TestVar1" UBYTE I_1 1 2 0 255 ECU_ADDRESS 0x0 /end MEASUREMENT
/begin MEASUREMENT MAIN_u8TrigOcByUser "MAIN_u8TrigOcByUser" UBYTE I_1 1 2 0 255 ECU_ADDRESS 0x0 /end MEASUREMENT
/begin MEASUREMENT MAIN_u8UdsSwVerSup "..." UBYTE Id_0x00 1 2 0 255 MATRIX_DIM 21 1 1 ECU_ADDRESS 0x0 /end MEASUREMENT
/begin MEASUREMENT MAIN_u8UdsSwVerSup[0] "MAIN_u8UdsSwVerSup[0]" UBYTE Id_0x00 1 2 0 255 ECU_ADDRESS 0x0 /end MEASUREMENT
/begin MEASUREMENT MAIN_u8UdsSwVerSup[10] "MAIN_u8UdsSwVerSup[10]" UBYTE Id_0x00 1 2 0 255 ECU_ADDRESS 0x0 /end MEASUREMENT
/begin MEASUREMENT MAIN_u8UdsSwVerSup[11] "MAIN_u8UdsSwVerSup[11]" UBYTE Id_0x00 1 2 0 255 ECU_ADDRESS 0x0 /end MEASUREMENT
/begin MEASUREMENT MAIN_u8UdsSwVerSup[12] "MAIN_u8UdsSwVerSup[12]" UBYTE Id_0x00 1 2 0 255 ECU_ADDRESS 0x0 /end MEASUREMENT
/begin MEASUREMENT MAIN_u8UdsSwVerSup[13] "MAIN_u8UdsSwVerSup[13]" UBYTE Id_0x00 1 2 0 255 ECU_ADDRESS 0x0 /end MEASUREMENT
/begin MEASUREMENT MAIN_u8UdsSwVerSup[14] "MAIN_u8UdsSwVerSup[14]" UBYTE Id_0x00 1 2 0 255 ECU_ADDRESS 0x0 /end MEASUREMENT
/begin MEASUREMENT MAIN_u8UdsSwVerSup[15] "MAIN_u8UdsSwVerSup[15]" UBYTE Id_0x00 1 2 0 255 ECU_ADDRESS 0x0 /end MEASUREMENT
/begin MEASUREMENT MAIN_u8UdsSwVerSup[16] "MAIN_u8UdsSwVerSup[16]" UBYTE Id_0x00 1 2 0 255 ECU_ADDRESS 0x0 /end MEASUREMENT
/begin MEASUREMENT MAIN_u8UdsSwVerSup[17] "MAIN_u8UdsSwVerSup[17]" UBYTE Id_0x00 1 2 0 255 ECU_ADDRESS 0x0 /end MEASUREMENT
/begin MEASUREMENT MAIN_u8UdsSwVerSup[18] "MAIN_u8UdsSwVerSup[18]" UBYTE Id_0x00 1 2 0 255 ECU_ADDRESS 0x0 /end MEASUREMENT
/begin MEASUREMENT MAIN_u8UdsSwVerSup[19] "MAIN_u8UdsSwVerSup[19]" UBYTE Id_0x00 1 2 0 255 ECU_ADDRESS 0x0 /end MEASUREMENT
/begin MEASUREMENT MAIN_u8UdsSwVerSup[1] "MAIN_u8UdsSwVerSup[1]" UBYTE Id_0x00 1 2 0 255 ECU_ADDRESS 0x0 /end MEASUREMENT
/begin MEASUREMENT MAIN_u8UdsSwVerSup[20] "MAIN_u8UdsSwVerSup[20]" UBYTE Id_0x00 1 2 0 255 ECU_ADDRESS 0x0 /end MEASUREMENT
/begin MEASUREMENT MAIN_u8UdsSwVerSup[2] "MAIN_u8UdsSwVerSup[2]" UBYTE Id_0x00 1 2 0 255 ECU_ADDRESS 0x0 /end MEASUREMENT
/begin MEASUREMENT MAIN_u8UdsSwVerSup[3] "MAIN_u8UdsSwVerSup[3]" UBYTE Id_0x00 1 2 0 255 ECU_ADDRESS 0x0 /end MEASUREMENT
/begin MEASUREMENT MAIN_u8UdsSwVerSup[4] "MAIN_u8UdsSwVerSup[4]" UBYTE Id_0x00 1 2 0 255 ECU_ADDRESS 0x0 /end MEASUREMENT
/begin MEASUREMENT MAIN_u8UdsSwVerSup[5] "MAIN_u8UdsSwVerSup[5]" UBYTE Id_0x00 1 2 0 255 ECU_ADDRESS 0x0 /end MEASUREMENT
/begin MEASUREMENT MAIN_u8UdsSwVerSup[6] "MAIN_u8UdsSwVerSup[6]" UBYTE Id_0x00 1 2 0 255 ECU_ADDRESS 0x0 /end MEASUREMENT
/begin MEASUREMENT MAIN_u8UdsSwVerSup[7] "MAIN_u8UdsSwVerSup[7]" UBYTE Id_0x00 1 2 0 255 ECU_ADDRESS 0x0 /end MEASUREMENT
/begin MEASUREMENT MAIN_u8UdsSwVerSup[8] "MAIN_u8UdsSwVerSup[8]" UBYTE Id_0x00 1 2 0 255 ECU_ADDRESS 0x0 /end MEASUREMENT
/begin MEASUREMENT MAIN_u8UdsSwVerSup[9] "MAIN_u8UdsSwVerSup[9]" UBYTE Id_0x00 1 2 0 255 ECU_ADDRESS 0x0 /end MEASUREMENT
/begin MEASUREMENT MAIN_u8UdsSwVerVeh "..." UBYTE Id_0x00 1 2 0 255 MATRIX_DIM 13 1 1 ECU_ADDRESS 0x0 /end MEASUREMENT
/begin MEASUREMENT MAIN_u8UdsSwVerVeh[0] "MAIN_u8UdsSwVerVeh[0]" UBYTE Id_0x00 1 2 0 255 ECU_ADDRESS 0x0 /end MEASUREMENT
/begin MEASUREMENT MAIN_u8UdsSwVerVeh[10] "MAIN_u8UdsSwVerVeh[10]" UBYTE Id_0x00 1 2 0 255 ECU_ADDRESS 0x0 /end MEASUREMENT
/begin MEASUREMENT MAIN_u8UdsSwVerVeh[11] "MAIN_u8UdsSwVerVeh[11]" UBYTE Id_0x00 1 2 0 255 ECU_ADDRESS 0x0 /end MEASUREMENT
/begin MEASUREMENT MAIN_u8UdsSwVerVeh[12] "MAIN_u8UdsSwVerVeh[12]" UBYTE Id_0x00 1 2 0 255 ECU_ADDRESS 0x0 /end MEASUREMENT
/begin MEASUREMENT MAIN_u8UdsSwVerVeh[1] "MAIN_u8UdsSwVerVeh[1]" UBYTE Id_0x00 1 2 0 255 ECU_ADDRESS 0x0 /end MEASUREMENT
/begin MEASUREMENT MAIN_u8UdsSwVerVeh[2] "MAIN_u8UdsSwVerVeh[2]" UBYTE Id_0x00 1 2 0 255 ECU_ADDRESS 0x0 /end MEASUREMENT
/begin MEASUREMENT MAIN_u8UdsSwVerVeh[3] "MAIN_u8UdsSwVerVeh[3]" UBYTE Id_0x00 1 2 0 255 ECU_ADDRESS 0x0 /end MEASUREMENT
/begin MEASUREMENT MAIN_u8UdsSwVerVeh[4] "MAIN_u8UdsSwVerVeh[4]" UBYTE Id_0x00 1 2 0 255 ECU_ADDRESS 0x0 /end MEASUREMENT
/begin MEASUREMENT MAIN_u8UdsSwVerVeh[5] "MAIN_u8UdsSwVerVeh[5]" UBYTE Id_0x00 1 2 0 255 ECU_ADDRESS 0x0 /end MEASUREMENT
/begin MEASUREMENT MAIN_u8UdsSwVerVeh[6] "MAIN_u8UdsSwVerVeh[6]" UBYTE Id_0x00 1 2 0 255 ECU_ADDRESS 0x0 /end MEASUREMENT
/begin MEASUREMENT MAIN_u8UdsSwVerVeh[7] "MAIN_u8UdsSwVerVeh[7]" UBYTE Id_0x00 1 2 0 255 ECU_ADDRESS 0x0 /end MEASUREMENT
/begin MEASUREMENT MAIN_u8UdsSwVerVeh[8] "MAIN_u8UdsSwVerVeh[8]" UBYTE Id_0x00 1 2 0 255 ECU_ADDRESS 0x0 /end MEASUREMENT
/begin MEASUREMENT MAIN_u8UdsSwVerVeh[9] "MAIN_u8UdsSwVerVeh[9]" UBYTE Id_0x00 1 2 0 255 ECU_ADDRESS 0x0 /end MEASUREMENT
/begin MEASUREMENT MCUF_ActualTorque "..." SWORD F_0v1_m450_64 1 2 -3726.8 2826.7 ECU_ADDRESS 0x0 /end MEASUREMENT
/begin MEASUREMENT MCUF_MotorPower "..." UWORD F_0v1_m260_65 1 2 -260 6293.5 ECU_ADDRESS 0x0 /end MEASUREMENT
/begin MEASUREMENT MCUF_MotorSpd "..." UWORD F_1_m20000_35 1 2 -20000 45535 ECU_ADDRESS 0x0 /end MEASUREMENT
/begin MEASUREMENT MCUF_MotorTemp "..." UBYTE F_1_m40_29 1 2 -40 215 ECU_ADDRESS 0x0 /end MEASUREMENT
/begin MEASUREMENT MILDve_e_MIL_RequestState "..." UBYTE I_1 1 2 0 255 ECU_ADDRESS 0x0 /end MEASUREMENT
/begin MEASUREMENT MosSWOverCurrent "..." UBYTE I_1 1 2 0 255 ECU_ADDRESS 0x0 /end MEASUREMENT
/begin MEASUREMENT OBD_au8McuDtcPath "OBD_au8McuDtcPath" UBYTE I_1 1 2 0 255 MATRIX_DIM 120 1 1 ECU_ADDRESS 0x0 /end MEASUREMENT
/begin MEASUREMENT OBD_au8McuDtcPath[0] "OBD_au8McuDtcPath[0]" UBYTE I_1 1 2 0 255 ECU_ADDRESS 0x0 /end MEASUREMENT
/begin MEASUREMENT OBD_au8McuDtcPath[100] "OBD_au8McuDtcPath[100]" UBYTE I_1 1 2 0 255 ECU_ADDRESS 0x0 /end MEASUREMENT
/begin MEASUREMENT OBD_au8McuDtcPath[101] "OBD_au8McuDtcPath[101]" UBYTE I_1 1 2 0 255 ECU_ADDRESS 0x0 /end MEASUREMENT
/begin MEASUREMENT OBD_au8McuDtcPath[102] "OBD_au8McuDtcPath[102]" UBYTE I_1 1 2 0 255 ECU_ADDRESS 0x0 /end MEASUREMENT
/begin MEASUREMENT OBD_au8McuDtcPath[103] "OBD_au8McuDtcPath[103]" UBYTE I_1 1 2 0 255 ECU_ADDRESS 0x0 /end MEASUREMENT
/begin MEASUREMENT OBD_au8McuDtcPath[104] "OBD_au8McuDtcPath[104]" UBYTE I_1 1 2 0 255 ECU_ADDRESS 0x0 /end MEASUREMENT
/begin MEASUREMENT OBD_au8McuDtcPath[105] "OBD_au8McuDtcPath[105]" UBYTE I_1 1 2 0 255 ECU_ADDRESS 0x0 /end MEASUREMENT
/begin MEASUREMENT OBD_au8McuDtcPath[106] "OBD_au8McuDtcPath[106]" UBYTE I_1 1 2 0 255 ECU_ADDRESS 0x0 /end MEASUREMENT
/begin MEASUREMENT OBD_au8McuDtcPath[107] "OBD_au8McuDtcPath[107]" UBYTE I_1 1 2 0 255 ECU_ADDRESS 0x0 /end MEASUREMENT
/begin MEASUREMENT OBD_au8McuDtcPath[108] "OBD_au8McuDtcPath[108]" UBYTE I_1 1 2 0 255 ECU_ADDRESS 0x0 /end MEASUREMENT
/begin MEASUREMENT OBD_au8McuDtcPath[109] "OBD_au8McuDtcPath[109]" UBYTE I_1 1 2 0 255 ECU_ADDRESS 0x0 /end MEASUREMENT
/begin MEASUREMENT OBD_au8McuDtcPath[10] "OBD_au8McuDtcPath[10]" UBYTE I_1 1 2 0 255 ECU_ADDRESS 0x0 /end MEASUREMENT
/begin MEASUREMENT OBD_au8McuDtcPath[110] "OBD_au8McuDtcPath[110]" UBYTE I_1 1 2 0 255 ECU_ADDRESS 0x0 /end MEASUREMENT
/begin MEASUREMENT OBD_au8McuDtcPath[111] "OBD_au8McuDtcPath[111]" UBYTE I_1 1 2 0 255 ECU_ADDRESS 0x0 /end MEASUREMENT
/begin MEASUREMENT OBD_au8McuDtcPath[112] "OBD_au8McuDtcPath[112]" UBYTE I_1 1 2 0 255 ECU_ADDRESS 0x0 /end MEASUREMENT
/begin MEASUREMENT OBD_au8McuDtcPath[113] "OBD_au8McuDtcPath[113]" UBYTE I_1 1 2 0 255 ECU_ADDRESS 0x0 /end MEASUREMENT
/begin MEASUREMENT OBD_au8McuDtcPath[114] "OBD_au8McuDtcPath[114]" UBYTE I_1 1 2 0 255 ECU_ADDRESS 0x0 /end MEASUREMENT
/begin MEASUREMENT OBD_au8McuDtcPath[115] "OBD_au8McuDtcPath[115]" UBYTE I_1 1 2 0 255 ECU_ADDRESS 0x0 /end MEASUREMENT
/begin MEASUREMENT OBD_au8McuDtcPath[116] "OBD_au8McuDtcPath[116]" UBYTE I_1 1 2 0 255 ECU_ADDRESS 0x0 /end MEASUREMENT
/begin MEASUREMENT OBD_au8McuDtcPath[117] "OBD_au8McuDtcPath[117]" UBYTE I_1 1 2 0 255 ECU_ADDRESS 0x0 /end MEASUREMENT
/begin MEASUREMENT OBD_au8McuDtcPath[118] "OBD_au8McuDtcPath[118]" UBYTE I_1 1 2 0 255 ECU_ADDRESS 0x0 /end MEASUREMENT
/begin MEASUREMENT OBD_au8McuDtcPath[119] "OBD_au8McuDtcPath[119]" UBYTE I_1 1 2 0 255 ECU_ADDRESS 0x0 /end MEASUREMENT
/begin MEASUREMENT OBD_au8McuDtcPath[11] "OBD_au8McuDtcPath[11]" UBYTE I_1 1 2 0 255 ECU_ADDRESS 0x0 /end MEASUREMENT
/begin MEASUREMENT OBD_au8McuDtcPath[12] "OBD_au8McuDtcPath[12]" UBYTE I_1 1 2 0 255 ECU_ADDRESS 0x0 /end MEASUREMENT
/begin MEASUREMENT OBD_au8McuDtcPath[13] "OBD_au8McuDtcPath[13]" UBYTE I_1 1 2 0 255 ECU_ADDRESS 0x0 /end MEASUREMENT
/begin MEASUREMENT OBD_au8McuDtcPath[14] "OBD_au8McuDtcPath[14]" UBYTE I_1 1 2 0 255 ECU_ADDRESS 0x0 /end MEASUREMENT
/begin MEASUREMENT OBD_au8McuDtcPath[15] "OBD_au8McuDtcPath[15]" UBYTE I_1 1 2 0 255 ECU_ADDRESS 0x0 /end MEASUREMENT
/begin MEASUREMENT OBD_au8McuDtcPath[16] "OBD_au8McuDtcPath[16]" UBYTE I_1 1 2 0 255 ECU_ADDRESS 0x0 /end MEASUREMENT
/begin MEASUREMENT OBD_au8McuDtcPath[17] "OBD_au8McuDtcPath[17]" UBYTE I_1 1 2 0 255 ECU_ADDRESS 0x0 /end MEASUREMENT
/begin MEASUREMENT OBD_au8McuDtcPath[18] "OBD_au8McuDtcPath[18]" UBYTE I_1 1 2 0 255 ECU_ADDRESS 0x0 /end MEASUREMENT
/begin MEASUREMENT OBD_au8McuDtcPath[19] "OBD_au8McuDtcPath[19]" UBYTE I_1 1 2 0 255 ECU_ADDRESS 0x0 /end MEASUREMENT
/begin MEASUREMENT OBD_au8McuDtcPath[1] "OBD_au8McuDtcPath[1]" UBYTE I_1 1 2 0 255 ECU_ADDRESS 0x0 /end MEASUREMENT
/begin MEASUREMENT OBD_au8McuDtcPath[20] "OBD_au8McuDtcPath[20]" UBYTE I_1 1 2 0 255 ECU_ADDRESS 0x0 /end MEASUREMENT
/begin MEASUREMENT OBD_au8McuDtcPath[21] "OBD_au8McuDtcPath[21]" UBYTE I_1 1 2 0 255 ECU_ADDRESS 0x0 /end MEASUREMENT
/begin MEASUREMENT OBD_au8McuDtcPath[22] "OBD_au8McuDtcPath[22]" UBYTE I_1 1 2 0 255 ECU_ADDRESS 0x0 /end MEASUREMENT
/begin MEASUREMENT OBD_au8McuDtcPath[23] "OBD_au8McuDtcPath[23]" UBYTE I_1 1 2 0 255 ECU_ADDRESS 0x0 /end MEASUREMENT
/begin MEASUREMENT OBD_au8McuDtcPath[24] "OBD_au8McuDtcPath[24]" UBYTE I_1 1 2 0 255 ECU_ADDRESS 0x0 /end MEASUREMENT
/begin MEASUREMENT OBD_au8McuDtcPath[25] "OBD_au8McuDtcPath[25]" UBYTE I_1 1 2 0 255 ECU_ADDRESS 0x0 /end MEASUREMENT
/begin MEASUREMENT OBD_au8McuDtcPath[26] "OBD_au8McuDtcPath[26]" UBYTE I_1 1 2 0 255 ECU_ADDRESS 0x0 /end MEASUREMENT
/begin MEASUREMENT OBD_au8McuDtcPath[27] "OBD_au8McuDtcPath[27]" UBYTE I_1 1 2 0 255 ECU_ADDRESS 0x0 /end MEASUREMENT
/begin MEASUREMENT OBD_au8McuDtcPath[28] "OBD_au8McuDtcPath[28]" UBYTE I_1 1 2 0 255 ECU_ADDRESS 0x0 /end MEASUREMENT
/begin MEASUREMENT OBD_au8McuDtcPath[29] "OBD_au8McuDtcPath[29]" UBYTE I_1 1 2 0 255 ECU_ADDRESS 0x0 /end MEASUREMENT
/begin MEASUREMENT OBD_au8McuDtcPath[2] "OBD_au8McuDtcPath[2]" UBYTE I_1 1 2 0 255 ECU_ADDRESS 0x0 /end MEASUREMENT
/begin MEASUREMENT OBD_au8McuDtcPath[30] "OBD_au8McuDtcPath[30]" UBYTE I_1 1 2 0 255 ECU_ADDRESS 0x0 /end MEASUREMENT
/begin MEASUREMENT OBD_au8McuDtcPath[31] "OBD_au8McuDtcPath[31]" UBYTE I_1 1 2 0 255 ECU_ADDRESS 0x0 /end MEASUREMENT
/begin MEASUREMENT OBD_au8McuDtcPath[32] "OBD_au8McuDtcPath[32]" UBYTE I_1 1 2 0 255 ECU_ADDRESS 0x0 /end MEASUREMENT
/begin MEASUREMENT OBD_au8McuDtcPath[33] "OBD_au8McuDtcPath[33]" UBYTE I_1 1 2 0 255 ECU_ADDRESS 0x0 /end MEASUREMENT
/begin MEASUREMENT OBD_au8McuDtcPath[34] "OBD_au8McuDtcPath[34]" UBYTE I_1 1 2 0 255 ECU_ADDRESS 0x0 /end MEASUREMENT
/begin MEASUREMENT OBD_au8McuDtcPath[35] "OBD_au8McuDtcPath[35]" UBYTE I_1 1 2 0 255 ECU_ADDRESS 0x0 /end MEASUREMENT
/begin MEASUREMENT OBD_au8McuDtcPath[36] "OBD_au8McuDtcPath[36]" UBYTE I_1 1 2 0 255 ECU_ADDRESS 0x0 /end MEASUREMENT
/begin MEASUREMENT OBD_au8McuDtcPath[37] "OBD_au8McuDtcPath[37]" UBYTE I_1 1 2 0 255 ECU_ADDRESS 0x0 /end MEASUREMENT
/begin MEASUREMENT OBD_au8McuDtcPath[38] "OBD_au8McuDtcPath[38]" UBYTE I_1 1 2 0 255 ECU_ADDRESS 0x0 /end MEASUREMENT
/begin MEASUREMENT OBD_au8McuDtcPath[39] "OBD_au8McuDtcPath[39]" UBYTE I_1 1 2 0 255 ECU_ADDRESS 0x0 /end MEASUREMENT
/begin MEASUREMENT OBD_au8McuDtcPath[3] "OBD_au8McuDtcPath[3]" UBYTE I_1 1 2 0 255 ECU_ADDRESS 0x0 /end MEASUREMENT
/begin MEASUREMENT OBD_au8McuDtcPath[40] "OBD_au8McuDtcPath[40]" UBYTE I_1 1 2 0 255 ECU_ADDRESS 0x0 /end MEASUREMENT
/begin MEASUREMENT OBD_au8McuDtcPath[41] "OBD_au8McuDtcPath[41]" UBYTE I_1 1 2 0 255 ECU_ADDRESS 0x0 /end MEASUREMENT
/begin MEASUREMENT OBD_au8McuDtcPath[42] "OBD_au8McuDtcPath[42]" UBYTE I_1 1 2 0 255 ECU_ADDRESS 0x0 /end MEASUREMENT
/begin MEASUREMENT OBD_au8McuDtcPath[43] "OBD_au8McuDtcPath[43]" UBYTE I_1 1 2 0 255 ECU_ADDRESS 0x0 /end MEASUREMENT
/begin MEASUREMENT OBD_au8McuDtcPath[44] "OBD_au8McuDtcPath[44]" UBYTE I_1 1 2 0 255 ECU_ADDRESS 0x0 /end MEASUREMENT
/begin MEASUREMENT OBD_au8McuDtcPath[45] "OBD_au8McuDtcPath[45]" UBYTE I_1 1 2 0 255 ECU_ADDRESS 0x0 /end MEASUREMENT
/begin MEASUREMENT OBD_au8McuDtcPath[46] "OBD_au8McuDtcPath[46]" UBYTE I_1 1 2 0 255 ECU_ADDRESS 0x0 /end MEASUREMENT
/begin MEASUREMENT OBD_au8McuDtcPath[47] "OBD_au8McuDtcPath[47]" UBYTE I_1 1 2 0 255 ECU_ADDRESS 0x0 /end MEASUREMENT
/begin MEASUREMENT OBD_au8McuDtcPath[48] "OBD_au8McuDtcPath[48]" UBYTE I_1 1 2 0 255 ECU_ADDRESS 0x0 /end MEASUREMENT
/begin MEASUREMENT OBD_au8McuDtcPath[49] "OBD_au8McuDtcPath[49]" UBYTE I_1 1 2 0 255 ECU_ADDRESS 0x0 /end MEASUREMENT
/begin MEASUREMENT OBD_au8McuDtcPath[4] "OBD_au8McuDtcPath[4]" UBYTE I_1 1 2 0 255 ECU_ADDRESS 0x0 /end MEASUREMENT
/begin MEASUREMENT OBD_au8McuDtcPath[50] "OBD_au8McuDtcPath[50]" UBYTE I_1 1 2 0 255 ECU_ADDRESS 0x0 /end MEASUREMENT
/begin MEASUREMENT OBD_au8McuDtcPath[51] "OBD_au8McuDtcPath[51]" UBYTE I_1 1 2 0 255 ECU_ADDRESS 0x0 /end MEASUREMENT
/begin MEASUREMENT OBD_au8McuDtcPath[52] "OBD_au8McuDtcPath[52]" UBYTE I_1 1 2 0 255 ECU_ADDRESS 0x0 /end MEASUREMENT
/begin MEASUREMENT OBD_au8McuDtcPath[53] "OBD_au8McuDtcPath[53]" UBYTE I_1 1 2 0 255 ECU_ADDRESS 0x0 /end MEASUREMENT
/begin MEASUREMENT OBD_au8McuDtcPath[54] "OBD_au8McuDtcPath[54]" UBYTE I_1 1 2 0 255 ECU_ADDRESS 0x0 /end MEASUREMENT
/begin MEASUREMENT OBD_au8McuDtcPath[55] "OBD_au8McuDtcPath[55]" UBYTE I_1 1 2 0 255 ECU_ADDRESS 0x0 /end MEASUREMENT
/begin MEASUREMENT OBD_au8McuDtcPath[56] "OBD_au8McuDtcPath[56]" UBYTE I_1 1 2 0 255 ECU_ADDRESS 0x0 /end MEASUREMENT
/begin MEASUREMENT OBD_au8McuDtcPath[57] "OBD_au8McuDtcPath[57]" UBYTE I_1 1 2 0 255 ECU_ADDRESS 0x0 /end MEASUREMENT
/begin MEASUREMENT OBD_au8McuDtcPath[58] "OBD_au8McuDtcPath[58]" UBYTE I_1 1 2 0 255 ECU_ADDRESS 0x0 /end MEASUREMENT
/begin MEASUREMENT OBD_au8McuDtcPath[59] "OBD_au8McuDtcPath[59]" UBYTE I_1 1 2 0 255 ECU_ADDRESS 0x0 /end MEASUREMENT
/begin MEASUREMENT OBD_au8McuDtcPath[5] "OBD_au8McuDtcPath[5]" UBYTE I_1 1 2 0 255 ECU_ADDRESS 0x0 /end MEASUREMENT
/begin MEASUREMENT OBD_au8McuDtcPath[60] "OBD_au8McuDtcPath[60]" UBYTE I_1 1 2 0 255 ECU_ADDRESS 0x0 /end MEASUREMENT
/begin MEASUREMENT OBD_au8McuDtcPath[61] "OBD_au8McuDtcPath[61]" UBYTE I_1 1 2 0 255 ECU_ADDRESS 0x0 /end MEASUREMENT
/begin MEASUREMENT OBD_au8McuDtcPath[62] "OBD_au8McuDtcPath[62]" UBYTE I_1 1 2 0 255 ECU_ADDRESS 0x0 /end MEASUREMENT
/begin MEASUREMENT OBD_au8McuDtcPath[63] "OBD_au8McuDtcPath[63]" UBYTE I_1 1 2 0 255 ECU_ADDRESS 0x0 /end MEASUREMENT
/begin MEASUREMENT OBD_au8McuDtcPath[64] "OBD_au8McuDtcPath[64]" UBYTE I_1 1 2 0 255 ECU_ADDRESS 0x0 /end MEASUREMENT
/begin MEASUREMENT OBD_au8McuDtcPath[65] "OBD_au8McuDtcPath[65]" UBYTE I_1 1 2 0 255 ECU_ADDRESS 0x0 /end MEASUREMENT
/begin MEASUREMENT OBD_au8McuDtcPath[66] "OBD_au8McuDtcPath[66]" UBYTE I_1 1 2 0 255 ECU_ADDRESS 0x0 /end MEASUREMENT
/begin MEASUREMENT OBD_au8McuDtcPath[67] "OBD_au8McuDtcPath[67]" UBYTE I_1 1 2 0 255 ECU_ADDRESS 0x0 /end MEASUREMENT
/begin MEASUREMENT OBD_au8McuDtcPath[68] "OBD_au8McuDtcPath[68]" UBYTE I_1 1 2 0 255 ECU_ADDRESS 0x0 /end MEASUREMENT
/begin MEASUREMENT OBD_au8McuDtcPath[69] "OBD_au8McuDtcPath[69]" UBYTE I_1 1 2 0 255 ECU_ADDRESS 0x0 /end MEASUREMENT
/begin MEASUREMENT OBD_au8McuDtcPath[6] "OBD_au8McuDtcPath[6]" UBYTE I_1 1 2 0 255 ECU_ADDRESS 0x0 /end MEASUREMENT
/begin MEASUREMENT OBD_au8McuDtcPath[70] "OBD_au8McuDtcPath[70]" UBYTE I_1 1 2 0 255 ECU_ADDRESS 0x0 /end MEASUREMENT
/begin MEASUREMENT OBD_au8McuDtcPath[71] "OBD_au8McuDtcPath[71]" UBYTE I_1 1 2 0 255 ECU_ADDRESS 0x0 /end MEASUREMENT
/begin MEASUREMENT OBD_au8McuDtcPath[72] "OBD_au8McuDtcPath[72]" UBYTE I_1 1 2 0 255 ECU_ADDRESS 0x0 /end MEASUREMENT
/begin MEASUREMENT OBD_au8McuDtcPath[73] "OBD_au8McuDtcPath[73]" UBYTE I_1 1 2 0 255 ECU_ADDRESS 0x0 /end MEASUREMENT
/begin MEASUREMENT OBD_au8McuDtcPath[74] "OBD_au8McuDtcPath[74]" UBYTE I_1 1 2 0 255 ECU_ADDRESS 0x0 /end MEASUREMENT
/begin MEASUREMENT OBD_au8McuDtcPath[75] "OBD_au8McuDtcPath[75]" UBYTE I_1 1 2 0 255 ECU_ADDRESS 0x0 /end MEASUREMENT
/begin MEASUREMENT OBD_au8McuDtcPath[76] "OBD_au8McuDtcPath[76]" UBYTE I_1 1 2 0 255 ECU_ADDRESS 0x0 /end MEASUREMENT
/begin MEASUREMENT OBD_au8McuDtcPath[77] "OBD_au8McuDtcPath[77]" UBYTE I_1 1 2 0 255 ECU_ADDRESS 0x0 /end MEASUREMENT
/begin MEASUREMENT OBD_au8McuDtcPath[78] "OBD_au8McuDtcPath[78]" UBYTE I_1 1 2 0 255 ECU_ADDRESS 0x0 /end MEASUREMENT
/begin MEASUREMENT OBD_au8McuDtcPath[79] "OBD_au8McuDtcPath[79]" UBYTE I_1 1 2 0 255 ECU_ADDRESS 0x0 /end MEASUREMENT
/begin MEASUREMENT OBD_au8McuDtcPath[7] "OBD_au8McuDtcPath[7]" UBYTE I_1 1 2 0 255 ECU_ADDRESS 0x0 /end MEASUREMENT
/begin MEASUREMENT OBD_au8McuDtcPath[80] "OBD_au8McuDtcPath[80]" UBYTE I_1 1 2 0 255 ECU_ADDRESS 0x0 /end MEASUREMENT
/begin MEASUREMENT OBD_au8McuDtcPath[81] "OBD_au8McuDtcPath[81]" UBYTE I_1 1 2 0 255 ECU_ADDRESS 0x0 /end MEASUREMENT
/begin MEASUREMENT OBD_au8McuDtcPath[82] "OBD_au8McuDtcPath[82]" UBYTE I_1 1 2 0 255 ECU_ADDRESS 0x0 /end MEASUREMENT
/begin MEASUREMENT OBD_au8McuDtcPath[83] "OBD_au8McuDtcPath[83]" UBYTE I_1 1 2 0 255 ECU_ADDRESS 0x0 /end MEASUREMENT
/begin MEASUREMENT OBD_au8McuDtcPath[84] "OBD_au8McuDtcPath[84]" UBYTE I_1 1 2 0 255 ECU_ADDRESS 0x0 /end MEASUREMENT
/begin MEASUREMENT OBD_au8McuDtcPath[85] "OBD_au8McuDtcPath[85]" UBYTE I_1 1 2 0 255 ECU_ADDRESS 0x0 /end MEASUREMENT
/begin MEASUREMENT OBD_au8McuDtcPath[86] "OBD_au8McuDtcPath[86]" UBYTE I_1 1 2 0 255 ECU_ADDRESS 0x0 /end MEASUREMENT
/begin MEASUREMENT OBD_au8McuDtcPath[87] "OBD_au8McuDtcPath[87]" UBYTE I_1 1 2 0 255 ECU_ADDRESS 0x0 /end MEASUREMENT
/begin MEASUREMENT OBD_au8McuDtcPath[88] "OBD_au8McuDtcPath[88]" UBYTE I_1 1 2 0 255 ECU_ADDRESS 0x0 /end MEASUREMENT
/begin MEASUREMENT OBD_au8McuDtcPath[89] "OBD_au8McuDtcPath[89]" UBYTE I_1 1 2 0 255 ECU_ADDRESS 0x0 /end MEASUREMENT
/begin MEASUREMENT OBD_au8McuDtcPath[8] "OBD_au8McuDtcPath[8]" UBYTE I_1 1 2 0 255 ECU_ADDRESS 0x0 /end MEASUREMENT
/begin MEASUREMENT OBD_au8McuDtcPath[90] "OBD_au8McuDtcPath[90]" UBYTE I_1 1 2 0 255 ECU_ADDRESS 0x0 /end MEASUREMENT
/begin MEASUREMENT OBD_au8McuDtcPath[91] "OBD_au8McuDtcPath[91]" UBYTE I_1 1 2 0 255 ECU_ADDRESS 0x0 /end MEASUREMENT
/begin MEASUREMENT OBD_au8McuDtcPath[92] "OBD_au8McuDtcPath[92]" UBYTE I_1 1 2 0 255 ECU_ADDRESS 0x0 /end MEASUREMENT
/begin MEASUREMENT OBD_au8McuDtcPath[93] "OBD_au8McuDtcPath[93]" UBYTE I_1 1 2 0 255 ECU_ADDRESS 0x0 /end MEASUREMENT
/begin MEASUREMENT OBD_au8McuDtcPath[94] "OBD_au8McuDtcPath[94]" UBYTE I_1 1 2 0 255 ECU_ADDRESS 0x0 /end MEASUREMENT
/begin MEASUREMENT OBD_au8McuDtcPath[95] "OBD_au8McuDtcPath[95]" UBYTE I_1 1 2 0 255 ECU_ADDRESS 0x0 /end MEASUREMENT
/begin MEASUREMENT OBD_au8McuDtcPath[96] "OBD_au8McuDtcPath[96]" UBYTE I_1 1 2 0 255 ECU_ADDRESS 0x0 /end MEASUREMENT
/begin MEASUREMENT OBD_au8McuDtcPath[97] "OBD_au8McuDtcPath[97]" UBYTE I_1 1 2 0 255 ECU_ADDRESS 0x0 /end MEASUREMENT
/begin MEASUREMENT OBD_au8McuDtcPath[98] "OBD_au8McuDtcPath[98]" UBYTE I_1 1 2 0 255 ECU_ADDRESS 0x0 /end MEASUREMENT
/begin MEASUREMENT OBD_au8McuDtcPath[99] "OBD_au8McuDtcPath[99]" UBYTE I_1 1 2 0 255 ECU_ADDRESS 0x0 /end MEASUREMENT
/begin MEASUREMENT OBD_au8McuDtcPath[9] "OBD_au8McuDtcPath[9]" UBYTE I_1 1 2 0 255 ECU_ADDRESS 0x0 /end MEASUREMENT
/begin MEASUREMENT OBD_bCompMonComplet "..." UBYTE Bool_ON_OFF 1 2 0 1 BIT_MASK 0x01 ECU_ADDRESS 0x0 /end MEASUREMENT
/begin MEASUREMENT OBD_bDtcClrFlg "..." UBYTE Bool_ON_OFF 1 2 0 1 BIT_MASK 0x01 ECU_ADDRESS 0x0 /end MEASUREMENT
/begin MEASUREMENT OBD_bDtcClrInhibitFlg "..." UBYTE Bool_ON_OFF 1 2 0 1 BIT_MASK 0x01 ECU_ADDRESS 0x0 /end MEASUREMENT
/begin MEASUREMENT OBD_bFFAccessLock "..." UBYTE Bool_ON_OFF 1 2 0 1 BIT_MASK 0x01 ECU_ADDRESS 0x0 /end MEASUREMENT
/begin MEASUREMENT OBD_bPerDtcClrCyc "..." UBYTE Bool_ON_OFF 1 2 0 1 BIT_MASK 0x01 ECU_ADDRESS 0x0 /end MEASUREMENT
/begin MEASUREMENT OBD_bPtReady "..." UBYTE Bool_ON_OFF 1 2 0 1 BIT_MASK 0x01 ECU_ADDRESS 0x0 /end MEASUREMENT
/begin MEASUREMENT OBD_bWarmCycCalcFlg "..." UBYTE Bool_ON_OFF 1 2 0 1 BIT_MASK 0x01 ECU_ADDRESS 0x0 /end MEASUREMENT
/begin MEASUREMENT OBD_bWarmUpAchiv "..." UBYTE Bool_ON_OFF 1 2 0 1 BIT_MASK 0x01 ECU_ADDRESS 0x0 /end MEASUREMENT
/begin MEASUREMENT OBD_u16Kl15Value "..." UWORD F_1_p0_4 1 2 0 65535 ECU_ADDRESS 0x0 /end MEASUREMENT
/begin MEASUREMENT OBD_u16Pid0CInfo "Engine speed rpm" UWORD F_1_p0_44 1 2 0 65535 ECU_ADDRESS 0x0 /end MEASUREMENT
/begin MEASUREMENT OBD_u16Pid42Info "control module voltage" UWORD F_1_p0_66 1 2 0 65535 ECU_ADDRESS 0x0 /end MEASUREMENT
/begin MEASUREMENT OBD_u32CalVerifyNum "..." ULONG Id_0x00 1 2 0 4294967295 ECU_ADDRESS 0x0 /end MEASUREMENT
/begin MEASUREMENT OBD_u32OdomtWhenDtcClr "..." ULONG I_1 1 2 0 4294967295 ECU_ADDRESS 0x0 /end MEASUREMENT
/begin MEASUREMENT OBD_u32OdomtWhenMilOn "..." ULONG I_1 1 2 0 4294967295 ECU_ADDRESS 0x0 /end MEASUREMENT
/begin MEASUREMENT OBD_u32TotalOdmtr "current travel distance" ULONG F_1_p0_67 1 2 0 4294967295 ECU_ADDRESS 0x0 /end MEASUREMENT
/begin MEASUREMENT OBD_u8NvmJobRes "..." UBYTE F_1_p0_4 1 2 0 255 ECU_ADDRESS 0x0 /end MEASUREMENT
/begin MEASUREMENT OBD_u8Pid04Info "Caculated load value" UBYTE F_1_p0_4 1 2 0 255 ECU_ADDRESS 0x0 /end MEASUREMENT
/begin MEASUREMENT OBD_u8Pid05Info "Engine coolant temp" UBYTE F_1_p0_68 1 2 0 255 ECU_ADDRESS 0x0 /end MEASUREMENT
/begin MEASUREMENT OBD_u8Pid0DInfo "Vehicle speed" UBYTE F_1_p0_68 1 2 0 255 ECU_ADDRESS 0x0 /end MEASUREMENT
/begin MEASUREMENT OBD_u8Pid11Info "Abs throttle position" UBYTE F_1_p0_68 1 2 0 255 ECU_ADDRESS 0x0 /end MEASUREMENT
/begin MEASUREMENT OBD_u8Pid49Info "Abs throttle position D" UBYTE F_1_p0_68 1 2 0 255 ECU_ADDRESS 0x0 /end MEASUREMENT
/begin MEASUREMENT OBD_u8PoCycMonStep "..." UBYTE F_1_p0_4 1 2 0 255 ECU_ADDRESS 0x0 /end MEASUREMENT
/begin MEASUREMENT Os_Task_BackGround_Counter "..." ULONG I_1 1 2 0 4294967295 ECU_ADDRESS 0x0 /end MEASUREMENT
/begin MEASUREMENT Os_Task_Idle_Counter "..." ULONG I_1 1 2 0 4294967295 ECU_ADDRESS 0x0 /end MEASUREMENT
/begin MEASUREMENT PDCM_AccelPedal_Position "..." UWORD F_0v1_p0_2 1 2 0 6553.5 ECU_ADDRESS 0x0 /end MEASUREMENT
/begin MEASUREMENT PDCM_AccelPedal_Status "..." UWORD F_0v1_p0_2 1 2 0 6553.5 ECU_ADDRESS 0x0 /end MEASUREMENT
/begin MEASUREMENT PDCM_BrakePedal_Status "..." UBYTE Bool_ON_OFF 1 2 0 1 BIT_MASK 0x01 ECU_ADDRESS 0x0 /end MEASUREMENT
/begin MEASUREMENT PDCM_ClutchCommand "..." UBYTE F_1_p0_4 1 2 0 255 ECU_ADDRESS 0x0 /end MEASUREMENT
/begin MEASUREMENT PDCM_ClutchCommandTransferTorque "..." UWORD F_0v125_m100_24 1 2 -100 8091.875 ECU_ADDRESS 0x0 /end MEASUREMENT
/begin MEASUREMENT PDCM_Dcy_valid "..." UBYTE I_1 1 2 0 255 ECU_ADDRESS 0x0 /end MEASUREMENT
/begin MEASUREMENT PDCM_DriveReady "..." UBYTE I_1 1 2 0 255 ECU_ADDRESS 0x0 /end MEASUREMENT
/begin MEASUREMENT PDCM_DrivingCycle "..." UBYTE I_1 1 2 0 255 ECU_ADDRESS 0x0 /end MEASUREMENT
/begin MEASUREMENT PDCM_OBD_DenoGenValid "..." UBYTE I_1 1 2 0 255 ECU_ADDRESS 0x0 /end MEASUREMENT
/begin MEASUREMENT PDCM_OBD_DenoGeneral "..." UBYTE I_1 1 2 0 255 ECU_ADDRESS 0x0 /end MEASUREMENT
/begin MEASUREMENT PDCM_OBD_FaultClrInhibit "..." UBYTE I_1 1 2 0 255 ECU_ADDRESS 0x0 /end MEASUREMENT
/begin MEASUREMENT PDCM_OBD_PDTCClrSts "..." UBYTE I_1 1 2 0 255 ECU_ADDRESS 0x0 /end MEASUREMENT
/begin MEASUREMENT PDCM_OBD_WarmCycleSts "..." UBYTE I_1 1 2 0 255 ECU_ADDRESS 0x0 /end MEASUREMENT
/begin MEASUREMENT PDCM_SOC "..." UWORD F_0v05_p0_69 1 2 0 3276.75 ECU_ADDRESS 0x0 /end MEASUREMENT
/begin MEASUREMENT PDCM_actualGear "..." UBYTE I_1 1 2 0 255 ECU_ADDRESS 0x0 /end MEASUREMENT
/begin MEASUREMENT PORSve_d2n_P1SecondDerivative "..." SWORD F_0v25_p0_27 1 2 -8192 8191.75 ECU_ADDRESS 0x0 /end MEASUREMENT
/begin MEASUREMENT PORSve_dn_P1Derivative "..." SWORD F_0v5_p0_28 1 2 -16384 16383.5 ECU_ADDRESS 0x0 /end MEASUREMENT
/begin MEASUREMENT PORSve_e_P1RotationalSpeedVld "..." UBYTE I_1 1 2 0 255 ECU_ADDRESS 0x0 /end MEASUREMENT
/begin MEASUREMENT PORSve_n_P1RotationalSpeed "..." SWORD F_1_p0_4 1 2 -32768 32767 ECU_ADDRESS 0x0 /end MEASUREMENT
/begin MEASUREMENT PORSve_n_P1RotationalSpeedUnsigned "..." SWORD F_1_p0_4 1 2 -32768 32767 ECU_ADDRESS 0x0 /end MEASUREMENT
/begin MEASUREMENT PWRMve_e_SysPwrMd "..." UBYTE I_1 1 2 0 255 ECU_ADDRESS 0x0 /end MEASUREMENT
/begin MEASUREMENT RSTSRV_bSWResetDetected "RSTSRV_bSWResetDetected" UBYTE Bool_ON_OFF 1 2 0 1 BIT_MASK 0x01 ECU_ADDRESS 0x0 /end MEASUREMENT
/begin MEASUREMENT RSTSRV_bSWResetDoneByPerformReset "RSTSRV_bSWResetDoneByPerformReset" UBYTE Bool_ON_OFF 1 2 0 1 BIT_MASK 0x01 ECU_ADDRESS 0x0 /end MEASUREMENT
/begin MEASUREMENT RSTSRV_u16ConsecutiveRstCtr "RSTSRV_u16ConsecutiveRstCtr" UWORD I_1 1 2 0 65535 ECU_ADDRESS 0x0 /end MEASUREMENT
/begin MEASUREMENT RSTSRV_u16HotResetCtr "RSTSRV_u16HotResetCtr" UWORD I_1 1 2 0 65535 ECU_ADDRESS 0x0 /end MEASUREMENT
/begin MEASUREMENT RSTSRV_u16TimeAfterInit "RSTSRV_u16TimeAfterInit" UWORD F_100_p0_71 1 2 0 6553500 ECU_ADDRESS 0x0 /end MEASUREMENT
/begin MEASUREMENT RSTSRV_u32ResetReason "RSTSRV_u32ResetReason" ULONG I_1 1 2 0 4294967295 ECU_ADDRESS 0x0 /end MEASUREMENT
/begin MEASUREMENT RTMCLD_u16MeasurementPeriodCounter "RTMCLD_u16MeasurementPeriodCounter" UWORD I_1 1 2 0 65535 ECU_ADDRESS 0x0 /end MEASUREMENT
/begin MEASUREMENT RTMCLD_u32IdleClock "RTMCLD_u32IdleClock" ULONG I_1 1 2 0 4294967295 ECU_ADDRESS 0x0 /end MEASUREMENT
/begin MEASUREMENT RTMCLD_u32Load "RTMCLD_u32Load" ULONG F_m0v0000045_p100_72 1 2 -19227.35283 100 ECU_ADDRESS 0x0 /end MEASUREMENT
/begin MEASUREMENT RTMCLD_u32PrevIdleClock "RTMCLD_u32PrevIdleClock" ULONG I_1 1 2 0 4294967295 ECU_ADDRESS 0x0 /end MEASUREMENT
/begin MEASUREMENT RTMTSK_u32TaskDuration "RTMTSK_u32TaskDuration" ULONG F_0v01_p0_73 1 2 0 42949672.95 ECU_ADDRESS 0x0 /end MEASUREMENT
/begin MEASUREMENT RTMTSK_u32TaskStartTime "RTMTSK_u32TaskStartTime" ULONG I_1 1 2 0 4294967295 ECU_ADDRESS 0x0 /end MEASUREMENT
/begin MEASUREMENT RTMTSK_u8TaskId "RTMTSK_u8TaskId" UBYTE I_1 1 2 0 255 ECU_ADDRESS 0x0 /end MEASUREMENT
/begin MEASUREMENT Rte_CACEve_b_IgnitionOn "..." UBYTE I_1 1 2 0 255 ECU_ADDRESS 0x0 /end MEASUREMENT
/begin MEASUREMENT Rte_CAPStuckFlag "..." UBYTE I_1 1 2 0 255 ECU_ADDRESS 0x0 /end MEASUREMENT
/begin MEASUREMENT Rte_CCPStuckFlag "..." UBYTE I_1 1 2 0 255 ECU_ADDRESS 0x0 /end MEASUREMENT
/begin MEASUREMENT Rte_CUTDve_T_PCB_Temperature "..." SWORD F_0v0625_p0_14 1 2 -2048 2047.9375 ECU_ADDRESS 0x0 /end MEASUREMENT
/begin MEASUREMENT Rte_FACTee_NA_Kisspoint "..." UWORD F_1_p0_4 1 2 0 65535 ECU_ADDRESS 0x0 /end MEASUREMENT
/begin MEASUREMENT Rte_FACTee_NA_Kisspoint_Inv "..." UWORD F_1_p0_4 1 2 0 65535 ECU_ADDRESS 0x0 /end MEASUREMENT
/begin MEASUREMENT Rte_FACTee_NA_TransferGain "..." UWORD F_1_p0_4 1 2 0 65535 ECU_ADDRESS 0x0 /end MEASUREMENT
/begin MEASUREMENT Rte_FACTee_NA_TransferGain_Inv "..." UWORD F_1_p0_4 1 2 0 65535 ECU_ADDRESS 0x0 /end MEASUREMENT
/begin MEASUREMENT Rte_FACTve_NA_CalibrationLength "..." ULONG F_1_p0_4 1 2 0 4294967295 ECU_ADDRESS 0x0 /end MEASUREMENT
/begin MEASUREMENT Rte_FACTve_NA_CalibrationStart "..." ULONG F_1_p0_4 1 2 0 4294967295 ECU_ADDRESS 0x0 /end MEASUREMENT
/begin MEASUREMENT Rte_FbVar_SWCI7_globalMode_currentMode "..." UBYTE I_1 1 2 0 255 ECU_ADDRESS 0x0 /end MEASUREMENT
/begin MEASUREMENT Rte_FbVar_SWCI7_mode0_currentMode "..." UBYTE I_1 1 2 0 255 ECU_ADDRESS 0x0 /end MEASUREMENT
/begin MEASUREMENT Rte_HAMFve_Cnt_CalMemChkSum "..." ULONG F_1_p0_4 1 2 0 4294967295 ECU_ADDRESS 0x0 /end MEASUREMENT
/begin MEASUREMENT Rte_HAMFve_b_CalMemChkSumReady "..." UBYTE Bool_ON_OFF 1 2 0 1 BIT_MASK 0x01 ECU_ADDRESS 0x0 /end MEASUREMENT
/begin MEASUREMENT Rte_HTCU_AirflowRequest "..." UBYTE F_0v5_p0_28 1 2 0 127.5 ECU_ADDRESS 0x0 /end MEASUREMENT
/begin MEASUREMENT Rte_HTCU_State "..." UBYTE I_1 1 2 0 255 ECU_ADDRESS 0x0 /end MEASUREMENT
/begin MEASUREMENT Rte_Irv_CLPC_CLPCve_n_CAPM_SpeedControllerTarget_IRV "..." SWORD F_1_p0_4 1 2 -32768 32767 ECU_ADDRESS 0x0 /end MEASUREMENT
/begin MEASUREMENT Rte_Irv_TCFC_TCFCve_n_CCPM_SpeedControllerTarget_IRV "..." SWORD F_1_p0_4 1 2 -32768 32767 ECU_ADDRESS 0x0 /end MEASUREMENT
/begin MEASUREMENT Rte_Irv_TCPD_TCPDve_p_ClutchPressure_IRV "..." UWORD F_1_p0_4 1 2 0 65535 ECU_ADDRESS 0x0 /end MEASUREMENT
/begin MEASUREMENT Rte_ModeCurrent_0 "..." UBYTE I_1 1 2 0 255 ECU_ADDRESS 0x0 /end MEASUREMENT
/begin MEASUREMENT Rte_ModeCurrent_19 "..." UBYTE I_1 1 2 0 255 ECU_ADDRESS 0x0 /end MEASUREMENT
/begin MEASUREMENT Rte_ModeCurrent_20 "..." UBYTE I_1 1 2 0 255 ECU_ADDRESS 0x0 /end MEASUREMENT
/begin MEASUREMENT Rte_ModeCurrent_4 "..." UBYTE I_1 1 2 0 255 ECU_ADDRESS 0x0 /end MEASUREMENT
/begin MEASUREMENT Rte_ModeStatus_4 "..." UBYTE I_1 1 2 0 255 ECU_ADDRESS 0x0 /end MEASUREMENT
/begin MEASUREMENT Rte_Ms_ActvSession "..." UBYTE I_1 1 2 0 255 ECU_ADDRESS 0x0 /end MEASUREMENT
/begin MEASUREMENT Rte_Ms_ComCtlTyp "..." UBYTE I_1 1 2 0 255 ECU_ADDRESS 0x0 /end MEASUREMENT
/begin MEASUREMENT Rte_Ms_DisblMskbit "..." ULONG I_1 1 2 0 4294967295 ECU_ADDRESS 0x0 /end MEASUREMENT
/begin MEASUREMENT Rte_Ms_DtcGrp "..." ULONG I_1 1 2 0 4294967295 ECU_ADDRESS 0x0 /end MEASUREMENT
/begin MEASUREMENT Rte_Ms_ErrCode "..." UBYTE I_1 1 2 0 255 ECU_ADDRESS 0x0 /end MEASUREMENT
/begin MEASUREMENT Rte_Ms_Fus_SafeExec_L2Pfc100ms "..." UBYTE I_1 1 2 0 255 ECU_ADDRESS 0x0 /end MEASUREMENT
/begin MEASUREMENT Rte_Ms_Fus_SafeExec_L2Pfc10ms "..." UBYTE I_1 1 2 0 255 ECU_ADDRESS 0x0 /end MEASUREMENT
/begin MEASUREMENT Rte_Ms_Fus_SafeExec_L2Pfc2p5ms "..." UBYTE I_1 1 2 0 255 ECU_ADDRESS 0x0 /end MEASUREMENT
/begin MEASUREMENT Rte_Ms_Fus_SafeExec_L2Pfc5ms "..." UBYTE I_1 1 2 0 255 ECU_ADDRESS 0x0 /end MEASUREMENT
/begin MEASUREMENT Rte_Ms_Nrc "..." UBYTE I_1 1 2 0 255 ECU_ADDRESS 0x0 /end MEASUREMENT
/begin MEASUREMENT Rte_Ms_OP_FI_IUMPR_GenDenInh "..." UBYTE Bool_ON_OFF 1 2 0 1 BIT_MASK 0x01 ECU_ADDRESS 0x0 /end MEASUREMENT
/begin MEASUREMENT Rte_Ms_OP_FI_IUMPR_PDTCClrCusPermission "..." UBYTE Bool_ON_OFF 1 2 0 1 BIT_MASK 0x01 ECU_ADDRESS 0x0 /end MEASUREMENT
/begin MEASUREMENT Rte_Ms_OP_Fl_DrvCycl "..." UBYTE I_1 1 2 0 255 ECU_ADDRESS 0x0 /end MEASUREMENT
/begin MEASUREMENT Rte_Ms_OP_Fl_IUMPR_GenDenInc "..." UBYTE Bool_ON_OFF 1 2 0 1 BIT_MASK 0x01 ECU_ADDRESS 0x0 /end MEASUREMENT
/begin MEASUREMENT Rte_Ms_OP_Fl_IgnCycl "..." UBYTE I_1 1 2 0 255 ECU_ADDRESS 0x0 /end MEASUREMENT
/begin MEASUREMENT Rte_Ms_OP_Fl_WrnUpCycl "..." UBYTE I_1 1 2 0 255 ECU_ADDRESS 0x0 /end MEASUREMENT
/begin MEASUREMENT Rte_Ms_OP_Idx_Mot "..." UBYTE I_1 1 2 0 255 ECU_ADDRESS 0x0 /end MEASUREMENT
/begin MEASUREMENT Rte_Ms_OP_Num_DayFrzFrm "..." UBYTE I_1 1 2 0 255 ECU_ADDRESS 0x0 /end MEASUREMENT
/begin MEASUREMENT Rte_Ms_OP_Num_HourFrzFrm "..." UBYTE I_1 1 2 0 255 ECU_ADDRESS 0x0 /end MEASUREMENT
/begin MEASUREMENT Rte_Ms_OP_Num_MinuteFrzFrm "..." UBYTE I_1 1 2 0 255 ECU_ADDRESS 0x0 /end MEASUREMENT
/begin MEASUREMENT Rte_Ms_OP_Num_MonthFrzFrm "..." UBYTE I_1 1 2 0 255 ECU_ADDRESS 0x0 /end MEASUREMENT
/begin MEASUREMENT Rte_Ms_OP_Num_SecsFrzFrm "..." UBYTE I_1 1 2 0 255 ECU_ADDRESS 0x0 /end MEASUREMENT
/begin MEASUREMENT Rte_Ms_OP_Num_YearFrzFrm "..." UBYTE I_1 1 2 0 255 ECU_ADDRESS 0x0 /end MEASUREMENT
/begin MEASUREMENT Rte_Ms_OP_St_MotSt "..." UBYTE I_1 1 2 0 255 ECU_ADDRESS 0x0 /end MEASUREMENT
/begin MEASUREMENT Rte_Ms_OP_St_PwrModeFrzFrm "..." UBYTE I_1 1 2 0 255 ECU_ADDRESS 0x0 /end MEASUREMENT
/begin MEASUREMENT Rte_Ms_OP_Temp_EngClntTempFrzFrm "..." UBYTE I_1 1 2 0 255 ECU_ADDRESS 0x0 /end MEASUREMENT
/begin MEASUREMENT Rte_Ms_OP_cyc_MotDuty "..." SWORD F_0v1_p0_2 1 2 -3276.8 3276.7 ECU_ADDRESS 0x0 /end MEASUREMENT
/begin MEASUREMENT Rte_Ms_OP_s_ODOPrmrFrzFrm "..." ULONG F_1_p0_4 1 2 0 4294967295 ECU_ADDRESS 0x0 /end MEASUREMENT
/begin MEASUREMENT Rte_Ms_ReqSession "..." UBYTE I_1 1 2 0 255 ECU_ADDRESS 0x0 /end MEASUREMENT
/begin MEASUREMENT Rte_Ms_Sid "..." UBYTE I_1 1 2 0 255 ECU_ADDRESS 0x0 /end MEASUREMENT
/begin MEASUREMENT Rte_Ms_TCU_Ct_PwrStgActPosInc "..." SWORD F_1_p0_4 1 2 -32768 32767 ECU_ADDRESS 0x0 /end MEASUREMENT
/begin MEASUREMENT Rte_Ms_TCU_Fl_SysSycT15 "..." UBYTE I_1 1 2 0 255 ECU_ADDRESS 0x0 /end MEASUREMENT
/begin MEASUREMENT Rte_Ms_TCU_I_MotAvrgCrnt "..." SWORD F_0v01_p0_20 1 2 -327.68 327.67 ECU_ADDRESS 0x0 /end MEASUREMENT
/begin MEASUREMENT Rte_Ms_TCU_I_MotMaxCrnt "..." SWORD F_0v01_p0_20 1 2 -327.68 327.67 ECU_ADDRESS 0x0 /end MEASUREMENT
/begin MEASUREMENT Rte_Ms_TCU_Idx_Mot "..." UBYTE I_1 1 2 0 255 ECU_ADDRESS 0x0 /end MEASUREMENT
/begin MEASUREMENT Rte_Ms_TCU_St_5V1RawSt "..." UBYTE I_1 1 2 0 255 ECU_ADDRESS 0x0 /end MEASUREMENT
/begin MEASUREMENT Rte_Ms_TCU_St_5V2RawSt "..." UBYTE I_1 1 2 0 255 ECU_ADDRESS 0x0 /end MEASUREMENT
/begin MEASUREMENT Rte_Ms_TCU_St_5V3RawSt "..." UBYTE I_1 1 2 0 255 ECU_ADDRESS 0x0 /end MEASUREMENT
/begin MEASUREMENT Rte_Ms_TCU_St_ACCRawSt "..." UBYTE I_1 1 2 0 255 ECU_ADDRESS 0x0 /end MEASUREMENT
/begin MEASUREMENT Rte_Ms_TCU_St_IgnRawSt "..." UBYTE I_1 1 2 0 255 ECU_ADDRESS 0x0 /end MEASUREMENT
/begin MEASUREMENT Rte_Ms_TCU_St_MotCrntSt "..." UBYTE I_1 1 2 0 255 ECU_ADDRESS 0x0 /end MEASUREMENT
/begin MEASUREMENT Rte_Ms_TCU_St_MotSpdSt "..." UBYTE I_1 1 2 0 255 ECU_ADDRESS 0x0 /end MEASUREMENT
/begin MEASUREMENT Rte_Ms_TCU_St_PresRawSt "..." UBYTE I_1 1 2 0 255 ECU_ADDRESS 0x0 /end MEASUREMENT
/begin MEASUREMENT Rte_Ms_TCU_St_PwrStgMode "..." UBYTE I_1 1 2 0 255 ECU_ADDRESS 0x0 /end MEASUREMENT
/begin MEASUREMENT Rte_Ms_TCU_St_PwrStgPosSt "..." UBYTE I_1 1 2 0 255 ECU_ADDRESS 0x0 /end MEASUREMENT
/begin MEASUREMENT Rte_Ms_TCU_St_PwrStgSt "..." UBYTE I_1 1 2 0 255 ECU_ADDRESS 0x0 /end MEASUREMENT
/begin MEASUREMENT Rte_Ms_TCU_St_PwrStgTempSt "..." UBYTE I_1 1 2 0 255 ECU_ADDRESS 0x0 /end MEASUREMENT
/begin MEASUREMENT Rte_Ms_TCU_St_PwrTempWarnLvl "..." UBYTE I_1 1 2 0 255 ECU_ADDRESS 0x0 /end MEASUREMENT
/begin MEASUREMENT Rte_Ms_TCU_St_T30HiRawSt "..." UBYTE I_1 1 2 0 255 ECU_ADDRESS 0x0 /end MEASUREMENT
/begin MEASUREMENT Rte_Ms_TCU_St_T30LowRawSt "..." UBYTE I_1 1 2 0 255 ECU_ADDRESS 0x0 /end MEASUREMENT
/begin MEASUREMENT Rte_Ms_TCU_Temp_PwrStgTemp "..." UWORD F_1_m40_29 1 2 -40 65495 ECU_ADDRESS 0x0 /end MEASUREMENT
/begin MEASUREMENT Rte_Ms_TCU_U_5V1Raw "..." UWORD F_1_p0_4 1 2 0 65535 ECU_ADDRESS 0x0 /end MEASUREMENT
/begin MEASUREMENT Rte_Ms_TCU_U_5V2Raw "..." UWORD F_1_p0_4 1 2 0 65535 ECU_ADDRESS 0x0 /end MEASUREMENT
/begin MEASUREMENT Rte_Ms_TCU_U_5V3Raw "..." UWORD F_1_p0_4 1 2 0 65535 ECU_ADDRESS 0x0 /end MEASUREMENT
/begin MEASUREMENT Rte_Ms_TCU_U_ACCRaw "..." UWORD F_1_p0_4 1 2 0 65535 ECU_ADDRESS 0x0 /end MEASUREMENT
/begin MEASUREMENT Rte_Ms_TCU_U_IgnRaw "..." UWORD F_1_p0_4 1 2 0 65535 ECU_ADDRESS 0x0 /end MEASUREMENT
/begin MEASUREMENT Rte_Ms_TCU_U_T30HiRaw "..." UWORD F_1_p0_4 1 2 0 65535 ECU_ADDRESS 0x0 /end MEASUREMENT
/begin MEASUREMENT Rte_Ms_TCU_U_T30LowRaw "..." UWORD F_1_p0_4 1 2 0 65535 ECU_ADDRESS 0x0 /end MEASUREMENT
/begin MEASUREMENT Rte_Ms_TCU_U_TempRaw "..." UWORD F_1_p0_4 1 2 0 65535 ECU_ADDRESS 0x0 /end MEASUREMENT
/begin MEASUREMENT Rte_Ms_TCU_cyc_PwrStgActPWM "..." SWORD F_0v1_p0_2 1 2 -3276.8 3276.7 ECU_ADDRESS 0x0 /end MEASUREMENT
/begin MEASUREMENT Rte_Ms_TCU_n_MotRotSpd "..." SWORD F_1_p0_4 1 2 -32768 32767 ECU_ADDRESS 0x0 /end MEASUREMENT
/begin MEASUREMENT Rte_Ms_TCU_p_PresRaw "..." UWORD F_0v01_p0_20 1 2 0 655.35 ECU_ADDRESS 0x0 /end MEASUREMENT
/begin MEASUREMENT Rte_Ms_TCU_st_ChipTemp "..." UBYTE I_1 1 2 0 255 ECU_ADDRESS 0x0 /end MEASUREMENT
/begin MEASUREMENT Rte_Ms_TCU_t_ChipTemp "..." SWORD F_1_p0_4 1 2 -32768 32767 ECU_ADDRESS 0x0 /end MEASUREMENT
/begin MEASUREMENT Rte_Ms_TCU_u_PresRaw "..." UWORD F_0v001_p0_42 1 2 0 65.535 ECU_ADDRESS 0x0 /end MEASUREMENT
/begin MEASUREMENT Rte_Ms_busbarCur "..." SWORD F_1_p0_4 1 2 -32768 32767 ECU_ADDRESS 0x0 /end MEASUREMENT
/begin MEASUREMENT Rte_Ms_busbarCurLoad "..." UWORD F_1_p0_4 1 2 0 65535 ECU_ADDRESS 0x0 /end MEASUREMENT
/begin MEASUREMENT Rte_Ms_data_RxSignal "..." UBYTE I_1 1 2 0 255 ECU_ADDRESS 0x0 /end MEASUREMENT
/begin MEASUREMENT Rte_Ms_idx_RxAck "..." UBYTE I_1 1 2 0 255 ECU_ADDRESS 0x0 /end MEASUREMENT
/begin MEASUREMENT Rte_Ms_idx_RxDlcErr "..." UBYTE I_1 1 2 0 255 ECU_ADDRESS 0x0 /end MEASUREMENT
/begin MEASUREMENT Rte_Ms_idx_RxSignal "..." UBYTE I_1 1 2 0 255 ECU_ADDRESS 0x0 /end MEASUREMENT
/begin MEASUREMENT Rte_Ms_idx_RxTOut "..." UBYTE I_1 1 2 0 255 ECU_ADDRESS 0x0 /end MEASUREMENT
/begin MEASUREMENT Rte_Ms_idx_TxAck "..." UBYTE I_1 1 2 0 255 ECU_ADDRESS 0x0 /end MEASUREMENT
/begin MEASUREMENT Rte_Ms_idx_TxMessage "..." UBYTE I_1 1 2 0 255 ECU_ADDRESS 0x0 /end MEASUREMENT
/begin MEASUREMENT Rte_Ms_idx_TxTOut "..." UBYTE I_1 1 2 0 255 ECU_ADDRESS 0x0 /end MEASUREMENT
/begin MEASUREMENT Rte_Ms_length_TxMessage "..." UBYTE I_1 1 2 0 255 ECU_ADDRESS 0x0 /end MEASUREMENT
/begin MEASUREMENT Rte_Ms_motIdx "..." UBYTE I_1 1 2 0 255 ECU_ADDRESS 0x0 /end MEASUREMENT
/begin MEASUREMENT Rte_Ms_phaseCurLoad "..." UWORD F_1_p0_4 1 2 0 65535 ECU_ADDRESS 0x0 /end MEASUREMENT
/begin MEASUREMENT Rte_Ms_sumCurLoad "..." UWORD F_1_p0_4 1 2 0 65535 ECU_ADDRESS 0x0 /end MEASUREMENT
/begin MEASUREMENT Rte_RECount_Os_BswEnd_10ms_Task_divby1000_0 "..." UWORD F_1_p0_4 1 2 0 65535 ECU_ADDRESS 0x0 /end MEASUREMENT
/begin MEASUREMENT Rte_RECount_Os_BswEnd_10ms_Task_divby100_0 "..." UBYTE I_1 1 2 0 255 ECU_ADDRESS 0x0 /end MEASUREMENT
/begin MEASUREMENT Rte_TCU_p_PresRaw "..." UWORD F_1_p0_4 1 2 0 65535 ECU_ADDRESS 0x0 /end MEASUREMENT
/begin MEASUREMENT Rte_TCU_st_PresRawSt "..." UBYTE I_1 1 2 0 255 ECU_ADDRESS 0x0 /end MEASUREMENT
/begin MEASUREMENT Rte_TCU_u_OilTemp "..." UWORD F_0v001_p0_42 1 2 0 65.535 ECU_ADDRESS 0x0 /end MEASUREMENT
/begin MEASUREMENT Rte_TCU_u_PresRaw "..." UWORD F_1_p0_4 1 2 0 65535 ECU_ADDRESS 0x0 /end MEASUREMENT
/begin MEASUREMENT Rte_V5RDve_U_VRef1RawValue "..." UWORD F_1_p0_4 1 2 0 65535 ECU_ADDRESS 0x0 /end MEASUREMENT
/begin MEASUREMENT Rte_V5RDve_U_VRef2RawValue "..." UWORD F_1_p0_4 1 2 0 65535 ECU_ADDRESS 0x0 /end MEASUREMENT
/begin MEASUREMENT Rte_V5RDve_U_VRef3RawValue "..." UWORD F_1_p0_4 1 2 0 65535 ECU_ADDRESS 0x0 /end MEASUREMENT
/begin MEASUREMENT Rte_V5RDve_y_EC_Ref1_Status "..." UBYTE I_1 1 2 0 255 ECU_ADDRESS 0x0 /end MEASUREMENT
/begin MEASUREMENT Rte_V5RDve_y_EC_Ref2_Status "..." UBYTE I_1 1 2 0 255 ECU_ADDRESS 0x0 /end MEASUREMENT
/begin MEASUREMENT Rte_V5RDve_y_EC_Ref3_Status "..." UBYTE I_1 1 2 0 255 ECU_ADDRESS 0x0 /end MEASUREMENT
/begin MEASUREMENT Rte_bClutchCapInsufficient "..." UBYTE Bool_ON_OFF 1 2 0 1 BIT_MASK 0x01 ECU_ADDRESS 0x0 /end MEASUREMENT
/begin MEASUREMENT Rte_bClutchDragTrqTooHigh "..." UBYTE Bool_ON_OFF 1 2 0 1 BIT_MASK 0x01 ECU_ADDRESS 0x0 /end MEASUREMENT
/begin MEASUREMENT Rte_bClutchPresAboveLim "..." UBYTE Bool_ON_OFF 1 2 0 1 BIT_MASK 0x01 ECU_ADDRESS 0x0 /end MEASUREMENT
/begin MEASUREMENT Rte_bClutchPresSensPerf "..." UBYTE Bool_ON_OFF 1 2 0 1 BIT_MASK 0x01 ECU_ADDRESS 0x0 /end MEASUREMENT
/begin MEASUREMENT Rte_bCoolingActSpdDev "..." UBYTE Bool_ON_OFF 1 2 0 1 BIT_MASK 0x01 ECU_ADDRESS 0x0 /end MEASUREMENT
/begin MEASUREMENT Rte_bHighClutchPressure "..." UBYTE Bool_ON_OFF 1 2 0 1 BIT_MASK 0x01 ECU_ADDRESS 0x0 /end MEASUREMENT
/begin MEASUREMENT Rte_bLowClutchPressure "..." UBYTE Bool_ON_OFF 1 2 0 1 BIT_MASK 0x01 ECU_ADDRESS 0x0 /end MEASUREMENT
/begin MEASUREMENT Rte_bTransCtrlSysPerf "..." UBYTE Bool_ON_OFF 1 2 0 1 BIT_MASK 0x01 ECU_ADDRESS 0x0 /end MEASUREMENT
/begin MEASUREMENT Rte_bTransOilTempCrit "..." UBYTE Bool_ON_OFF 1 2 0 1 BIT_MASK 0x01 ECU_ADDRESS 0x0 /end MEASUREMENT
/begin MEASUREMENT Rte_bTransOilTempWarn "..." UBYTE Bool_ON_OFF 1 2 0 1 BIT_MASK 0x01 ECU_ADDRESS 0x0 /end MEASUREMENT
/begin MEASUREMENT Rte_bUnreasonHighOilTemp "..." UBYTE Bool_ON_OFF 1 2 0 1 BIT_MASK 0x01 ECU_ADDRESS 0x0 /end MEASUREMENT
/begin MEASUREMENT Rte_bUnreasonLowOilTemp "..." UBYTE Bool_ON_OFF 1 2 0 1 BIT_MASK 0x01 ECU_ADDRESS 0x0 /end MEASUREMENT
/begin MEASUREMENT Rte_bVcuFault "..." UBYTE Bool_ON_OFF 1 2 0 1 BIT_MASK 0x01 ECU_ADDRESS 0x0 /end MEASUREMENT
/begin MEASUREMENT Rte_b_IgnitionOn "..." UBYTE Bool_ON_OFF 1 2 0 1 BIT_MASK 0x01 ECU_ADDRESS 0x0 /end MEASUREMENT
/begin MEASUREMENT SDADva_b_IUPR_GenDenStatus "..." UBYTE Bool_ON_OFF 1 2 0 1 BIT_MASK 0x01 MATRIX_DIM 2 1 1 ECU_ADDRESS 0x0 /end MEASUREMENT
/begin MEASUREMENT SDADva_b_IUPR_GenDenStatus[0] "SDADva_b_IUPR_GenDenStatus[0]" UBYTE Bool_ON_OFF 1 2 0 1 BIT_MASK 0x01 ECU_ADDRESS 0x0 /end MEASUREMENT
/begin MEASUREMENT SDADva_b_IUPR_GenDenStatus[1] "SDADva_b_IUPR_GenDenStatus[1]" UBYTE Bool_ON_OFF 1 2 0 1 BIT_MASK 0x01 ECU_ADDRESS 0x0 /end MEASUREMENT
/begin MEASUREMENT SPARte_e_Validity "..." UBYTE I_1 1 2 0 255 ECU_ADDRESS 0x0 /end MEASUREMENT
/begin MEASUREMENT SPARve_l_WheelRadius "..." SWORD F_0v0009765625_p0_22 1 2 -32 31.99902344 ECU_ADDRESS 0x0 /end MEASUREMENT
/begin MEASUREMENT SPARve_r_P1MtrRatio "..." SWORD F_0v0009765625_p0_22 1 2 -32 31.99902344 ECU_ADDRESS 0x0 /end MEASUREMENT
/begin MEASUREMENT SPARve_r_P1Trans1stGearRatio "..." SWORD F_0v0009765625_p0_22 1 2 -32 31.99902344 ECU_ADDRESS 0x0 /end MEASUREMENT
/begin MEASUREMENT SPARve_r_P1Trans1stGearRatio_IRV "..." SWORD F_0v0009765625_p0_22 1 2 -32 31.99902344 ECU_ADDRESS 0x0 /end MEASUREMENT
/begin MEASUREMENT SPARve_r_P1Trans2ndGearRatio "..." SWORD F_0v0009765625_p0_22 1 2 -32 31.99902344 ECU_ADDRESS 0x0 /end MEASUREMENT
/begin MEASUREMENT SPARve_r_P3TransDM_Ratio "..." SWORD F_0v0009765625_p0_22 1 2 -32 31.99902344 ECU_ADDRESS 0x0 /end MEASUREMENT
/begin MEASUREMENT SPARve_r_P3TransDM_Ratio_IRV "..." SWORD F_0v0009765625_p0_22 1 2 -32 31.99902344 ECU_ADDRESS 0x0 /end MEASUREMENT
/begin MEASUREMENT SPARve_r_TransFnlDrvRatio "..." SWORD F_0v0009765625_p0_22 1 2 -32 31.99902344 ECU_ADDRESS 0x0 /end MEASUREMENT
/begin MEASUREMENT SSSCve_e_EngineStatus "..." UBYTE I_1 1 2 0 255 ECU_ADDRESS 0x0 /end MEASUREMENT
/begin MEASUREMENT SWINve_M_P1MtrTrq "..." SWORD F_0v03125_p0_13 1 2 -1024 1023.96875 ECU_ADDRESS 0x0 /end MEASUREMENT
/begin MEASUREMENT SWINve_M_P3MtrTrq "..." SWORD F_0v03125_p0_13 1 2 -1024 1023.96875 ECU_ADDRESS 0x0 /end MEASUREMENT
/begin MEASUREMENT SWINve_P_MotorPower "..." FLOAT32_IEEE F_1_p0_76 1 2 -3.402823466E+038 3.402823466E+038 ECU_ADDRESS 0x0 /end MEASUREMENT
/begin MEASUREMENT SWINve_Pct_AccelPedalPosition "..." SWORD F_0v1_p0_2 1 2 -3276.8 3276.7 ECU_ADDRESS 0x0 /end MEASUREMENT
/begin MEASUREMENT SWINve_Pct_pepsPowerMode "..." SWORD F_0v1_p0_2 1 2 -3276.8 3276.7 ECU_ADDRESS 0x0 /end MEASUREMENT
/begin MEASUREMENT SWINve_T_P1Motor "..." SWORD F_0v0625_p0_14 1 2 -2048 2047.9375 ECU_ADDRESS 0x0 /end MEASUREMENT
/begin MEASUREMENT SWINve_T_P1Motor_IRV "..." SWORD F_0v0625_p0_14 1 2 -2048 2047.9375 ECU_ADDRESS 0x0 /end MEASUREMENT
/begin MEASUREMENT SWINve_T_P3Motor "..." SWORD F_0v0625_p0_14 1 2 -2048 2047.9375 ECU_ADDRESS 0x0 /end MEASUREMENT
/begin MEASUREMENT SWINve_T_P3Motor_IRV "..." SWORD F_0v0625_p0_14 1 2 -2048 2047.9375 ECU_ADDRESS 0x0 /end MEASUREMENT
/begin MEASUREMENT SWINve_U_ebsBATT "..." SWORD F_0v001953125_p0_77 1 2 -64 63.99804688 ECU_ADDRESS 0x0 /end MEASUREMENT
/begin MEASUREMENT SWINve_b_DrivingCycle "..." UBYTE Bool_ON_OFF 1 2 0 1 BIT_MASK 0x01 ECU_ADDRESS 0x0 /end MEASUREMENT
/begin MEASUREMENT SWINve_b_FaultClrInhibit "..." UBYTE Bool_ON_OFF 1 2 0 1 BIT_MASK 0x01 ECU_ADDRESS 0x0 /end MEASUREMENT
/begin MEASUREMENT SWINve_b_PDTCClrSts "..." UBYTE Bool_ON_OFF 1 2 0 1 BIT_MASK 0x01 ECU_ADDRESS 0x0 /end MEASUREMENT
/begin MEASUREMENT SWINve_b_PropulsionActive "..." UBYTE Bool_ON_OFF 1 2 0 1 BIT_MASK 0x01 ECU_ADDRESS 0x0 /end MEASUREMENT
/begin MEASUREMENT SWINve_b_WarmUpCycleCompleted "..." UBYTE Bool_ON_OFF 1 2 0 1 BIT_MASK 0x01 ECU_ADDRESS 0x0 /end MEASUREMENT
/begin MEASUREMENT SWINve_e_Dcyvalid "..." UBYTE I_1 1 2 0 255 ECU_ADDRESS 0x0 /end MEASUREMENT
/begin MEASUREMENT SWINve_e_GCU_COM_Validity "..." UBYTE I_1 1 2 0 255 ECU_ADDRESS 0x0 /end MEASUREMENT
/begin MEASUREMENT SWINve_e_MCU_COM_Validity "..." UBYTE I_1 1 2 0 255 ECU_ADDRESS 0x0 /end MEASUREMENT
/begin MEASUREMENT SWINve_e_MCU_P1_COM_Validity "..." UBYTE I_1 1 2 0 255 ECU_ADDRESS 0x0 /end MEASUREMENT
/begin MEASUREMENT SWINve_e_MCU_P3_COM_Validity "..." UBYTE I_1 1 2 0 255 ECU_ADDRESS 0x0 /end MEASUREMENT
/begin MEASUREMENT SWINve_e_P1MtrSpdVld "..." UBYTE I_1 1 2 0 255 ECU_ADDRESS 0x0 /end MEASUREMENT
/begin MEASUREMENT SWINve_e_P1MtrTempVld "..." UBYTE I_1 1 2 0 255 ECU_ADDRESS 0x0 /end MEASUREMENT
/begin MEASUREMENT SWINve_e_P1MtrTrqVld "..." UBYTE I_1 1 2 0 255 ECU_ADDRESS 0x0 /end MEASUREMENT
/begin MEASUREMENT SWINve_e_P3MtrSpdVld "..." UBYTE I_1 1 2 0 255 ECU_ADDRESS 0x0 /end MEASUREMENT
/begin MEASUREMENT SWINve_e_P3MtrTempVld "..." UBYTE I_1 1 2 0 255 ECU_ADDRESS 0x0 /end MEASUREMENT
/begin MEASUREMENT SWINve_e_P3MtrTrqVld "..." UBYTE I_1 1 2 0 255 ECU_ADDRESS 0x0 /end MEASUREMENT
/begin MEASUREMENT SWINve_e_VCU_COM_Validity "..." UBYTE I_1 1 2 0 255 ECU_ADDRESS 0x0 /end MEASUREMENT
/begin MEASUREMENT SWINve_n_P1MtrSpd "..." SWORD F_1_p0_4 1 2 -32768 32767 ECU_ADDRESS 0x0 /end MEASUREMENT
/begin MEASUREMENT SWINve_n_P3MtrSpd "..." SWORD F_1_p0_4 1 2 -32768 32767 ECU_ADDRESS 0x0 /end MEASUREMENT
/begin MEASUREMENT SWINve_r_P1TransInput "..." SWORD F_0v0009765625_p0_22 1 2 -32 31.99902344 ECU_ADDRESS 0x0 /end MEASUREMENT
/begin MEASUREMENT SWINve_r_P1TransInput_IRV "..." SWORD F_0v0009765625_p0_22 1 2 -32 31.99902344 ECU_ADDRESS 0x0 /end MEASUREMENT
/begin MEASUREMENT SWINve_t_Day "..." UBYTE I_1 1 2 0 255 ECU_ADDRESS 0x0 /end MEASUREMENT
/begin MEASUREMENT SWINve_t_Hour "..." UBYTE I_1 1 2 0 255 ECU_ADDRESS 0x0 /end MEASUREMENT
/begin MEASUREMENT SWINve_t_Minute "..." UBYTE I_1 1 2 0 255 ECU_ADDRESS 0x0 /end MEASUREMENT
/begin MEASUREMENT SWINve_t_Month "..." UBYTE I_1 1 2 0 255 ECU_ADDRESS 0x0 /end MEASUREMENT
/begin MEASUREMENT SWINve_t_Second "..." UBYTE I_1 1 2 0 255 ECU_ADDRESS 0x0 /end MEASUREMENT
/begin MEASUREMENT SWINve_t_Year "..." UWORD F_1_p0_4 1 2 0 65535 ECU_ADDRESS 0x0 /end MEASUREMENT
/begin MEASUREMENT SWINve_y_VCUFault "..." UBYTE I_1 1 2 0 255 ECU_ADDRESS 0x0 /end MEASUREMENT
/begin MEASUREMENT SYVDve_U_MotorSupplyVoltage "..." SWORD F_0v001953125_p0_77 1 2 -64 63.99804688 ECU_ADDRESS 0x0 /end MEASUREMENT
/begin MEASUREMENT SYVDve_U_SystemVoltage "..." SWORD F_0v001953125_p0_77 1 2 -64 63.99804688 ECU_ADDRESS 0x0 /end MEASUREMENT
/begin MEASUREMENT SYVDve_U_SystemVoltage_IRV "..." SWORD F_0v001953125_p0_77 1 2 -64 63.99804688 ECU_ADDRESS 0x0 /end MEASUREMENT
/begin MEASUREMENT SYVDve_y_BSWDiagBLDCSupOvrVolt "..." UBYTE I_1 1 2 0 255 ECU_ADDRESS 0x0 /end MEASUREMENT
/begin MEASUREMENT SYVDve_y_BSWDiagBLDCSupUnrVolt "..." UBYTE I_1 1 2 0 255 ECU_ADDRESS 0x0 /end MEASUREMENT
/begin MEASUREMENT TAMDve_I_HWIO_MotorCurrent_IRV "..." SWORD F_0v03125_p0_13 1 2 -1024 1023.96875 ECU_ADDRESS 0x0 /end MEASUREMENT
/begin MEASUREMENT TAMDve_Pct_HWIO_MotorActPWM_IRV "..." SWORD F_0v1_p0_2 1 2 -3276.8 3276.7 ECU_ADDRESS 0x0 /end MEASUREMENT
/begin MEASUREMENT TAMDve_T_ClutchActPwrStg "..." SWORD F_0v0625_p0_14 1 2 -2048 2047.9375 ECU_ADDRESS 0x0 /end MEASUREMENT
/begin MEASUREMENT TAMDve_e_ClutchActPwrStgTempVld "..." UBYTE I_1 1 2 0 255 ECU_ADDRESS 0x0 /end MEASUREMENT
/begin MEASUREMENT TAMDve_e_ClutchActuatorVld "..." UBYTE I_1 1 2 0 255 ECU_ADDRESS 0x0 /end MEASUREMENT
/begin MEASUREMENT TAMDve_e_MosfetVld "..." UBYTE I_1 1 2 0 255 ECU_ADDRESS 0x0 /end MEASUREMENT
/begin MEASUREMENT TAMDve_e_StuckVld "..." UBYTE I_1 1 2 0 255 ECU_ADDRESS 0x0 /end MEASUREMENT
/begin MEASUREMENT TAMDve_n_HWIO_MotorRotSpd_IRV "..." SWORD F_1_p0_4 1 2 -32768 32767 ECU_ADDRESS 0x0 /end MEASUREMENT
/begin MEASUREMENT TAMDve_y_BSWDiagDrvOvrCur "..." UBYTE I_1 1 2 0 255 ECU_ADDRESS 0x0 /end MEASUREMENT
/begin MEASUREMENT TAMDve_y_BSWDiagDrvOvrTemp "..." UBYTE I_1 1 2 0 255 ECU_ADDRESS 0x0 /end MEASUREMENT
/begin MEASUREMENT TAMDve_y_BSWDiagDrvSupOvrVolt "..." UBYTE I_1 1 2 0 255 ECU_ADDRESS 0x0 /end MEASUREMENT
/begin MEASUREMENT TAMDve_y_BSWDiagHALInvalFault "..." UBYTE I_1 1 2 0 255 ECU_ADDRESS 0x0 /end MEASUREMENT
/begin MEASUREMENT TAMDve_y_BSWDiagHALSigOvrVolt "..." UBYTE I_1 1 2 0 255 ECU_ADDRESS 0x0 /end MEASUREMENT
/begin MEASUREMENT TAMDve_y_BSWDiagHALSigUndrVolt "..." UBYTE I_1 1 2 0 255 ECU_ADDRESS 0x0 /end MEASUREMENT
/begin MEASUREMENT TAMDve_y_BSWDiagHALSupOvrVolt "..." UBYTE I_1 1 2 0 255 ECU_ADDRESS 0x0 /end MEASUREMENT
/begin MEASUREMENT TAMDve_y_BSWDiagHALSupUndrVolt "..." UBYTE I_1 1 2 0 255 ECU_ADDRESS 0x0 /end MEASUREMENT
/begin MEASUREMENT TAMDve_y_BSWDiagHALUndefFault "..." UBYTE I_1 1 2 0 255 ECU_ADDRESS 0x0 /end MEASUREMENT
/begin MEASUREMENT TAMDve_y_BSWDiagMosUnderVolt "..." UBYTE I_1 1 2 0 255 ECU_ADDRESS 0x0 /end MEASUREMENT
/begin MEASUREMENT TAMDve_y_BSWDiagPhaseHigh "..." UBYTE I_1 1 2 0 255 ECU_ADDRESS 0x0 /end MEASUREMENT
/begin MEASUREMENT TAMDve_y_BSWDiagPhaseLow "..." UBYTE I_1 1 2 0 255 ECU_ADDRESS 0x0 /end MEASUREMENT
/begin MEASUREMENT TAMDve_y_BSWDiagPhasePerf "..." UBYTE I_1 1 2 0 255 ECU_ADDRESS 0x0 /end MEASUREMENT
/begin MEASUREMENT TAMDve_y_EC_MosStatus "..." UBYTE I_1 1 2 0 255 ECU_ADDRESS 0x0 /end MEASUREMENT
/begin MEASUREMENT TAMDve_y_EC_Status "..." UBYTE I_1 1 2 0 255 ECU_ADDRESS 0x0 /end MEASUREMENT
/begin MEASUREMENT TAMDve_y_EC_StuckStatus "..." UBYTE I_1 1 2 0 255 ECU_ADDRESS 0x0 /end MEASUREMENT
/begin MEASUREMENT TAMDve_y_Status "..." UBYTE I_1 1 2 0 255 ECU_ADDRESS 0x0 /end MEASUREMENT
/begin MEASUREMENT TCAPve_e_DrivelineState "..." UBYTE I_1 1 2 0 255 ECU_ADDRESS 0x0 /end MEASUREMENT
/begin MEASUREMENT TCFCve_Cnt_CCPM_CommandDBC "..." UBYTE I_1 1 2 0 255 ECU_ADDRESS 0x0 /end MEASUREMENT
/begin MEASUREMENT TCFCve_I_CCPM "..." SWORD F_0v03125_p0_13 1 2 -1024 1023.96875 ECU_ADDRESS 0x0 /end MEASUREMENT
/begin MEASUREMENT TCFCve_I_CCPM_CompletePhase "..." SWORD F_0v03125_p0_13 1 2 -1024 1023.96875 ECU_ADDRESS 0x0 /end MEASUREMENT
/begin MEASUREMENT TCFCve_I_CCPM_IRV "..." SWORD F_0v03125_p0_13 1 2 -1024 1023.96875 ECU_ADDRESS 0x0 /end MEASUREMENT
/begin MEASUREMENT TCFCve_Pct_CCPM_DC "..." SWORD F_0v1_p0_2 1 2 -3276.8 3276.7 ECU_ADDRESS 0x0 /end MEASUREMENT
/begin MEASUREMENT TCFCve_Pct_CCPM_DC_DBC "..." SWORD F_0v1_p0_2 1 2 -3276.8 3276.7 ECU_ADDRESS 0x0 /end MEASUREMENT
/begin MEASUREMENT TCFCve_Pct_CCPM_DC_IRV "..." SWORD F_0v1_p0_2 1 2 -3276.8 3276.7 ECU_ADDRESS 0x0 /end MEASUREMENT
/begin MEASUREMENT TCFCve_Pct_C_Pct_CCP_Data "..." SWORD F_0v1_p0_2 1 2 -3276.8 3276.7 ECU_ADDRESS 0x0 /end MEASUREMENT
/begin MEASUREMENT TCFCve_b_CCPM_SpeedControllerActive "..." UBYTE I_1 1 2 0 255 ECU_ADDRESS 0x0 /end MEASUREMENT
/begin MEASUREMENT TCFCve_b_TargetSpeedActive_IRV "..." UBYTE I_1 1 2 0 255 ECU_ADDRESS 0x0 /end MEASUREMENT
/begin MEASUREMENT TCFCve_dV_C_dV_CCP_Data "..." SWORD F_0v0078125_p0_78 1 2 -256 255.9921875 ECU_ADDRESS 0x0 /end MEASUREMENT
/begin MEASUREMENT TCFCve_dV_CoolingFlow "..." SWORD F_0v0078125_p0_78 1 2 -256 255.9921875 ECU_ADDRESS 0x0 /end MEASUREMENT
/begin MEASUREMENT TCFCve_dV_CoolingFlowDBC "..." SWORD F_0v0078125_p0_78 1 2 -256 255.9921875 ECU_ADDRESS 0x0 /end MEASUREMENT
/begin MEASUREMENT TCFCve_dV_CoolingFlow_IRV "..." SWORD F_0v0078125_p0_78 1 2 -256 255.9921875 ECU_ADDRESS 0x0 /end MEASUREMENT
/begin MEASUREMENT TCFCve_e_CCP_DID_Enabled "..." UBYTE I_1 1 2 0 255 ECU_ADDRESS 0x0 /end MEASUREMENT
/begin MEASUREMENT TCFCve_e_CCP_DID_EnabledIndication "..." UBYTE I_1 1 2 0 255 ECU_ADDRESS 0x0 /end MEASUREMENT
/begin MEASUREMENT TCFCve_e_NegativeResponseCode_IRV "..." UBYTE I_1 1 2 0 255 ECU_ADDRESS 0x0 /end MEASUREMENT
/begin MEASUREMENT TCFCve_n_CCPM_CurrentSpeedLimit "..." SWORD F_1_p0_4 1 2 -32768 32767 ECU_ADDRESS 0x0 /end MEASUREMENT
/begin MEASUREMENT TCFCve_n_CCPM_IRV "..." SWORD F_1_p0_4 1 2 -32768 32767 ECU_ADDRESS 0x0 /end MEASUREMENT
/begin MEASUREMENT TCFCve_n_CCPM_SpeedControllerTarget "..." SWORD F_1_p0_4 1 2 -32768 32767 ECU_ADDRESS 0x0 /end MEASUREMENT
/begin MEASUREMENT TCFCve_n_CCPM_SpeedControllerTarget_IRV "..." SWORD F_1_p0_4 1 2 -32768 32767 ECU_ADDRESS 0x0 /end MEASUREMENT
/begin MEASUREMENT TCFCve_n_CCPM_SpeedTgtDBC "..." SWORD F_1_p0_4 1 2 -32768 32767 ECU_ADDRESS 0x0 /end MEASUREMENT
/begin MEASUREMENT TCFCve_n_C_n_CCP_Data "..." SWORD F_1_p0_4 1 2 -32768 32767 ECU_ADDRESS 0x0 /end MEASUREMENT
/begin MEASUREMENT TCFCve_r_CCP_Y "..." UWORD F_0v0000305176_p0_19 1 2 0 1.999969482 ECU_ADDRESS 0x0 /end MEASUREMENT
/begin MEASUREMENT TCFRve_I_CAP_PhaseCurrentLimitation "..." SWORD F_0v03125_p0_13 1 2 -1024 1023.96875 ECU_ADDRESS 0x0 /end MEASUREMENT
/begin MEASUREMENT TCFRve_I_CurrentAvailableForClutch "..." SWORD F_0v03125_p0_13 1 2 -1024 1023.96875 ECU_ADDRESS 0x0 /end MEASUREMENT
/begin MEASUREMENT TCFRve_Pct_FanRequest "..." SWORD F_1_p0_4 1 2 -32768 32767 ECU_ADDRESS 0x0 /end MEASUREMENT
/begin MEASUREMENT TCFRve_b_AfterRunRequest "..." UBYTE I_1 1 2 0 255 ECU_ADDRESS 0x0 /end MEASUREMENT
/begin MEASUREMENT TCFRve_b_AtMinLubrication_IRV "..." UBYTE I_1 1 2 0 255 ECU_ADDRESS 0x0 /end MEASUREMENT
/begin MEASUREMENT TCFRve_b_ClutchAvailable "..." UBYTE Bool_ON_OFF 1 2 0 1 BIT_MASK 0x01 ECU_ADDRESS 0x0 /end MEASUREMENT
/begin MEASUREMENT TCFRve_b_CoolingNeedPreventsCoolingIOC "..." UBYTE I_1 1 2 0 255 ECU_ADDRESS 0x0 /end MEASUREMENT
/begin MEASUREMENT TCFRve_b_TooCloseToOverCurrent "..." UBYTE I_1 1 2 0 255 ECU_ADDRESS 0x0 /end MEASUREMENT
/begin MEASUREMENT TCFRve_dV_CCP_OvercurrentLimitation "..." SWORD F_0v0078125_p0_78 1 2 -256 255.9921875 ECU_ADDRESS 0x0 /end MEASUREMENT
/begin MEASUREMENT TCFRve_dV_CCP_UsedLimit "..." SWORD F_0v0078125_p0_78 1 2 -256 255.9921875 ECU_ADDRESS 0x0 /end MEASUREMENT
/begin MEASUREMENT TCFRve_dV_CoolingFlowCommand "..." SWORD F_0v0078125_p0_78 1 2 -256 255.9921875 ECU_ADDRESS 0x0 /end MEASUREMENT
/begin MEASUREMENT TCMDve_Cnt_RC_SpdDev_Diags "..." UWORD F_1_p0_4 1 2 0 65535 ECU_ADDRESS 0x0 /end MEASUREMENT
/begin MEASUREMENT TCMDve_Cnt_RC_SpdDev_Fails "..." UWORD F_1_p0_4 1 2 0 65535 ECU_ADDRESS 0x0 /end MEASUREMENT
/begin MEASUREMENT TCMDve_I_HWIO_MotorCurrent_IRV "..." SWORD F_0v03125_p0_13 1 2 -1024 1023.96875 ECU_ADDRESS 0x0 /end MEASUREMENT
/begin MEASUREMENT TCMDve_Pct_HWIO_MotorActPWM_IRV "..." SWORD F_1_p0_4 1 2 -32768 32767 ECU_ADDRESS 0x0 /end MEASUREMENT
/begin MEASUREMENT TCMDve_T_CoolingActPwrStg "..." SWORD F_0v0625_p0_14 1 2 -2048 2047.9375 ECU_ADDRESS 0x0 /end MEASUREMENT
/begin MEASUREMENT TCMDve_b_NewCycle "..." UBYTE Bool_ON_OFF 1 2 0 1 BIT_MASK 0x01 ECU_ADDRESS 0x0 /end MEASUREMENT
/begin MEASUREMENT TCMDve_b_StuckNewCycle "..." UBYTE Bool_ON_OFF 1 2 0 1 BIT_MASK 0x01 ECU_ADDRESS 0x0 /end MEASUREMENT
/begin MEASUREMENT TCMDve_e_CoolingActPwrStgTempVld "..." UBYTE I_1 1 2 0 255 ECU_ADDRESS 0x0 /end MEASUREMENT
/begin MEASUREMENT TCMDve_e_CoolingActSpdDevVld "..." UBYTE I_1 1 2 0 255 ECU_ADDRESS 0x0 /end MEASUREMENT
/begin MEASUREMENT TCMDve_e_CoolingActuatorVld "..." UBYTE I_1 1 2 0 255 ECU_ADDRESS 0x0 /end MEASUREMENT
/begin MEASUREMENT TCMDve_e_MosfetVld "..." UBYTE I_1 1 2 0 255 ECU_ADDRESS 0x0 /end MEASUREMENT
/begin MEASUREMENT TCMDve_e_StuckVld "..." UBYTE I_1 1 2 0 255 ECU_ADDRESS 0x0 /end MEASUREMENT
/begin MEASUREMENT TCMDve_n_HWIO_MotorRotSpd_IRV "..." SWORD F_1_p0_4 1 2 -32768 32767 ECU_ADDRESS 0x0 /end MEASUREMENT
/begin MEASUREMENT TCMDve_n_MotorSpeed "..." SWORD F_1_p0_4 1 2 -32768 32767 ECU_ADDRESS 0x0 /end MEASUREMENT
/begin MEASUREMENT TCMDve_y_BSWDiagDrvOvrCur "..." UBYTE I_1 1 2 0 255 ECU_ADDRESS 0x0 /end MEASUREMENT
/begin MEASUREMENT TCMDve_y_BSWDiagDrvOvrTemp "..." UBYTE I_1 1 2 0 255 ECU_ADDRESS 0x0 /end MEASUREMENT
/begin MEASUREMENT TCMDve_y_BSWDiagDrvSupOvrVolt "..." UBYTE I_1 1 2 0 255 ECU_ADDRESS 0x0 /end MEASUREMENT
/begin MEASUREMENT TCMDve_y_BSWDiagHALFault "..." UBYTE I_1 1 2 0 255 ECU_ADDRESS 0x0 /end MEASUREMENT
/begin MEASUREMENT TCMDve_y_BSWDiagHALSupOvrVolt "..." UBYTE I_1 1 2 0 255 ECU_ADDRESS 0x0 /end MEASUREMENT
/begin MEASUREMENT TCMDve_y_BSWDiagHALSupUndrVolt "..." UBYTE I_1 1 2 0 255 ECU_ADDRESS 0x0 /end MEASUREMENT
/begin MEASUREMENT TCMDve_y_BSWDiagPhaseHigh "..." UBYTE I_1 1 2 0 255 ECU_ADDRESS 0x0 /end MEASUREMENT
/begin MEASUREMENT TCMDve_y_BSWDiagPhaseLow "..." UBYTE I_1 1 2 0 255 ECU_ADDRESS 0x0 /end MEASUREMENT
/begin MEASUREMENT TCMDve_y_BSWDiagPhasePerf "..." UBYTE I_1 1 2 0 255 ECU_ADDRESS 0x0 /end MEASUREMENT
/begin MEASUREMENT TCMDve_y_EC_MosStatus "..." UBYTE I_1 1 2 0 255 ECU_ADDRESS 0x0 /end MEASUREMENT
/begin MEASUREMENT TCMDve_y_EC_Status "..." UBYTE I_1 1 2 0 255 ECU_ADDRESS 0x0 /end MEASUREMENT
/begin MEASUREMENT TCMDve_y_EC_StuckStatus "..." UBYTE I_1 1 2 0 255 ECU_ADDRESS 0x0 /end MEASUREMENT
/begin MEASUREMENT TCMDve_y_RC_SpdDev_MosStatus "..." UBYTE Bool_ON_OFF 1 2 0 1 BIT_MASK 0x01 ECU_ADDRESS 0x0 /end MEASUREMENT
/begin MEASUREMENT TCMDve_y_RC_SpdDev_Progress "..." UBYTE I_1 1 2 0 255 ECU_ADDRESS 0x0 /end MEASUREMENT
/begin MEASUREMENT TCMDve_y_RC_SpdDev_Status "..." UBYTE I_1 1 2 0 255 ECU_ADDRESS 0x0 /end MEASUREMENT
/begin MEASUREMENT TCMDve_y_Status "..." UBYTE I_1 1 2 0 255 ECU_ADDRESS 0x0 /end MEASUREMENT
/begin MEASUREMENT TCPDne_p_BiasComp "..." FLOAT32_IEEE I_1 1 2 -3.402823466E+038 3.402823466E+038 ECU_ADDRESS 0x0 /end MEASUREMENT
/begin MEASUREMENT TCPDve_Cnt_RC_Bias_Diags "..." UWORD F_1_p0_4 1 2 0 65535 ECU_ADDRESS 0x0 /end MEASUREMENT
/begin MEASUREMENT TCPDve_Cnt_RC_Bias_Fails "..." UWORD F_1_p0_4 1 2 0 65535 ECU_ADDRESS 0x0 /end MEASUREMENT
/begin MEASUREMENT TCPDve_Cnt_RC_HighClutchPres_Diags "..." UWORD F_1_p0_4 1 2 0 65535 ECU_ADDRESS 0x0 /end MEASUREMENT
/begin MEASUREMENT TCPDve_Cnt_RC_HighClutchPres_Fails "..." UWORD F_1_p0_4 1 2 0 65535 ECU_ADDRESS 0x0 /end MEASUREMENT
/begin MEASUREMENT TCPDve_Cnt_RC_LowClutchPres_Diags "..." UWORD F_1_p0_4 1 2 0 65535 ECU_ADDRESS 0x0 /end MEASUREMENT
/begin MEASUREMENT TCPDve_Cnt_RC_LowClutchPres_Fails "..." UWORD F_1_p0_4 1 2 0 65535 ECU_ADDRESS 0x0 /end MEASUREMENT
/begin MEASUREMENT TCPDve_Cnt_RC_MaxPres_Diags "..." UWORD F_1_p0_4 1 2 0 65535 ECU_ADDRESS 0x0 /end MEASUREMENT
/begin MEASUREMENT TCPDve_Cnt_RC_MaxPres_Fails "..." UWORD F_1_p0_4 1 2 0 65535 ECU_ADDRESS 0x0 /end MEASUREMENT
/begin MEASUREMENT TCPDve_U_ClutchPressureRaw "..." SWORD F_1_p0_4 1 2 -32768 32767 ECU_ADDRESS 0x0 /end MEASUREMENT
/begin MEASUREMENT TCPDve_U_ClutchPressureVoltage "..." SWORD F_1_p0_4 1 2 -32768 32767 ECU_ADDRESS 0x0 /end MEASUREMENT
/begin MEASUREMENT TCPDve_b_ClearBiasComp "..." UBYTE Bool_ON_OFF 1 2 0 1 BIT_MASK 0x01 ECU_ADDRESS 0x0 /end MEASUREMENT
/begin MEASUREMENT TCPDve_e_ClutchPressureHighVld "..." UBYTE I_1 1 2 0 255 ECU_ADDRESS 0x0 /end MEASUREMENT
/begin MEASUREMENT TCPDve_e_ClutchPressureLowVld "..." UBYTE I_1 1 2 0 255 ECU_ADDRESS 0x0 /end MEASUREMENT
/begin MEASUREMENT TCPDve_e_ClutchPressureSensPerfVld "..." UBYTE I_1 1 2 0 255 ECU_ADDRESS 0x0 /end MEASUREMENT
/begin MEASUREMENT TCPDve_e_ClutchPressureSensorVld "..." UBYTE I_1 1 2 0 255 ECU_ADDRESS 0x0 /end MEASUREMENT
/begin MEASUREMENT TCPDve_p_AveragePresAtStart "..." FLOAT32_IEEE I_1 1 2 -3.402823466E+038 3.402823466E+038 ECU_ADDRESS 0x0 /end MEASUREMENT
/begin MEASUREMENT TCPDve_p_BiasComp_IRV "..." FLOAT32_IEEE I_1 1 2 -3.402823466E+038 3.402823466E+038 ECU_ADDRESS 0x0 /end MEASUREMENT
/begin MEASUREMENT TCPDve_p_ClutchPressure "..." UWORD F_0v03125_p0_13 1 2 0 2047.96875 ECU_ADDRESS 0x0 /end MEASUREMENT
/begin MEASUREMENT TCPDve_y_BSWDiagHigh "..." UBYTE I_1 1 2 0 255 ECU_ADDRESS 0x0 /end MEASUREMENT
/begin MEASUREMENT TCPDve_y_BSWDiagLow "..." UBYTE I_1 1 2 0 255 ECU_ADDRESS 0x0 /end MEASUREMENT
/begin MEASUREMENT TCPDve_y_EC_Status "..." UBYTE I_1 1 2 0 255 ECU_ADDRESS 0x0 /end MEASUREMENT
/begin MEASUREMENT TCPDve_y_RC_Bias_Progress "..." UBYTE I_1 1 2 0 255 ECU_ADDRESS 0x0 /end MEASUREMENT
/begin MEASUREMENT TCPDve_y_RC_Bias_Status "..." UBYTE I_1 1 2 0 255 ECU_ADDRESS 0x0 /end MEASUREMENT
/begin MEASUREMENT TCPDve_y_RC_HighClutchPres_Progress "..." UBYTE I_1 1 2 0 255 ECU_ADDRESS 0x0 /end MEASUREMENT
/begin MEASUREMENT TCPDve_y_RC_HighClutchPres_Status "..." UBYTE I_1 1 2 0 255 ECU_ADDRESS 0x0 /end MEASUREMENT
/begin MEASUREMENT TCPDve_y_RC_LowClutchPres_Progress "..." UBYTE I_1 1 2 0 255 ECU_ADDRESS 0x0 /end MEASUREMENT
/begin MEASUREMENT TCPDve_y_RC_LowClutchPres_Status "..." UBYTE I_1 1 2 0 255 ECU_ADDRESS 0x0 /end MEASUREMENT
/begin MEASUREMENT TCPDve_y_RC_MaxPres_Progress "..." UBYTE I_1 1 2 0 255 ECU_ADDRESS 0x0 /end MEASUREMENT
/begin MEASUREMENT TCPDve_y_RC_MaxPres_Status "..." UBYTE I_1 1 2 0 255 ECU_ADDRESS 0x0 /end MEASUREMENT
/begin MEASUREMENT TCPDve_y_Status "..." UBYTE I_1 1 2 0 255 ECU_ADDRESS 0x0 /end MEASUREMENT
/begin MEASUREMENT TCU_AirFlowRequest "..." UBYTE F_0v5_p0_28 1 2 0 127.5 ECU_ADDRESS 0x0 /end MEASUREMENT
/begin MEASUREMENT TCU_ClutchAvailableMaximumTorque "..." UWORD F_0v125_m100_24 1 2 -100 8091.875 ECU_ADDRESS 0x0 /end MEASUREMENT
/begin MEASUREMENT TCU_ClutchAvailableMinimumTorque "..." UWORD F_0v125_m100_24 1 2 -100 8091.875 ECU_ADDRESS 0x0 /end MEASUREMENT
/begin MEASUREMENT TCU_ClutchCapacityAct "..." UWORD F_0v125_m100_24 1 2 -100 8091.875 ECU_ADDRESS 0x0 /end MEASUREMENT
/begin MEASUREMENT TCU_Clutch_Status "..." UBYTE I_1 1 2 0 255 ECU_ADDRESS 0x0 /end MEASUREMENT
/begin MEASUREMENT TCU_CrankingAuthorizationEnable "..." UBYTE I_1 1 2 0 255 ECU_ADDRESS 0x0 /end MEASUREMENT
/begin MEASUREMENT TCU_FaultLamp_Req "..." UBYTE I_1 1 2 0 255 ECU_ADDRESS 0x0 /end MEASUREMENT
/begin MEASUREMENT TCU_Fault_Reaction_Req "..." UBYTE I_1 1 2 0 255 ECU_ADDRESS 0x0 /end MEASUREMENT
/begin MEASUREMENT TCU_GearEngagementAvailable "..." UBYTE I_1 1 2 0 255 ECU_ADDRESS 0x0 /end MEASUREMENT
/begin MEASUREMENT TCU_MaxFrtMotPwr_Req "..." UWORD F_0v1_m260_65 1 2 -260 6293.5 ECU_ADDRESS 0x0 /end MEASUREMENT
/begin MEASUREMENT TCU_MaxGCUPwr_Req "..." UWORD F_0v1_m150_79 1 2 -150 6403.5 ECU_ADDRESS 0x0 /end MEASUREMENT
/begin MEASUREMENT TCU_OBD_Lamp "..." UBYTE I_1 1 2 0 255 ECU_ADDRESS 0x0 /end MEASUREMENT
/begin MEASUREMENT TCU_OBD_Lamp_Req "..." UBYTE I_1 1 2 0 255 ECU_ADDRESS 0x0 /end MEASUREMENT
/begin MEASUREMENT TCU_TransmissionFluidTemp "..." UBYTE I_1 1 2 0 255 ECU_ADDRESS 0x0 /end MEASUREMENT
/begin MEASUREMENT TIRCve_M_ReqAtLashRtLim "..." SWORD F_0v03125_p0_13 1 2 -1024 1023.96875 ECU_ADDRESS 0x0 /end MEASUREMENT
/begin MEASUREMENT TIRCve_M_TransInputTorqueImmd "..." SWORD F_0v03125_p0_13 1 2 -1024 1023.96875 ECU_ADDRESS 0x0 /end MEASUREMENT
/begin MEASUREMENT TISCve_n_TargetIdleSpd "..." SWORD F_1_p0_4 1 2 -32768 32767 ECU_ADDRESS 0x0 /end MEASUREMENT
/begin MEASUREMENT TLMDve_Cnt_TransCtrlSysPerf_Diags "..." UWORD F_1_p0_4 1 2 0 65535 ECU_ADDRESS 0x0 /end MEASUREMENT
/begin MEASUREMENT TLMDve_Cnt_TransCtrlSysPerf_Fails "..." UWORD F_1_p0_4 1 2 0 65535 ECU_ADDRESS 0x0 /end MEASUREMENT
/begin MEASUREMENT TLMDve_b_PwrstgCrrntlShtOffByTLMD "..." UBYTE Bool_ON_OFF 1 2 0 1 BIT_MASK 0x01 ECU_ADDRESS 0x0 /end MEASUREMENT
/begin MEASUREMENT TLMDve_e_TransCtrlSysPerfVld "..." UBYTE I_1 1 2 0 255 ECU_ADDRESS 0x0 /end MEASUREMENT
/begin MEASUREMENT TLMDve_y_Status "..." UBYTE I_1 1 2 0 255 ECU_ADDRESS 0x0 /end MEASUREMENT
/begin MEASUREMENT TLMDve_y_TransCtrlSysPerf_Progress "..." UBYTE I_1 1 2 0 255 ECU_ADDRESS 0x0 /end MEASUREMENT
/begin MEASUREMENT TLMDve_y_TransCtrlSysPerf_Status "..." UBYTE I_1 1 2 0 255 ECU_ADDRESS 0x0 /end MEASUREMENT
/begin MEASUREMENT TOTDve_Cnt_RC_High_Diags "..." UWORD F_1_p0_4 1 2 0 65535 ECU_ADDRESS 0x0 /end MEASUREMENT
/begin MEASUREMENT TOTDve_Cnt_RC_High_Fails "..." UWORD F_1_p0_4 1 2 0 65535 ECU_ADDRESS 0x0 /end MEASUREMENT
/begin MEASUREMENT TOTDve_Cnt_RC_Low_Diags "..." UWORD F_1_p0_4 1 2 0 65535 ECU_ADDRESS 0x0 /end MEASUREMENT
/begin MEASUREMENT TOTDve_Cnt_RC_Low_Fails "..." UWORD F_1_p0_4 1 2 0 65535 ECU_ADDRESS 0x0 /end MEASUREMENT
/begin MEASUREMENT TOTDve_Cnt_RC_OilT_CritDiags "..." UWORD F_1_p0_4 1 2 0 65535 ECU_ADDRESS 0x0 /end MEASUREMENT
/begin MEASUREMENT TOTDve_Cnt_RC_OilT_CritFails "..." UWORD F_1_p0_4 1 2 0 65535 ECU_ADDRESS 0x0 /end MEASUREMENT
/begin MEASUREMENT TOTDve_Cnt_RC_OilT_WarnDiags "..." UWORD F_1_p0_4 1 2 0 65535 ECU_ADDRESS 0x0 /end MEASUREMENT
/begin MEASUREMENT TOTDve_Cnt_RC_OilT_WarnFails "..." UWORD F_1_p0_4 1 2 0 65535 ECU_ADDRESS 0x0 /end MEASUREMENT
/begin MEASUREMENT TOTDve_T_OilTemperature "..." SWORD F_0v0625_p0_14 1 2 -2048 2047.9375 ECU_ADDRESS 0x0 /end MEASUREMENT
/begin MEASUREMENT TOTDve_T_OilTemperature_IRV "..." SWORD F_0v0625_p0_14 1 2 -2048 2047.9375 ECU_ADDRESS 0x0 /end MEASUREMENT
/begin MEASUREMENT TOTDve_b_RC_DltFailRst "..." UBYTE Bool_ON_OFF 1 2 0 1 BIT_MASK 0x01 ECU_ADDRESS 0x0 /end MEASUREMENT
/begin MEASUREMENT TOTDve_e_TransmissionOilTempCritVld "..." UBYTE I_1 1 2 0 255 ECU_ADDRESS 0x0 /end MEASUREMENT
/begin MEASUREMENT TOTDve_e_TransmissionOilTempWarnVld "..." UBYTE I_1 1 2 0 255 ECU_ADDRESS 0x0 /end MEASUREMENT
/begin MEASUREMENT TOTDve_e_TransmissionTempSensorVld "..." UBYTE I_1 1 2 0 255 ECU_ADDRESS 0x0 /end MEASUREMENT
/begin MEASUREMENT TOTDve_y_RC_High_Progress "..." UBYTE I_1 1 2 0 255 ECU_ADDRESS 0x0 /end MEASUREMENT
/begin MEASUREMENT TOTDve_y_RC_High_Status "..." UBYTE I_1 1 2 0 255 ECU_ADDRESS 0x0 /end MEASUREMENT
/begin MEASUREMENT TOTDve_y_RC_Low_Progress "..." UBYTE I_1 1 2 0 255 ECU_ADDRESS 0x0 /end MEASUREMENT
/begin MEASUREMENT TOTDve_y_RC_Low_Status "..." UBYTE I_1 1 2 0 255 ECU_ADDRESS 0x0 /end MEASUREMENT
/begin MEASUREMENT TOTDve_y_RC_OilT_CritProgress "..." UBYTE I_1 1 2 0 255 ECU_ADDRESS 0x0 /end MEASUREMENT
/begin MEASUREMENT TOTDve_y_RC_OilT_CritStatus "..." UBYTE I_1 1 2 0 255 ECU_ADDRESS 0x0 /end MEASUREMENT
/begin MEASUREMENT TOTDve_y_RC_OilT_WarnProgress "..." UBYTE I_1 1 2 0 255 ECU_ADDRESS 0x0 /end MEASUREMENT
/begin MEASUREMENT TOTDve_y_RC_OilT_WarnStatus "..." UBYTE I_1 1 2 0 255 ECU_ADDRESS 0x0 /end MEASUREMENT
/begin MEASUREMENT TOTDve_y_Status "..." UBYTE I_1 1 2 0 255 ECU_ADDRESS 0x0 /end MEASUREMENT
/begin MEASUREMENT TSPCve_n_EvenClthSpeed "..." SWORD F_1_p0_4 1 2 -32768 32767 ECU_ADDRESS 0x0 /end MEASUREMENT
/begin MEASUREMENT TSPCve_n_OddClthSpeed "..." SWORD F_1_p0_4 1 2 -32768 32767 ECU_ADDRESS 0x0 /end MEASUREMENT
/begin MEASUREMENT TSPCve_n_P1RotationalSpeedERS "..." SWORD F_1_p0_4 1 2 -32768 32767 ECU_ADDRESS 0x0 /end MEASUREMENT
/begin MEASUREMENT TSPCve_n_TransOutputSpeed "..." SWORD F_1_p0_4 1 2 -32768 32767 ECU_ADDRESS 0x0 /end MEASUREMENT
/begin MEASUREMENT TSPCve_n_TransP1ClutchInputSpeed "..." SWORD F_1_p0_4 1 2 -32768 32767 ECU_ADDRESS 0x0 /end MEASUREMENT
/begin MEASUREMENT TSPCve_n_TransP3InputSpeed "..." SWORD F_1_p0_4 1 2 -32768 32767 ECU_ADDRESS 0x0 /end MEASUREMENT
/begin MEASUREMENT TSSDve_Cnt_ClutchDragTrqTooHighFail "..." UBYTE I_1 1 2 0 255 ECU_ADDRESS 0x0 /end MEASUREMENT
/begin MEASUREMENT TSSDve_Cnt_RC_ClTrq_Diags "..." UWORD F_1_p0_4 1 2 0 65535 ECU_ADDRESS 0x0 /end MEASUREMENT
/begin MEASUREMENT TSSDve_Cnt_RC_ClTrq_Fails "..." UWORD F_1_p0_4 1 2 0 65535 ECU_ADDRESS 0x0 /end MEASUREMENT
/begin MEASUREMENT TSSDve_Cnt_RC_DrgTrq_Diags "..." UWORD F_1_p0_4 1 2 0 65535 ECU_ADDRESS 0x0 /end MEASUREMENT
/begin MEASUREMENT TSSDve_Cnt_RC_DrgTrq_Fails "..." UWORD F_1_p0_4 1 2 0 65535 ECU_ADDRESS 0x0 /end MEASUREMENT
/begin MEASUREMENT TSSDve_e_ClutchCapacityInsuffVld "..." UBYTE I_1 1 2 0 255 ECU_ADDRESS 0x0 /end MEASUREMENT
/begin MEASUREMENT TSSDve_e_ClutchDragTrqTooHighVld "..." UBYTE I_1 1 2 0 255 ECU_ADDRESS 0x0 /end MEASUREMENT
/begin MEASUREMENT TSSDve_t_RC_DrgTrq_ClOpenTimer "..." UWORD F_1_p0_4 1 2 0 65535 ECU_ADDRESS 0x0 /end MEASUREMENT
/begin MEASUREMENT TSSDve_t_RC_DrgTrq_ICEOffTimer "..." UWORD F_1_p0_4 1 2 0 65535 ECU_ADDRESS 0x0 /end MEASUREMENT
/begin MEASUREMENT TSSDve_y_RC_ClTrq_Progress "..." UBYTE I_1 1 2 0 255 ECU_ADDRESS 0x0 /end MEASUREMENT
/begin MEASUREMENT TSSDve_y_RC_ClTrq_Status "..." UBYTE I_1 1 2 0 255 ECU_ADDRESS 0x0 /end MEASUREMENT
/begin MEASUREMENT TSSDve_y_RC_DrgTrq_Progress "..." UBYTE I_1 1 2 0 255 ECU_ADDRESS 0x0 /end MEASUREMENT
/begin MEASUREMENT TSSDve_y_RC_DrgTrq_Status "..." UBYTE I_1 1 2 0 255 ECU_ADDRESS 0x0 /end MEASUREMENT
/begin MEASUREMENT TSSDve_y_Status "..." UBYTE I_1 1 2 0 255 ECU_ADDRESS 0x0 /end MEASUREMENT
/begin MEASUREMENT TTSSve_M_P1MaxTrqImmd "..." SWORD F_0v03125_p0_13 1 2 -1024 1023.96875 ECU_ADDRESS 0x0 /end MEASUREMENT
/begin MEASUREMENT TTSSve_M_P1MinTrqImmd "..." SWORD F_0v03125_p0_13 1 2 -1024 1023.96875 ECU_ADDRESS 0x0 /end MEASUREMENT
/begin MEASUREMENT TTSSve_b_P1TrqLimReq "..." UBYTE I_1 1 2 0 255 ECU_ADDRESS 0x0 /end MEASUREMENT
/begin MEASUREMENT TTSSve_e_SpdCntrlReqMod "..." UBYTE I_1 1 2 0 255 ECU_ADDRESS 0x0 /end MEASUREMENT
/begin MEASUREMENT TTSSve_n_SpdCntrlTarget "..." SWORD F_1_p0_4 1 2 -32768 32767 ECU_ADDRESS 0x0 /end MEASUREMENT
/begin MEASUREMENT Tbox3_CoolantTempValid "..." UBYTE I_1 1 2 0 255 ECU_ADDRESS 0x0 /end MEASUREMENT
/begin MEASUREMENT Tbox3_WarmUpCycle "..." UBYTE I_1 1 2 0 255 ECU_ADDRESS 0x0 /end MEASUREMENT
/begin MEASUREMENT V5RDve_e_EC_StatusRef1Vld "..." UBYTE I_1 1 2 0 255 ECU_ADDRESS 0x0 /end MEASUREMENT
/begin MEASUREMENT V5RDve_e_EC_StatusRef2Vld "..." UBYTE I_1 1 2 0 255 ECU_ADDRESS 0x0 /end MEASUREMENT
/begin MEASUREMENT V5RDve_e_EC_StatusRef3Vld "..." UBYTE I_1 1 2 0 255 ECU_ADDRESS 0x0 /end MEASUREMENT
/begin MEASUREMENT VCU_Fault "..." UBYTE I_1 1 2 0 255 ECU_ADDRESS 0x0 /end MEASUREMENT
/begin MEASUREMENT VECU_EngRunningStatusExpanded "..." UBYTE I_1 1 2 0 255 ECU_ADDRESS 0x0 /end MEASUREMENT
/begin MEASUREMENT VECU_EngSpdSignalFailure "..." UBYTE I_1 1 2 0 255 ECU_ADDRESS 0x0 /end MEASUREMENT
/begin MEASUREMENT VECU_IUP_RATE_GEN_DEN "..." UBYTE I_1 1 2 0 255 ECU_ADDRESS 0x0 /end MEASUREMENT
/begin MEASUREMENT VECU_IUP_RATE_GEN_INH "..." UBYTE I_1 1 2 0 255 ECU_ADDRESS 0x0 /end MEASUREMENT
/begin MEASUREMENT VODOve_l_TotalOdometer "..." ULONG I_1 1 2 0 4294967295 ECU_ADDRESS 0x0 /end MEASUREMENT
/begin MEASUREMENT VSPEve_e_DrvnWhlsSpdUnsignedVld "..." UBYTE I_1 1 2 0 255 ECU_ADDRESS 0x0 /end MEASUREMENT
/begin MEASUREMENT VSPEve_e_DrvnWhlsSpdVld "..." UBYTE I_1 1 2 0 255 ECU_ADDRESS 0x0 /end MEASUREMENT
/begin MEASUREMENT VSPEve_e_VehSpdCOGUnsignedVld "..." UBYTE I_1 1 2 0 255 ECU_ADDRESS 0x0 /end MEASUREMENT
/begin MEASUREMENT VSPEve_e_VehSpdCOGVld "..." UBYTE I_1 1 2 0 255 ECU_ADDRESS 0x0 /end MEASUREMENT
/begin MEASUREMENT VSPEve_v_DrvnWhlsSpd "..." SWORD F_0v015625_p0_17 1 2 -512 511.984375 ECU_ADDRESS 0x0 /end MEASUREMENT
/begin MEASUREMENT VSPEve_v_DrvnWhlsSpdUnsigned "..." UWORD F_0v015625_p0_17 1 2 0 1023.984375 ECU_ADDRESS 0x0 /end MEASUREMENT
/begin MEASUREMENT VSPEve_v_VehSpdCOG "..." SWORD F_0v015625_p0_17 1 2 -512 511.984375 ECU_ADDRESS 0x0 /end MEASUREMENT
/begin MEASUREMENT VSPEve_v_VehSpdCOGUnsigned "..." UWORD F_0v015625_p0_17 1 2 0 1023.984375 ECU_ADDRESS 0x0 /end MEASUREMENT
/begin MEASUREMENT VSPEve_v_VehSpdNonDrivenUnsigned "..." UWORD F_0v015625_p0_17 1 2 0 1023.984375 ECU_ADDRESS 0x0 /end MEASUREMENT
/begin MEASUREMENT VSSDve_e_VehicleSpeedVld "..." UBYTE I_1 1 2 0 255 ECU_ADDRESS 0x0 /end MEASUREMENT
/begin MEASUREMENT VSSDve_v_VehicleSpeed "..." SWORD F_0v015625_p0_17 1 2 -512 511.984375 ECU_ADDRESS 0x0 /end MEASUREMENT
/begin MEASUREMENT WSSDve_e_DrvnWhlSpdLeftVld "..." UBYTE I_1 1 2 0 255 ECU_ADDRESS 0x0 /end MEASUREMENT
/begin MEASUREMENT WSSDve_e_DrvnWhlSpdRightVld "..." UBYTE I_1 1 2 0 255 ECU_ADDRESS 0x0 /end MEASUREMENT
/begin MEASUREMENT WSSDve_e_NonDrvnWhlSpdLeftVld "..." UBYTE I_1 1 2 0 255 ECU_ADDRESS 0x0 /end MEASUREMENT
/begin MEASUREMENT WSSDve_e_NonDrvnWhlSpdRightVld "..." UBYTE I_1 1 2 0 255 ECU_ADDRESS 0x0 /end MEASUREMENT
/begin MEASUREMENT WSSDve_v_DrvnWhlSpdLeft "..." SWORD F_0v015625_p0_17 1 2 -512 511.984375 ECU_ADDRESS 0x0 /end MEASUREMENT
/begin MEASUREMENT WSSDve_v_DrvnWhlSpdRight "..." SWORD F_0v015625_p0_17 1 2 -512 511.984375 ECU_ADDRESS 0x0 /end MEASUREMENT
/begin MEASUREMENT WSSDve_v_NonDrvnWhlSpdLeft "..." SWORD F_0v015625_p0_17 1 2 -512 511.984375 ECU_ADDRESS 0x0 /end MEASUREMENT
/begin MEASUREMENT WSSDve_v_NonDrvnWhlSpdRight "..." SWORD F_0v015625_p0_17 1 2 -512 511.984375 ECU_ADDRESS 0x0 /end MEASUREMENT
/begin MEASUREMENT bcm_pepsPowerMode "..." UBYTE I_1 1 2 0 255 ECU_ADDRESS 0x0 /end MEASUREMENT
/begin MEASUREMENT ebs_U_BATT "..." UWORD F_0v0009765625_p0_22 1 2 0 63.99902344 ECU_ADDRESS 0x0 /end MEASUREMENT
/begin MEASUREMENT ic_totalMileage "..." ULONG I_1 1 2 0 4294967295 ECU_ADDRESS 0x0 /end MEASUREMENT
/begin MEASUREMENT ivi_timeInfoDay "..." UBYTE I_1 1 2 0 255 ECU_ADDRESS 0x0 /end MEASUREMENT
/begin MEASUREMENT ivi_timeInfoHour "..." UBYTE I_1 1 2 0 255 ECU_ADDRESS 0x0 /end MEASUREMENT
/begin MEASUREMENT ivi_timeInfoMinute "..." UBYTE I_1 1 2 0 255 ECU_ADDRESS 0x0 /end MEASUREMENT
/begin MEASUREMENT ivi_timeInfoMonth "..." UBYTE I_1 1 2 0 255 ECU_ADDRESS 0x0 /end MEASUREMENT
/begin MEASUREMENT ivi_timeInfoSecond "..." UBYTE I_1 1 2 0 255 ECU_ADDRESS 0x0 /end MEASUREMENT
/begin MEASUREMENT ivi_timeInfoYear "..." UBYTE F_1_p2000_85 1 2 2000 2255 ECU_ADDRESS 0x0 /end MEASUREMENT
/begin COMPU_METHOD I_1 "" RAT_FUNC "%9.2" "-" COEFFS 0 1 0 0 0 1 /end COMPU_METHOD
/begin COMPU_METHOD F_0v1_p0_2 "" RAT_FUNC "%9.2" "-" COEFFS 0 1 0 0 0 0.1 /end COMPU_METHOD
/begin COMPU_METHOD F_1_p0_4 "" RAT_FUNC "%9.2" "-" COEFFS 0 1 0 0 0 1 /end COMPU_METHOD
/begin COMPU_METHOD F_0v04_p1_8 "" RAT_FUNC "%9.2" "-" COEFFS 0 1 -1 0 0 0.04 /end COMPU_METHOD
/begin COMPU_METHOD F_0v01_p0_12 "" RAT_FUNC "%9.2" "ï¿½s" COEFFS 0 1 0 0 0 0.01 /end COMPU_METHOD
/begin COMPU_METHOD F_0v03125_p0_13 "" RAT_FUNC "%9.2" "-" COEFFS 0 1 0 0 0 0.03125 /end COMPU_METHOD
/begin COMPU_METHOD F_0v0625_p0_14 "" RAT_FUNC "%9.2" "-" COEFFS 0 1 0 0 0 0.0625 /end COMPU_METHOD
/begin COMPU_METHOD F_0v00390625_p0_16 "" RAT_FUNC "%9.3" "-" COEFFS 0 1 0 0 0 0.00390625 /end COMPU_METHOD
/begin COMPU_METHOD F_0v015625_p0_17 "" RAT_FUNC "%9.2" "-" COEFFS 0 1 0 0 0 0.015625 /end COMPU_METHOD
/begin COMPU_METHOD F_0v15625_p0_18 "" RAT_FUNC "%9.2" "-" COEFFS 0 1 0 0 0 0.15625 /end COMPU_METHOD
/begin COMPU_METHOD F_0v0000305176_p0_19 "" RAT_FUNC "%9.5" "-" COEFFS 0 1 0 0 0 3.05176e-005 /end COMPU_METHOD
/begin COMPU_METHOD F_0v01_p0_20 "" RAT_FUNC "%9.2" "-" COEFFS 0 1 0 0 0 0.01 /end COMPU_METHOD
/begin COMPU_METHOD F_0v0009765625_p0_22 "" RAT_FUNC "%9.4" "-" COEFFS 0 1 0 0 0 0.000976563 /end COMPU_METHOD
/begin COMPU_METHOD F_0v125_m100_24 "" RAT_FUNC "%9.2" "-" COEFFS 0 1 100 0 0 0.125 /end COMPU_METHOD
/begin COMPU_METHOD F_0v1_m350_25 "" RAT_FUNC "%9.2" "-" COEFFS 0 1 350 0 0 0.1 /end COMPU_METHOD
/begin COMPU_METHOD F_0v125_p0_26 "" RAT_FUNC "%9.2" "-" COEFFS 0 1 0 0 0 0.125 /end COMPU_METHOD
/begin COMPU_METHOD F_0v25_p0_27 "" RAT_FUNC "%9.2" "-" COEFFS 0 1 0 0 0 0.25 /end COMPU_METHOD
/begin COMPU_METHOD F_0v5_p0_28 "" RAT_FUNC "%9.2" "-" COEFFS 0 1 0 0 0 0.5 /end COMPU_METHOD
/begin COMPU_METHOD F_1_m40_29 "" RAT_FUNC "%9.2" "-" COEFFS 0 1 40 0 0 1 /end COMPU_METHOD
/begin COMPU_METHOD F_0v01_m327v68_32 "" RAT_FUNC "%9.2" "-" COEFFS 0 1 327.68 0 0 0.01 /end COMPU_METHOD
/begin COMPU_METHOD F_1_m32768_33 "" RAT_FUNC "%9.2" "-" COEFFS 0 1 32768 0 0 1 /end COMPU_METHOD
/begin COMPU_METHOD F_0v1_m3276v8_34 "" RAT_FUNC "%9.2" "-" COEFFS 0 1 3276.8 0 0 0.1 /end COMPU_METHOD
/begin COMPU_METHOD F_1_m20000_35 "" RAT_FUNC "%9.2" "-" COEFFS 0 1 20000 0 0 1 /end COMPU_METHOD
/begin COMPU_METHOD F_0v1_m310_36 "" RAT_FUNC "%9.2" "-" COEFFS 0 1 310 0 0 0.1 /end COMPU_METHOD
/begin COMPU_METHOD F_1_p0_39 "" RAT_FUNC "%9.2" "Nm" COEFFS 0 1 0 0 0 1 /end COMPU_METHOD
/begin COMPU_METHOD F_1_p0_40 "" RAT_FUNC "%9.2" "%" COEFFS 0 1 0 0 0 1 /end COMPU_METHOD
/begin COMPU_METHOD F_0v001_p0_42 "" RAT_FUNC "%9.3" "-" COEFFS 0 1 0 0 0 0.001 /end COMPU_METHOD
/begin COMPU_METHOD F_0v0061035156_p0_43 "" RAT_FUNC "%9.3" "%" COEFFS 0 1 0 0 0 0.00610352 /end COMPU_METHOD
/begin COMPU_METHOD F_1_p0_44 "" RAT_FUNC "%9.2" "rpm" COEFFS 0 1 0 0 0 1 /end COMPU_METHOD
/begin COMPU_METHOD F_1_p0_48 "" RAT_FUNC "%9.2" "A" COEFFS 0 1 0 0 0 1 /end COMPU_METHOD
/begin COMPU_METHOD F_1000000_p0_49 "" RAT_FUNC "%9.2" "us" COEFFS 0 1 0 0 0 1e+006 /end COMPU_METHOD
/begin COMPU_METHOD F_1_p0_51 "" RAT_FUNC "%9.2" "ms" COEFFS 0 1 0 0 0 1 /end COMPU_METHOD
/begin COMPU_METHOD F_0v04_p1_52 "" RAT_FUNC "%9.2" "us" COEFFS 0 1 -1 0 0 0.04 /end COMPU_METHOD
/begin COMPU_METHOD F_0v055_p0_53 "" RAT_FUNC "%9.2" "ï¿½s" COEFFS 0 1 0 0 0 0.055 /end COMPU_METHOD
/begin COMPU_METHOD F_0v02_p0_54 "" RAT_FUNC "%9.2" "ï¿½s" COEFFS 0 1 0 0 0 0.02 /end COMPU_METHOD
/begin COMPU_METHOD F_0v05625_p0_62 "" RAT_FUNC "%9.2" "-" COEFFS 0 1 0 0 0 0.05625 /end COMPU_METHOD
/begin COMPU_METHOD F_0v007813_p0_63 "" RAT_FUNC "%9.3" "-" COEFFS 0 1 0 0 0 0.007813 /end COMPU_METHOD
/begin COMPU_METHOD F_0v1_m450_64 "" RAT_FUNC "%9.2" "-" COEFFS 0 1 450 0 0 0.1 /end COMPU_METHOD
/begin COMPU_METHOD F_0v1_m260_65 "" RAT_FUNC "%9.2" "-" COEFFS 0 1 260 0 0 0.1 /end COMPU_METHOD
/begin COMPU_METHOD F_1_p0_66 "" RAT_FUNC "%9.2" "V" COEFFS 0 1 0 0 0 1 /end COMPU_METHOD
/begin COMPU_METHOD F_1_p0_67 "" RAT_FUNC "%9.2" "km" COEFFS 0 1 0 0 0 1 /end COMPU_METHOD
/begin COMPU_METHOD F_1_p0_68 "" RAT_FUNC "%9.2" "C" COEFFS 0 1 0 0 0 1 /end COMPU_METHOD
/begin COMPU_METHOD F_0v05_p0_69 "" RAT_FUNC "%9.2" "-" COEFFS 0 1 0 0 0 0.05 /end COMPU_METHOD
/begin COMPU_METHOD F_0v1_p0_70 "" RAT_FUNC "%9.2" "µs" COEFFS 0 1 0 0 0 0.1 /end COMPU_METHOD
/begin COMPU_METHOD F_100_p0_71 "" RAT_FUNC "%9.2" "ms" COEFFS 0 1 0 0 0 100 /end COMPU_METHOD
/begin COMPU_METHOD F_m0v0000045_p100_72 "" RAT_FUNC "%9.6" "%" COEFFS 0 1 -100 0 0 -4.5e-006 /end COMPU_METHOD
/begin COMPU_METHOD F_0v01_p0_73 "" RAT_FUNC "%9.2" "µs" COEFFS 0 1 0 0 0 0.01 /end COMPU_METHOD
/begin COMPU_METHOD F_1_p0_76 "" RAT_FUNC "%9.2" "kW" COEFFS 0 1 0 0 0 1 /end COMPU_METHOD
/begin COMPU_METHOD F_0v001953125_p0_77 "" RAT_FUNC "%9.3" "-" COEFFS 0 1 0 0 0 0.00195313 /end COMPU_METHOD
/begin COMPU_METHOD F_0v0078125_p0_78 "" RAT_FUNC "%9.3" "-" COEFFS 0 1 0 0 0 0.0078125 /end COMPU_METHOD
/begin COMPU_METHOD F_0v1_m150_79 "" RAT_FUNC "%9.2" "-" COEFFS 0 1 150 0 0 0.1 /end COMPU_METHOD
/begin COMPU_METHOD F_1_p2000_85 "" RAT_FUNC "%9.2" "-" COEFFS 0 1 -2000 0 0 1 /end COMPU_METHOD
/begin COMPU_METHOD Id_0x00 "" RAT_FUNC "%9.2" "." COEFFS 0 1 0 0 0 1 /end COMPU_METHOD
/begin COMPU_METHOD Bool_ON_OFF "" TAB_VERB "%8.4" "." COMPU_TAB_REF Bool_ON_OFF_table /end COMPU_METHOD
/begin COMPU_VTAB Bool_ON_OFF_table "" TAB_VERB 2 0 "OFF" 1 "ON" /end COMPU_VTAB
/begin FUNCTION MAIN ""
 /begin DEF_CHARACTERISTIC BSW_ku16CCPReinitTriggerC CLPCke_b_CAPM_CommandDBC_Enable FDMAie_b_ForceEngineStop_ob FDMAie_b_ForceEngineStop_ov FDMAie_b_ForceNeutralGear_ob FDMAie_b_ForceNeutralGear_ov GMAIN_bBldcBenchOnC GMAIN_bMSGRxToutBenchOnC GMAIN_bTcuStuckFlagTestOnC GMAIN_CCPbBenchTestOnC GMAIN_f32AccPosClrSSTimC GMAIN_f32AntiSlopExitSpdC GMAIN_f32AntiSsGapDrtGainC GMAIN_f32AntiSsValidTrqC GMAIN_f32BldcDebugDutyC GMAIN_f32BldcStuckDutyC GMAIN_f32BrakDeratGainC GMAIN_f32BrakPedalPosLowC GMAIN_f32BrakPedPosHighC GMAIN_f32OcAutophsGainC GMAIN_f32OcAutophsOffstC GMAIN_f32PowerdownVoltC GMAIN_f32PwmFreqHighThrdC GMAIN_f32PwmMaxDutyPhysC GMAIN_f32PwmMinDutyPhysC GMAIN_f32PwmRatioReduceC GMAIN_f32RandomFrecMecaSpdMaxC GMAIN_f32RandomFrecMecaSpdMinC GMAIN_f32SlopOrRoadSpdDiffC GMAIN_f32UvwOvCurrThdC GMAIN_f32VsiPwmPeriodC GMAIN_HARDBenchOnC GMAIN_ku16PwmPerdInitValC GMAIN_ku16SpdReadyEstConfirmC GMAIN_MSGbBenchTestOnC GMAIN_MSGbDbgFrameOnC GMAIN_MSGRxBenchOnC GMAIN_MSGTxBenchOnC GMAIN_MSGu8PwModFiltCntC GMAIN_s32CurHardDelayC GMAIN_s32ResHardDelayC GMAIN_s32SampleDelayC GMAIN_TCUbHilTestOnC GMAIN_TCUs16GcuMotTorqC GMAIN_TCUs16McuMotTorqC GMAIN_TCUu16OilPresVoltC GMAIN_TCUu16OilTempC GMAIN_TCUu32GcuMotSpeedC GMAIN_TCUu32McuMotSpeedC GMAIN_TCUu8GcuTempC GMAIN_TCUu8McuTempC GMAIN_TSTBenchOnC GMAIN_u16AntiSsChkTimC GMAIN_u16AntiSsEnaBrakTimC GMAIN_u16AntiSsGapTimC GMAIN_u16BrakRelsDelayC GMAIN_u16DetectSpdTestC GMAIN_u16FpgaFltClrTimoutC GMAIN_u16IdqDeltaCntMaxC GMAIN_u16OverBhvThdC GMAIN_u16PwmRatioPerd0C GMAIN_u16PwmRatioPerd1C GMAIN_u16PwmRatioPerd2C GMAIN_u16PwmRatioPerd3C GMAIN_u16RandomFrecMaxC GMAIN_u16SlopSlideTim1C GMAIN_u16SlopSlideTim2C GMAIN_u16SlopSlideTimoutC GMAIN_u16SlopSpdConfirmC GMAIN_u16StuckRecoverTimeStepC GMAIN_u16StuckSpdThresholdC GMAIN_u16StuckTimeThresholdC GMAIN_u32VSICntCkreqESMStartedC GMAIN_u32VSICntCkreqVSIStartedC GMAIN_VSIBenchOnWriteDataC GMAIN_VSIBenchOnWriteEmergSwC GMosSWOverCurrentTestOnC GRTE_bCCPbTcuStuckFlagTestOnC GRTE_bCCPDrvOverCurrentTestOnC GRTE_bCCPDrvOverTempTestOnC GRTE_bCCPDrvOverVoltageTestOnC GRTE_bCCPDrvUnderVoltageTestOnC GRTE_bCCPHALOrderInvalidTestOnC GRTE_bCCPHALOverVoltTestOnC GRTE_bCCPHALUndefinedTestOnC GRTE_bCCPHALUnderVoltTestOnC GRTE_bCCPPhasePerfTestOnC GRTE_bCCPPhaseShortHighTestOnC GRTE_bCCPPhaseShortLowTestOnC GRTE_bCCPSwOverCurrentTestOnC MAIN_bBldcBenchOnC MAIN_bMSGRxToutBenchOnC MAIN_bTcuStuckFlagTestOnC MAIN_CCPbBenchTestOnC MAIN_f32AccPosClrSSTimC MAIN_f32AntiSlopExitSpdC MAIN_f32AntiSsGapDrtGainC MAIN_f32AntiSsValidTrqC MAIN_f32BldcDebugDutyC MAIN_f32BldcStuckDutyC MAIN_f32BrakDeratGainC MAIN_f32BrakPedalPosLowC MAIN_f32BrakPedPosHighC MAIN_f32OcAutophsGainC MAIN_f32OcAutophsOffstC MAIN_f32PowerdownVoltC MAIN_f32PwmFreqHighThrdC MAIN_f32PwmMaxDutyPhysC MAIN_f32PwmMinDutyPhysC MAIN_f32PwmRatioReduceC MAIN_f32RandomFrecMecaSpdMaxC MAIN_f32RandomFrecMecaSpdMinC MAIN_f32SlopOrRoadSpdDiffC MAIN_f32UvwOvCurrThdC MAIN_f32VsiPwmPeriodC MAIN_HARDBenchOnC MAIN_ku16PwmPerdInitValC MAIN_ku16SpdReadyEstConfirmC MAIN_MSGbBenchTestOnC MAIN_MSGbDbgFrameOnC MAIN_MSGRxBenchOnC MAIN_MSGTxBenchOnC MAIN_MSGu8PwModFiltCntC MAIN_s32CurHardDelayC MAIN_s32ResHardDelayC MAIN_s32SampleDelayC MAIN_SampleSequenceEnC MAIN_TCUbHilTestOnC MAIN_TCUs16GcuMotTorqC MAIN_TCUs16McuMotTorqC MAIN_TCUu16OilPresVoltC MAIN_TCUu16OilTempC MAIN_TCUu32GcuMotSpeedC MAIN_TCUu32McuMotSpeedC MAIN_TCUu8GcuTempC MAIN_TCUu8McuTempC MAIN_TSTBenchOnC MAIN_u16AntiSsChkTimC MAIN_u16AntiSsEnaBrakTimC MAIN_u16AntiSsGapTimC MAIN_u16BrakRelsDelayC MAIN_u16DetectSpdTestC MAIN_u16FpgaFltClrTimoutC MAIN_u16IdqDeltaCntMaxC MAIN_u16OverBhvThdC MAIN_u16PwmRatioPerd0C MAIN_u16PwmRatioPerd1C MAIN_u16PwmRatioPerd2C MAIN_u16PwmRatioPerd3C MAIN_u16RandomFrecMaxC MAIN_u16SlopSlideTim1C MAIN_u16SlopSlideTim2C MAIN_u16SlopSlideTimoutC MAIN_u16SlopSpdConfirmC MAIN_u16StuckRecoverTimeStepC MAIN_u16StuckSpdThresholdC MAIN_u16StuckTimeThresholdC MAIN_u32VSICntCkreqESMStartedC MAIN_u32VSICntCkreqVSIStartedC MAIN_VSIBenchOnWriteDataC MAIN_VSIBenchOnWriteEmergSwC MosSWOverCurrentTestOnC RTE_bCCPbTcuStuckFlagTestOnC RTE_bCCPDrvOverCurrentTestOnC RTE_bCCPDrvOverTempTestOnC RTE_bCCPDrvOverVoltageTestOnC RTE_bCCPDrvUnderVoltageTestOnC RTE_bCCPHALOrderInvalidTestOnC RTE_bCCPHALOverVoltTestOnC RTE_bCCPHALUndefinedTestOnC RTE_bCCPHALUnderVoltTestOnC RTE_bCCPPhasePerfTestOnC RTE_bCCPPhaseShortHighTestOnC RTE_bCCPPhaseShortLowTestOnC RTE_bCCPSwOverCurrentTestOnC SBC_bServiceDisableC SBC_f32RecoverThresholdC SBC_f32UnderVolHighThresholdC SBC_f32UnderVolLowThresholdC TCFCke_b_CCPM_CommandDBC_Enable /end DEF_CHARACTERISTIC
 /begin OUT_MEASUREMENT MAIN_u16IuPositiveCnt MAIN_u16IuPositiveSum MAIN_u16MotorStallCnt MAIN_u16OverVolHighDelay MAIN_u16OverVolLowDelay MAIN_u16OverVolMidDelay MAIN_u16PWMPeriodVal MAIN_u16RandomNum MAIN_u16ResCosADVal MAIN_u16ResSinADVal MAIN_u16SlopSlideTimCnt MAIN_u16SlopSpdConfirmCnt MAIN_u16SpdReadyEstCnt MAIN_u16T12CntVal MAIN_u16TeachInWrtDelayCnt MAIN_u16VadcBhv MAIN_u16VadcPhaseCurU MAIN_u16VadcPhaseCurV MAIN_u16VadcPhaseCurW MAIN_u32BldcDeltTime MAIN_u32BldcPattnTreatCnt MAIN_u32BldcPwmTreatCnt MAIN_u32BldcTimStampA MAIN_u32BldcTimStampB MAIN_u32EmailCkreq MAIN_u32EmailPosATimeStamp MAIN_u32IuCycleTim MAIN_u32PosATimeStamp MAIN_u32PosBTimeStamp MAIN_u32PosTreatCkreq MAIN_u32TestVar2 MAIN_u32TestVar4 MAIN_u32WaitValueVSISafeTreatment MAIN_u32WaitValueVSITreatment MAIN_u8BldcFaultLevel MAIN_u8BldcHallStt MAIN_u8BldcHallSttPre MAIN_u8BldcMotDir MAIN_u8ErrCodNum MAIN_u8ErrCodRdIdx MAIN_u8ErrCodWrIdx MAIN_u8FaultSum MAIN_u8OcState MAIN_u8OcStsRptDelayCnt MAIN_u8OverVolIndex MAIN_u8PrevGearPos MAIN_u8TcFaultCodeL3 MAIN_u8TcFaultCodeL5 MAIN_u8TestVar1 MAIN_u8TrigOcByUser MAIN_u8UdsSwVerSup MAIN_u8UdsSwVerSup[0] MAIN_u8UdsSwVerSup[10] MAIN_u8UdsSwVerSup[11] MAIN_u8UdsSwVerSup[12] MAIN_u8UdsSwVerSup[13] MAIN_u8UdsSwVerSup[14] MAIN_u8UdsSwVerSup[15] MAIN_u8UdsSwVerSup[16] MAIN_u8UdsSwVerSup[17] MAIN_u8UdsSwVerSup[18] MAIN_u8UdsSwVerSup[19] MAIN_u8UdsSwVerSup[1] MAIN_u8UdsSwVerSup[20] MAIN_u8UdsSwVerSup[2] MAIN_u8UdsSwVerSup[3] MAIN_u8UdsSwVerSup[4] MAIN_u8UdsSwVerSup[5] MAIN_u8UdsSwVerSup[6] MAIN_u8UdsSwVerSup[7] MAIN_u8UdsSwVerSup[8] MAIN_u8UdsSwVerSup[9] MAIN_u8UdsSwVerVeh MAIN_u8UdsSwVerVeh[0] MAIN_u8UdsSwVerVeh[10] MAIN_u8UdsSwVerVeh[11] MAIN_u8UdsSwVerVeh[12] MAIN_u8UdsSwVerVeh[1] MAIN_u8UdsSwVerVeh[2] MAIN_u8UdsSwVerVeh[3] MAIN_u8UdsSwVerVeh[4] MAIN_u8UdsSwVerVeh[5] MAIN_u8UdsSwVerVeh[6] MAIN_u8UdsSwVerVeh[7] MAIN_u8UdsSwVerVeh[8] MAIN_u8UdsSwVerVeh[9] MAIN_VSITxsPwmUl MAIN_VSITxsPwmUlOn MAIN_VSITxsPwmUr MAIN_VSITxsPwmUrOn MAIN_VSITxsPwmVl MAIN_VSITxsPwmVlOn MAIN_VSITxsPwmVr MAIN_VSITxsPwmVrOn MAIN_VSITxsPwmWl MAIN_VSITxsPwmWlOn MAIN_VSITxsPwmWr MAIN_VSITxsPwmWrOn Os_Task_BackGround_Counter Os_Task_Idle_Counter /end OUT_MEASUREMENT
/end FUNCTION
/begin FUNCTION OBD ""
 /begin OUT_MEASUREMENT OBD_au8McuDtcPath OBD_au8McuDtcPath[0] OBD_au8McuDtcPath[100] OBD_au8McuDtcPath[101] OBD_au8McuDtcPath[102] OBD_au8McuDtcPath[103] OBD_au8McuDtcPath[104] OBD_au8McuDtcPath[105] OBD_au8McuDtcPath[106] OBD_au8McuDtcPath[107] OBD_au8McuDtcPath[108] OBD_au8McuDtcPath[109] OBD_au8McuDtcPath[10] OBD_au8McuDtcPath[110] OBD_au8McuDtcPath[111] OBD_au8McuDtcPath[112] OBD_au8McuDtcPath[113] OBD_au8McuDtcPath[114] OBD_au8McuDtcPath[115] OBD_au8McuDtcPath[116] OBD_au8McuDtcPath[117] OBD_au8McuDtcPath[118] OBD_au8McuDtcPath[119] OBD_au8McuDtcPath[11] OBD_au8McuDtcPath[12] OBD_au8McuDtcPath[13] OBD_au8McuDtcPath[14] OBD_au8McuDtcPath[15] OBD_au8McuDtcPath[16] OBD_au8McuDtcPath[17] OBD_au8McuDtcPath[18] OBD_au8McuDtcPath[19] OBD_au8McuDtcPath[1] OBD_au8McuDtcPath[20] OBD_au8McuDtcPath[21] OBD_au8McuDtcPath[22] OBD_au8McuDtcPath[23] OBD_au8McuDtcPath[24] OBD_au8McuDtcPath[25] OBD_au8McuDtcPath[26] OBD_au8McuDtcPath[27] OBD_au8McuDtcPath[28] OBD_au8McuDtcPath[29] OBD_au8McuDtcPath[2] OBD_au8McuDtcPath[30] OBD_au8McuDtcPath[31] OBD_au8McuDtcPath[32] OBD_au8McuDtcPath[33] OBD_au8McuDtcPath[34] OBD_au8McuDtcPath[35] OBD_au8McuDtcPath[36] OBD_au8McuDtcPath[37] OBD_au8McuDtcPath[38] OBD_au8McuDtcPath[39] OBD_au8McuDtcPath[3] OBD_au8McuDtcPath[40] OBD_au8McuDtcPath[41] OBD_au8McuDtcPath[42] OBD_au8McuDtcPath[43] OBD_au8McuDtcPath[44] OBD_au8McuDtcPath[45] OBD_au8McuDtcPath[46] OBD_au8McuDtcPath[47] OBD_au8McuDtcPath[48] OBD_au8McuDtcPath[49] OBD_au8McuDtcPath[4] OBD_au8McuDtcPath[50] OBD_au8McuDtcPath[51] OBD_au8McuDtcPath[52] OBD_au8McuDtcPath[53] OBD_au8McuDtcPath[54] OBD_au8McuDtcPath[55] OBD_au8McuDtcPath[56] OBD_au8McuDtcPath[57] OBD_au8McuDtcPath[58] OBD_au8McuDtcPath[59] OBD_au8McuDtcPath[5] OBD_au8McuDtcPath[60] OBD_au8McuDtcPath[61] OBD_au8McuDtcPath[62] OBD_au8McuDtcPath[63] OBD_au8McuDtcPath[64] OBD_au8McuDtcPath[65] OBD_au8McuDtcPath[66] OBD_au8McuDtcPath[67] OBD_au8McuDtcPath[68] OBD_au8McuDtcPath[69] OBD_au8McuDtcPath[6] OBD_au8McuDtcPath[70] OBD_au8McuDtcPath[71] OBD_au8McuDtcPath[72] OBD_au8McuDtcPath[73] OBD_au8McuDtcPath[74] OBD_au8McuDtcPath[75] OBD_au8McuDtcPath[76] OBD_au8McuDtcPath[77] OBD_au8McuDtcPath[78] OBD_au8McuDtcPath[79] OBD_au8McuDtcPath[7] OBD_au8McuDtcPath[80] OBD_au8McuDtcPath[81] OBD_au8McuDtcPath[82] OBD_au8McuDtcPath[83] OBD_au8McuDtcPath[84] OBD_au8McuDtcPath[85] OBD_au8McuDtcPath[86] OBD_au8McuDtcPath[87] OBD_au8McuDtcPath[88] OBD_au8McuDtcPath[89] OBD_au8McuDtcPath[8] OBD_au8McuDtcPath[90] OBD_au8McuDtcPath[91] OBD_au8McuDtcPath[92] OBD_au8McuDtcPath[93] OBD_au8McuDtcPath[94] OBD_au8McuDtcPath[95] OBD_au8McuDtcPath[96] OBD_au8McuDtcPath[97] OBD_au8McuDtcPath[98] OBD_au8McuDtcPath[99] OBD_au8McuDtcPath[9] OBD_bCompMonComplet OBD_bDtcClrFlg OBD_bDtcClrInhibitFlg OBD_bFFAccessLock OBD_bPerDtcClrCyc OBD_bPtReady OBD_bWarmCycCalcFlg OBD_bWarmUpAchiv OBD_u16Kl15Value OBD_u16Pid0CInfo OBD_u16Pid42Info OBD_u32CalVerifyNum OBD_u32OdomtWhenDtcClr OBD_u32OdomtWhenMilOn OBD_u32TotalOdmtr OBD_u8NvmJobRes OBD_u8Pid04Info OBD_u8Pid05Info OBD_u8Pid0DInfo OBD_u8Pid11Info OBD_u8Pid49Info OBD_u8PoCycMonStep /end OUT_MEASUREMENT
/end FUNCTION
/begin FUNCTION RES ""
 /begin DEF_CHARACTERISTIC RES_bGenerateSyncPosC RES_u16ExcitDelayC RES_u16SyncDelay2C RES_u16SyncDelayC RES_u16VSICkreqPeriodDefC RES_u8ExcitDutyPercentC RES_u8SyncDutyPercentC /end DEF_CHARACTERISTIC
/end FUNCTION
/begin FUNCTION RSTSRV "" /begin DEF_CHARACTERISTIC RSTSRV_ku16ConsecutiveRstMaxNbC /end DEF_CHARACTERISTIC
 /begin OUT_MEASUREMENT RSTSRV_bSWResetDetected RSTSRV_bSWResetDoneByPerformReset RSTSRV_u16ConsecutiveRstCtr RSTSRV_u16HotResetCtr RSTSRV_u16TimeAfterInit RSTSRV_u32ResetReason /end OUT_MEASUREMENT
/end FUNCTION
/begin FUNCTION RTE ""
 /begin OUT_MEASUREMENT APSSve_Pct_AccPedPos bcm_pepsPowerMode BPPDve_b_BrakeSwitchActive CACEve_b_IgnitionOn CANDve_b_ATFailure CANDve_Cnt_DiagCounts CANDve_Cnt_DiagFails CANDve_e_VCU_InvalidDataVld CANDve_y_HTCU_Fault CANDve_y_HTCU_State CANDve_y_ID_Status CANDve_y_Progress CANDve_y_Status CANDve_y_VCUFAULT_DiagCounts CANDve_y_VCUFAULT_DiagFails CANDve_y_VCUFAULT_Progress CANDve_y_VCUFAULT_Status CANEve_b_ProdTestModeActive CANEve_y_BSWDiagBcmCANFault CANEve_y_BSWDiagEmsCANFault CANEve_y_BSWDiagGcuCANFault CANEve_y_BSWDiagIpbCANFault CANEve_y_BSWDiagIviCANFault CANEve_y_BSWDiagPdcmCANFault CANEve_y_BSWDiagTboxCANFault CCAPve_e_ClutchState CCAPve_e_EvenClutchState CCAPve_e_OddClutchState CCAPve_M_EstClchTrnsfTrq CCAPve_M_InstantaneousCapabilityOdd CCAPve_M_OddClutchMaxTransferTorque CCAPve_p_ReturnSpringEven CCAPve_p_ReturnSpringOdd CCAPve_T_EvenClutchTemp CCAPve_T_OddClutchTemp CLCOve_b_EvenClutchOpenReq CLCOve_b_OddClutchOpenReq CLCOve_b_OddClutchSlipDetected CLCOve_e_EvenActualClutchState CLCOve_e_EvenClutchProgress CLCOve_e_OddActualClutchState CLCOve_e_OddClutchProgress CLCOve_M_CurrentTorqueMargin CLCOve_M_EvenDesiredClutchTrq CLCOve_M_OddDesiredClutchTrq CLPCve_b_AdaptionFinished CLPCve_b_AdaptKissPointActive CLPCve_b_CAP_TooCloseToOverCurrent CLPCve_b_CAPM_DC_SaturatedHigh_IRV CLPCve_b_CAPM_DC_SaturatedLow_IRV CLPCve_b_ClutchControlActive CLPCve_b_DisableCAP CLPCve_b_DisengageComplete CLPCve_b_InGearComplete CLPCve_b_KneePoint_FirstDone CLPCve_b_NewKissPointAdaptionPointFound CLPCve_b_PrepareComplete CLPCve_b_SpeedControllerActive_IRV CLPCve_Cf_PressureToTorqueEven CLPCve_Cf_PressureToTorqueOdd CLPCve_Cnt_CAPM_CommandDBC CLPCve_DC_CAPM_SpeedControllerPressureCompensation_IRV CLPCve_e_CAP_DID_Enabled CLPCve_e_CAP_DID_EnabledIndication CLPCve_e_NegativeResponseCode_IRV CLPCve_I_CAP_ReducedMaxCurrent CLPCve_I_CAPM CLPCve_I_CAPM_CompletePhase CLPCve_I_CAPM_IRV CLPCve_n_C_n_CAP_Data CLPCve_n_CAPM_IRV CLPCve_n_CAPM_Overrequest_IRV CLPCve_n_CAPM_SpeedTgtDBC CLPCve_p_C_p_CAP_Data CLPCve_P_CAPM_IRV CLPCve_p_CAPM_PressTgtDBC CLPCve_p_ClutchPresReq CLPCve_p_ClutchTarget CLPCve_p_EvenClutchPresReq CLPCve_p_KissPoint CLPCve_p_KneePoint_Stored CLPCve_p_LastEstimatedKisspoint_IRV CLPCve_p_OddClutchPresReq CLPCve_p_OddMaxAllowedClutchOilPress CLPCve_p_PressureKneePoint CLPCve_Pct_C_Pct_CAP_Data CLPCve_Pct_CAPM_DC CLPCve_Pct_CAPM_DC_DBC CLPCve_Pct_CAPM_DC_IRV CLPCve_Pct_CAPMPS_DC_Actual CLPCve_r_CAP_Y CLPCve_r_CAP_Y_IRV Core0_Asw100msStartTime Core0_Asw100msStopTime Core0_Asw100msTotalTime Core0_Asw10msStartTime Core0_Asw10msStopTime Core0_Asw10msTotalTime Core0_Bsw100msStartTime Core0_Bsw100msStopTime Core0_Bsw100msTotalTime Core0_Bsw10msStartTime Core0_Bsw10msStopTime Core0_Bsw10msTotalTime Core0_Bsw1msStartTime Core0_Bsw1msStopTime Core0_Bsw1msTotalTime Core0_Bsw50msStartTime Core0_Bsw50msStopTime Core0_Bsw50msTotalTime Core0_WdgCurTime Core0_WdgLastTime Core0_WdgTotalTime Core1_Asw10msStartTime Core1_Asw10msStopTime Core1_Asw10msTotalTime Core1_Asw1msStartTime Core1_Asw1msStopTime Core1_Asw1msTotalTime Core1_Asw5msStartTime Core1_Asw5msStopTime Core1_Asw5msTotalTime Core1_Bsw10msStartTime Core1_Bsw10msStopTime Core1_Bsw10msTotalTime Core2_Asw10msStartTime Core2_Asw10msStopTime Core2_Asw10msTotalTime Core2_Asw1msStartTime Core2_Asw1msStopTime Core2_Asw1msTotalTime Core2_Bsw10msStartTime Core2_Bsw10msStopTime Core2_Bsw10msTotalTime CWTDve_e_EngineCoolantVld CWTDve_T_EngineCoolant DGPSte_e_Gear DGPSve_n_LaunchTargetSpeed DPSCve_e_VehicleActState DRSPve_e_RangeSelPos ebs_U_BATT EMS_EngActualFlwTorque EMS_EngFlywh EMS_EngRunningStatus EMS_EngSpd EMS_EngSpdValid EOL1_CCP_control_DC EOL1_CCP_control_Enable EOL1_CCP_control_flow EOL1_CCP_control_speed EOL2_CAP_control_DC EOL2_CAP_control_Enable EOL2_CAP_control_pres EOL2_CAP_control_speed EOL3_CAP_current EOL3_CAP_DC EOL3_CAP_speed EOL4_CCP_current EOL4_CCP_DC EOL4_CCP_flow EOL4_CCP_speed EOL5_clutch_pressure EOL5_clutch_targetpressure EOL5_oil_temp EP_Tbox3_CoolantTemp EP_Tbox3_CoolantTempValid EP_Tbox3_WarmUpCycle EPOSve_d2n_EngSpdAccel EPOSve_dn_EngSpdChangeRate EPOSve_e_EngSpdValidity EPOSve_n_EngSpd FDMAve_b_AcceleratorStuckErrExt FDMAve_b_ForceAC_CompressorCpbyPrioHigh FDMAve_b_ForceAC_CompressorToOff FDMAve_b_ForceAC_LoadCompensationToOff FDMAve_b_ForceActiveDischarge FDMAve_b_ForceAirEstimationByMAP_SensorToOff FDMAve_b_ForceAntiJerkControlOff FDMAve_b_ForceBackupPowerModeToActive FDMAve_b_ForceBoostPressureControlToLowPressure FDMAve_b_ForceBoostPressureControlToLowPressureIRV FDMAve_b_ForceBoostTorqueOff FDMAve_b_ForceBrakeRegenerationTorqueOff FDMAve_b_ForceCamPositionToParked FDMAve_b_ForceCamPositionToParkedIRV FDMAve_b_ForceCCPCancleSpdLimit FDMAve_b_ForceClutchOddOpen FDMAve_b_ForceCoastRegenerationTorqueOff FDMAve_b_ForceContactorsOpen FDMAve_b_ForceCreepControlToOff FDMAve_b_ForceCruiseControlToOff FDMAve_b_ForceDCDC_BuckConversionOff FDMAve_b_ForceDCDC_ControlToDefault FDMAve_b_ForceEGR_ControlToOff FDMAve_b_ForceElectricLoadCompensationToOff FDMAve_b_ForceElectricThermostatControlToLowTemp FDMAve_b_ForceElectricThermostatToOff FDMAve_b_ForceElectricVacuumPumpOff FDMAve_b_ForceElectricVacuumPumpPulseMode FDMAve_b_ForceEngCoolantTempToEstimationModel FDMAve_b_ForceEngineRunning FDMAve_b_ForceEngineStop FDMAve_b_ForceEngineStopIRV FDMAve_b_ForceEngineTorqueFillOff FDMAve_b_ForceEngineTorqueReductionToMedium FDMAve_b_ForceEngineTorqueReductionToMediumIRV FDMAve_b_ForceEngTransientLimOff FDMAve_b_ForceFrntO2SnsrBnk1ToPrtctnMd FDMAve_b_ForceFuelControlToOpenLoop FDMAve_b_ForceFuelPressureActivationToOff FDMAve_b_ForceFuelPressureActivationToOffIRV FDMAve_b_ForceFuelRailPressureFeedbackExclusion FDMAve_b_ForceFuelRailPressureFeedbackExclusionIRV FDMAve_b_ForceGCUTrqToExclFromTransClutchPresTarget FDMAve_b_ForceGearRecommendationToOff FDMAve_b_ForceHiPressFuelPumpEnblToDisable FDMAve_b_ForceHiPressFuelPumpEnblToDisableIRV FDMAve_b_ForceHVAC_ElectricHeaterOff FDMAve_b_ForceHVBattSOC_ControlOff FDMAve_b_ForceIdleControlToElevatedMode FDMAve_b_ForceIgnitionToLowOctane FDMAve_b_ForceIgnitionToOff FDMAve_b_ForceIgnitionToOffIRV FDMAve_b_ForceIntelligentGeneratorControlToDefault FDMAve_b_ForceLftDrvnWhlSpdInfoExclusion FDMAve_b_ForceLftNnDrvnWhlSpdInfoExclusion FDMAve_b_ForceLongTermAdaptionToOff FDMAve_b_ForceNeutralGear FDMAve_b_ForceP1ElectricMotorToNeutral FDMAve_b_ForceP1ElectricTorqueReserveOff FDMAve_b_ForceP3MtrSpdInfoExclusion FDMAve_b_ForcePF_ActiveRegenOff FDMAve_b_ForcePF_PrssrSnsrAdptnOff FDMAve_b_ForcePF_PrssrSnsrBasedSootEstOff FDMAve_b_ForcePowerModeLock FDMAve_b_ForcePowerSteeringCompensationToOff FDMAve_b_ForcePropModeCalcToExcludeVehSpd FDMAve_b_ForcePropulsionAllowedToNotAllowed FDMAve_b_ForcePurgeControlToOff FDMAve_b_ForceRearO2SensorFuelControlToOff FDMAve_b_ForceRghtDrvnWhlSpdInfoExclusion FDMAve_b_ForceRghtNnDrvnWhlSpdInfoExclusion FDMAve_b_ForceTCU_CreepTorqueControlToOff FDMAve_b_ForceThrottleMassAirFlowToDefaultAir FDMAve_b_ForceThrottleMassAirFlowToDefaultAirIRV FDMAve_b_ForceTransIOCControlToOff FDMAve_b_ForceTransOilCoolingToSafeCoolingMode FDMAve_b_ForceTransOilLubricationToSafeLubricationMode FDMAve_b_ForceUnderHoodCoolingToHigh FDMAve_b_ForceVehicleSpeedInfoExclusion FDMAve_b_LimitHV_BattSOC_CntrlAuthorityToLow FDMAve_b_LockoutEngineStateChange FDMAve_b_LockoutPropulsionSystemStart FDMAve_b_LockoutPropulsionSystemStartIRV FDMAve_b_LockoutSpdDepCntctrAfterrun FDMAve_b_LockoutStopStartEngineStateChange FDMAve_b_SetAccPedPosToZero FDMAve_b_SetAccPedPosToZeroIRV FDMAve_b_SetAutoTransIdleSpdRqstToNoRqst FDMAve_b_SetAutoTransTorqueRequestToNoRequest FDMAve_b_SetDCDC_ActualLoadDefaultVal FDMAve_b_SetDriversRequestToZero FDMAve_b_SetDriversRequestToZeroIRV FDMAve_b_SetESP_TCS_TorqueRequestToNoRequest FDMAve_b_SetFuelMassToZeroCylinder1 FDMAve_b_SetFuelMassToZeroCylinder1IRV FDMAve_b_SetFuelMassToZeroCylinder2 FDMAve_b_SetFuelMassToZeroCylinder2IRV FDMAve_b_SetFuelMassToZeroCylinder3 FDMAve_b_SetFuelMassToZeroCylinder3IRV FDMAve_b_SetFuelMassToZeroCylinder4 FDMAve_b_SetFuelMassToZeroCylinder4IRV FDMAve_b_SetHVBattElectricPowerLimToHalf FDMAve_b_SetHVBattElectricPowerLimToHalfIRV FDMAve_b_SetICETrqCapToSafeVal FDMAve_b_SetICETrqCapToSafeValIRV FDMAve_b_SetLoTempCoolantCircuitPumpFlowHigh FDMAve_b_SetMAT_ToTempBeforeThrottle FDMAve_b_SetP1ElectricMotorCapabilityToZero FDMAve_b_SetP3ElectricMotorCapabilityToZero FDMAve_b_SetShftLvrPstnToLstKnwnVal FDMAve_b_SetShftLvrPstnToN FDMAve_b_SetShftLvrPstnToP FDMAve_Cnt_DID_NoOfInputsDrivingFA_TKO FDMAve_e_ETC_ControlMode FMCU24_CAP_current FMCU24_CAP_DC FMCU24_CAP_speed FMCU25_CCP_current FMCU25_CCP_DC FMCU25_CCP_speed FMCU26_clutch_pressure FMCU26_clutch_targetpressure FMCU26_oil_temp FMCU8_HTCUFault FMCU8_HTCULimphomeSts FMCU8_OilTemp GCU_ActualTorque GCU_GeneratorSpd GCU_MotorTemp GERCve_e_ActualGear GERCve_r_TransP1SpdRatio GERCve_r_TransP3SpdRatio GSCHte_e_ShiftType GSCHve_b_GearAvailable GSCHve_b_ShiftToSameClutch GSEQve_e_EvenClutchStateReq GSEQve_e_OddClutchStateReq GSEQve_e_ShiftType GSEQve_e_SpdCntrlTrgtCltch GW_IBCMIgnitionSt HBSCve_Pct_HVBattSOC HETEve_M_P1TotalActuatorDmn HTCU_ATFailure HTCU_CAP_DC HTCU_CAP_DutyCycle HTCU_CCP_DutyCycle HTCU_CCPSpd HTCU_Clutch_Progress HTCU_ClutchActualTransferTorque HTCU_ObdCLRReq HTCU_P1_OverTempWarning HTCU_P3_OverTempWarning ic_totalMileage IPB_vehicleSpeed IPB_vehicleSpeedValid IPB_wheelSpeedFL IPB_wheelSpeedFLValid IPB_wheelSpeedFR IPB_wheelSpeedFRValid IPB_wheelSpeedRL IPB_wheelSpeedRLValid IPB_wheelSpeedRR IPB_wheelSpeedRRValid ivi_timeInfoDay ivi_timeInfoHour ivi_timeInfoMinute ivi_timeInfoMonth ivi_timeInfoSecond ivi_timeInfoYear LMSCve_dV_LubeFlow LSIDve_Cnt_PID_30_Server_Data_IRV LSIDve_NA_VIT_06_Server_Data_IRV MAIN_u32PositionStartTime MAIN_u32PositionStopTime MAIN_u32PositionTotalTime MAIN_u32Task100msC1StartTime MAIN_u32Task100msC1StopTime MAIN_u32Task100msC1TotalTime MAIN_u32Task100msC2StartTime MAIN_u32Task100msC2StopTime MAIN_u32Task100msC2TotalTime MAIN_u32Task10msC1StartTime MAIN_u32Task10msC1StopTime MAIN_u32Task10msC1TotalTime MAIN_u32Task10msC2StartTime MAIN_u32Task10msC2StopTime MAIN_u32Task10msC2TotalTime MAIN_u32Task1msC2StartTime MAIN_u32Task1msC2StopTime MAIN_u32Task1msC2TotalTime MAIN_u32Task1msStartTime MAIN_u32Task1msStopTime MAIN_u32Task1msTotalTime MAIN_u32Task200msC1StartTime MAIN_u32Task200msC1StopTime MAIN_u32Task200msC1TotalTime MAIN_u32Task2msC2StartTime MAIN_u32Task2msC2StopTime MAIN_u32Task2msC2TotalTime MAIN_u32Task2msStartTime MAIN_u32Task2msStopTime MAIN_u32Task2msTotalTime MAIN_u32Task5msC2StartTime MAIN_u32Task5msC2StopTime MAIN_u32Task5msC2TotalTime MAIN_u32Task5msStartTime MAIN_u32Task5msStopTime MAIN_u32Task5msTotalTime MCUF_ActualTorque MCUF_MotorPower MCUF_MotorSpd MCUF_MotorTemp MILDve_e_MIL_RequestState MosSWOverCurrent PDCM_AccelPedal_Position PDCM_AccelPedal_Status PDCM_actualGear PDCM_BrakePedal_Status PDCM_ClutchCommand PDCM_ClutchCommandTransferTorque PDCM_Dcy_valid PDCM_DriveReady PDCM_DrivingCycle PDCM_OBD_DenoGeneral PDCM_OBD_DenoGenValid PDCM_OBD_FaultClrInhibit PDCM_OBD_PDTCClrSts PDCM_OBD_WarmCycleSts PDCM_SOC PORSve_d2n_P1SecondDerivative PORSve_dn_P1Derivative PORSve_e_P1RotationalSpeedVld PORSve_n_P1RotationalSpeed PORSve_n_P1RotationalSpeedUnsigned PWRMve_e_SysPwrMd Rte_b_IgnitionOn Rte_bClutchCapInsufficient Rte_bClutchDragTrqTooHigh Rte_bClutchPresAboveLim Rte_bClutchPresSensPerf Rte_bCoolingActSpdDev Rte_bHighClutchPressure Rte_bLowClutchPressure Rte_bTransCtrlSysPerf Rte_bTransOilTempCrit Rte_bTransOilTempWarn Rte_bUnreasonHighOilTemp Rte_bUnreasonLowOilTemp Rte_bVcuFault Rte_CACEve_b_IgnitionOn Rte_CAPStuckFlag Rte_CCPStuckFlag Rte_CUTDve_T_PCB_Temperature Rte_FACTee_NA_Kisspoint Rte_FACTee_NA_Kisspoint_Inv Rte_FACTee_NA_TransferGain Rte_FACTee_NA_TransferGain_Inv Rte_FACTve_NA_CalibrationLength Rte_FACTve_NA_CalibrationStart Rte_FbVar_SWCI7_globalMode_currentMode Rte_FbVar_SWCI7_mode0_currentMode Rte_HAMFve_b_CalMemChkSumReady Rte_HAMFve_Cnt_CalMemChkSum Rte_HTCU_AirflowRequest Rte_HTCU_State Rte_Irv_CLPC_CLPCve_n_CAPM_SpeedControllerTarget_IRV Rte_Irv_TCFC_TCFCve_n_CCPM_SpeedControllerTarget_IRV Rte_Irv_TCPD_TCPDve_p_ClutchPressure_IRV Rte_ModeCurrent_0 Rte_ModeCurrent_19 Rte_ModeCurrent_20 Rte_ModeCurrent_4 Rte_ModeStatus_4 Rte_Ms_ActvSession Rte_Ms_busbarCur Rte_Ms_busbarCurLoad Rte_Ms_ComCtlTyp Rte_Ms_data_RxSignal Rte_Ms_DisblMskbit Rte_Ms_DtcGrp Rte_Ms_ErrCode Rte_Ms_Fus_SafeExec_L2Pfc100ms Rte_Ms_Fus_SafeExec_L2Pfc10ms Rte_Ms_Fus_SafeExec_L2Pfc2p5ms Rte_Ms_Fus_SafeExec_L2Pfc5ms Rte_Ms_idx_RxAck Rte_Ms_idx_RxDlcErr Rte_Ms_idx_RxSignal Rte_Ms_idx_RxTOut Rte_Ms_idx_TxAck Rte_Ms_idx_TxMessage Rte_Ms_idx_TxTOut Rte_Ms_length_TxMessage Rte_Ms_motIdx Rte_Ms_Nrc Rte_Ms_OP_cyc_MotDuty Rte_Ms_OP_FI_IUMPR_GenDenInh Rte_Ms_OP_FI_IUMPR_PDTCClrCusPermission Rte_Ms_OP_Fl_DrvCycl Rte_Ms_OP_Fl_IgnCycl Rte_Ms_OP_Fl_IUMPR_GenDenInc Rte_Ms_OP_Fl_WrnUpCycl Rte_Ms_OP_Idx_Mot Rte_Ms_OP_Num_DayFrzFrm Rte_Ms_OP_Num_HourFrzFrm Rte_Ms_OP_Num_MinuteFrzFrm Rte_Ms_OP_Num_MonthFrzFrm Rte_Ms_OP_Num_SecsFrzFrm Rte_Ms_OP_Num_YearFrzFrm Rte_Ms_OP_s_ODOPrmrFrzFrm Rte_Ms_OP_St_MotSt Rte_Ms_OP_St_PwrModeFrzFrm Rte_Ms_OP_Temp_EngClntTempFrzFrm Rte_Ms_phaseCurLoad Rte_Ms_ReqSession Rte_Ms_Sid Rte_Ms_sumCurLoad Rte_Ms_TCU_Ct_PwrStgActPosInc Rte_Ms_TCU_cyc_PwrStgActPWM Rte_Ms_TCU_Fl_SysSycT15 Rte_Ms_TCU_I_MotAvrgCrnt Rte_Ms_TCU_I_MotMaxCrnt Rte_Ms_TCU_Idx_Mot Rte_Ms_TCU_n_MotRotSpd Rte_Ms_TCU_p_PresRaw Rte_Ms_TCU_St_5V1RawSt Rte_Ms_TCU_St_5V2RawSt Rte_Ms_TCU_St_5V3RawSt Rte_Ms_TCU_St_ACCRawSt Rte_Ms_TCU_st_ChipTemp Rte_Ms_TCU_St_IgnRawSt Rte_Ms_TCU_St_MotCrntSt Rte_Ms_TCU_St_MotSpdSt Rte_Ms_TCU_St_PresRawSt Rte_Ms_TCU_St_PwrStgMode Rte_Ms_TCU_St_PwrStgPosSt Rte_Ms_TCU_St_PwrStgSt Rte_Ms_TCU_St_PwrStgTempSt Rte_Ms_TCU_St_PwrTempWarnLvl Rte_Ms_TCU_St_T30HiRawSt Rte_Ms_TCU_St_T30LowRawSt Rte_Ms_TCU_t_ChipTemp Rte_Ms_TCU_Temp_PwrStgTemp Rte_Ms_TCU_U_5V1Raw Rte_Ms_TCU_U_5V2Raw Rte_Ms_TCU_U_5V3Raw Rte_Ms_TCU_U_ACCRaw Rte_Ms_TCU_U_IgnRaw Rte_Ms_TCU_u_PresRaw Rte_Ms_TCU_U_T30HiRaw Rte_Ms_TCU_U_T30LowRaw Rte_Ms_TCU_U_TempRaw Rte_RECount_Os_BswEnd_10ms_Task_divby1000_0 Rte_RECount_Os_BswEnd_10ms_Task_divby100_0 Rte_TCU_p_PresRaw Rte_TCU_st_PresRawSt Rte_TCU_u_OilTemp Rte_TCU_u_PresRaw Rte_V5RDve_U_VRef1RawValue Rte_V5RDve_U_VRef2RawValue Rte_V5RDve_U_VRef3RawValue Rte_V5RDve_y_EC_Ref1_Status Rte_V5RDve_y_EC_Ref2_Status Rte_V5RDve_y_EC_Ref3_Status SDADva_b_IUPR_GenDenStatus SDADva_b_IUPR_GenDenStatus[0] SDADva_b_IUPR_GenDenStatus[1] SPARte_e_Validity SPARve_l_WheelRadius SPARve_r_P1MtrRatio SPARve_r_P1Trans1stGearRatio SPARve_r_P1Trans1stGearRatio_IRV SPARve_r_P1Trans2ndGearRatio SPARve_r_P3TransDM_Ratio SPARve_r_P3TransDM_Ratio_IRV SPARve_r_TransFnlDrvRatio SSSCve_e_EngineStatus SWINve_b_DrivingCycle SWINve_b_FaultClrInhibit SWINve_b_PDTCClrSts SWINve_b_PropulsionActive SWINve_b_WarmUpCycleCompleted SWINve_e_Dcyvalid SWINve_e_GCU_COM_Validity SWINve_e_MCU_COM_Validity SWINve_e_MCU_P1_COM_Validity SWINve_e_MCU_P3_COM_Validity SWINve_e_P1MtrSpdVld SWINve_e_P1MtrTempVld SWINve_e_P1MtrTrqVld SWINve_e_P3MtrSpdVld SWINve_e_P3MtrTempVld SWINve_e_P3MtrTrqVld SWINve_e_VCU_COM_Validity SWINve_M_P1MtrTrq SWINve_M_P3MtrTrq SWINve_n_P1MtrSpd SWINve_n_P3MtrSpd SWINve_P_MotorPower SWINve_Pct_AccelPedalPosition SWINve_Pct_pepsPowerMode SWINve_r_P1TransInput SWINve_r_P1TransInput_IRV SWINve_t_Day SWINve_t_Hour SWINve_t_Minute SWINve_t_Month SWINve_T_P1Motor SWINve_T_P1Motor_IRV SWINve_T_P3Motor SWINve_T_P3Motor_IRV SWINve_t_Second SWINve_t_Year SWINve_U_ebsBATT SWINve_y_VCUFault SYVDve_U_MotorSupplyVoltage SYVDve_U_SystemVoltage SYVDve_U_SystemVoltage_IRV SYVDve_y_BSWDiagBLDCSupOvrVolt SYVDve_y_BSWDiagBLDCSupUnrVolt TAMDve_e_ClutchActPwrStgTempVld TAMDve_e_ClutchActuatorVld TAMDve_e_MosfetVld TAMDve_e_StuckVld TAMDve_I_HWIO_MotorCurrent_IRV TAMDve_n_HWIO_MotorRotSpd_IRV TAMDve_Pct_HWIO_MotorActPWM_IRV TAMDve_T_ClutchActPwrStg TAMDve_y_BSWDiagDrvOvrCur TAMDve_y_BSWDiagDrvOvrTemp TAMDve_y_BSWDiagDrvSupOvrVolt TAMDve_y_BSWDiagHALInvalFault TAMDve_y_BSWDiagHALSigOvrVolt TAMDve_y_BSWDiagHALSigUndrVolt TAMDve_y_BSWDiagHALSupOvrVolt TAMDve_y_BSWDiagHALSupUndrVolt TAMDve_y_BSWDiagHALUndefFault TAMDve_y_BSWDiagMosUnderVolt TAMDve_y_BSWDiagPhaseHigh TAMDve_y_BSWDiagPhaseLow TAMDve_y_BSWDiagPhasePerf TAMDve_y_EC_MosStatus TAMDve_y_EC_Status TAMDve_y_EC_StuckStatus TAMDve_y_Status Tbox3_CoolantTempValid Tbox3_WarmUpCycle TCAPve_e_DrivelineState TCFCve_b_CCPM_SpeedControllerActive TCFCve_b_TargetSpeedActive_IRV TCFCve_Cnt_CCPM_CommandDBC TCFCve_dV_C_dV_CCP_Data TCFCve_dV_CoolingFlow TCFCve_dV_CoolingFlow_IRV TCFCve_dV_CoolingFlowDBC TCFCve_e_CCP_DID_Enabled TCFCve_e_CCP_DID_EnabledIndication TCFCve_e_NegativeResponseCode_IRV TCFCve_I_CCPM TCFCve_I_CCPM_CompletePhase TCFCve_I_CCPM_IRV TCFCve_n_C_n_CCP_Data TCFCve_n_CCPM_CurrentSpeedLimit TCFCve_n_CCPM_IRV TCFCve_n_CCPM_SpeedControllerTarget TCFCve_n_CCPM_SpeedControllerTarget_IRV TCFCve_n_CCPM_SpeedTgtDBC TCFCve_Pct_C_Pct_CCP_Data TCFCve_Pct_CCPM_DC TCFCve_Pct_CCPM_DC_DBC TCFCve_Pct_CCPM_DC_IRV TCFCve_r_CCP_Y TCFRve_b_AfterRunRequest TCFRve_b_AtMinLubrication_IRV TCFRve_b_ClutchAvailable TCFRve_b_CoolingNeedPreventsCoolingIOC TCFRve_b_TooCloseToOverCurrent TCFRve_dV_CCP_OvercurrentLimitation TCFRve_dV_CCP_UsedLimit TCFRve_dV_CoolingFlowCommand TCFRve_I_CAP_PhaseCurrentLimitation TCFRve_I_CurrentAvailableForClutch TCFRve_Pct_FanRequest TCMDve_b_NewCycle TCMDve_b_StuckNewCycle TCMDve_Cnt_RC_SpdDev_Diags TCMDve_Cnt_RC_SpdDev_Fails TCMDve_e_CoolingActPwrStgTempVld TCMDve_e_CoolingActSpdDevVld TCMDve_e_CoolingActuatorVld TCMDve_e_MosfetVld TCMDve_e_StuckVld TCMDve_I_HWIO_MotorCurrent_IRV TCMDve_n_HWIO_MotorRotSpd_IRV TCMDve_n_MotorSpeed TCMDve_Pct_HWIO_MotorActPWM_IRV TCMDve_T_CoolingActPwrStg TCMDve_y_BSWDiagDrvOvrCur TCMDve_y_BSWDiagDrvOvrTemp TCMDve_y_BSWDiagDrvSupOvrVolt TCMDve_y_BSWDiagHALFault TCMDve_y_BSWDiagHALSupOvrVolt TCMDve_y_BSWDiagHALSupUndrVolt TCMDve_y_BSWDiagPhaseHigh TCMDve_y_BSWDiagPhaseLow TCMDve_y_BSWDiagPhasePerf TCMDve_y_EC_MosStatus TCMDve_y_EC_Status TCMDve_y_EC_StuckStatus TCMDve_y_RC_SpdDev_MosStatus TCMDve_y_RC_SpdDev_Progress TCMDve_y_RC_SpdDev_Status TCMDve_y_Status TCPDne_p_BiasComp TCPDve_b_ClearBiasComp TCPDve_Cnt_RC_Bias_Diags TCPDve_Cnt_RC_Bias_Fails TCPDve_Cnt_RC_HighClutchPres_Diags TCPDve_Cnt_RC_HighClutchPres_Fails TCPDve_Cnt_RC_LowClutchPres_Diags TCPDve_Cnt_RC_LowClutchPres_Fails TCPDve_Cnt_RC_MaxPres_Diags TCPDve_Cnt_RC_MaxPres_Fails TCPDve_e_ClutchPressureHighVld TCPDve_e_ClutchPressureLowVld TCPDve_e_ClutchPressureSensorVld TCPDve_e_ClutchPressureSensPerfVld TCPDve_p_AveragePresAtStart TCPDve_p_BiasComp_IRV TCPDve_p_ClutchPressure TCPDve_U_ClutchPressureRaw TCPDve_U_ClutchPressureVoltage TCPDve_y_BSWDiagHigh TCPDve_y_BSWDiagLow TCPDve_y_EC_Status TCPDve_y_RC_Bias_Progress TCPDve_y_RC_Bias_Status TCPDve_y_RC_HighClutchPres_Progress TCPDve_y_RC_HighClutchPres_Status TCPDve_y_RC_LowClutchPres_Progress TCPDve_y_RC_LowClutchPres_Status TCPDve_y_RC_MaxPres_Progress TCPDve_y_RC_MaxPres_Status TCPDve_y_Status TCU_AirFlowRequest TCU_Clutch_Status TCU_ClutchAvailableMaximumTorque TCU_ClutchAvailableMinimumTorque TCU_ClutchCapacityAct TCU_CrankingAuthorizationEnable TCU_Fault_Reaction_Req TCU_FaultLamp_Req TCU_GearEngagementAvailable TCU_MaxFrtMotPwr_Req TCU_MaxGCUPwr_Req TCU_OBD_Lamp TCU_OBD_Lamp_Req TCU_TransmissionFluidTemp TIRCve_M_ReqAtLashRtLim TIRCve_M_TransInputTorqueImmd TISCve_n_TargetIdleSpd TLMDve_b_PwrstgCrrntlShtOffByTLMD TLMDve_Cnt_TransCtrlSysPerf_Diags TLMDve_Cnt_TransCtrlSysPerf_Fails TLMDve_e_TransCtrlSysPerfVld TLMDve_y_Status TLMDve_y_TransCtrlSysPerf_Progress TLMDve_y_TransCtrlSysPerf_Status TOTDve_b_RC_DltFailRst TOTDve_Cnt_RC_High_Diags TOTDve_Cnt_RC_High_Fails TOTDve_Cnt_RC_Low_Diags TOTDve_Cnt_RC_Low_Fails TOTDve_Cnt_RC_OilT_CritDiags TOTDve_Cnt_RC_OilT_CritFails TOTDve_Cnt_RC_OilT_WarnDiags TOTDve_Cnt_RC_OilT_WarnFails TOTDve_e_TransmissionOilTempCritVld TOTDve_e_TransmissionOilTempWarnVld TOTDve_e_TransmissionTempSensorVld TOTDve_T_OilTemperature TOTDve_T_OilTemperature_IRV TOTDve_y_RC_High_Progress TOTDve_y_RC_High_Status TOTDve_y_RC_Low_Progress TOTDve_y_RC_Low_Status TOTDve_y_RC_OilT_CritProgress TOTDve_y_RC_OilT_CritStatus TOTDve_y_RC_OilT_WarnProgress TOTDve_y_RC_OilT_WarnStatus TOTDve_y_Status TSPCve_n_EvenClthSpeed TSPCve_n_OddClthSpeed TSPCve_n_P1RotationalSpeedERS TSPCve_n_TransOutputSpeed TSPCve_n_TransP1ClutchInputSpeed TSPCve_n_TransP3InputSpeed TSSDve_Cnt_ClutchDragTrqTooHighFail TSSDve_Cnt_RC_ClTrq_Diags TSSDve_Cnt_RC_ClTrq_Fails TSSDve_Cnt_RC_DrgTrq_Diags TSSDve_Cnt_RC_DrgTrq_Fails TSSDve_e_ClutchCapacityInsuffVld TSSDve_e_ClutchDragTrqTooHighVld TSSDve_t_RC_DrgTrq_ClOpenTimer TSSDve_t_RC_DrgTrq_ICEOffTimer TSSDve_y_RC_ClTrq_Progress TSSDve_y_RC_ClTrq_Status TSSDve_y_RC_DrgTrq_Progress TSSDve_y_RC_DrgTrq_Status TSSDve_y_Status TTSSve_b_P1TrqLimReq TTSSve_e_SpdCntrlReqMod TTSSve_M_P1MaxTrqImmd TTSSve_M_P1MinTrqImmd TTSSve_n_SpdCntrlTarget V5RDve_e_EC_StatusRef1Vld V5RDve_e_EC_StatusRef2Vld V5RDve_e_EC_StatusRef3Vld VCU_Fault VECU_EngRunningStatusExpanded VECU_EngSpdSignalFailure VECU_IUP_RATE_GEN_DEN VECU_IUP_RATE_GEN_INH VODOve_l_TotalOdometer VSPEve_e_DrvnWhlsSpdUnsignedVld VSPEve_e_DrvnWhlsSpdVld VSPEve_e_VehSpdCOGUnsignedVld VSPEve_e_VehSpdCOGVld VSPEve_v_DrvnWhlsSpd VSPEve_v_DrvnWhlsSpdUnsigned VSPEve_v_VehSpdCOG VSPEve_v_VehSpdCOGUnsigned VSPEve_v_VehSpdNonDrivenUnsigned VSSDve_e_VehicleSpeedVld VSSDve_v_VehicleSpeed WSSDve_e_DrvnWhlSpdLeftVld WSSDve_e_DrvnWhlSpdRightVld WSSDve_e_NonDrvnWhlSpdLeftVld WSSDve_e_NonDrvnWhlSpdRightVld WSSDve_v_DrvnWhlSpdLeft WSSDve_v_DrvnWhlSpdRight WSSDve_v_NonDrvnWhlSpdLeft WSSDve_v_NonDrvnWhlSpdRight /end OUT_MEASUREMENT
/end FUNCTION
/begin FUNCTION RTMCLD ""
 /begin OUT_MEASUREMENT RTMCLD_u16MeasurementPeriodCounter RTMCLD_u32IdleClock RTMCLD_u32Load RTMCLD_u32PrevIdleClock /end OUT_MEASUREMENT
/end FUNCTION
/begin FUNCTION RTMTSK "" /begin DEF_CHARACTERISTIC RTMTSK_ku8TaskId /end DEF_CHARACTERISTIC
 /begin OUT_MEASUREMENT RTMTSK_u32TaskDuration RTMTSK_u32TaskStartTime RTMTSK_u8TaskId /end OUT_MEASUREMENT
/end FUNCTION
/end MODULE
/end PROJECT
