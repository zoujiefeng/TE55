ASAP2_VERSION 1 3
/begin PROJECT D_TC387_PLATFORM_0_0 "D_TC387_PLATFORM_0_0"
/begin HEADER "" VERSION "5210.00" PROJECT_NO D0 /end HEADER
/begin MODULE D_TC387_PLATFORM_0_0 "Invt"
/begin MOD_COMMON "" DEPOSIT ABSOLUTE ALIGNMENT_BYTE 1 ALIGNMENT_WORD 2 ALIGNMENT_LONG 4 ALIGNMENT_FLOAT32_IEEE 4 ALIGNMENT_FLOAT64_IEEE 8 BYTE_ORDER MSB_LAST /end MOD_COMMON
/begin MEASUREMENT GMAIN_ESMGo2StartupIEvent "Evï¿½nement pour rï¿½initialiser lautomate ESM" UBYTE Bool_ON_OFF 1 2 0 1 BIT_MASK 0x01 ECU_ADDRESS 0x0 /end MEASUREMENT
/begin MEASUREMENT GMAIN_MSGbFMCU1_ActTrqValid "BSW Power on check finish flag." UBYTE Bool_ON_OFF 1 2 0 1 BIT_MASK 0x01 ECU_ADDRESS 0x0 /end MEASUREMENT
/begin MEASUREMENT GMAIN_MSGbFMCU2_DischrgAllowed "BSW Power on check finish flag." UBYTE Bool_ON_OFF 1 2 0 1 BIT_MASK 0x01 ECU_ADDRESS 0x0 /end MEASUREMENT
/begin MEASUREMENT GMAIN_MSGbRMCU4_McuOverTemp "BSW Power on check finish flag." UBYTE Bool_ON_OFF 1 2 0 1 BIT_MASK 0x01 ECU_ADDRESS 0x0 /end MEASUREMENT
/begin MEASUREMENT GMAIN_MSGbRMCU4_MilReq "BSW Power on check finish flag." UBYTE Bool_ON_OFF 1 2 0 1 BIT_MASK 0x01 ECU_ADDRESS 0x0 /end MEASUREMENT
/begin MEASUREMENT GMAIN_MSGbRMCU4_MoterFault "BSW Power on check finish flag." UBYTE Bool_ON_OFF 1 2 0 1 BIT_MASK 0x01 ECU_ADDRESS 0x0 /end MEASUREMENT
/begin MEASUREMENT GMAIN_MSGbRMCU4_MoterOverTemp "BSW Power on check finish flag." UBYTE Bool_ON_OFF 1 2 0 1 BIT_MASK 0x01 ECU_ADDRESS 0x0 /end MEASUREMENT
/begin MEASUREMENT GMAIN_MSGbTCU_P1OverTempWarn "BSW Power on check finish flag." UBYTE Bool_ON_OFF 1 2 0 1 BIT_MASK 0x01 ECU_ADDRESS 0x0 /end MEASUREMENT
/begin MEASUREMENT GMAIN_MSGbTCU_P3OverTempWarn "BSW Power on check finish flag." UBYTE Bool_ON_OFF 1 2 0 1 BIT_MASK 0x01 ECU_ADDRESS 0x0 /end MEASUREMENT
/begin MEASUREMENT GMAIN_MSGbVCU_FmcuAkdReq "BSW Power on check finish flag." UBYTE Bool_ON_OFF 1 2 0 1 BIT_MASK 0x01 ECU_ADDRESS 0x0 /end MEASUREMENT
/begin MEASUREMENT GMAIN_MSGf32CAP_PhsCurLoadPhys "..." FLOAT32_IEEE I_37 1 2 -3.402823466E+038 3.402823466E+038 ECU_ADDRESS 0x0 /end MEASUREMENT
/begin MEASUREMENT GMAIN_MSGf32DCU_OilPressurePhys "..." FLOAT32_IEEE F_1_p0_38 1 2 -3.402823466E+038 3.402823466E+038 ECU_ADDRESS 0x0 /end MEASUREMENT
/begin MEASUREMENT GMAIN_MSGf32MCU_LvVoltPhys "..." FLOAT32_IEEE I_15 1 2 -3.402823466E+038 3.402823466E+038 ECU_ADDRESS 0x0 /end MEASUREMENT
/begin MEASUREMENT GMAIN_MSGf32VCU7_12VBatVoltPhys "..." FLOAT32_IEEE F_1_p0_39 1 2 -3.402823466E+038 3.402823466E+038 ECU_ADDRESS 0x0 /end MEASUREMENT
/begin MEASUREMENT GMAIN_MSGf32VCU_AccPedPosPhys "..." FLOAT32_IEEE F_1_p0_40 1 2 -3.402823466E+038 3.402823466E+038 ECU_ADDRESS 0x0 /end MEASUREMENT
/begin MEASUREMENT GMAIN_MSGf32VCU_BrakPedPosPhys "..." FLOAT32_IEEE I_41 1 2 -3.402823466E+038 3.402823466E+038 ECU_ADDRESS 0x0 /end MEASUREMENT
/begin MEASUREMENT GMAIN_MSGu16DCU_OilPressureRaw "..." UWORD I_1 1 2 0 65535 ECU_ADDRESS 0x0 /end MEASUREMENT
/begin MEASUREMENT GMAIN_MSGu16EMS_EngActualFlwTorqueRaw "..." UWORD I_1 1 2 0 65535 ECU_ADDRESS 0x0 /end MEASUREMENT
/begin MEASUREMENT GMAIN_MSGu16TCU_ClutchActTorqRaw "..." UWORD I_1 1 2 0 65535 ECU_ADDRESS 0x0 /end MEASUREMENT
/begin MEASUREMENT GMAIN_MSGu8BMS_MainNegConnSts "..." UBYTE I_1 1 2 0 255 ECU_ADDRESS 0x0 /end MEASUREMENT
/begin MEASUREMENT GMAIN_MSGu8BMS_MainPosConnSts "..." UBYTE I_1 1 2 0 255 ECU_ADDRESS 0x0 /end MEASUREMENT
/begin MEASUREMENT GMAIN_MSGu8CompileDay "..." UBYTE I_1 1 2 0 255 ECU_ADDRESS 0x0 /end MEASUREMENT
/begin MEASUREMENT GMAIN_MSGu8CompileMonth "..." UBYTE I_1 1 2 0 255 ECU_ADDRESS 0x0 /end MEASUREMENT
/begin MEASUREMENT GMAIN_MSGu8CompileYear "..." UBYTE I_1 1 2 0 255 ECU_ADDRESS 0x0 /end MEASUREMENT
/begin MEASUREMENT GMAIN_MSGu8DCU_OfsAlCalSts "..." UBYTE I_1 1 2 0 255 ECU_ADDRESS 0x0 /end MEASUREMENT
/begin MEASUREMENT GMAIN_MSGu8DEV_Fault0 "..." UBYTE I_1 1 2 0 255 ECU_ADDRESS 0x0 /end MEASUREMENT
/begin MEASUREMENT GMAIN_MSGu8DEV_Fault1 "..." UBYTE I_1 1 2 0 255 ECU_ADDRESS 0x0 /end MEASUREMENT
/begin MEASUREMENT GMAIN_MSGu8DEV_Fault10 "..." UBYTE I_1 1 2 0 255 ECU_ADDRESS 0x0 /end MEASUREMENT
/begin MEASUREMENT GMAIN_MSGu8DEV_Fault11 "..." UBYTE I_1 1 2 0 255 ECU_ADDRESS 0x0 /end MEASUREMENT
/begin MEASUREMENT GMAIN_MSGu8DEV_Fault12 "..." UBYTE I_1 1 2 0 255 ECU_ADDRESS 0x0 /end MEASUREMENT
/begin MEASUREMENT GMAIN_MSGu8DEV_Fault13 "..." UBYTE I_1 1 2 0 255 ECU_ADDRESS 0x0 /end MEASUREMENT
/begin MEASUREMENT GMAIN_MSGu8DEV_Fault14 "..." UBYTE I_1 1 2 0 255 ECU_ADDRESS 0x0 /end MEASUREMENT
/begin MEASUREMENT GMAIN_MSGu8DEV_Fault15 "..." UBYTE I_1 1 2 0 255 ECU_ADDRESS 0x0 /end MEASUREMENT
/begin MEASUREMENT GMAIN_MSGu8DEV_Fault2 "..." UBYTE I_1 1 2 0 255 ECU_ADDRESS 0x0 /end MEASUREMENT
/begin MEASUREMENT GMAIN_MSGu8DEV_Fault3 "..." UBYTE I_1 1 2 0 255 ECU_ADDRESS 0x0 /end MEASUREMENT
/begin MEASUREMENT GMAIN_MSGu8DEV_Fault4 "..." UBYTE I_1 1 2 0 255 ECU_ADDRESS 0x0 /end MEASUREMENT
/begin MEASUREMENT GMAIN_MSGu8DEV_Fault5 "..." UBYTE I_1 1 2 0 255 ECU_ADDRESS 0x0 /end MEASUREMENT
/begin MEASUREMENT GMAIN_MSGu8DEV_Fault6 "..." UBYTE I_1 1 2 0 255 ECU_ADDRESS 0x0 /end MEASUREMENT
/begin MEASUREMENT GMAIN_MSGu8DEV_Fault7 "..." UBYTE I_1 1 2 0 255 ECU_ADDRESS 0x0 /end MEASUREMENT
/begin MEASUREMENT GMAIN_MSGu8DEV_Fault8 "..." UBYTE I_1 1 2 0 255 ECU_ADDRESS 0x0 /end MEASUREMENT
/begin MEASUREMENT GMAIN_MSGu8DEV_Fault9 "..." UBYTE I_1 1 2 0 255 ECU_ADDRESS 0x0 /end MEASUREMENT
/begin MEASUREMENT GMAIN_MSGu8FMCU8_HtcuLimpHomeSts "..." UBYTE I_1 1 2 0 255 ECU_ADDRESS 0x0 /end MEASUREMENT
/begin MEASUREMENT GMAIN_MSGu8GW2_PwrMode "..." UBYTE I_3 1 2 0 255 ECU_ADDRESS 0x0 /end MEASUREMENT
/begin MEASUREMENT GMAIN_MSGu8MCU_McuEnableSts "..." UBYTE I_1 1 2 0 255 ECU_ADDRESS 0x0 /end MEASUREMENT
/begin MEASUREMENT GMAIN_MSGu8MCU_McuPrevSlipFlg "..." UBYTE I_1 1 2 0 255 ECU_ADDRESS 0x0 /end MEASUREMENT
/begin MEASUREMENT GMAIN_MSGu8MCU_PwrActvMod "..." UBYTE I_1 1 2 0 255 ECU_ADDRESS 0x0 /end MEASUREMENT
/begin MEASUREMENT GMAIN_MSGu8McuActvDischgFlt "..." UBYTE I_1 1 2 0 255 ECU_ADDRESS 0x0 /end MEASUREMENT
/begin MEASUREMENT GMAIN_MSGu8McuBusUVFlt "..." UBYTE I_1 1 2 0 255 ECU_ADDRESS 0x0 /end MEASUREMENT
/begin MEASUREMENT GMAIN_MSGu8McuCANComFlt "..." UBYTE I_1 1 2 0 255 ECU_ADDRESS 0x0 /end MEASUREMENT
/begin MEASUREMENT GMAIN_MSGu8McuDcHVCurSensFlt "..." UBYTE I_1 1 2 0 255 ECU_ADDRESS 0x0 /end MEASUREMENT
/begin MEASUREMENT GMAIN_MSGu8McuHVLoopFlt "..." UBYTE I_1 1 2 0 255 ECU_ADDRESS 0x0 /end MEASUREMENT
/begin MEASUREMENT GMAIN_MSGu8McuHwCapOVFlt "..." UBYTE I_1 1 2 0 255 ECU_ADDRESS 0x0 /end MEASUREMENT
/begin MEASUREMENT GMAIN_MSGu8McuIgbtFlt "..." UBYTE I_1 1 2 0 255 ECU_ADDRESS 0x0 /end MEASUREMENT
/begin MEASUREMENT GMAIN_MSGu8McuInvtTempSensErr "..." UBYTE I_1 1 2 0 255 ECU_ADDRESS 0x0 /end MEASUREMENT
/begin MEASUREMENT GMAIN_MSGu8McuLVVoltFlt "..." UBYTE I_1 1 2 0 255 ECU_ADDRESS 0x0 /end MEASUREMENT
/begin MEASUREMENT GMAIN_MSGu8McuMemoryFlt "..." UBYTE I_1 1 2 0 255 ECU_ADDRESS 0x0 /end MEASUREMENT
/begin MEASUREMENT GMAIN_MSGu8McuMotLockRotErr "..." UBYTE I_1 1 2 0 255 ECU_ADDRESS 0x0 /end MEASUREMENT
/begin MEASUREMENT GMAIN_MSGu8McuMotSN "..." UBYTE I_1 1 2 0 255 ECU_ADDRESS 0x0 /end MEASUREMENT
/begin MEASUREMENT GMAIN_MSGu8McuMotSpdHighAlarm "..." UBYTE I_1 1 2 0 255 ECU_ADDRESS 0x0 /end MEASUREMENT
/begin MEASUREMENT GMAIN_MSGu8McuMotSubFltLevel "..." UBYTE I_1 1 2 0 255 ECU_ADDRESS 0x0 /end MEASUREMENT
/begin MEASUREMENT GMAIN_MSGu8McuMotSysOVCAlarm "..." UBYTE I_1 1 2 0 255 ECU_ADDRESS 0x0 /end MEASUREMENT
/begin MEASUREMENT GMAIN_MSGu8McuMotTempHighAlarm "..." UBYTE I_1 1 2 0 255 ECU_ADDRESS 0x0 /end MEASUREMENT
/begin MEASUREMENT GMAIN_MSGu8McuMotTempSensErr "..." UBYTE I_1 1 2 0 255 ECU_ADDRESS 0x0 /end MEASUREMENT
/begin MEASUREMENT GMAIN_MSGu8McuResolverFlt "..." UBYTE I_1 1 2 0 255 ECU_ADDRESS 0x0 /end MEASUREMENT
/begin MEASUREMENT GMAIN_MSGu8McuSoftCapOVFlt "..." UBYTE I_1 1 2 0 255 ECU_ADDRESS 0x0 /end MEASUREMENT
/begin MEASUREMENT GMAIN_MSGu8McuSoftMajorVer "..." UBYTE I_1 1 2 0 255 ECU_ADDRESS 0x0 /end MEASUREMENT
/begin MEASUREMENT GMAIN_MSGu8McuSoftMinorVer "..." UBYTE I_1 1 2 0 255 ECU_ADDRESS 0x0 /end MEASUREMENT
/begin MEASUREMENT GMAIN_MSGu8McuTempHighAlarm "..." UBYTE I_1 1 2 0 255 ECU_ADDRESS 0x0 /end MEASUREMENT
/begin MEASUREMENT GMAIN_MSGu8McuUCurSensFlt "..." UBYTE I_1 1 2 0 255 ECU_ADDRESS 0x0 /end MEASUREMENT
/begin MEASUREMENT GMAIN_MSGu8McuVCurSensFlt "..." UBYTE I_1 1 2 0 255 ECU_ADDRESS 0x0 /end MEASUREMENT
/begin MEASUREMENT GMAIN_MSGu8McuWCurSensFlt "..." UBYTE I_1 1 2 0 255 ECU_ADDRESS 0x0 /end MEASUREMENT
/begin MEASUREMENT GMAIN_MSGu8PwModOffCnt "GMAIN_MSGu8PwModOffCnt" UBYTE I_1 1 2 0 255 ECU_ADDRESS 0x0 /end MEASUREMENT
/begin MEASUREMENT GMAIN_MSGu8PwModOnCnt "GMAIN_MSGu8PwModOnCnt" UBYTE I_1 1 2 0 255 ECU_ADDRESS 0x0 /end MEASUREMENT
/begin MEASUREMENT GMAIN_MSGu8TCU_ClutchProgress "..." UBYTE I_1 1 2 0 255 ECU_ADDRESS 0x0 /end MEASUREMENT
/begin MEASUREMENT GMAIN_MSGu8VCU_AccPedPosRaw "..." UBYTE I_1 1 2 0 255 ECU_ADDRESS 0x0 /end MEASUREMENT
/begin MEASUREMENT GMAIN_MSGu8VCU_EMWorkMod "..." UBYTE I_1 1 2 0 255 ECU_ADDRESS 0x0 /end MEASUREMENT
/begin MEASUREMENT GMAIN_MSGu8VCU_HandBrakSts "..." UBYTE I_1 1 2 0 255 ECU_ADDRESS 0x0 /end MEASUREMENT
/begin MEASUREMENT GMAIN_MSGu8VCU_McuEnableReq "..." UBYTE I_1 1 2 0 255 ECU_ADDRESS 0x0 /end MEASUREMENT
/begin MEASUREMENT GMAIN_MSGu8VCU_ePTReady "..." UBYTE I_1 1 2 0 255 ECU_ADDRESS 0x0 /end MEASUREMENT
/begin MEASUREMENT GMAIN_TCUf32CAP_AvrgCurrentPhys "..." FLOAT32_IEEE I_37 1 2 -3.402823466E+038 3.402823466E+038 ECU_ADDRESS 0x0 /end MEASUREMENT
/begin MEASUREMENT GMAIN_TCUf32CAP_DutyCyclePhys "..." FLOAT32_IEEE I_37 1 2 -3.402823466E+038 3.402823466E+038 ECU_ADDRESS 0x0 /end MEASUREMENT
/begin MEASUREMENT GMAIN_TCUf32CAP_MotSpeedPhys "..." FLOAT32_IEEE I_37 1 2 -3.402823466E+038 3.402823466E+038 ECU_ADDRESS 0x0 /end MEASUREMENT
/begin MEASUREMENT GMAIN_TCUf32CAP_TargetDutyCyclePhys "..." FLOAT32_IEEE I_41 1 2 -3.402823466E+038 3.402823466E+038 ECU_ADDRESS 0x0 /end MEASUREMENT
/begin MEASUREMENT GMAIN_TCUu8CAP_TargetMotSts "..." UBYTE I_1 1 2 0 255 ECU_ADDRESS 0x0 /end MEASUREMENT
/begin MEASUREMENT GMAIN_TotalTime "GMAIN_TotalTime" ULONG I_1 1 2 0 4294967295 ECU_ADDRESS 0x0 /end MEASUREMENT
/begin MEASUREMENT GMAIN_VSITxsPwmUl "GMAIN_VSITxsPwmUl" UWORD F_0v0061035156_p0_43 1 2 0 399.9938965 ECU_ADDRESS 0x0 /end MEASUREMENT
/begin MEASUREMENT GMAIN_VSITxsPwmUlOn "GMAIN_VSITxsPwmUlOn" UBYTE Bool_ON_OFF 1 2 0 1 BIT_MASK 0x01 ECU_ADDRESS 0x0 /end MEASUREMENT
/begin MEASUREMENT GMAIN_VSITxsPwmUr "GMAIN_VSITxsPwmUr" UWORD F_0v0061035156_p0_43 1 2 0 399.9938965 ECU_ADDRESS 0x0 /end MEASUREMENT
/begin MEASUREMENT GMAIN_VSITxsPwmUrOn "GMAIN_VSITxsPwmUrOn" UBYTE Bool_ON_OFF 1 2 0 1 BIT_MASK 0x01 ECU_ADDRESS 0x0 /end MEASUREMENT
/begin MEASUREMENT GMAIN_VSITxsPwmVl "GMAIN_VSITxsPwmVl" UWORD F_0v0061035156_p0_43 1 2 0 399.9938965 ECU_ADDRESS 0x0 /end MEASUREMENT
/begin MEASUREMENT GMAIN_VSITxsPwmVlOn "GMAIN_VSITxsPwmVlOn" UBYTE Bool_ON_OFF 1 2 0 1 BIT_MASK 0x01 ECU_ADDRESS 0x0 /end MEASUREMENT
/begin MEASUREMENT GMAIN_VSITxsPwmVr "GMAIN_VSITxsPwmVr" UWORD F_0v0061035156_p0_43 1 2 0 399.9938965 ECU_ADDRESS 0x0 /end MEASUREMENT
/begin MEASUREMENT GMAIN_VSITxsPwmVrOn "GMAIN_VSITxsPwmVrOn" UBYTE Bool_ON_OFF 1 2 0 1 BIT_MASK 0x01 ECU_ADDRESS 0x0 /end MEASUREMENT
/begin MEASUREMENT GMAIN_VSITxsPwmWl "GMAIN_VSITxsPwmWl" UWORD F_0v0061035156_p0_43 1 2 0 399.9938965 ECU_ADDRESS 0x0 /end MEASUREMENT
/begin MEASUREMENT GMAIN_VSITxsPwmWlOn "GMAIN_VSITxsPwmWlOn" UBYTE Bool_ON_OFF 1 2 0 1 BIT_MASK 0x01 ECU_ADDRESS 0x0 /end MEASUREMENT
/begin MEASUREMENT GMAIN_VSITxsPwmWr "GMAIN_VSITxsPwmWr" UWORD F_0v0061035156_p0_43 1 2 0 399.9938965 ECU_ADDRESS 0x0 /end MEASUREMENT
/begin MEASUREMENT GMAIN_VSITxsPwmWrOn "GMAIN_VSITxsPwmWrOn" UBYTE Bool_ON_OFF 1 2 0 1 BIT_MASK 0x01 ECU_ADDRESS 0x0 /end MEASUREMENT
/begin MEASUREMENT GMAIN_au8ErrCode[9] "GMAIN_au8ErrCode[9]" UBYTE F_1_p0_4 1 2 0 255 ECU_ADDRESS 0x0 /end MEASUREMENT
/begin MEASUREMENT GMAIN_bAkdAfterAscReq "..." UBYTE Bool_ON_OFF 1 2 0 1 BIT_MASK 0x01 ECU_ADDRESS 0x0 /end MEASUREMENT
/begin MEASUREMENT GMAIN_bAntiSlopGearEna "..." UBYTE Bool_ON_OFF 1 2 0 1 BIT_MASK 0x01 ECU_ADDRESS 0x0 /end MEASUREMENT
/begin MEASUREMENT GMAIN_bAscFlag "Flag ESM started" UBYTE Bool_ON_OFF 1 2 0 1 BIT_MASK 0x01 ECU_ADDRESS 0x0 /end MEASUREMENT
/begin MEASUREMENT GMAIN_bBswReadySts "BSW Power on check finish flag." UBYTE Bool_ON_OFF 1 2 0 1 BIT_MASK 0x01 ECU_ADDRESS 0x0 /end MEASUREMENT
/begin MEASUREMENT GMAIN_bESMStarted "Flag ESM started" UBYTE Bool_ON_OFF 1 2 0 1 BIT_MASK 0x01 ECU_ADDRESS 0x0 /end MEASUREMENT
/begin MEASUREMENT GMAIN_bFTInitFinshFlg "FT Initilize finished flag" UBYTE Bool_ON_OFF 1 2 0 1 BIT_MASK 0x01 ECU_ADDRESS 0x0 /end MEASUREMENT
/begin MEASUREMENT GMAIN_bMcuMilStatus "..." UBYTE Bool_ON_OFF 1 2 0 1 BIT_MASK 0x01 ECU_ADDRESS 0x0 /end MEASUREMENT
/begin MEASUREMENT GMAIN_bOCStoreManualReq "..." UBYTE Bool_ON_OFF 1 2 0 1 BIT_MASK 0x01 ECU_ADDRESS 0x0 /end MEASUREMENT
/begin MEASUREMENT GMAIN_bOcDataStoreEna "..." UBYTE Bool_ON_OFF 1 2 0 1 BIT_MASK 0x01 ECU_ADDRESS 0x0 /end MEASUREMENT
/begin MEASUREMENT GMAIN_bOcFailureFlg "..." UBYTE Bool_ON_OFF 1 2 0 1 BIT_MASK 0x01 ECU_ADDRESS 0x0 /end MEASUREMENT
/begin MEASUREMENT GMAIN_bOcFinshFlg "..." UBYTE Bool_ON_OFF 1 2 0 1 BIT_MASK 0x01 ECU_ADDRESS 0x0 /end MEASUREMENT
/begin MEASUREMENT GMAIN_bOcModeEna "OC mode enable flag" UBYTE Bool_ON_OFF 1 2 0 1 BIT_MASK 0x01 ECU_ADDRESS 0x0 /end MEASUREMENT
/begin MEASUREMENT GMAIN_bOcNotRatFlg "..." UBYTE Bool_ON_OFF 1 2 0 1 BIT_MASK 0x01 ECU_ADDRESS 0x0 /end MEASUREMENT
/begin MEASUREMENT GMAIN_bOcRdResultFlag "..." UBYTE Bool_ON_OFF 1 2 0 1 BIT_MASK 0x01 ECU_ADDRESS 0x0 /end MEASUREMENT
/begin MEASUREMENT GMAIN_bOcStartFlag "..." UBYTE Bool_ON_OFF 1 2 0 1 BIT_MASK 0x01 ECU_ADDRESS 0x0 /end MEASUREMENT
/begin MEASUREMENT GMAIN_bPosAccessLock "Must be Volatile variable." UBYTE Bool_ON_OFF 1 2 0 1 BIT_MASK 0x01 ECU_ADDRESS 0x0 /end MEASUREMENT
/begin MEASUREMENT GMAIN_bProgConditionOk "..." UBYTE Bool_ON_OFF 1 2 0 1 BIT_MASK 0x01 ECU_ADDRESS 0x0 /end MEASUREMENT
/begin MEASUREMENT GMAIN_bResExcFltDetEna "..." UBYTE Bool_ON_OFF 1 2 0 1 BIT_MASK 0x01 ECU_ADDRESS 0x0 /end MEASUREMENT
/begin MEASUREMENT GMAIN_bSlopSlideTimoutFlg "..." UBYTE Bool_ON_OFF 1 2 0 1 BIT_MASK 0x01 ECU_ADDRESS 0x0 /end MEASUREMENT
/begin MEASUREMENT GMAIN_bSoftOvBhvFlg "..." UBYTE Bool_ON_OFF 1 2 0 1 BIT_MASK 0x01 ECU_ADDRESS 0x0 /end MEASUREMENT
/begin MEASUREMENT GMAIN_bSoftOvCurrPhsUFlg "..." UBYTE Bool_ON_OFF 1 2 0 1 BIT_MASK 0x01 ECU_ADDRESS 0x0 /end MEASUREMENT
/begin MEASUREMENT GMAIN_bSoftOvCurrPhsVFlg "..." UBYTE Bool_ON_OFF 1 2 0 1 BIT_MASK 0x01 ECU_ADDRESS 0x0 /end MEASUREMENT
/begin MEASUREMENT GMAIN_bSoftOvCurrPhsWFlg "..." UBYTE Bool_ON_OFF 1 2 0 1 BIT_MASK 0x01 ECU_ADDRESS 0x0 /end MEASUREMENT
/begin MEASUREMENT GMAIN_bSpdReadyEst "..." UBYTE Bool_ON_OFF 1 2 0 1 BIT_MASK 0x01 ECU_ADDRESS 0x0 /end MEASUREMENT
/begin MEASUREMENT GMAIN_bSpeedReadyFlg "..." UBYTE Bool_ON_OFF 1 2 0 1 BIT_MASK 0x01 ECU_ADDRESS 0x0 /end MEASUREMENT
/begin MEASUREMENT GMAIN_bTcuStuckFlag "..." UBYTE Bool_ON_OFF 1 2 0 1 BIT_MASK 0x01 ECU_ADDRESS 0x0 /end MEASUREMENT
/begin MEASUREMENT GMAIN_bTeachInCompleteFlg "..." UBYTE Bool_ON_OFF 1 2 0 1 BIT_MASK 0x01 ECU_ADDRESS 0x0 /end MEASUREMENT
/begin MEASUREMENT GMAIN_bVSIStarted "Flag VSI started" UBYTE Bool_ON_OFF 1 2 0 1 BIT_MASK 0x01 ECU_ADDRESS 0x0 /end MEASUREMENT
/begin MEASUREMENT GMAIN_f32AntiSsEnaBrakPos "..." FLOAT32_IEEE I_45 1 2 -3.402823466E+038 3.402823466E+038 ECU_ADDRESS 0x0 /end MEASUREMENT
/begin MEASUREMENT GMAIN_f32BldcCurrentPos "..." FLOAT32_IEEE F_100_p0_5 1 2 -3.402823466E+038 3.402823466E+038 ECU_ADDRESS 0x0 /end MEASUREMENT
/begin MEASUREMENT GMAIN_f32BldcCurrentPosRolCnt "..." FLOAT32_IEEE F_100_p0_5 1 2 -3.402823466E+038 3.402823466E+038 ECU_ADDRESS 0x0 /end MEASUREMENT
/begin MEASUREMENT GMAIN_f32BldcDuty "..." FLOAT32_IEEE F_100_p0_5 1 2 -3.402823466E+038 3.402823466E+038 ECU_ADDRESS 0x0 /end MEASUREMENT
/begin MEASUREMENT GMAIN_f32BldcHallCapPos "..." FLOAT32_IEEE F_100_p0_5 1 2 -3.402823466E+038 3.402823466E+038 ECU_ADDRESS 0x0 /end MEASUREMENT
/begin MEASUREMENT GMAIN_f32BldcHallCapPosErr "..." FLOAT32_IEEE F_100_p0_5 1 2 -3.402823466E+038 3.402823466E+038 ECU_ADDRESS 0x0 /end MEASUREMENT
/begin MEASUREMENT GMAIN_f32BldcHallCapPosPre "..." FLOAT32_IEEE F_100_p0_5 1 2 -3.402823466E+038 3.402823466E+038 ECU_ADDRESS 0x0 /end MEASUREMENT
/begin MEASUREMENT GMAIN_f32BldcPositionDuty "..." FLOAT32_IEEE F_100_p0_5 1 2 -3.402823466E+038 3.402823466E+038 ECU_ADDRESS 0x0 /end MEASUREMENT
/begin MEASUREMENT GMAIN_f32CpuLoadCore0 "..." FLOAT32_IEEE F_1_p0_21 1 2 -3.402823466E+038 3.402823466E+038 ECU_ADDRESS 0x0 /end MEASUREMENT
/begin MEASUREMENT GMAIN_f32CpuLoadCore1 "..." FLOAT32_IEEE F_1_p0_21 1 2 -3.402823466E+038 3.402823466E+038 ECU_ADDRESS 0x0 /end MEASUREMENT
/begin MEASUREMENT GMAIN_f32CpuLoadCore2 "..." FLOAT32_IEEE F_1_p0_21 1 2 -3.402823466E+038 3.402823466E+038 ECU_ADDRESS 0x0 /end MEASUREMENT
/begin MEASUREMENT GMAIN_f32CpuLoadMaxCore0 "..." FLOAT32_IEEE F_1_p0_21 1 2 -3.402823466E+038 3.402823466E+038 ECU_ADDRESS 0x0 /end MEASUREMENT
/begin MEASUREMENT GMAIN_f32CpuLoadMaxCore1 "..." FLOAT32_IEEE F_1_p0_21 1 2 -3.402823466E+038 3.402823466E+038 ECU_ADDRESS 0x0 /end MEASUREMENT
/begin MEASUREMENT GMAIN_f32CpuLoadMaxCore2 "..." FLOAT32_IEEE F_1_p0_21 1 2 -3.402823466E+038 3.402823466E+038 ECU_ADDRESS 0x0 /end MEASUREMENT
/begin MEASUREMENT GMAIN_f32ElecSpeedRds "..." FLOAT32_IEEE F_1_p0_21 1 2 -3.402823466E+038 3.402823466E+038 ECU_ADDRESS 0x0 /end MEASUREMENT
/begin MEASUREMENT GMAIN_f32EmailElecSpeedRds "..." FLOAT32_IEEE F_1_p0_21 1 2 -3.402823466E+038 3.402823466E+038 ECU_ADDRESS 0x0 /end MEASUREMENT
/begin MEASUREMENT GMAIN_f32EmailErrThetaRdSurPi "..." FLOAT32_IEEE F_1_p0_21 1 2 -3.402823466E+038 3.402823466E+038 ECU_ADDRESS 0x0 /end MEASUREMENT
/begin MEASUREMENT GMAIN_f32EmailMecaSpeedRds "..." FLOAT32_IEEE F_1_p0_21 1 2 -3.402823466E+038 3.402823466E+038 ECU_ADDRESS 0x0 /end MEASUREMENT
/begin MEASUREMENT GMAIN_f32EmailMecaSpeedRpm "..." FLOAT32_IEEE F_1_p0_21 1 2 -3.402823466E+038 3.402823466E+038 ECU_ADDRESS 0x0 /end MEASUREMENT
/begin MEASUREMENT GMAIN_f32EmailNextThetaElecRdSurPi "..." FLOAT32_IEEE F_1_p0_21 1 2 -3.402823466E+038 3.402823466E+038 ECU_ADDRESS 0x0 /end MEASUREMENT
/begin MEASUREMENT GMAIN_f32EmailThetaElecRdSurPi "..." FLOAT32_IEEE F_1_p0_21 1 2 -3.402823466E+038 3.402823466E+038 ECU_ADDRESS 0x0 /end MEASUREMENT
/begin MEASUREMENT GMAIN_f32ErrThetaRdSurPi "..." FLOAT32_IEEE F_1_p0_21 1 2 -3.402823466E+038 3.402823466E+038 ECU_ADDRESS 0x0 /end MEASUREMENT
/begin MEASUREMENT GMAIN_f32EstTempRatioScale "..." FLOAT32_IEEE F_1_p0_4 1 2 -3.402823466E+038 3.402823466E+038 ECU_ADDRESS 0x0 /end MEASUREMENT
/begin MEASUREMENT GMAIN_f32IdDeltaAvg "..." FLOAT32_IEEE F_1_p0_4 1 2 -3.402823466E+038 3.402823466E+038 ECU_ADDRESS 0x0 /end MEASUREMENT
/begin MEASUREMENT GMAIN_f32IdDeltaSum "..." FLOAT32_IEEE F_1_p0_4 1 2 -3.402823466E+038 3.402823466E+038 ECU_ADDRESS 0x0 /end MEASUREMENT
/begin MEASUREMENT GMAIN_f32IdQuality "..." FLOAT32_IEEE F_1_p0_40 1 2 -3.402823466E+038 3.402823466E+038 ECU_ADDRESS 0x0 /end MEASUREMENT
/begin MEASUREMENT GMAIN_f32IqDeltaAvg "..." FLOAT32_IEEE F_1_p0_4 1 2 -3.402823466E+038 3.402823466E+038 ECU_ADDRESS 0x0 /end MEASUREMENT
/begin MEASUREMENT GMAIN_f32IqDeltaSum "..." FLOAT32_IEEE F_1_p0_4 1 2 -3.402823466E+038 3.402823466E+038 ECU_ADDRESS 0x0 /end MEASUREMENT
/begin MEASUREMENT GMAIN_f32IqQuality "..." FLOAT32_IEEE F_1_p0_40 1 2 -3.402823466E+038 3.402823466E+038 ECU_ADDRESS 0x0 /end MEASUREMENT
/begin MEASUREMENT GMAIN_f32IuFrequency "..." FLOAT32_IEEE F_1_p0_46 1 2 -3.402823466E+038 3.402823466E+038 ECU_ADDRESS 0x0 /end MEASUREMENT
/begin MEASUREMENT GMAIN_f32IuPeriod "..." FLOAT32_IEEE F_1_p0_47 1 2 -3.402823466E+038 3.402823466E+038 ECU_ADDRESS 0x0 /end MEASUREMENT
/begin MEASUREMENT GMAIN_f32MecaSpeedRds "..." FLOAT32_IEEE F_1_p0_21 1 2 -3.402823466E+038 3.402823466E+038 ECU_ADDRESS 0x0 /end MEASUREMENT
/begin MEASUREMENT GMAIN_f32MecaSpeedRpm "..." FLOAT32_IEEE F_1_p0_21 1 2 -3.402823466E+038 3.402823466E+038 ECU_ADDRESS 0x0 /end MEASUREMENT
/begin MEASUREMENT GMAIN_f32MotSpdEst "..." FLOAT32_IEEE F_1_p0_47 1 2 -3.402823466E+038 3.402823466E+038 ECU_ADDRESS 0x0 /end MEASUREMENT
/begin MEASUREMENT GMAIN_f32PWMDutyUPhys "..." FLOAT32_IEEE F_100_p0_5 1 2 -3.402823466E+038 3.402823466E+038 ECU_ADDRESS 0x0 /end MEASUREMENT
/begin MEASUREMENT GMAIN_f32PWMDutyVPhys "..." FLOAT32_IEEE F_100_p0_5 1 2 -3.402823466E+038 3.402823466E+038 ECU_ADDRESS 0x0 /end MEASUREMENT
/begin MEASUREMENT GMAIN_f32PWMDutyWPhys "..." FLOAT32_IEEE F_100_p0_5 1 2 -3.402823466E+038 3.402823466E+038 ECU_ADDRESS 0x0 /end MEASUREMENT
/begin MEASUREMENT GMAIN_f32ShiftDrumInitPos "..." FLOAT32_IEEE F_100_p0_5 1 2 -3.402823466E+038 3.402823466E+038 ECU_ADDRESS 0x0 /end MEASUREMENT
/begin MEASUREMENT GMAIN_f32ShiftDrumTermPos "..." FLOAT32_IEEE F_100_p0_5 1 2 -3.402823466E+038 3.402823466E+038 ECU_ADDRESS 0x0 /end MEASUREMENT
/begin MEASUREMENT GMAIN_f32TcReadPosDuty "..." FLOAT32_IEEE F_100_p0_5 1 2 -3.402823466E+038 3.402823466E+038 ECU_ADDRESS 0x0 /end MEASUREMENT
/begin MEASUREMENT GMAIN_f32ThetaElecRdSurPi "..." FLOAT32_IEEE F_1_p0_21 1 2 -3.402823466E+038 3.402823466E+038 ECU_ADDRESS 0x0 /end MEASUREMENT
/begin MEASUREMENT GMAIN_f32VsiPwmPeriod "..." FLOAT32_IEEE F_1000000_p0_49 1 2 -3.402823466E+038 3.402823466E+038 ECU_ADDRESS 0x0 /end MEASUREMENT
/begin MEASUREMENT GMAIN_s16BldcHallDirFdb "GMAIN_s16BldcHallDirFdb" SBYTE I_1 1 2 -128 127 ECU_ADDRESS 0x0 /end MEASUREMENT
/begin MEASUREMENT GMAIN_s32DeltTimDiff "..." SLONG F_0v01_p0_12 1 2 -21474836.48 21474836.47 ECU_ADDRESS 0x0 /end MEASUREMENT
/begin MEASUREMENT GMAIN_s32Email2PosTreqDiff "..." SLONG I_1 1 2 -2147483648 2147483647 ECU_ADDRESS 0x0 /end MEASUREMENT
/begin MEASUREMENT GMAIN_s32PosA2BDeltTimMax "..." SLONG F_0v1_p0_50 1 2 -214748364.8 214748364.7 ECU_ADDRESS 0x0 /end MEASUREMENT
/begin MEASUREMENT GMAIN_s32PosA2BDeltTimMin "..." SLONG F_0v1_p0_50 1 2 -214748364.8 214748364.7 ECU_ADDRESS 0x0 /end MEASUREMENT
/begin MEASUREMENT GMAIN_s32PosA2BDeltTime "..." SLONG F_0v1_p0_50 1 2 -214748364.8 214748364.7 ECU_ADDRESS 0x0 /end MEASUREMENT
/begin MEASUREMENT GMAIN_u16AntiSsBrakTimCnt "..." UWORD I_1 1 2 0 65535 ECU_ADDRESS 0x0 /end MEASUREMENT
/begin MEASUREMENT GMAIN_u16AntiSsEnaBrakCnt "..." UWORD I_1 1 2 0 65535 ECU_ADDRESS 0x0 /end MEASUREMENT
/begin MEASUREMENT GMAIN_u16AntiSsValidCnt "..." UWORD I_1 1 2 0 65535 ECU_ADDRESS 0x0 /end MEASUREMENT
/begin MEASUREMENT GMAIN_u16BldcIbatAdcV01 "GMAIN_u16BldcIbatAdcV01" UWORD I_1 1 2 0 65535 ECU_ADDRESS 0x0 /end MEASUREMENT
/begin MEASUREMENT GMAIN_u16BldcIbatAdcVR0 "GMAIN_u16BldcIbatAdcVR0" UWORD I_1 1 2 0 65535 ECU_ADDRESS 0x0 /end MEASUREMENT
/begin MEASUREMENT GMAIN_u16BldcOilPressAdc "GMAIN_u16BldcOilPressAdc" UWORD I_1 1 2 0 65535 ECU_ADDRESS 0x0 /end MEASUREMENT
/begin MEASUREMENT GMAIN_u16BldcOilTempAdc "GMAIN_u16BldcOilTempAdc" UWORD I_1 1 2 0 65535 ECU_ADDRESS 0x0 /end MEASUREMENT
/begin MEASUREMENT GMAIN_u16BrakRelsDelayCnt "..." UWORD I_1 1 2 0 65535 ECU_ADDRESS 0x0 /end MEASUREMENT
/begin MEASUREMENT GMAIN_u16Cnt1 "GMAIN_u16Cnt1" UWORD I_1 1 2 0 65535 ECU_ADDRESS 0x0 /end MEASUREMENT
/begin MEASUREMENT GMAIN_u16Cnt10 "GMAIN_u16Cnt10" UWORD I_1 1 2 0 65535 ECU_ADDRESS 0x0 /end MEASUREMENT
/begin MEASUREMENT GMAIN_u16Cnt100 "GMAIN_u16Cnt100" UWORD I_1 1 2 0 65535 ECU_ADDRESS 0x0 /end MEASUREMENT
/begin MEASUREMENT GMAIN_u16Cnt1000 "GMAIN_u16Cnt1000" UWORD I_1 1 2 0 65535 ECU_ADDRESS 0x0 /end MEASUREMENT
/begin MEASUREMENT GMAIN_u16Cnt2 "GMAIN_u16Cnt2" UWORD I_1 1 2 0 65535 ECU_ADDRESS 0x0 /end MEASUREMENT
/begin MEASUREMENT GMAIN_u16Cnt20 "GMAIN_u16Cnt20" UWORD I_1 1 2 0 65535 ECU_ADDRESS 0x0 /end MEASUREMENT
/begin MEASUREMENT GMAIN_u16Cnt200 "GMAIN_u16Cnt200" UWORD I_1 1 2 0 65535 ECU_ADDRESS 0x0 /end MEASUREMENT
/begin MEASUREMENT GMAIN_u16Cnt2000 "GMAIN_u16Cnt2000" UWORD I_1 1 2 0 65535 ECU_ADDRESS 0x0 /end MEASUREMENT
/begin MEASUREMENT GMAIN_u16Cnt30 "GMAIN_u16Cnt30" UWORD I_1 1 2 0 65535 ECU_ADDRESS 0x0 /end MEASUREMENT
/begin MEASUREMENT GMAIN_u16Cnt4 "GMAIN_u16Cnt4" UWORD I_1 1 2 0 65535 ECU_ADDRESS 0x0 /end MEASUREMENT
/begin MEASUREMENT GMAIN_u16Cnt5 "GMAIN_u16Cnt5" UWORD I_1 1 2 0 65535 ECU_ADDRESS 0x0 /end MEASUREMENT
/begin MEASUREMENT GMAIN_u16Cnt50 "GMAIN_u16Cnt50" UWORD I_1 1 2 0 65535 ECU_ADDRESS 0x0 /end MEASUREMENT
/begin MEASUREMENT GMAIN_u16Cnt500 "GMAIN_u16Cnt500" UWORD I_1 1 2 0 65535 ECU_ADDRESS 0x0 /end MEASUREMENT
/begin MEASUREMENT GMAIN_u16FaultDelayCnt "GMAIN_u16FaultDelayCnt" UWORD I_1 1 2 0 65535 ECU_ADDRESS 0x0 /end MEASUREMENT
/begin MEASUREMENT GMAIN_u16FpgaFltClrCnt "GMAIN_u16FpgaFltClrCnt" UWORD I_1 1 2 0 65535 ECU_ADDRESS 0x0 /end MEASUREMENT
/begin MEASUREMENT GMAIN_u16HandBrkRelsDelay "..." UWORD I_1 1 2 0 65535 ECU_ADDRESS 0x0 /end MEASUREMENT
/begin MEASUREMENT GMAIN_u16IdqDeltaSumCnt "GMAIN_u16IdqDeltaSumCnt" UWORD I_1 1 2 0 65535 ECU_ADDRESS 0x0 /end MEASUREMENT
/begin MEASUREMENT GMAIN_u16IuCycleCnt "..." UWORD I_1 1 2 0 65535 ECU_ADDRESS 0x0 /end MEASUREMENT
/begin MEASUREMENT GMAIN_u16IuMiddleCnt "..." UWORD I_1 1 2 0 65535 ECU_ADDRESS 0x0 /end MEASUREMENT
/begin MEASUREMENT GMAIN_u16IuMiddleSum "..." UWORD I_1 1 2 0 65535 ECU_ADDRESS 0x0 /end MEASUREMENT
/begin MEASUREMENT GMAIN_u16IuNegtiveCnt "..." UWORD I_1 1 2 0 65535 ECU_ADDRESS 0x0 /end MEASUREMENT
/begin MEASUREMENT GMAIN_u16IuNegtiveSum "..." UWORD I_1 1 2 0 65535 ECU_ADDRESS 0x0 /end MEASUREMENT
/begin MEASUREMENT GMAIN_u16IuPositiveCnt "..." UWORD I_1 1 2 0 65535 ECU_ADDRESS 0x0 /end MEASUREMENT
/begin MEASUREMENT GMAIN_u16IuPositiveSum "..." UWORD I_1 1 2 0 65535 ECU_ADDRESS 0x0 /end MEASUREMENT
/begin MEASUREMENT GMAIN_u16MotorStallCnt "..." UWORD I_1 1 2 0 65535 ECU_ADDRESS 0x0 /end MEASUREMENT
/begin MEASUREMENT GMAIN_u16OverVolHighDelay "GMAIN_u16OverVolHighDelay" UWORD I_1 1 2 0 65535 ECU_ADDRESS 0x0 /end MEASUREMENT
/begin MEASUREMENT GMAIN_u16OverVolLowDelay "GMAIN_u16OverVolLowDelay" UWORD I_1 1 2 0 65535 ECU_ADDRESS 0x0 /end MEASUREMENT
/begin MEASUREMENT GMAIN_u16OverVolMidDelay "GMAIN_u16OverVolMidDelay" UWORD I_1 1 2 0 65535 ECU_ADDRESS 0x0 /end MEASUREMENT
/begin MEASUREMENT GMAIN_u16PWMPeriodVal "GMAIN_u16PWMPeriodVal" UWORD I_1 1 2 0 65535 ECU_ADDRESS 0x0 /end MEASUREMENT
/begin MEASUREMENT GMAIN_u16RandomNum "GMAIN_u16RandomNum" UWORD I_1 1 2 0 65535 ECU_ADDRESS 0x0 /end MEASUREMENT
/begin MEASUREMENT GMAIN_u16ResCosADVal "GMAIN_u16ResCosADVal" UWORD I_1 1 2 0 65535 ECU_ADDRESS 0x0 /end MEASUREMENT
/begin MEASUREMENT GMAIN_u16ResSinADVal "GMAIN_u16ResSinADVal" UWORD I_1 1 2 0 65535 ECU_ADDRESS 0x0 /end MEASUREMENT
/begin MEASUREMENT GMAIN_u16SlopSlideTimCnt "..." UWORD I_1 1 2 0 65535 ECU_ADDRESS 0x0 /end MEASUREMENT
/begin MEASUREMENT GMAIN_u16SlopSpdConfirmCnt "..." UWORD I_1 1 2 0 65535 ECU_ADDRESS 0x0 /end MEASUREMENT
/begin MEASUREMENT GMAIN_u16SpdReadyEstCnt "..." UWORD I_1 1 2 0 65535 ECU_ADDRESS 0x0 /end MEASUREMENT
/begin MEASUREMENT GMAIN_u16T12CntVal "GMAIN_u16T12CntVal" UWORD I_1 1 2 0 65535 ECU_ADDRESS 0x0 /end MEASUREMENT
/begin MEASUREMENT GMAIN_u16TeachInWrtDelayCnt "GMAIN_u16TeachInWrtDelayCnt" UWORD I_1 1 2 0 65535 ECU_ADDRESS 0x0 /end MEASUREMENT
/begin MEASUREMENT GMAIN_u16VadcBhv "GMAIN_u16VadcBhv" UWORD I_1 1 2 0 65535 ECU_ADDRESS 0x0 /end MEASUREMENT
/begin MEASUREMENT GMAIN_u16VadcPhaseCurU "GMAIN_u16VadcPhaseCurU" UWORD I_1 1 2 0 65535 ECU_ADDRESS 0x0 /end MEASUREMENT
/begin MEASUREMENT GMAIN_u16VadcPhaseCurV "GMAIN_u16VadcPhaseCurV" UWORD I_1 1 2 0 65535 ECU_ADDRESS 0x0 /end MEASUREMENT
/begin MEASUREMENT GMAIN_u16VadcPhaseCurW "GMAIN_u16VadcPhaseCurW" UWORD I_1 1 2 0 65535 ECU_ADDRESS 0x0 /end MEASUREMENT
/begin MEASUREMENT GMAIN_u32BldcDeltTime "..." ULONG F_0v01_p0_12 1 2 0 42949672.95 ECU_ADDRESS 0x0 /end MEASUREMENT
/begin MEASUREMENT GMAIN_u32BldcPattnTreatCnt "..." ULONG I_1 1 2 0 4294967295 ECU_ADDRESS 0x0 /end MEASUREMENT
/begin MEASUREMENT GMAIN_u32BldcPwmTreatCnt "..." ULONG I_1 1 2 0 4294967295 ECU_ADDRESS 0x0 /end MEASUREMENT
/begin MEASUREMENT GMAIN_u32BldcTimStampA "..." ULONG I_1 1 2 0 4294967295 ECU_ADDRESS 0x0 /end MEASUREMENT
/begin MEASUREMENT GMAIN_u32BldcTimStampB "..." ULONG I_1 1 2 0 4294967295 ECU_ADDRESS 0x0 /end MEASUREMENT
/begin MEASUREMENT GMAIN_u32EmailCkreq "..." ULONG I_1 1 2 0 4294967295 ECU_ADDRESS 0x0 /end MEASUREMENT
/begin MEASUREMENT GMAIN_u32EmailPosATimeStamp "..." ULONG I_1 1 2 0 4294967295 ECU_ADDRESS 0x0 /end MEASUREMENT
/begin MEASUREMENT GMAIN_u32IuCycleTim "..." ULONG I_1 1 2 0 4294967295 ECU_ADDRESS 0x0 /end MEASUREMENT
/begin MEASUREMENT GMAIN_u32PosATimeStamp "..." ULONG I_1 1 2 0 4294967295 ECU_ADDRESS 0x0 /end MEASUREMENT
/begin MEASUREMENT GMAIN_u32PosBTimeStamp "..." ULONG I_1 1 2 0 4294967295 ECU_ADDRESS 0x0 /end MEASUREMENT
/begin MEASUREMENT GMAIN_u32PosTreatCkreq "..." ULONG I_1 1 2 0 4294967295 ECU_ADDRESS 0x0 /end MEASUREMENT
/begin MEASUREMENT GMAIN_u32TestVar2 "GMAIN_u32TestVar2" ULONG I_1 1 2 0 4294967295 ECU_ADDRESS 0x0 /end MEASUREMENT
/begin MEASUREMENT GMAIN_u32TestVar4 "GMAIN_u32TestVar4" ULONG I_1 1 2 0 4294967295 ECU_ADDRESS 0x0 /end MEASUREMENT
/begin MEASUREMENT GMAIN_u32WaitValueVSISafeTreatment "Additional wait value for VSISafeTreatment function (debug)" ULONG F_0v055_p0_53 1 2 0 236223201.2 ECU_ADDRESS 0x0 /end MEASUREMENT
/begin MEASUREMENT GMAIN_u32WaitValueVSITreatment "Additional wait value for VSITreatment function (debug)" ULONG F_0v02_p0_54 1 2 0 85899345.9 ECU_ADDRESS 0x0 /end MEASUREMENT
/begin MEASUREMENT GMAIN_u8BldcFaultLevel "GMAIN_u8BldcFaultLevel" UBYTE I_1 1 2 0 255 ECU_ADDRESS 0x0 /end MEASUREMENT
/begin MEASUREMENT GMAIN_u8BldcHallStt "GMAIN_u8BldcHallStt" UBYTE I_1 1 2 0 255 ECU_ADDRESS 0x0 /end MEASUREMENT
/begin MEASUREMENT GMAIN_u8BldcHallSttPre "GMAIN_u8BldcHallSttPre" UBYTE I_1 1 2 0 255 ECU_ADDRESS 0x0 /end MEASUREMENT
/begin MEASUREMENT GMAIN_u8BldcMotDir "GMAIN_u8BldcMotDir" UBYTE I_1 1 2 0 255 ECU_ADDRESS 0x0 /end MEASUREMENT
/begin MEASUREMENT GMAIN_u8ErrCodNum "GMAIN_u8ErrCodNum" UBYTE I_1 1 2 0 255 ECU_ADDRESS 0x0 /end MEASUREMENT
/begin MEASUREMENT GMAIN_u8ErrCodRdIdx "GMAIN_u8ErrCodRdIdx" UBYTE I_1 1 2 0 255 ECU_ADDRESS 0x0 /end MEASUREMENT
/begin MEASUREMENT GMAIN_u8ErrCodWrIdx "GMAIN_u8ErrCodWrIdx" UBYTE I_1 1 2 0 255 ECU_ADDRESS 0x0 /end MEASUREMENT
/begin MEASUREMENT GMAIN_u8FaultSum "..." UBYTE I_1 1 2 0 255 ECU_ADDRESS 0x0 /end MEASUREMENT
/begin MEASUREMENT GMAIN_u8OcState "GMAIN_u8OcState" UBYTE I_1 1 2 0 255 ECU_ADDRESS 0x0 /end MEASUREMENT
/begin MEASUREMENT GMAIN_u8OcStsRptDelayCnt "GMAIN_u8OcStsRptDelayCnt" UBYTE I_1 1 2 0 255 ECU_ADDRESS 0x0 /end MEASUREMENT
/begin MEASUREMENT GMAIN_u8OverVolIndex "GMAIN_u8OverVolIndex" UBYTE I_1 1 2 0 255 ECU_ADDRESS 0x0 /end MEASUREMENT
/begin MEASUREMENT GMAIN_u8PrevGearPos "..." UBYTE I_1 1 2 0 255 ECU_ADDRESS 0x0 /end MEASUREMENT
/begin MEASUREMENT GMAIN_u8TcFaultCodeL3 "GMAIN_u8TcFaultCodeL3" UBYTE I_1 1 2 0 255 ECU_ADDRESS 0x0 /end MEASUREMENT
/begin MEASUREMENT GMAIN_u8TcFaultCodeL5 "GMAIN_u8TcFaultCodeL5" UBYTE I_1 1 2 0 255 ECU_ADDRESS 0x0 /end MEASUREMENT
/begin MEASUREMENT GMAIN_u8TestVar1 "GMAIN_u8TestVar1" UBYTE I_1 1 2 0 255 ECU_ADDRESS 0x0 /end MEASUREMENT
/begin MEASUREMENT GMAIN_u8TrigOcByUser "GMAIN_u8TrigOcByUser" UBYTE I_1 1 2 0 255 ECU_ADDRESS 0x0 /end MEASUREMENT
/begin MEASUREMENT GMAIN_u8UdsSwVerSup "..." UBYTE Id_0x00 1 2 0 255 MATRIX_DIM 21 1 1 ECU_ADDRESS 0x0 /end MEASUREMENT
/begin MEASUREMENT GMAIN_u8UdsSwVerSup[0] "GMAIN_u8UdsSwVerSup[0]" UBYTE Id_0x00 1 2 0 255 ECU_ADDRESS 0x0 /end MEASUREMENT
/begin MEASUREMENT GMAIN_u8UdsSwVerSup[10] "GMAIN_u8UdsSwVerSup[10]" UBYTE Id_0x00 1 2 0 255 ECU_ADDRESS 0x0 /end MEASUREMENT
/begin MEASUREMENT GMAIN_u8UdsSwVerSup[11] "GMAIN_u8UdsSwVerSup[11]" UBYTE Id_0x00 1 2 0 255 ECU_ADDRESS 0x0 /end MEASUREMENT
/begin MEASUREMENT GMAIN_u8UdsSwVerSup[12] "GMAIN_u8UdsSwVerSup[12]" UBYTE Id_0x00 1 2 0 255 ECU_ADDRESS 0x0 /end MEASUREMENT
/begin MEASUREMENT GMAIN_u8UdsSwVerSup[13] "GMAIN_u8UdsSwVerSup[13]" UBYTE Id_0x00 1 2 0 255 ECU_ADDRESS 0x0 /end MEASUREMENT
/begin MEASUREMENT GMAIN_u8UdsSwVerSup[14] "GMAIN_u8UdsSwVerSup[14]" UBYTE Id_0x00 1 2 0 255 ECU_ADDRESS 0x0 /end MEASUREMENT
/begin MEASUREMENT GMAIN_u8UdsSwVerSup[15] "GMAIN_u8UdsSwVerSup[15]" UBYTE Id_0x00 1 2 0 255 ECU_ADDRESS 0x0 /end MEASUREMENT
/begin MEASUREMENT GMAIN_u8UdsSwVerSup[16] "GMAIN_u8UdsSwVerSup[16]" UBYTE Id_0x00 1 2 0 255 ECU_ADDRESS 0x0 /end MEASUREMENT
/begin MEASUREMENT GMAIN_u8UdsSwVerSup[17] "GMAIN_u8UdsSwVerSup[17]" UBYTE Id_0x00 1 2 0 255 ECU_ADDRESS 0x0 /end MEASUREMENT
/begin MEASUREMENT GMAIN_u8UdsSwVerSup[18] "GMAIN_u8UdsSwVerSup[18]" UBYTE Id_0x00 1 2 0 255 ECU_ADDRESS 0x0 /end MEASUREMENT
/begin MEASUREMENT GMAIN_u8UdsSwVerSup[19] "GMAIN_u8UdsSwVerSup[19]" UBYTE Id_0x00 1 2 0 255 ECU_ADDRESS 0x0 /end MEASUREMENT
/begin MEASUREMENT GMAIN_u8UdsSwVerSup[1] "GMAIN_u8UdsSwVerSup[1]" UBYTE Id_0x00 1 2 0 255 ECU_ADDRESS 0x0 /end MEASUREMENT
/begin MEASUREMENT GMAIN_u8UdsSwVerSup[20] "GMAIN_u8UdsSwVerSup[20]" UBYTE Id_0x00 1 2 0 255 ECU_ADDRESS 0x0 /end MEASUREMENT
/begin MEASUREMENT GMAIN_u8UdsSwVerSup[2] "GMAIN_u8UdsSwVerSup[2]" UBYTE Id_0x00 1 2 0 255 ECU_ADDRESS 0x0 /end MEASUREMENT
/begin MEASUREMENT GMAIN_u8UdsSwVerSup[3] "GMAIN_u8UdsSwVerSup[3]" UBYTE Id_0x00 1 2 0 255 ECU_ADDRESS 0x0 /end MEASUREMENT
/begin MEASUREMENT GMAIN_u8UdsSwVerSup[4] "GMAIN_u8UdsSwVerSup[4]" UBYTE Id_0x00 1 2 0 255 ECU_ADDRESS 0x0 /end MEASUREMENT
/begin MEASUREMENT GMAIN_u8UdsSwVerSup[5] "GMAIN_u8UdsSwVerSup[5]" UBYTE Id_0x00 1 2 0 255 ECU_ADDRESS 0x0 /end MEASUREMENT
/begin MEASUREMENT GMAIN_u8UdsSwVerSup[6] "GMAIN_u8UdsSwVerSup[6]" UBYTE Id_0x00 1 2 0 255 ECU_ADDRESS 0x0 /end MEASUREMENT
/begin MEASUREMENT GMAIN_u8UdsSwVerSup[7] "GMAIN_u8UdsSwVerSup[7]" UBYTE Id_0x00 1 2 0 255 ECU_ADDRESS 0x0 /end MEASUREMENT
/begin MEASUREMENT GMAIN_u8UdsSwVerSup[8] "GMAIN_u8UdsSwVerSup[8]" UBYTE Id_0x00 1 2 0 255 ECU_ADDRESS 0x0 /end MEASUREMENT
/begin MEASUREMENT GMAIN_u8UdsSwVerSup[9] "GMAIN_u8UdsSwVerSup[9]" UBYTE Id_0x00 1 2 0 255 ECU_ADDRESS 0x0 /end MEASUREMENT
/begin MEASUREMENT GMAIN_u8UdsSwVerVeh "..." UBYTE Id_0x00 1 2 0 255 MATRIX_DIM 13 1 1 ECU_ADDRESS 0x0 /end MEASUREMENT
/begin MEASUREMENT GMAIN_u8UdsSwVerVeh[0] "GMAIN_u8UdsSwVerVeh[0]" UBYTE Id_0x00 1 2 0 255 ECU_ADDRESS 0x0 /end MEASUREMENT
/begin MEASUREMENT GMAIN_u8UdsSwVerVeh[10] "GMAIN_u8UdsSwVerVeh[10]" UBYTE Id_0x00 1 2 0 255 ECU_ADDRESS 0x0 /end MEASUREMENT
/begin MEASUREMENT GMAIN_u8UdsSwVerVeh[11] "GMAIN_u8UdsSwVerVeh[11]" UBYTE Id_0x00 1 2 0 255 ECU_ADDRESS 0x0 /end MEASUREMENT
/begin MEASUREMENT GMAIN_u8UdsSwVerVeh[12] "GMAIN_u8UdsSwVerVeh[12]" UBYTE Id_0x00 1 2 0 255 ECU_ADDRESS 0x0 /end MEASUREMENT
/begin MEASUREMENT GMAIN_u8UdsSwVerVeh[1] "GMAIN_u8UdsSwVerVeh[1]" UBYTE Id_0x00 1 2 0 255 ECU_ADDRESS 0x0 /end MEASUREMENT
/begin MEASUREMENT GMAIN_u8UdsSwVerVeh[2] "GMAIN_u8UdsSwVerVeh[2]" UBYTE Id_0x00 1 2 0 255 ECU_ADDRESS 0x0 /end MEASUREMENT
/begin MEASUREMENT GMAIN_u8UdsSwVerVeh[3] "GMAIN_u8UdsSwVerVeh[3]" UBYTE Id_0x00 1 2 0 255 ECU_ADDRESS 0x0 /end MEASUREMENT
/begin MEASUREMENT GMAIN_u8UdsSwVerVeh[4] "GMAIN_u8UdsSwVerVeh[4]" UBYTE Id_0x00 1 2 0 255 ECU_ADDRESS 0x0 /end MEASUREMENT
/begin MEASUREMENT GMAIN_u8UdsSwVerVeh[5] "GMAIN_u8UdsSwVerVeh[5]" UBYTE Id_0x00 1 2 0 255 ECU_ADDRESS 0x0 /end MEASUREMENT
/begin MEASUREMENT GMAIN_u8UdsSwVerVeh[6] "GMAIN_u8UdsSwVerVeh[6]" UBYTE Id_0x00 1 2 0 255 ECU_ADDRESS 0x0 /end MEASUREMENT
/begin MEASUREMENT GMAIN_u8UdsSwVerVeh[7] "GMAIN_u8UdsSwVerVeh[7]" UBYTE Id_0x00 1 2 0 255 ECU_ADDRESS 0x0 /end MEASUREMENT
/begin MEASUREMENT GMAIN_u8UdsSwVerVeh[8] "GMAIN_u8UdsSwVerVeh[8]" UBYTE Id_0x00 1 2 0 255 ECU_ADDRESS 0x0 /end MEASUREMENT
/begin MEASUREMENT GMAIN_u8UdsSwVerVeh[9] "GMAIN_u8UdsSwVerVeh[9]" UBYTE Id_0x00 1 2 0 255 ECU_ADDRESS 0x0 /end MEASUREMENT
/begin MEASUREMENT GOs_Task_BackGround_Counter "..." ULONG I_1 1 2 0 4294967295 ECU_ADDRESS 0x0 /end MEASUREMENT
/begin MEASUREMENT GOs_Task_Idle_Counter "..." ULONG I_1 1 2 0 4294967295 ECU_ADDRESS 0x0 /end MEASUREMENT
/begin MEASUREMENT HARD_bDioWriteTestEna "HARD activation" UBYTE Bool_ON_OFF 1 2 0 1 BIT_MASK 0x01 ECU_ADDRESS 0x0 /end MEASUREMENT
/begin MEASUREMENT MAIN_ESMGo2StartupIEvent "Evï¿½nement pour rï¿½initialiser lautomate ESM" UBYTE Bool_ON_OFF 1 2 0 1 BIT_MASK 0x01 ECU_ADDRESS 0x0 /end MEASUREMENT
/begin MEASUREMENT MAIN_MSGbBMS_MotorPowerOnFinishSig "MAIN_MSGbBMS_MotorPowerOnFinishSig" UBYTE Bool_ON_OFF 1 2 0 1 BIT_MASK 0x01 ECU_ADDRESS 0x0 /end MEASUREMENT
/begin MEASUREMENT MAIN_MSGbCCP_DrvOverCurrent "BSW Power on check finish flag." UBYTE Bool_ON_OFF 1 2 0 1 BIT_MASK 0x01 ECU_ADDRESS 0x0 /end MEASUREMENT
/begin MEASUREMENT MAIN_MSGbCCP_DrvOverTemp "BSW Power on check finish flag." UBYTE Bool_ON_OFF 1 2 0 1 BIT_MASK 0x01 ECU_ADDRESS 0x0 /end MEASUREMENT
/begin MEASUREMENT MAIN_MSGbCCP_DrvOverVoltage "BSW Power on check finish flag." UBYTE Bool_ON_OFF 1 2 0 1 BIT_MASK 0x01 ECU_ADDRESS 0x0 /end MEASUREMENT
/begin MEASUREMENT MAIN_MSGbCCP_DrvUnderVoltage "BSW Power on check finish flag." UBYTE Bool_ON_OFF 1 2 0 1 BIT_MASK 0x01 ECU_ADDRESS 0x0 /end MEASUREMENT
/begin MEASUREMENT MAIN_MSGbCCP_FetShorted "BSW Power on check finish flag." UBYTE Bool_ON_OFF 1 2 0 1 BIT_MASK 0x01 ECU_ADDRESS 0x0 /end MEASUREMENT
/begin MEASUREMENT MAIN_MSGbCCP_HALFault "BSW Power on check finish flag." UBYTE Bool_ON_OFF 1 2 0 1 BIT_MASK 0x01 ECU_ADDRESS 0x0 /end MEASUREMENT
/begin MEASUREMENT MAIN_MSGbCCP_HALOrderInvalid "BSW Power on check finish flag." UBYTE Bool_ON_OFF 1 2 0 1 BIT_MASK 0x01 ECU_ADDRESS 0x0 /end MEASUREMENT
/begin MEASUREMENT MAIN_MSGbCCP_HALOverVolt "BSW Power on check finish flag." UBYTE Bool_ON_OFF 1 2 0 1 BIT_MASK 0x01 ECU_ADDRESS 0x0 /end MEASUREMENT
/begin MEASUREMENT MAIN_MSGbCCP_HALUndefined "BSW Power on check finish flag." UBYTE Bool_ON_OFF 1 2 0 1 BIT_MASK 0x01 ECU_ADDRESS 0x0 /end MEASUREMENT
/begin MEASUREMENT MAIN_MSGbCCP_HALUnderVolt "BSW Power on check finish flag." UBYTE Bool_ON_OFF 1 2 0 1 BIT_MASK 0x01 ECU_ADDRESS 0x0 /end MEASUREMENT
/begin MEASUREMENT MAIN_MSGbCCP_HwOverCurrent "BSW Power on check finish flag." UBYTE Bool_ON_OFF 1 2 0 1 BIT_MASK 0x01 ECU_ADDRESS 0x0 /end MEASUREMENT
/begin MEASUREMENT MAIN_MSGbCCP_PhasePerf "BSW Power on check finish flag." UBYTE Bool_ON_OFF 1 2 0 1 BIT_MASK 0x01 ECU_ADDRESS 0x0 /end MEASUREMENT
/begin MEASUREMENT MAIN_MSGbCCP_PhaseShortHigh "BSW Power on check finish flag." UBYTE Bool_ON_OFF 1 2 0 1 BIT_MASK 0x01 ECU_ADDRESS 0x0 /end MEASUREMENT
/begin MEASUREMENT MAIN_MSGbCCP_PhaseShortLow "BSW Power on check finish flag." UBYTE Bool_ON_OFF 1 2 0 1 BIT_MASK 0x01 ECU_ADDRESS 0x0 /end MEASUREMENT
/begin MEASUREMENT MAIN_MSGbCCP_PhaseVoltHigh "BSW Power on check finish flag." UBYTE Bool_ON_OFF 1 2 0 1 BIT_MASK 0x01 ECU_ADDRESS 0x0 /end MEASUREMENT
/begin MEASUREMENT MAIN_MSGbCCP_StuckFlag "BSW Power on check finish flag." UBYTE Bool_ON_OFF 1 2 0 1 BIT_MASK 0x01 ECU_ADDRESS 0x0 /end MEASUREMENT
/begin MEASUREMENT MAIN_MSGbCCP_SwOverCurrent "BSW Power on check finish flag." UBYTE Bool_ON_OFF 1 2 0 1 BIT_MASK 0x01 ECU_ADDRESS 0x0 /end MEASUREMENT
/begin MEASUREMENT MAIN_MSGbCCP_ThermalShutDown "BSW Power on check finish flag." UBYTE Bool_ON_OFF 1 2 0 1 BIT_MASK 0x01 ECU_ADDRESS 0x0 /end MEASUREMENT
/begin MEASUREMENT MAIN_MSGbEMS_DrivingCycle "MAIN_MSGbEMS_DrivingCycle" UBYTE Bool_ON_OFF 1 2 0 1 BIT_MASK 0x01 ECU_ADDRESS 0x0 /end MEASUREMENT
/begin MEASUREMENT MAIN_MSGbEMS_EngSpdSignalFailure "MAIN_MSGbEMS_EngSpdSignalFailure" UBYTE Bool_ON_OFF 1 2 0 1 BIT_MASK 0x01 ECU_ADDRESS 0x0 /end MEASUREMENT
/begin MEASUREMENT MAIN_MSGbEMS_EngineCoolantTempValid "MAIN_MSGbEMS_EngineCoolantTempValid" UBYTE Bool_ON_OFF 1 2 0 1 BIT_MASK 0x01 ECU_ADDRESS 0x0 /end MEASUREMENT
/begin MEASUREMENT MAIN_MSGbEMS_OBDDenoGenValid "MAIN_MSGbEMS_OBDDenoGenValid" UBYTE Bool_ON_OFF 1 2 0 1 BIT_MASK 0x01 ECU_ADDRESS 0x0 /end MEASUREMENT
/begin MEASUREMENT MAIN_MSGbEMS_OBDDenoGeneral "MAIN_MSGbEMS_OBDDenoGeneral" UBYTE Bool_ON_OFF 1 2 0 1 BIT_MASK 0x01 ECU_ADDRESS 0x0 /end MEASUREMENT
/begin MEASUREMENT MAIN_MSGbEMS_OBDDenoSpecValid "MAIN_MSGbEMS_OBDDenoSpecValid" UBYTE Bool_ON_OFF 1 2 0 1 BIT_MASK 0x01 ECU_ADDRESS 0x0 /end MEASUREMENT
/begin MEASUREMENT MAIN_MSGbEMS_OBDDenoSpecial "MAIN_MSGbEMS_OBDDenoSpecial" UBYTE Bool_ON_OFF 1 2 0 1 BIT_MASK 0x01 ECU_ADDRESS 0x0 /end MEASUREMENT
/begin MEASUREMENT MAIN_MSGbEMS_OBDFaultClrInhi "MAIN_MSGbEMS_OBDFaultClrInhi" UBYTE Bool_ON_OFF 1 2 0 1 BIT_MASK 0x01 ECU_ADDRESS 0x0 /end MEASUREMENT
/begin MEASUREMENT MAIN_MSGbEMS_OBDPDTCClrSt "MAIN_MSGbEMS_OBDPDTCClrSt" UBYTE Bool_ON_OFF 1 2 0 1 BIT_MASK 0x01 ECU_ADDRESS 0x0 /end MEASUREMENT
/begin MEASUREMENT MAIN_MSGbEMS_WarmUpCycle "MAIN_MSGbEMS_WarmUpCycle" UBYTE Bool_ON_OFF 1 2 0 1 BIT_MASK 0x01 ECU_ADDRESS 0x0 /end MEASUREMENT
/begin MEASUREMENT MAIN_MSGbFMCU1_ActTrqValid "BSW Power on check finish flag." UBYTE Bool_ON_OFF 1 2 0 1 BIT_MASK 0x01 ECU_ADDRESS 0x0 /end MEASUREMENT
/begin MEASUREMENT MAIN_MSGbFMCU2_DischrgAllowed "BSW Power on check finish flag." UBYTE Bool_ON_OFF 1 2 0 1 BIT_MASK 0x01 ECU_ADDRESS 0x0 /end MEASUREMENT
/begin MEASUREMENT MAIN_MSGbGCU_12V_VoltFault "MAIN_MSGbGCU_12V_VoltFault" UBYTE Bool_ON_OFF 1 2 0 1 BIT_MASK 0x01 ECU_ADDRESS 0x0 /end MEASUREMENT
/begin MEASUREMENT MAIN_MSGbGCU_ActiveDischrgFault "MAIN_MSGbGCU_ActiveDischrgFault" UBYTE Bool_ON_OFF 1 2 0 1 BIT_MASK 0x01 ECU_ADDRESS 0x0 /end MEASUREMENT
/begin MEASUREMENT MAIN_MSGbGCU_Aftermastercmd "MAIN_MSGbGCU_Aftermastercmd" UBYTE Bool_ON_OFF 1 2 0 1 BIT_MASK 0x01 ECU_ADDRESS 0x0 /end MEASUREMENT
/begin MEASUREMENT MAIN_MSGbGCU_Busoff "MAIN_MSGbGCU_Busoff" UBYTE Bool_ON_OFF 1 2 0 1 BIT_MASK 0x01 ECU_ADDRESS 0x0 /end MEASUREMENT
/begin MEASUREMENT MAIN_MSGbGCU_CAN_LostFrames "MAIN_MSGbGCU_CAN_LostFrames" UBYTE Bool_ON_OFF 1 2 0 1 BIT_MASK 0x01 ECU_ADDRESS 0x0 /end MEASUREMENT
/begin MEASUREMENT MAIN_MSGbGCU_HVConnectionAllowed "MAIN_MSGbGCU_HVConnectionAllowed" UBYTE Bool_ON_OFF 1 2 0 1 BIT_MASK 0x01 ECU_ADDRESS 0x0 /end MEASUREMENT
/begin MEASUREMENT MAIN_MSGbGCU_IGBT_HighTempPwrLim "MAIN_MSGbGCU_IGBT_HighTempPwrLim" UBYTE Bool_ON_OFF 1 2 0 1 BIT_MASK 0x01 ECU_ADDRESS 0x0 /end MEASUREMENT
/begin MEASUREMENT MAIN_MSGbGCU_IGBT_ModuleFault "MAIN_MSGbGCU_IGBT_ModuleFault" UBYTE Bool_ON_OFF 1 2 0 1 BIT_MASK 0x01 ECU_ADDRESS 0x0 /end MEASUREMENT
/begin MEASUREMENT MAIN_MSGbGCU_IGBT_Overheating "MAIN_MSGbGCU_IGBT_Overheating" UBYTE Bool_ON_OFF 1 2 0 1 BIT_MASK 0x01 ECU_ADDRESS 0x0 /end MEASUREMENT
/begin MEASUREMENT MAIN_MSGbGCU_MCUTempSnsrDiscnct "MAIN_MSGbGCU_MCUTempSnsrDiscnct" UBYTE Bool_ON_OFF 1 2 0 1 BIT_MASK 0x01 ECU_ADDRESS 0x0 /end MEASUREMENT
/begin MEASUREMENT MAIN_MSGbGCU_MCUTempSnsrShortCircuit "MAIN_MSGbGCU_MCUTempSnsrShortCircuit" UBYTE Bool_ON_OFF 1 2 0 1 BIT_MASK 0x01 ECU_ADDRESS 0x0 /end MEASUREMENT
/begin MEASUREMENT MAIN_MSGbGCU_MCU_HardwOverCurrent "MAIN_MSGbGCU_MCU_HardwOverCurrent" UBYTE Bool_ON_OFF 1 2 0 1 BIT_MASK 0x01 ECU_ADDRESS 0x0 /end MEASUREMENT
/begin MEASUREMENT MAIN_MSGbGCU_ModeCmdFault "MAIN_MSGbGCU_ModeCmdFault" UBYTE Bool_ON_OFF 1 2 0 1 BIT_MASK 0x01 ECU_ADDRESS 0x0 /end MEASUREMENT
/begin MEASUREMENT MAIN_MSGbGCU_MotorHighTempPwrLim "MAIN_MSGbGCU_MotorHighTempPwrLim" UBYTE Bool_ON_OFF 1 2 0 1 BIT_MASK 0x01 ECU_ADDRESS 0x0 /end MEASUREMENT
/begin MEASUREMENT MAIN_MSGbGCU_MotorOverSpdNeg "MAIN_MSGbGCU_MotorOverSpdNeg" UBYTE Bool_ON_OFF 1 2 0 1 BIT_MASK 0x01 ECU_ADDRESS 0x0 /end MEASUREMENT
/begin MEASUREMENT MAIN_MSGbGCU_MotorOverSpdPosi "MAIN_MSGbGCU_MotorOverSpdPosi" UBYTE Bool_ON_OFF 1 2 0 1 BIT_MASK 0x01 ECU_ADDRESS 0x0 /end MEASUREMENT
/begin MEASUREMENT MAIN_MSGbGCU_MotorOverSpd_NegPwrLim "MAIN_MSGbGCU_MotorOverSpd_NegPwrLim" UBYTE Bool_ON_OFF 1 2 0 1 BIT_MASK 0x01 ECU_ADDRESS 0x0 /end MEASUREMENT
/begin MEASUREMENT MAIN_MSGbGCU_MotorOverSpd_PosiPwrLim "MAIN_MSGbGCU_MotorOverSpd_PosiPwrLim" UBYTE Bool_ON_OFF 1 2 0 1 BIT_MASK 0x01 ECU_ADDRESS 0x0 /end MEASUREMENT
/begin MEASUREMENT MAIN_MSGbGCU_MotorTempSnsrDiscnct "MAIN_MSGbGCU_MotorTempSnsrDiscnct" UBYTE Bool_ON_OFF 1 2 0 1 BIT_MASK 0x01 ECU_ADDRESS 0x0 /end MEASUREMENT
/begin MEASUREMENT MAIN_MSGbGCU_MotorTempSnsrShortCircuit "MAIN_MSGbGCU_MotorTempSnsrShortCircuit" UBYTE Bool_ON_OFF 1 2 0 1 BIT_MASK 0x01 ECU_ADDRESS 0x0 /end MEASUREMENT
/begin MEASUREMENT MAIN_MSGbGCU_Motor_Overheating "MAIN_MSGbGCU_Motor_Overheating" UBYTE Bool_ON_OFF 1 2 0 1 BIT_MASK 0x01 ECU_ADDRESS 0x0 /end MEASUREMENT
/begin MEASUREMENT MAIN_MSGbGCU_PDCU_CmdFault "MAIN_MSGbGCU_PDCU_CmdFault" UBYTE Bool_ON_OFF 1 2 0 1 BIT_MASK 0x01 ECU_ADDRESS 0x0 /end MEASUREMENT
/begin MEASUREMENT MAIN_MSGbGCU_RotatExcitationFault "MAIN_MSGbGCU_RotatExcitationFault" UBYTE Bool_ON_OFF 1 2 0 1 BIT_MASK 0x01 ECU_ADDRESS 0x0 /end MEASUREMENT
/begin MEASUREMENT MAIN_MSGbGCU_RotatSigGCU_ault "MAIN_MSGbGCU_RotatSigGCU_ault" UBYTE Bool_ON_OFF 1 2 0 1 BIT_MASK 0x01 ECU_ADDRESS 0x0 /end MEASUREMENT
/begin MEASUREMENT MAIN_MSGbGCU_U_OverCurrent "MAIN_MSGbGCU_U_OverCurrent" UBYTE Bool_ON_OFF 1 2 0 1 BIT_MASK 0x01 ECU_ADDRESS 0x0 /end MEASUREMENT
/begin MEASUREMENT MAIN_MSGbGCU_V_OverCurrent "MAIN_MSGbGCU_V_OverCurrent" UBYTE Bool_ON_OFF 1 2 0 1 BIT_MASK 0x01 ECU_ADDRESS 0x0 /end MEASUREMENT
/begin MEASUREMENT MAIN_MSGbGCU_VoltBelowAllwLowPwrLim "MAIN_MSGbGCU_VoltBelowAllwLowPwrLim" UBYTE Bool_ON_OFF 1 2 0 1 BIT_MASK 0x01 ECU_ADDRESS 0x0 /end MEASUREMENT
/begin MEASUREMENT MAIN_MSGbGCU_VoltBelowAllwLowerLim "MAIN_MSGbGCU_VoltBelowAllwLowerLim" UBYTE Bool_ON_OFF 1 2 0 1 BIT_MASK 0x01 ECU_ADDRESS 0x0 /end MEASUREMENT
/begin MEASUREMENT MAIN_MSGbGCU_VoltExceedAllwUpPwrLim "MAIN_MSGbGCU_VoltExceedAllwUpPwrLim" UBYTE Bool_ON_OFF 1 2 0 1 BIT_MASK 0x01 ECU_ADDRESS 0x0 /end MEASUREMENT
/begin MEASUREMENT MAIN_MSGbGCU_VoltExceedAllwUpperLim "MAIN_MSGbGCU_VoltExceedAllwUpperLim" UBYTE Bool_ON_OFF 1 2 0 1 BIT_MASK 0x01 ECU_ADDRESS 0x0 /end MEASUREMENT
/begin MEASUREMENT MAIN_MSGbGCU_W_OverCurrent "MAIN_MSGbGCU_W_OverCurrent" UBYTE Bool_ON_OFF 1 2 0 1 BIT_MASK 0x01 ECU_ADDRESS 0x0 /end MEASUREMENT
/begin MEASUREMENT MAIN_MSGbGW_ESC_FLWHeelSpdFault "MAIN_MSGbGW_ESC_FLWHeelSpdFault" UBYTE Bool_ON_OFF 1 2 0 1 BIT_MASK 0x01 ECU_ADDRESS 0x0 /end MEASUREMENT
/begin MEASUREMENT MAIN_MSGbGW_ESC_FRWHeelSpdFault "MAIN_MSGbGW_ESC_FRWHeelSpdFault" UBYTE Bool_ON_OFF 1 2 0 1 BIT_MASK 0x01 ECU_ADDRESS 0x0 /end MEASUREMENT
/begin MEASUREMENT MAIN_MSGbGW_ESC_RLWHeelSpdFault "MAIN_MSGbGW_ESC_RLWHeelSpdFault" UBYTE Bool_ON_OFF 1 2 0 1 BIT_MASK 0x01 ECU_ADDRESS 0x0 /end MEASUREMENT
/begin MEASUREMENT MAIN_MSGbGW_ESC_RRWHeelSpdFault "MAIN_MSGbGW_ESC_RRWHeelSpdFault" UBYTE Bool_ON_OFF 1 2 0 1 BIT_MASK 0x01 ECU_ADDRESS 0x0 /end MEASUREMENT
/begin MEASUREMENT MAIN_MSGbGW_ESC_VehSpdValidFlag "MAIN_MSGbGW_ESC_VehSpdValidFlag" UBYTE Bool_ON_OFF 1 2 0 1 BIT_MASK 0x01 ECU_ADDRESS 0x0 /end MEASUREMENT
/begin MEASUREMENT MAIN_MSGbHTCU_ATFailure "MAIN_MSGbHTCU_ATFailure" UBYTE Bool_ON_OFF 1 2 0 1 BIT_MASK 0x01 ECU_ADDRESS 0x0 /end MEASUREMENT
/begin MEASUREMENT MAIN_MSGbHTCU_EngineStopStartAllowed "MAIN_MSGbHTCU_EngineStopStartAllowed" UBYTE Bool_ON_OFF 1 2 0 1 BIT_MASK 0x01 ECU_ADDRESS 0x0 /end MEASUREMENT
/begin MEASUREMENT MAIN_MSGbHTCU_EngineStopStartRequest "MAIN_MSGbHTCU_EngineStopStartRequest" UBYTE Bool_ON_OFF 1 2 0 1 BIT_MASK 0x01 ECU_ADDRESS 0x0 /end MEASUREMENT
/begin MEASUREMENT MAIN_MSGbHTCU_ShiftDrumTeachinInProgs "MAIN_MSGbHTCU_ShiftDrumTeachinInProgs" UBYTE Bool_ON_OFF 1 2 0 1 BIT_MASK 0x01 ECU_ADDRESS 0x0 /end MEASUREMENT
/begin MEASUREMENT MAIN_MSGbHTCU_ShiftDrumTeachinReq "MAIN_MSGbHTCU_ShiftDrumTeachinReq" UBYTE Bool_ON_OFF 1 2 0 1 BIT_MASK 0x01 ECU_ADDRESS 0x0 /end MEASUREMENT
/begin MEASUREMENT MAIN_MSGbHTCU_SlaveRequestAfterrun "MAIN_MSGbHTCU_SlaveRequestAfterrun" UBYTE Bool_ON_OFF 1 2 0 1 BIT_MASK 0x01 ECU_ADDRESS 0x0 /end MEASUREMENT
/begin MEASUREMENT MAIN_MSGbHTCU_TorqueLimitationFlag "MAIN_MSGbHTCU_TorqueLimitationFlag" UBYTE Bool_ON_OFF 1 2 0 1 BIT_MASK 0x01 ECU_ADDRESS 0x0 /end MEASUREMENT
/begin MEASUREMENT MAIN_MSGbHTCU_TransmissionMILReq "MAIN_MSGbHTCU_TransmissionMILReq" UBYTE Bool_ON_OFF 1 2 0 1 BIT_MASK 0x01 ECU_ADDRESS 0x0 /end MEASUREMENT
/begin MEASUREMENT MAIN_MSGbMCU_12V_VoltFault "MAIN_MSGbMCU_12V_VoltFault" UBYTE Bool_ON_OFF 1 2 0 1 BIT_MASK 0x01 ECU_ADDRESS 0x0 /end MEASUREMENT
/begin MEASUREMENT MAIN_MSGbMCU_ActiveDischrgFault "MAIN_MSGbMCU_ActiveDischrgFault" UBYTE Bool_ON_OFF 1 2 0 1 BIT_MASK 0x01 ECU_ADDRESS 0x0 /end MEASUREMENT
/begin MEASUREMENT MAIN_MSGbMCU_Busoff "MAIN_MSGbMCU_Busoff" UBYTE Bool_ON_OFF 1 2 0 1 BIT_MASK 0x01 ECU_ADDRESS 0x0 /end MEASUREMENT
/begin MEASUREMENT MAIN_MSGbMCU_CAN_LostFrames "MAIN_MSGbMCU_CAN_LostFrames" UBYTE Bool_ON_OFF 1 2 0 1 BIT_MASK 0x01 ECU_ADDRESS 0x0 /end MEASUREMENT
/begin MEASUREMENT MAIN_MSGbMCU_EngineAuthResultResp "MAIN_MSGbMCU_EngineAuthResultResp" UBYTE Bool_ON_OFF 1 2 0 1 BIT_MASK 0x01 ECU_ADDRESS 0x0 /end MEASUREMENT
/begin MEASUREMENT MAIN_MSGbMCU_HighVoltConnectionAllowed "MAIN_MSGbMCU_HighVoltConnectionAllowed" UBYTE Bool_ON_OFF 1 2 0 1 BIT_MASK 0x01 ECU_ADDRESS 0x0 /end MEASUREMENT
/begin MEASUREMENT MAIN_MSGbMCU_IGBT_HighTempPwrLim "MAIN_MSGbMCU_IGBT_HighTempPwrLim" UBYTE Bool_ON_OFF 1 2 0 1 BIT_MASK 0x01 ECU_ADDRESS 0x0 /end MEASUREMENT
/begin MEASUREMENT MAIN_MSGbMCU_IGBT_ModuleFault "MAIN_MSGbMCU_IGBT_ModuleFault" UBYTE Bool_ON_OFF 1 2 0 1 BIT_MASK 0x01 ECU_ADDRESS 0x0 /end MEASUREMENT
/begin MEASUREMENT MAIN_MSGbMCU_IGBT_Overheating "MAIN_MSGbMCU_IGBT_Overheating" UBYTE Bool_ON_OFF 1 2 0 1 BIT_MASK 0x01 ECU_ADDRESS 0x0 /end MEASUREMENT
/begin MEASUREMENT MAIN_MSGbMCU_MCUTempSnsrDiscnct "MAIN_MSGbMCU_MCUTempSnsrDiscnct" UBYTE Bool_ON_OFF 1 2 0 1 BIT_MASK 0x01 ECU_ADDRESS 0x0 /end MEASUREMENT
/begin MEASUREMENT MAIN_MSGbMCU_MCUTempSnsrShortCircuit "MAIN_MSGbMCU_MCUTempSnsrShortCircuit" UBYTE Bool_ON_OFF 1 2 0 1 BIT_MASK 0x01 ECU_ADDRESS 0x0 /end MEASUREMENT
/begin MEASUREMENT MAIN_MSGbMCU_MCU_HardwOverCurrent "MAIN_MSGbMCU_MCU_HardwOverCurrent" UBYTE Bool_ON_OFF 1 2 0 1 BIT_MASK 0x01 ECU_ADDRESS 0x0 /end MEASUREMENT
/begin MEASUREMENT MAIN_MSGbMCU_ModeCmdFault "MAIN_MSGbMCU_ModeCmdFault" UBYTE Bool_ON_OFF 1 2 0 1 BIT_MASK 0x01 ECU_ADDRESS 0x0 /end MEASUREMENT
/begin MEASUREMENT MAIN_MSGbMCU_MotorHighTempPwrLim "MAIN_MSGbMCU_MotorHighTempPwrLim" UBYTE Bool_ON_OFF 1 2 0 1 BIT_MASK 0x01 ECU_ADDRESS 0x0 /end MEASUREMENT
/begin MEASUREMENT MAIN_MSGbMCU_MotorOverSpdNeg "MAIN_MSGbMCU_MotorOverSpdNeg" UBYTE Bool_ON_OFF 1 2 0 1 BIT_MASK 0x01 ECU_ADDRESS 0x0 /end MEASUREMENT
/begin MEASUREMENT MAIN_MSGbMCU_MotorOverSpdPosi "MAIN_MSGbMCU_MotorOverSpdPosi" UBYTE Bool_ON_OFF 1 2 0 1 BIT_MASK 0x01 ECU_ADDRESS 0x0 /end MEASUREMENT
/begin MEASUREMENT MAIN_MSGbMCU_MotorOverSpd_NegPwrLim "MAIN_MSGbMCU_MotorOverSpd_NegPwrLim" UBYTE Bool_ON_OFF 1 2 0 1 BIT_MASK 0x01 ECU_ADDRESS 0x0 /end MEASUREMENT
/begin MEASUREMENT MAIN_MSGbMCU_MotorOverSpd_PosiPwrLim "MAIN_MSGbMCU_MotorOverSpd_PosiPwrLim" UBYTE Bool_ON_OFF 1 2 0 1 BIT_MASK 0x01 ECU_ADDRESS 0x0 /end MEASUREMENT
/begin MEASUREMENT MAIN_MSGbMCU_MotorTempSnsrDiscnct "MAIN_MSGbMCU_MotorTempSnsrDiscnct" UBYTE Bool_ON_OFF 1 2 0 1 BIT_MASK 0x01 ECU_ADDRESS 0x0 /end MEASUREMENT
/begin MEASUREMENT MAIN_MSGbMCU_MotorTempSnsrShortCircuit "MAIN_MSGbMCU_MotorTempSnsrShortCircuit" UBYTE Bool_ON_OFF 1 2 0 1 BIT_MASK 0x01 ECU_ADDRESS 0x0 /end MEASUREMENT
/begin MEASUREMENT MAIN_MSGbMCU_Motor_Overheating "MAIN_MSGbMCU_Motor_Overheating" UBYTE Bool_ON_OFF 1 2 0 1 BIT_MASK 0x01 ECU_ADDRESS 0x0 /end MEASUREMENT
/begin MEASUREMENT MAIN_MSGbMCU_PDCU_CmdFault "MAIN_MSGbMCU_PDCU_CmdFault" UBYTE Bool_ON_OFF 1 2 0 1 BIT_MASK 0x01 ECU_ADDRESS 0x0 /end MEASUREMENT
/begin MEASUREMENT MAIN_MSGbMCU_RotatExcitationFault "MAIN_MSGbMCU_RotatExcitationFault" UBYTE Bool_ON_OFF 1 2 0 1 BIT_MASK 0x01 ECU_ADDRESS 0x0 /end MEASUREMENT
/begin MEASUREMENT MAIN_MSGbMCU_RotatSigMCU_ault "MAIN_MSGbMCU_RotatSigMCU_ault" UBYTE Bool_ON_OFF 1 2 0 1 BIT_MASK 0x01 ECU_ADDRESS 0x0 /end MEASUREMENT
/begin MEASUREMENT MAIN_MSGbMCU_U_OverCurrent "MAIN_MSGbMCU_U_OverCurrent" UBYTE Bool_ON_OFF 1 2 0 1 BIT_MASK 0x01 ECU_ADDRESS 0x0 /end MEASUREMENT
/begin MEASUREMENT MAIN_MSGbMCU_V_OverCurrent "MAIN_MSGbMCU_V_OverCurrent" UBYTE Bool_ON_OFF 1 2 0 1 BIT_MASK 0x01 ECU_ADDRESS 0x0 /end MEASUREMENT
/begin MEASUREMENT MAIN_MSGbMCU_VoltBelowAllwLowPwrLim "MAIN_MSGbMCU_VoltBelowAllwLowPwrLim" UBYTE Bool_ON_OFF 1 2 0 1 BIT_MASK 0x01 ECU_ADDRESS 0x0 /end MEASUREMENT
/begin MEASUREMENT MAIN_MSGbMCU_VoltBelowAllwLowerLim "MAIN_MSGbMCU_VoltBelowAllwLowerLim" UBYTE Bool_ON_OFF 1 2 0 1 BIT_MASK 0x01 ECU_ADDRESS 0x0 /end MEASUREMENT
/begin MEASUREMENT MAIN_MSGbMCU_VoltExceedAllwUpPwrLim "MAIN_MSGbMCU_VoltExceedAllwUpPwrLim" UBYTE Bool_ON_OFF 1 2 0 1 BIT_MASK 0x01 ECU_ADDRESS 0x0 /end MEASUREMENT
/begin MEASUREMENT MAIN_MSGbMCU_VoltExceedAllwUpperLim "MAIN_MSGbMCU_VoltExceedAllwUpperLim" UBYTE Bool_ON_OFF 1 2 0 1 BIT_MASK 0x01 ECU_ADDRESS 0x0 /end MEASUREMENT
/begin MEASUREMENT MAIN_MSGbMCU_W_OverCurrent "MAIN_MSGbMCU_W_OverCurrent" UBYTE Bool_ON_OFF 1 2 0 1 BIT_MASK 0x01 ECU_ADDRESS 0x0 /end MEASUREMENT
/begin MEASUREMENT MAIN_MSGbMP5_TBOX_Time_Valid "MAIN_MSGbMP5_TBOX_Time_Valid" UBYTE Bool_ON_OFF 1 2 0 1 BIT_MASK 0x01 ECU_ADDRESS 0x0 /end MEASUREMENT
/begin MEASUREMENT MAIN_MSGbOPC_CANComFailure "MAIN_MSGbOPC_CANComFailure" UBYTE Bool_ON_OFF 1 2 0 1 BIT_MASK 0x01 ECU_ADDRESS 0x0 /end MEASUREMENT
/begin MEASUREMENT MAIN_MSGbOPC_DriverCircuitFailure "MAIN_MSGbOPC_DriverCircuitFailure" UBYTE Bool_ON_OFF 1 2 0 1 BIT_MASK 0x01 ECU_ADDRESS 0x0 /end MEASUREMENT
/begin MEASUREMENT MAIN_MSGbOPC_HighTempDePwrFlag "MAIN_MSGbOPC_HighTempDePwrFlag" UBYTE Bool_ON_OFF 1 2 0 1 BIT_MASK 0x01 ECU_ADDRESS 0x0 /end MEASUREMENT
/begin MEASUREMENT MAIN_MSGbOPC_LimitCurrentFlag "MAIN_MSGbOPC_LimitCurrentFlag" UBYTE Bool_ON_OFF 1 2 0 1 BIT_MASK 0x01 ECU_ADDRESS 0x0 /end MEASUREMENT
/begin MEASUREMENT MAIN_MSGbOPC_LowVoltage "MAIN_MSGbOPC_LowVoltage" UBYTE Bool_ON_OFF 1 2 0 1 BIT_MASK 0x01 ECU_ADDRESS 0x0 /end MEASUREMENT
/begin MEASUREMENT MAIN_MSGbOPC_MotorStallingFailure "MAIN_MSGbOPC_MotorStallingFailure" UBYTE Bool_ON_OFF 1 2 0 1 BIT_MASK 0x01 ECU_ADDRESS 0x0 /end MEASUREMENT
/begin MEASUREMENT MAIN_MSGbOPC_OverCurrent "MAIN_MSGbOPC_OverCurrent" UBYTE Bool_ON_OFF 1 2 0 1 BIT_MASK 0x01 ECU_ADDRESS 0x0 /end MEASUREMENT
/begin MEASUREMENT MAIN_MSGbOPC_OverTemperatue "MAIN_MSGbOPC_OverTemperatue" UBYTE Bool_ON_OFF 1 2 0 1 BIT_MASK 0x01 ECU_ADDRESS 0x0 /end MEASUREMENT
/begin MEASUREMENT MAIN_MSGbOPC_OverVoltage "MAIN_MSGbOPC_OverVoltage" UBYTE Bool_ON_OFF 1 2 0 1 BIT_MASK 0x01 ECU_ADDRESS 0x0 /end MEASUREMENT
/begin MEASUREMENT MAIN_MSGbOPC_SensorFailure "MAIN_MSGbOPC_SensorFailure" UBYTE Bool_ON_OFF 1 2 0 1 BIT_MASK 0x01 ECU_ADDRESS 0x0 /end MEASUREMENT
/begin MEASUREMENT MAIN_MSGbRMCU4_MilReq "BSW Power on check finish flag." UBYTE Bool_ON_OFF 1 2 0 1 BIT_MASK 0x01 ECU_ADDRESS 0x0 /end MEASUREMENT
/begin MEASUREMENT MAIN_MSGbRMCU4_MoterFault "BSW Power on check finish flag." UBYTE Bool_ON_OFF 1 2 0 1 BIT_MASK 0x01 ECU_ADDRESS 0x0 /end MEASUREMENT
/begin MEASUREMENT MAIN_MSGbTCU_P1OverTempWarn "BSW Power on check finish flag." UBYTE Bool_ON_OFF 1 2 0 1 BIT_MASK 0x01 ECU_ADDRESS 0x0 /end MEASUREMENT
/begin MEASUREMENT MAIN_MSGbTCU_P3OverTempWarn "BSW Power on check finish flag." UBYTE Bool_ON_OFF 1 2 0 1 BIT_MASK 0x01 ECU_ADDRESS 0x0 /end MEASUREMENT
/begin MEASUREMENT MAIN_MSGbTbox_OTAModeStatus "MAIN_MSGbTbox_OTAModeStatus" UBYTE Bool_ON_OFF 1 2 0 1 BIT_MASK 0x01 ECU_ADDRESS 0x0 /end MEASUREMENT
/begin MEASUREMENT MAIN_MSGbVCU_DrivingPermit "MAIN_MSGbVCU_DrivingPermit" UBYTE Bool_ON_OFF 1 2 0 1 BIT_MASK 0x01 ECU_ADDRESS 0x0 /end MEASUREMENT
/begin MEASUREMENT MAIN_MSGbVCU_FmcuAkdReq "BSW Power on check finish flag." UBYTE Bool_ON_OFF 1 2 0 1 BIT_MASK 0x01 ECU_ADDRESS 0x0 /end MEASUREMENT
/begin MEASUREMENT MAIN_MSGbVCU_GeneratorAlloweWork "MAIN_MSGbVCU_GeneratorAlloweWork" UBYTE Bool_ON_OFF 1 2 0 1 BIT_MASK 0x01 ECU_ADDRESS 0x0 /end MEASUREMENT
/begin MEASUREMENT MAIN_MSGbVCU_MotorAlloweWork "MAIN_MSGbVCU_MotorAlloweWork" UBYTE Bool_ON_OFF 1 2 0 1 BIT_MASK 0x01 ECU_ADDRESS 0x0 /end MEASUREMENT
/begin MEASUREMENT MAIN_MSGbVCU_PropulsionActive "MAIN_MSGbVCU_PropulsionActive" UBYTE Bool_ON_OFF 1 2 0 1 BIT_MASK 0x01 ECU_ADDRESS 0x0 /end MEASUREMENT
/begin MEASUREMENT MAIN_MSGbVECU_AfterMasterCmd "MAIN_MSGbVECU_AfterMasterCmd" UBYTE Bool_ON_OFF 1 2 0 1 BIT_MASK 0x01 ECU_ADDRESS 0x0 /end MEASUREMENT
/begin MEASUREMENT MAIN_MSGbVECU_ShiftDrumTeachinAllwd_flg "MAIN_MSGbVECU_ShiftDrumTeachinAllwd_flg" UBYTE Bool_ON_OFF 1 2 0 1 BIT_MASK 0x01 ECU_ADDRESS 0x0 /end MEASUREMENT
/begin MEASUREMENT MAIN_MSGbVECU_ShiftDrumTeachinTrig "MAIN_MSGbVECU_ShiftDrumTeachinTrig" UBYTE Bool_ON_OFF 1 2 0 1 BIT_MASK 0x01 ECU_ADDRESS 0x0 /end MEASUREMENT
/begin MEASUREMENT MAIN_MSGf32AC_AmbTemp "..." FLOAT32_IEEE I_1 1 2 -3.402823466E+038 3.402823466E+038 ECU_ADDRESS 0x0 /end MEASUREMENT
/begin MEASUREMENT MAIN_MSGf32BCM_BattVolt "..." FLOAT32_IEEE I_1 1 2 -3.402823466E+038 3.402823466E+038 ECU_ADDRESS 0x0 /end MEASUREMENT
/begin MEASUREMENT MAIN_MSGf32BMS_Current "..." FLOAT32_IEEE I_1 1 2 -3.402823466E+038 3.402823466E+038 ECU_ADDRESS 0x0 /end MEASUREMENT
/begin MEASUREMENT MAIN_MSGf32BMS_HVBLongTimChargeLim "..." FLOAT32_IEEE I_1 1 2 -3.402823466E+038 3.402823466E+038 ECU_ADDRESS 0x0 /end MEASUREMENT
/begin MEASUREMENT MAIN_MSGf32BMS_HVBLongTimDischargeLim "..." FLOAT32_IEEE I_1 1 2 -3.402823466E+038 3.402823466E+038 ECU_ADDRESS 0x0 /end MEASUREMENT
/begin MEASUREMENT MAIN_MSGf32BMS_HVBShortTimChargeLim "..." FLOAT32_IEEE I_1 1 2 -3.402823466E+038 3.402823466E+038 ECU_ADDRESS 0x0 /end MEASUREMENT
/begin MEASUREMENT MAIN_MSGf32BMS_HVBShortTimDischargerLim "..." FLOAT32_IEEE I_1 1 2 -3.402823466E+038 3.402823466E+038 ECU_ADDRESS 0x0 /end MEASUREMENT
/begin MEASUREMENT MAIN_MSGf32BMS_SOC "..." FLOAT32_IEEE I_1 1 2 -3.402823466E+038 3.402823466E+038 ECU_ADDRESS 0x0 /end MEASUREMENT
/begin MEASUREMENT MAIN_MSGf32CAP_PhsCurLoadPhys "..." FLOAT32_IEEE I_37 1 2 -3.402823466E+038 3.402823466E+038 ECU_ADDRESS 0x0 /end MEASUREMENT
/begin MEASUREMENT MAIN_MSGf32CCP_5VSupplyPhys "..." FLOAT32_IEEE I_37 1 2 -3.402823466E+038 3.402823466E+038 ECU_ADDRESS 0x0 /end MEASUREMENT
/begin MEASUREMENT MAIN_MSGf32CCP_AvrgCurrentPhys "..." FLOAT32_IEEE I_37 1 2 -3.402823466E+038 3.402823466E+038 ECU_ADDRESS 0x0 /end MEASUREMENT
/begin MEASUREMENT MAIN_MSGf32CCP_BenchDutyCyclePhys "..." FLOAT32_IEEE I_1 1 2 -3.402823466E+038 3.402823466E+038 ECU_ADDRESS 0x0 /end MEASUREMENT
/begin MEASUREMENT MAIN_MSGf32CCP_DcCurrentPhys "..." FLOAT32_IEEE I_37 1 2 -3.402823466E+038 3.402823466E+038 ECU_ADDRESS 0x0 /end MEASUREMENT
/begin MEASUREMENT MAIN_MSGf32CCP_DutyCyclePhys "..." FLOAT32_IEEE I_37 1 2 -3.402823466E+038 3.402823466E+038 ECU_ADDRESS 0x0 /end MEASUREMENT
/begin MEASUREMENT MAIN_MSGf32CCP_MotSpeedPhys "..." FLOAT32_IEEE I_37 1 2 -3.402823466E+038 3.402823466E+038 ECU_ADDRESS 0x0 /end MEASUREMENT
/begin MEASUREMENT MAIN_MSGf32CCP_PhsCurLoadPhys "..." FLOAT32_IEEE I_37 1 2 -3.402823466E+038 3.402823466E+038 ECU_ADDRESS 0x0 /end MEASUREMENT
/begin MEASUREMENT MAIN_MSGf32CCP_PwrStgActPosIncPhys "..." FLOAT32_IEEE I_37 1 2 -3.402823466E+038 3.402823466E+038 ECU_ADDRESS 0x0 /end MEASUREMENT
/begin MEASUREMENT MAIN_MSGf32CCP_PwrStgTempPhys "..." FLOAT32_IEEE I_37 1 2 -3.402823466E+038 3.402823466E+038 ECU_ADDRESS 0x0 /end MEASUREMENT
/begin MEASUREMENT MAIN_MSGf32CCP_TargetDutyCyclePhys "..." FLOAT32_IEEE I_41 1 2 -3.402823466E+038 3.402823466E+038 ECU_ADDRESS 0x0 /end MEASUREMENT
/begin MEASUREMENT MAIN_MSGf32DCU_OilPressurePhys "..." FLOAT32_IEEE F_1_p0_38 1 2 -3.402823466E+038 3.402823466E+038 ECU_ADDRESS 0x0 /end MEASUREMENT
/begin MEASUREMENT MAIN_MSGf32EMS_AccPedPos1NormRaw "..." FLOAT32_IEEE I_1 1 2 -3.402823466E+038 3.402823466E+038 ECU_ADDRESS 0x0 /end MEASUREMENT
/begin MEASUREMENT MAIN_MSGf32EMS_CalcuLoadValue "..." FLOAT32_IEEE I_1 1 2 -3.402823466E+038 3.402823466E+038 ECU_ADDRESS 0x0 /end MEASUREMENT
/begin MEASUREMENT MAIN_MSGf32EMS_EngActualFlwTorque "..." FLOAT32_IEEE I_1 1 2 -3.402823466E+038 3.402823466E+038 ECU_ADDRESS 0x0 /end MEASUREMENT
/begin MEASUREMENT MAIN_MSGf32EMS_EngCoolantTemp "..." FLOAT32_IEEE I_1 1 2 -3.402823466E+038 3.402823466E+038 ECU_ADDRESS 0x0 /end MEASUREMENT
/begin MEASUREMENT MAIN_MSGf32EMS_EngSpd "..." FLOAT32_IEEE I_1 1 2 -3.402823466E+038 3.402823466E+038 ECU_ADDRESS 0x0 /end MEASUREMENT
/begin MEASUREMENT MAIN_MSGf32GCU_ControllerTemp "..." FLOAT32_IEEE I_1 1 2 -3.402823466E+038 3.402823466E+038 ECU_ADDRESS 0x0 /end MEASUREMENT
/begin MEASUREMENT MAIN_MSGf32GCU_GeneratorDCCurrent "..." FLOAT32_IEEE I_1 1 2 -3.402823466E+038 3.402823466E+038 ECU_ADDRESS 0x0 /end MEASUREMENT
/begin MEASUREMENT MAIN_MSGf32GCU_GeneratorDCVolt "..." FLOAT32_IEEE I_1 1 2 -3.402823466E+038 3.402823466E+038 ECU_ADDRESS 0x0 /end MEASUREMENT
/begin MEASUREMENT MAIN_MSGf32GCU_GeneratorMaxPosTorque "..." FLOAT32_IEEE I_1 1 2 -3.402823466E+038 3.402823466E+038 ECU_ADDRESS 0x0 /end MEASUREMENT
/begin MEASUREMENT MAIN_MSGf32GCU_GeneratorMaxSpd "..." FLOAT32_IEEE I_1 1 2 -3.402823466E+038 3.402823466E+038 ECU_ADDRESS 0x0 /end MEASUREMENT
/begin MEASUREMENT MAIN_MSGf32GCU_GeneratorMinNegTorque "..." FLOAT32_IEEE I_1 1 2 -3.402823466E+038 3.402823466E+038 ECU_ADDRESS 0x0 /end MEASUREMENT
/begin MEASUREMENT MAIN_MSGf32GCU_GeneratorSpd "..." FLOAT32_IEEE I_1 1 2 -3.402823466E+038 3.402823466E+038 ECU_ADDRESS 0x0 /end MEASUREMENT
/begin MEASUREMENT MAIN_MSGf32GCU_GeneratorTemp "..." FLOAT32_IEEE I_1 1 2 -3.402823466E+038 3.402823466E+038 ECU_ADDRESS 0x0 /end MEASUREMENT
/begin MEASUREMENT MAIN_MSGf32GCU_GeneratorTorqueFeedback "..." FLOAT32_IEEE I_1 1 2 -3.402823466E+038 3.402823466E+038 ECU_ADDRESS 0x0 /end MEASUREMENT
/begin MEASUREMENT MAIN_MSGf32GCU_MotorPower "..." FLOAT32_IEEE I_1 1 2 -3.402823466E+038 3.402823466E+038 ECU_ADDRESS 0x0 /end MEASUREMENT
/begin MEASUREMENT MAIN_MSGf32GW_ESC_BrakeOilPress "..." FLOAT32_IEEE I_1 1 2 -3.402823466E+038 3.402823466E+038 ECU_ADDRESS 0x0 /end MEASUREMENT
/begin MEASUREMENT MAIN_MSGf32GW_ESC_FrontLeftWHeelSpd "..." FLOAT32_IEEE I_1 1 2 -3.402823466E+038 3.402823466E+038 ECU_ADDRESS 0x0 /end MEASUREMENT
/begin MEASUREMENT MAIN_MSGf32GW_ESC_FrontRightWHeelSpd "..." FLOAT32_IEEE I_1 1 2 -3.402823466E+038 3.402823466E+038 ECU_ADDRESS 0x0 /end MEASUREMENT
/begin MEASUREMENT MAIN_MSGf32GW_ESC_RearLeftWheelSpd "..." FLOAT32_IEEE I_1 1 2 -3.402823466E+038 3.402823466E+038 ECU_ADDRESS 0x0 /end MEASUREMENT
/begin MEASUREMENT MAIN_MSGf32GW_ESC_RearRightWheelSpd "..." FLOAT32_IEEE I_1 1 2 -3.402823466E+038 3.402823466E+038 ECU_ADDRESS 0x0 /end MEASUREMENT
/begin MEASUREMENT MAIN_MSGf32GW_ESC_VehSpd "..." FLOAT32_IEEE I_1 1 2 -3.402823466E+038 3.402823466E+038 ECU_ADDRESS 0x0 /end MEASUREMENT
/begin MEASUREMENT MAIN_MSGf32HTCU_AcDrumAngle "..." FLOAT32_IEEE I_1 1 2 -3.402823466E+038 3.402823466E+038 ECU_ADDRESS 0x0 /end MEASUREMENT
/begin MEASUREMENT MAIN_MSGf32HTCU_CCPSpd "..." FLOAT32_IEEE I_1 1 2 -3.402823466E+038 3.402823466E+038 ECU_ADDRESS 0x0 /end MEASUREMENT
/begin MEASUREMENT MAIN_MSGf32HTCU_CalShiftForce "..." FLOAT32_IEEE I_1 1 2 -3.402823466E+038 3.402823466E+038 ECU_ADDRESS 0x0 /end MEASUREMENT
/begin MEASUREMENT MAIN_MSGf32HTCU_TorqueLimitation "..." FLOAT32_IEEE I_1 1 2 -3.402823466E+038 3.402823466E+038 ECU_ADDRESS 0x0 /end MEASUREMENT
/begin MEASUREMENT MAIN_MSGf32HTCU_TransmissionFluidTemp "..." FLOAT32_IEEE I_1 1 2 -3.402823466E+038 3.402823466E+038 ECU_ADDRESS 0x0 /end MEASUREMENT
/begin MEASUREMENT MAIN_MSGf32MCU_ControllerTemp "..." FLOAT32_IEEE I_1 1 2 -3.402823466E+038 3.402823466E+038 ECU_ADDRESS 0x0 /end MEASUREMENT
/begin MEASUREMENT MAIN_MSGf32MCU_LvVoltPhys "..." FLOAT32_IEEE I_15 1 2 -3.402823466E+038 3.402823466E+038 ECU_ADDRESS 0x0 /end MEASUREMENT
/begin MEASUREMENT MAIN_MSGf32MCU_MotorDCCurrent "..." FLOAT32_IEEE I_1 1 2 -3.402823466E+038 3.402823466E+038 ECU_ADDRESS 0x0 /end MEASUREMENT
/begin MEASUREMENT MAIN_MSGf32MCU_MotorDCVolt1 "..." FLOAT32_IEEE I_1 1 2 -3.402823466E+038 3.402823466E+038 ECU_ADDRESS 0x0 /end MEASUREMENT
/begin MEASUREMENT MAIN_MSGf32MCU_MotorMaxPositiveTorque "..." FLOAT32_IEEE I_1 1 2 -3.402823466E+038 3.402823466E+038 ECU_ADDRESS 0x0 /end MEASUREMENT
/begin MEASUREMENT MAIN_MSGf32MCU_MotorMaxSpd "..." FLOAT32_IEEE I_1 1 2 -3.402823466E+038 3.402823466E+038 ECU_ADDRESS 0x0 /end MEASUREMENT
/begin MEASUREMENT MAIN_MSGf32MCU_MotorMinNegativeTorque "..." FLOAT32_IEEE I_1 1 2 -3.402823466E+038 3.402823466E+038 ECU_ADDRESS 0x0 /end MEASUREMENT
/begin MEASUREMENT MAIN_MSGf32MCU_MotorPower "..." FLOAT32_IEEE I_1 1 2 -3.402823466E+038 3.402823466E+038 ECU_ADDRESS 0x0 /end MEASUREMENT
/begin MEASUREMENT MAIN_MSGf32MCU_MotorSpeed "..." FLOAT32_IEEE I_1 1 2 -3.402823466E+038 3.402823466E+038 ECU_ADDRESS 0x0 /end MEASUREMENT
/begin MEASUREMENT MAIN_MSGf32MCU_MotorTemp "..." FLOAT32_IEEE I_1 1 2 -3.402823466E+038 3.402823466E+038 ECU_ADDRESS 0x0 /end MEASUREMENT
/begin MEASUREMENT MAIN_MSGf32MCU_MotorTorqueFeedback "..." FLOAT32_IEEE I_1 1 2 -3.402823466E+038 3.402823466E+038 ECU_ADDRESS 0x0 /end MEASUREMENT
/begin MEASUREMENT MAIN_MSGf32MP5_TBOX_Time_Year "..." FLOAT32_IEEE I_1 1 2 -3.402823466E+038 3.402823466E+038 ECU_ADDRESS 0x0 /end MEASUREMENT
/begin MEASUREMENT MAIN_MSGf32VCU7_12VBatVoltPhys "..." FLOAT32_IEEE F_1_p0_39 1 2 -3.402823466E+038 3.402823466E+038 ECU_ADDRESS 0x0 /end MEASUREMENT
/begin MEASUREMENT MAIN_MSGf32VCU_AccPedPosPhys "..." FLOAT32_IEEE F_1_p0_40 1 2 -3.402823466E+038 3.402823466E+038 ECU_ADDRESS 0x0 /end MEASUREMENT
/begin MEASUREMENT MAIN_MSGf32VCU_BrakPedPosPhys "..." FLOAT32_IEEE I_41 1 2 -3.402823466E+038 3.402823466E+038 ECU_ADDRESS 0x0 /end MEASUREMENT
/begin MEASUREMENT MAIN_MSGf32VCU_DCDCVoltageReq "..." FLOAT32_IEEE I_1 1 2 -3.402823466E+038 3.402823466E+038 ECU_ADDRESS 0x0 /end MEASUREMENT
/begin MEASUREMENT MAIN_MSGf32VCU_GeneratorSpeedCmd "..." FLOAT32_IEEE I_1 1 2 -3.402823466E+038 3.402823466E+038 ECU_ADDRESS 0x0 /end MEASUREMENT
/begin MEASUREMENT MAIN_MSGf32VCU_GeneratorTorqueCmd "..." FLOAT32_IEEE I_1 1 2 -3.402823466E+038 3.402823466E+038 ECU_ADDRESS 0x0 /end MEASUREMENT
/begin MEASUREMENT MAIN_MSGf32VCU_MotorTorqueCmd "..." FLOAT32_IEEE I_1 1 2 -3.402823466E+038 3.402823466E+038 ECU_ADDRESS 0x0 /end MEASUREMENT
/begin MEASUREMENT MAIN_MSGf32VCU_TargetDriveTrq "..." FLOAT32_IEEE I_1 1 2 -3.402823466E+038 3.402823466E+038 ECU_ADDRESS 0x0 /end MEASUREMENT
/begin MEASUREMENT MAIN_MSGf32VECU_MotorSpeedCmd "..." FLOAT32_IEEE I_1 1 2 -3.402823466E+038 3.402823466E+038 ECU_ADDRESS 0x0 /end MEASUREMENT
/begin MEASUREMENT MAIN_MSGu16BCM_BattVoltRaw "..." UWORD I_1 1 2 0 65535 ECU_ADDRESS 0x0 /end MEASUREMENT
/begin MEASUREMENT MAIN_MSGu16BMS_CurrentRaw "..." UWORD I_1 1 2 0 65535 ECU_ADDRESS 0x0 /end MEASUREMENT
/begin MEASUREMENT MAIN_MSGu16BMS_HVBLongTimChargeLimRaw "..." UWORD I_1 1 2 0 65535 ECU_ADDRESS 0x0 /end MEASUREMENT
/begin MEASUREMENT MAIN_MSGu16BMS_HVBLongTimDischargeLimRaw "..." UWORD I_1 1 2 0 65535 ECU_ADDRESS 0x0 /end MEASUREMENT
/begin MEASUREMENT MAIN_MSGu16BMS_HVBShortTimChargeLimRaw "..." UWORD I_1 1 2 0 65535 ECU_ADDRESS 0x0 /end MEASUREMENT
/begin MEASUREMENT MAIN_MSGu16BMS_HVBShortTimDischargerLimRaw "..." UWORD I_1 1 2 0 65535 ECU_ADDRESS 0x0 /end MEASUREMENT
/begin MEASUREMENT MAIN_MSGu16BMS_SOCRaw "..." UWORD I_1 1 2 0 65535 ECU_ADDRESS 0x0 /end MEASUREMENT
/begin MEASUREMENT MAIN_MSGu16BMS_Voltage "..." UWORD I_1 1 2 0 65535 ECU_ADDRESS 0x0 /end MEASUREMENT
/begin MEASUREMENT MAIN_MSGu16CCp_AvrgCurrentRaw "..." UWORD I_1 1 2 0 65535 ECU_ADDRESS 0x0 /end MEASUREMENT
/begin MEASUREMENT MAIN_MSGu16CCp_DcCurrentRaw "..." UWORD I_1 1 2 0 65535 ECU_ADDRESS 0x0 /end MEASUREMENT
/begin MEASUREMENT MAIN_MSGu16CCp_DutyCycleRaw "..." UWORD I_1 1 2 0 65535 ECU_ADDRESS 0x0 /end MEASUREMENT
/begin MEASUREMENT MAIN_MSGu16CCp_MotSpeedRaw "..." UWORD I_1 1 2 0 65535 ECU_ADDRESS 0x0 /end MEASUREMENT
/begin MEASUREMENT MAIN_MSGu16CCp_PhsCurLoadRaw "..." UWORD I_1 1 2 0 65535 ECU_ADDRESS 0x0 /end MEASUREMENT
/begin MEASUREMENT MAIN_MSGu16CCp_PwrStgActPosIncRaw "..." UWORD I_1 1 2 0 65535 ECU_ADDRESS 0x0 /end MEASUREMENT
/begin MEASUREMENT MAIN_MSGu16DCU_OilPressureRaw "..." UWORD I_1 1 2 0 65535 ECU_ADDRESS 0x0 /end MEASUREMENT
/begin MEASUREMENT MAIN_MSGu16EMS_EngActualFlwTorqueRaw "..." UWORD I_1 1 2 0 65535 ECU_ADDRESS 0x0 /end MEASUREMENT
/begin MEASUREMENT MAIN_MSGu16EMS_EngSpdRaw "..." UWORD I_1 1 2 0 65535 ECU_ADDRESS 0x0 /end MEASUREMENT
/begin MEASUREMENT MAIN_MSGu16GCU_GeneratorDCCurrentRaw "..." UWORD I_1 1 2 0 65535 ECU_ADDRESS 0x0 /end MEASUREMENT
/begin MEASUREMENT MAIN_MSGu16GCU_GeneratorDCVoltRaw "..." UWORD I_1 1 2 0 65535 ECU_ADDRESS 0x0 /end MEASUREMENT
/begin MEASUREMENT MAIN_MSGu16GCU_GeneratorMaxPosTorqueRaw "..." UWORD I_1 1 2 0 65535 ECU_ADDRESS 0x0 /end MEASUREMENT
/begin MEASUREMENT MAIN_MSGu16GCU_GeneratorMaxSpdRaw "..." UWORD I_1 1 2 0 65535 ECU_ADDRESS 0x0 /end MEASUREMENT
/begin MEASUREMENT MAIN_MSGu16GCU_GeneratorMinNegTorqueRaw "..." UWORD I_1 1 2 0 65535 ECU_ADDRESS 0x0 /end MEASUREMENT
/begin MEASUREMENT MAIN_MSGu16GCU_GeneratorSpdRaw "..." UWORD I_1 1 2 0 65535 ECU_ADDRESS 0x0 /end MEASUREMENT
/begin MEASUREMENT MAIN_MSGu16GCU_GeneratorTorqueFeedbackRaw "..." UWORD I_1 1 2 0 65535 ECU_ADDRESS 0x0 /end MEASUREMENT
/begin MEASUREMENT MAIN_MSGu16GCU_MotorPowerRaw "..." UWORD I_1 1 2 0 65535 ECU_ADDRESS 0x0 /end MEASUREMENT
/begin MEASUREMENT MAIN_MSGu16GCU_SpdSet "..." UWORD I_1 1 2 0 65535 ECU_ADDRESS 0x0 /end MEASUREMENT
/begin MEASUREMENT MAIN_MSGu16GW_ESC_BrakeOilPressRaw "..." UWORD I_1 1 2 0 65535 ECU_ADDRESS 0x0 /end MEASUREMENT
/begin MEASUREMENT MAIN_MSGu16GW_ESC_FrontLeftWHeelSpdRaw "..." UWORD I_1 1 2 0 65535 ECU_ADDRESS 0x0 /end MEASUREMENT
/begin MEASUREMENT MAIN_MSGu16GW_ESC_FrontRightWHeelSpdRaw "..." UWORD I_1 1 2 0 65535 ECU_ADDRESS 0x0 /end MEASUREMENT
/begin MEASUREMENT MAIN_MSGu16GW_ESC_RearLeftWheelSpdRaw "..." UWORD I_1 1 2 0 65535 ECU_ADDRESS 0x0 /end MEASUREMENT
/begin MEASUREMENT MAIN_MSGu16GW_ESC_RearRightWheelSpdRaw "..." UWORD I_1 1 2 0 65535 ECU_ADDRESS 0x0 /end MEASUREMENT
/begin MEASUREMENT MAIN_MSGu16GW_ESC_VehSpdRaw "..." UWORD I_1 1 2 0 65535 ECU_ADDRESS 0x0 /end MEASUREMENT
/begin MEASUREMENT MAIN_MSGu16HTCU_AcDrumAngleRaw "..." UWORD I_1 1 2 0 65535 ECU_ADDRESS 0x0 /end MEASUREMENT
/begin MEASUREMENT MAIN_MSGu16HTCU_CCPSpdRaw "..." UWORD I_1 1 2 0 65535 ECU_ADDRESS 0x0 /end MEASUREMENT
/begin MEASUREMENT MAIN_MSGu16HTCU_CalShiftForceRaw "..." UWORD I_1 1 2 0 65535 ECU_ADDRESS 0x0 /end MEASUREMENT
/begin MEASUREMENT MAIN_MSGu16HTCU_DevelopFrame1 "..." UWORD I_1 1 2 0 65535 ECU_ADDRESS 0x0 /end MEASUREMENT
/begin MEASUREMENT MAIN_MSGu16HTCU_DevelopFrame2 "..." UWORD I_1 1 2 0 65535 ECU_ADDRESS 0x0 /end MEASUREMENT
/begin MEASUREMENT MAIN_MSGu16HTCU_DevelopFrame3 "..." UWORD I_1 1 2 0 65535 ECU_ADDRESS 0x0 /end MEASUREMENT
/begin MEASUREMENT MAIN_MSGu16HTCU_DevelopFrame4 "..." UWORD I_1 1 2 0 65535 ECU_ADDRESS 0x0 /end MEASUREMENT
/begin MEASUREMENT MAIN_MSGu16HTCU_TorqueLimitationRaw "..." UWORD I_1 1 2 0 65535 ECU_ADDRESS 0x0 /end MEASUREMENT
/begin MEASUREMENT MAIN_MSGu16MCU_MotorDCCurrentRaw "..." UWORD I_1 1 2 0 65535 ECU_ADDRESS 0x0 /end MEASUREMENT
/begin MEASUREMENT MAIN_MSGu16MCU_MotorDCVolt1Raw "..." UWORD I_1 1 2 0 65535 ECU_ADDRESS 0x0 /end MEASUREMENT
/begin MEASUREMENT MAIN_MSGu16MCU_MotorMaxPositiveTorqueRaw "..." UWORD I_1 1 2 0 65535 ECU_ADDRESS 0x0 /end MEASUREMENT
/begin MEASUREMENT MAIN_MSGu16MCU_MotorMaxSpdRaw "..." UWORD I_1 1 2 0 65535 ECU_ADDRESS 0x0 /end MEASUREMENT
/begin MEASUREMENT MAIN_MSGu16MCU_MotorMinNegativeTorqueRaw "..." UWORD I_1 1 2 0 65535 ECU_ADDRESS 0x0 /end MEASUREMENT
/begin MEASUREMENT MAIN_MSGu16MCU_MotorPowerRaw "..." UWORD I_1 1 2 0 65535 ECU_ADDRESS 0x0 /end MEASUREMENT
/begin MEASUREMENT MAIN_MSGu16MCU_MotorSpeedRaw "..." UWORD I_1 1 2 0 65535 ECU_ADDRESS 0x0 /end MEASUREMENT
/begin MEASUREMENT MAIN_MSGu16MCU_MotorTorqueFeedbackRaw "..." UWORD I_1 1 2 0 65535 ECU_ADDRESS 0x0 /end MEASUREMENT
/begin MEASUREMENT MAIN_MSGu16OPC_SpdAct "..." UWORD I_1 1 2 0 65535 ECU_ADDRESS 0x0 /end MEASUREMENT
/begin MEASUREMENT MAIN_MSGu16TCU_ClutchActTorqRaw "..." UWORD I_1 1 2 0 65535 ECU_ADDRESS 0x0 /end MEASUREMENT
/begin MEASUREMENT MAIN_MSGu16VCU_DevelopSignal1 "..." UWORD I_1 1 2 0 65535 ECU_ADDRESS 0x0 /end MEASUREMENT
/begin MEASUREMENT MAIN_MSGu16VCU_DevelopSignal2 "..." UWORD I_1 1 2 0 65535 ECU_ADDRESS 0x0 /end MEASUREMENT
/begin MEASUREMENT MAIN_MSGu16VCU_DevelopSignal3 "..." UWORD I_1 1 2 0 65535 ECU_ADDRESS 0x0 /end MEASUREMENT
/begin MEASUREMENT MAIN_MSGu16VCU_DevelopSignal4 "..." UWORD I_1 1 2 0 65535 ECU_ADDRESS 0x0 /end MEASUREMENT
/begin MEASUREMENT MAIN_MSGu16VCU_GeneratorSpeedCmdRaw "..." UWORD I_1 1 2 0 65535 ECU_ADDRESS 0x0 /end MEASUREMENT
/begin MEASUREMENT MAIN_MSGu16VCU_GeneratorTorqueCmdRaw "..." UWORD I_1 1 2 0 65535 ECU_ADDRESS 0x0 /end MEASUREMENT
/begin MEASUREMENT MAIN_MSGu16VCU_MotorTorqueCmdRaw "..." UWORD I_1 1 2 0 65535 ECU_ADDRESS 0x0 /end MEASUREMENT
/begin MEASUREMENT MAIN_MSGu16VCU_TargetDriveTrqRaw "..." UWORD I_1 1 2 0 65535 ECU_ADDRESS 0x0 /end MEASUREMENT
/begin MEASUREMENT MAIN_MSGu16VECU_MotorSpeedCmdRaw "..." UWORD I_1 1 2 0 65535 ECU_ADDRESS 0x0 /end MEASUREMENT
/begin MEASUREMENT MAIN_MSGu32IBCM_IMMOdata "..." ULONG I_1 1 2 0 4294967295 ECU_ADDRESS 0x0 /end MEASUREMENT
/begin MEASUREMENT MAIN_MSGu32IC_TotalOdmeter "..." ULONG I_1 1 2 0 4294967295 ECU_ADDRESS 0x0 /end MEASUREMENT
/begin MEASUREMENT MAIN_MSGu32MCU_ImmoData "..." ULONG I_1 1 2 0 4294967295 ECU_ADDRESS 0x0 /end MEASUREMENT
/begin MEASUREMENT MAIN_MSGu8AC1_buf "-" UBYTE Id_0x00 1 2 0 255 MATRIX_DIM 8 1 1 ECU_ADDRESS 0x0 /end MEASUREMENT
/begin MEASUREMENT MAIN_MSGu8AC1_buf[0] "MAIN_MSGu8AC1_buf[0]" UBYTE Id_0x00 1 2 0 255 ECU_ADDRESS 0x0 /end MEASUREMENT
/begin MEASUREMENT MAIN_MSGu8AC1_buf[1] "MAIN_MSGu8AC1_buf[1]" UBYTE Id_0x00 1 2 0 255 ECU_ADDRESS 0x0 /end MEASUREMENT
/begin MEASUREMENT MAIN_MSGu8AC1_buf[2] "MAIN_MSGu8AC1_buf[2]" UBYTE Id_0x00 1 2 0 255 ECU_ADDRESS 0x0 /end MEASUREMENT
/begin MEASUREMENT MAIN_MSGu8AC1_buf[3] "MAIN_MSGu8AC1_buf[3]" UBYTE Id_0x00 1 2 0 255 ECU_ADDRESS 0x0 /end MEASUREMENT
/begin MEASUREMENT MAIN_MSGu8AC1_buf[4] "MAIN_MSGu8AC1_buf[4]" UBYTE Id_0x00 1 2 0 255 ECU_ADDRESS 0x0 /end MEASUREMENT
/begin MEASUREMENT MAIN_MSGu8AC1_buf[5] "MAIN_MSGu8AC1_buf[5]" UBYTE Id_0x00 1 2 0 255 ECU_ADDRESS 0x0 /end MEASUREMENT
/begin MEASUREMENT MAIN_MSGu8AC1_buf[6] "MAIN_MSGu8AC1_buf[6]" UBYTE Id_0x00 1 2 0 255 ECU_ADDRESS 0x0 /end MEASUREMENT
/begin MEASUREMENT MAIN_MSGu8AC1_buf[7] "MAIN_MSGu8AC1_buf[7]" UBYTE Id_0x00 1 2 0 255 ECU_ADDRESS 0x0 /end MEASUREMENT
/begin MEASUREMENT MAIN_MSGu8AC_AmbTempRaw "..." UBYTE I_1 1 2 0 255 ECU_ADDRESS 0x0 /end MEASUREMENT
/begin MEASUREMENT MAIN_MSGu8BCM_IgnitionSt "..." UBYTE I_1 1 2 0 255 ECU_ADDRESS 0x0 /end MEASUREMENT
/begin MEASUREMENT MAIN_MSGu8BMS1_buf "-" UBYTE Id_0x00 1 2 0 255 MATRIX_DIM 8 1 1 ECU_ADDRESS 0x0 /end MEASUREMENT
/begin MEASUREMENT MAIN_MSGu8BMS1_buf[0] "MAIN_MSGu8BMS1_buf[0]" UBYTE Id_0x00 1 2 0 255 ECU_ADDRESS 0x0 /end MEASUREMENT
/begin MEASUREMENT MAIN_MSGu8BMS1_buf[1] "MAIN_MSGu8BMS1_buf[1]" UBYTE Id_0x00 1 2 0 255 ECU_ADDRESS 0x0 /end MEASUREMENT
/begin MEASUREMENT MAIN_MSGu8BMS1_buf[2] "MAIN_MSGu8BMS1_buf[2]" UBYTE Id_0x00 1 2 0 255 ECU_ADDRESS 0x0 /end MEASUREMENT
/begin MEASUREMENT MAIN_MSGu8BMS1_buf[3] "MAIN_MSGu8BMS1_buf[3]" UBYTE Id_0x00 1 2 0 255 ECU_ADDRESS 0x0 /end MEASUREMENT
/begin MEASUREMENT MAIN_MSGu8BMS1_buf[4] "MAIN_MSGu8BMS1_buf[4]" UBYTE Id_0x00 1 2 0 255 ECU_ADDRESS 0x0 /end MEASUREMENT
/begin MEASUREMENT MAIN_MSGu8BMS1_buf[5] "MAIN_MSGu8BMS1_buf[5]" UBYTE Id_0x00 1 2 0 255 ECU_ADDRESS 0x0 /end MEASUREMENT
/begin MEASUREMENT MAIN_MSGu8BMS1_buf[6] "MAIN_MSGu8BMS1_buf[6]" UBYTE Id_0x00 1 2 0 255 ECU_ADDRESS 0x0 /end MEASUREMENT
/begin MEASUREMENT MAIN_MSGu8BMS1_buf[7] "MAIN_MSGu8BMS1_buf[7]" UBYTE Id_0x00 1 2 0 255 ECU_ADDRESS 0x0 /end MEASUREMENT
/begin MEASUREMENT MAIN_MSGu8BMS3_buf "-" UBYTE Id_0x00 1 2 0 255 MATRIX_DIM 8 1 1 ECU_ADDRESS 0x0 /end MEASUREMENT
/begin MEASUREMENT MAIN_MSGu8BMS3_buf[0] "MAIN_MSGu8BMS3_buf[0]" UBYTE Id_0x00 1 2 0 255 ECU_ADDRESS 0x0 /end MEASUREMENT
/begin MEASUREMENT MAIN_MSGu8BMS3_buf[1] "MAIN_MSGu8BMS3_buf[1]" UBYTE Id_0x00 1 2 0 255 ECU_ADDRESS 0x0 /end MEASUREMENT
/begin MEASUREMENT MAIN_MSGu8BMS3_buf[2] "MAIN_MSGu8BMS3_buf[2]" UBYTE Id_0x00 1 2 0 255 ECU_ADDRESS 0x0 /end MEASUREMENT
/begin MEASUREMENT MAIN_MSGu8BMS3_buf[3] "MAIN_MSGu8BMS3_buf[3]" UBYTE Id_0x00 1 2 0 255 ECU_ADDRESS 0x0 /end MEASUREMENT
/begin MEASUREMENT MAIN_MSGu8BMS3_buf[4] "MAIN_MSGu8BMS3_buf[4]" UBYTE Id_0x00 1 2 0 255 ECU_ADDRESS 0x0 /end MEASUREMENT
/begin MEASUREMENT MAIN_MSGu8BMS3_buf[5] "MAIN_MSGu8BMS3_buf[5]" UBYTE Id_0x00 1 2 0 255 ECU_ADDRESS 0x0 /end MEASUREMENT
/begin MEASUREMENT MAIN_MSGu8BMS3_buf[6] "MAIN_MSGu8BMS3_buf[6]" UBYTE Id_0x00 1 2 0 255 ECU_ADDRESS 0x0 /end MEASUREMENT
/begin MEASUREMENT MAIN_MSGu8BMS3_buf[7] "MAIN_MSGu8BMS3_buf[7]" UBYTE Id_0x00 1 2 0 255 ECU_ADDRESS 0x0 /end MEASUREMENT
/begin MEASUREMENT MAIN_MSGu8BMS4_buf "-" UBYTE Id_0x00 1 2 0 255 MATRIX_DIM 8 1 1 ECU_ADDRESS 0x0 /end MEASUREMENT
/begin MEASUREMENT MAIN_MSGu8BMS4_buf[0] "MAIN_MSGu8BMS4_buf[0]" UBYTE Id_0x00 1 2 0 255 ECU_ADDRESS 0x0 /end MEASUREMENT
/begin MEASUREMENT MAIN_MSGu8BMS4_buf[1] "MAIN_MSGu8BMS4_buf[1]" UBYTE Id_0x00 1 2 0 255 ECU_ADDRESS 0x0 /end MEASUREMENT
/begin MEASUREMENT MAIN_MSGu8BMS4_buf[2] "MAIN_MSGu8BMS4_buf[2]" UBYTE Id_0x00 1 2 0 255 ECU_ADDRESS 0x0 /end MEASUREMENT
/begin MEASUREMENT MAIN_MSGu8BMS4_buf[3] "MAIN_MSGu8BMS4_buf[3]" UBYTE Id_0x00 1 2 0 255 ECU_ADDRESS 0x0 /end MEASUREMENT
/begin MEASUREMENT MAIN_MSGu8BMS4_buf[4] "MAIN_MSGu8BMS4_buf[4]" UBYTE Id_0x00 1 2 0 255 ECU_ADDRESS 0x0 /end MEASUREMENT
/begin MEASUREMENT MAIN_MSGu8BMS4_buf[5] "MAIN_MSGu8BMS4_buf[5]" UBYTE Id_0x00 1 2 0 255 ECU_ADDRESS 0x0 /end MEASUREMENT
/begin MEASUREMENT MAIN_MSGu8BMS4_buf[6] "MAIN_MSGu8BMS4_buf[6]" UBYTE Id_0x00 1 2 0 255 ECU_ADDRESS 0x0 /end MEASUREMENT
/begin MEASUREMENT MAIN_MSGu8BMS4_buf[7] "MAIN_MSGu8BMS4_buf[7]" UBYTE Id_0x00 1 2 0 255 ECU_ADDRESS 0x0 /end MEASUREMENT
/begin MEASUREMENT MAIN_MSGu8BMS7_buf "-" UBYTE Id_0x00 1 2 0 255 MATRIX_DIM 8 1 1 ECU_ADDRESS 0x0 /end MEASUREMENT
/begin MEASUREMENT MAIN_MSGu8BMS7_buf[0] "MAIN_MSGu8BMS7_buf[0]" UBYTE Id_0x00 1 2 0 255 ECU_ADDRESS 0x0 /end MEASUREMENT
/begin MEASUREMENT MAIN_MSGu8BMS7_buf[1] "MAIN_MSGu8BMS7_buf[1]" UBYTE Id_0x00 1 2 0 255 ECU_ADDRESS 0x0 /end MEASUREMENT
/begin MEASUREMENT MAIN_MSGu8BMS7_buf[2] "MAIN_MSGu8BMS7_buf[2]" UBYTE Id_0x00 1 2 0 255 ECU_ADDRESS 0x0 /end MEASUREMENT
/begin MEASUREMENT MAIN_MSGu8BMS7_buf[3] "MAIN_MSGu8BMS7_buf[3]" UBYTE Id_0x00 1 2 0 255 ECU_ADDRESS 0x0 /end MEASUREMENT
/begin MEASUREMENT MAIN_MSGu8BMS7_buf[4] "MAIN_MSGu8BMS7_buf[4]" UBYTE Id_0x00 1 2 0 255 ECU_ADDRESS 0x0 /end MEASUREMENT
/begin MEASUREMENT MAIN_MSGu8BMS7_buf[5] "MAIN_MSGu8BMS7_buf[5]" UBYTE Id_0x00 1 2 0 255 ECU_ADDRESS 0x0 /end MEASUREMENT
/begin MEASUREMENT MAIN_MSGu8BMS7_buf[6] "MAIN_MSGu8BMS7_buf[6]" UBYTE Id_0x00 1 2 0 255 ECU_ADDRESS 0x0 /end MEASUREMENT
/begin MEASUREMENT MAIN_MSGu8BMS7_buf[7] "MAIN_MSGu8BMS7_buf[7]" UBYTE Id_0x00 1 2 0 255 ECU_ADDRESS 0x0 /end MEASUREMENT
/begin MEASUREMENT MAIN_MSGu8BMS_MainNegConnSts "..." UBYTE I_1 1 2 0 255 ECU_ADDRESS 0x0 /end MEASUREMENT
/begin MEASUREMENT MAIN_MSGu8BMS_MainPosConnSts "..." UBYTE I_1 1 2 0 255 ECU_ADDRESS 0x0 /end MEASUREMENT
/begin MEASUREMENT MAIN_MSGu8BMS_SOCCalculate "..." UBYTE I_1 1 2 0 255 ECU_ADDRESS 0x0 /end MEASUREMENT
/begin MEASUREMENT MAIN_MSGu8CCP_CurrentSts "..." UBYTE I_1 1 2 0 255 ECU_ADDRESS 0x0 /end MEASUREMENT
/begin MEASUREMENT MAIN_MSGu8CCP_FaultCode "..." UBYTE I_1 1 2 0 255 ECU_ADDRESS 0x0 /end MEASUREMENT
/begin MEASUREMENT MAIN_MSGu8CCP_FaultLevel "..." UBYTE I_1 1 2 0 255 ECU_ADDRESS 0x0 /end MEASUREMENT
/begin MEASUREMENT MAIN_MSGu8CCP_PwrStgMode "..." UBYTE I_1 1 2 0 255 ECU_ADDRESS 0x0 /end MEASUREMENT
/begin MEASUREMENT MAIN_MSGu8CCP_PwrStgPosSts "..." UBYTE I_1 1 2 0 255 ECU_ADDRESS 0x0 /end MEASUREMENT
/begin MEASUREMENT MAIN_MSGu8CCP_PwrStgSts "..." UBYTE I_1 1 2 0 255 ECU_ADDRESS 0x0 /end MEASUREMENT
/begin MEASUREMENT MAIN_MSGu8CCP_TargetMotSts "..." UBYTE I_1 1 2 0 255 ECU_ADDRESS 0x0 /end MEASUREMENT
/begin MEASUREMENT MAIN_MSGu8CCp_5VSupplyRaw "..." UBYTE I_1 1 2 0 255 ECU_ADDRESS 0x0 /end MEASUREMENT
/begin MEASUREMENT MAIN_MSGu8CCp_PwrStgTempRaw "..." UBYTE I_1 1 2 0 255 ECU_ADDRESS 0x0 /end MEASUREMENT
/begin MEASUREMENT MAIN_MSGu8Checksum30A "..." UBYTE I_1 1 2 0 255 ECU_ADDRESS 0x0 /end MEASUREMENT
/begin MEASUREMENT MAIN_MSGu8CompileDay "..." UBYTE I_1 1 2 0 255 ECU_ADDRESS 0x0 /end MEASUREMENT
/begin MEASUREMENT MAIN_MSGu8CompileMonth "..." UBYTE I_1 1 2 0 255 ECU_ADDRESS 0x0 /end MEASUREMENT
/begin MEASUREMENT MAIN_MSGu8CompileYear "..." UBYTE I_1 1 2 0 255 ECU_ADDRESS 0x0 /end MEASUREMENT
/begin MEASUREMENT MAIN_MSGu8DCU_FltLev "..." UBYTE I_1 1 2 0 255 ECU_ADDRESS 0x0 /end MEASUREMENT
/begin MEASUREMENT MAIN_MSGu8DCU_OfsAlCalSts "..." UBYTE I_1 1 2 0 255 ECU_ADDRESS 0x0 /end MEASUREMENT
/begin MEASUREMENT MAIN_MSGu8DEV_Fault0 "..." UBYTE I_1 1 2 0 255 ECU_ADDRESS 0x0 /end MEASUREMENT
/begin MEASUREMENT MAIN_MSGu8DEV_Fault1 "..." UBYTE I_1 1 2 0 255 ECU_ADDRESS 0x0 /end MEASUREMENT
/begin MEASUREMENT MAIN_MSGu8DEV_Fault10 "..." UBYTE I_1 1 2 0 255 ECU_ADDRESS 0x0 /end MEASUREMENT
/begin MEASUREMENT MAIN_MSGu8DEV_Fault11 "..." UBYTE I_1 1 2 0 255 ECU_ADDRESS 0x0 /end MEASUREMENT
/begin MEASUREMENT MAIN_MSGu8DEV_Fault12 "..." UBYTE I_1 1 2 0 255 ECU_ADDRESS 0x0 /end MEASUREMENT
/begin MEASUREMENT MAIN_MSGu8DEV_Fault13 "..." UBYTE I_1 1 2 0 255 ECU_ADDRESS 0x0 /end MEASUREMENT
/begin MEASUREMENT MAIN_MSGu8DEV_Fault14 "..." UBYTE I_1 1 2 0 255 ECU_ADDRESS 0x0 /end MEASUREMENT
/begin MEASUREMENT MAIN_MSGu8DEV_Fault15 "..." UBYTE I_1 1 2 0 255 ECU_ADDRESS 0x0 /end MEASUREMENT
/begin MEASUREMENT MAIN_MSGu8DEV_Fault2 "..." UBYTE I_1 1 2 0 255 ECU_ADDRESS 0x0 /end MEASUREMENT
/begin MEASUREMENT MAIN_MSGu8DEV_Fault3 "..." UBYTE I_1 1 2 0 255 ECU_ADDRESS 0x0 /end MEASUREMENT
/begin MEASUREMENT MAIN_MSGu8DEV_Fault4 "..." UBYTE I_1 1 2 0 255 ECU_ADDRESS 0x0 /end MEASUREMENT
/begin MEASUREMENT MAIN_MSGu8DEV_Fault5 "..." UBYTE I_1 1 2 0 255 ECU_ADDRESS 0x0 /end MEASUREMENT
/begin MEASUREMENT MAIN_MSGu8DEV_Fault6 "..." UBYTE I_1 1 2 0 255 ECU_ADDRESS 0x0 /end MEASUREMENT
/begin MEASUREMENT MAIN_MSGu8DEV_Fault7 "..." UBYTE I_1 1 2 0 255 ECU_ADDRESS 0x0 /end MEASUREMENT
/begin MEASUREMENT MAIN_MSGu8DEV_Fault8 "..." UBYTE I_1 1 2 0 255 ECU_ADDRESS 0x0 /end MEASUREMENT
/begin MEASUREMENT MAIN_MSGu8DEV_Fault9 "..." UBYTE I_1 1 2 0 255 ECU_ADDRESS 0x0 /end MEASUREMENT
/begin MEASUREMENT MAIN_MSGu8EMS0_buf "-" UBYTE Id_0x00 1 2 0 255 MATRIX_DIM 8 1 1 ECU_ADDRESS 0x0 /end MEASUREMENT
/begin MEASUREMENT MAIN_MSGu8EMS0_buf[0] "MAIN_MSGu8EMS0_buf[0]" UBYTE Id_0x00 1 2 0 255 ECU_ADDRESS 0x0 /end MEASUREMENT
/begin MEASUREMENT MAIN_MSGu8EMS0_buf[1] "MAIN_MSGu8EMS0_buf[1]" UBYTE Id_0x00 1 2 0 255 ECU_ADDRESS 0x0 /end MEASUREMENT
/begin MEASUREMENT MAIN_MSGu8EMS0_buf[2] "MAIN_MSGu8EMS0_buf[2]" UBYTE Id_0x00 1 2 0 255 ECU_ADDRESS 0x0 /end MEASUREMENT
/begin MEASUREMENT MAIN_MSGu8EMS0_buf[3] "MAIN_MSGu8EMS0_buf[3]" UBYTE Id_0x00 1 2 0 255 ECU_ADDRESS 0x0 /end MEASUREMENT
/begin MEASUREMENT MAIN_MSGu8EMS0_buf[4] "MAIN_MSGu8EMS0_buf[4]" UBYTE Id_0x00 1 2 0 255 ECU_ADDRESS 0x0 /end MEASUREMENT
/begin MEASUREMENT MAIN_MSGu8EMS0_buf[5] "MAIN_MSGu8EMS0_buf[5]" UBYTE Id_0x00 1 2 0 255 ECU_ADDRESS 0x0 /end MEASUREMENT
/begin MEASUREMENT MAIN_MSGu8EMS0_buf[6] "MAIN_MSGu8EMS0_buf[6]" UBYTE Id_0x00 1 2 0 255 ECU_ADDRESS 0x0 /end MEASUREMENT
/begin MEASUREMENT MAIN_MSGu8EMS0_buf[7] "MAIN_MSGu8EMS0_buf[7]" UBYTE Id_0x00 1 2 0 255 ECU_ADDRESS 0x0 /end MEASUREMENT
/begin MEASUREMENT MAIN_MSGu8EMS1_buf "-" UBYTE Id_0x00 1 2 0 255 MATRIX_DIM 8 1 1 ECU_ADDRESS 0x0 /end MEASUREMENT
/begin MEASUREMENT MAIN_MSGu8EMS1_buf[0] "MAIN_MSGu8EMS1_buf[0]" UBYTE Id_0x00 1 2 0 255 ECU_ADDRESS 0x0 /end MEASUREMENT
/begin MEASUREMENT MAIN_MSGu8EMS1_buf[1] "MAIN_MSGu8EMS1_buf[1]" UBYTE Id_0x00 1 2 0 255 ECU_ADDRESS 0x0 /end MEASUREMENT
/begin MEASUREMENT MAIN_MSGu8EMS1_buf[2] "MAIN_MSGu8EMS1_buf[2]" UBYTE Id_0x00 1 2 0 255 ECU_ADDRESS 0x0 /end MEASUREMENT
/begin MEASUREMENT MAIN_MSGu8EMS1_buf[3] "MAIN_MSGu8EMS1_buf[3]" UBYTE Id_0x00 1 2 0 255 ECU_ADDRESS 0x0 /end MEASUREMENT
/begin MEASUREMENT MAIN_MSGu8EMS1_buf[4] "MAIN_MSGu8EMS1_buf[4]" UBYTE Id_0x00 1 2 0 255 ECU_ADDRESS 0x0 /end MEASUREMENT
/begin MEASUREMENT MAIN_MSGu8EMS1_buf[5] "MAIN_MSGu8EMS1_buf[5]" UBYTE Id_0x00 1 2 0 255 ECU_ADDRESS 0x0 /end MEASUREMENT
/begin MEASUREMENT MAIN_MSGu8EMS1_buf[6] "MAIN_MSGu8EMS1_buf[6]" UBYTE Id_0x00 1 2 0 255 ECU_ADDRESS 0x0 /end MEASUREMENT
/begin MEASUREMENT MAIN_MSGu8EMS1_buf[7] "MAIN_MSGu8EMS1_buf[7]" UBYTE Id_0x00 1 2 0 255 ECU_ADDRESS 0x0 /end MEASUREMENT
/begin MEASUREMENT MAIN_MSGu8EMS2_buf "-" UBYTE Id_0x00 1 2 0 255 MATRIX_DIM 8 1 1 ECU_ADDRESS 0x0 /end MEASUREMENT
/begin MEASUREMENT MAIN_MSGu8EMS2_buf[0] "MAIN_MSGu8EMS2_buf[0]" UBYTE Id_0x00 1 2 0 255 ECU_ADDRESS 0x0 /end MEASUREMENT
/begin MEASUREMENT MAIN_MSGu8EMS2_buf[1] "MAIN_MSGu8EMS2_buf[1]" UBYTE Id_0x00 1 2 0 255 ECU_ADDRESS 0x0 /end MEASUREMENT
/begin MEASUREMENT MAIN_MSGu8EMS2_buf[2] "MAIN_MSGu8EMS2_buf[2]" UBYTE Id_0x00 1 2 0 255 ECU_ADDRESS 0x0 /end MEASUREMENT
/begin MEASUREMENT MAIN_MSGu8EMS2_buf[3] "MAIN_MSGu8EMS2_buf[3]" UBYTE Id_0x00 1 2 0 255 ECU_ADDRESS 0x0 /end MEASUREMENT
/begin MEASUREMENT MAIN_MSGu8EMS2_buf[4] "MAIN_MSGu8EMS2_buf[4]" UBYTE Id_0x00 1 2 0 255 ECU_ADDRESS 0x0 /end MEASUREMENT
/begin MEASUREMENT MAIN_MSGu8EMS2_buf[5] "MAIN_MSGu8EMS2_buf[5]" UBYTE Id_0x00 1 2 0 255 ECU_ADDRESS 0x0 /end MEASUREMENT
/begin MEASUREMENT MAIN_MSGu8EMS2_buf[6] "MAIN_MSGu8EMS2_buf[6]" UBYTE Id_0x00 1 2 0 255 ECU_ADDRESS 0x0 /end MEASUREMENT
/begin MEASUREMENT MAIN_MSGu8EMS2_buf[7] "MAIN_MSGu8EMS2_buf[7]" UBYTE Id_0x00 1 2 0 255 ECU_ADDRESS 0x0 /end MEASUREMENT
/begin MEASUREMENT MAIN_MSGu8EMS7_buf "-" UBYTE Id_0x00 1 2 0 255 MATRIX_DIM 8 1 1 ECU_ADDRESS 0x0 /end MEASUREMENT
/begin MEASUREMENT MAIN_MSGu8EMS7_buf[0] "MAIN_MSGu8EMS7_buf[0]" UBYTE Id_0x00 1 2 0 255 ECU_ADDRESS 0x0 /end MEASUREMENT
/begin MEASUREMENT MAIN_MSGu8EMS7_buf[1] "MAIN_MSGu8EMS7_buf[1]" UBYTE Id_0x00 1 2 0 255 ECU_ADDRESS 0x0 /end MEASUREMENT
/begin MEASUREMENT MAIN_MSGu8EMS7_buf[2] "MAIN_MSGu8EMS7_buf[2]" UBYTE Id_0x00 1 2 0 255 ECU_ADDRESS 0x0 /end MEASUREMENT
/begin MEASUREMENT MAIN_MSGu8EMS7_buf[3] "MAIN_MSGu8EMS7_buf[3]" UBYTE Id_0x00 1 2 0 255 ECU_ADDRESS 0x0 /end MEASUREMENT
/begin MEASUREMENT MAIN_MSGu8EMS7_buf[4] "MAIN_MSGu8EMS7_buf[4]" UBYTE Id_0x00 1 2 0 255 ECU_ADDRESS 0x0 /end MEASUREMENT
/begin MEASUREMENT MAIN_MSGu8EMS7_buf[5] "MAIN_MSGu8EMS7_buf[5]" UBYTE Id_0x00 1 2 0 255 ECU_ADDRESS 0x0 /end MEASUREMENT
/begin MEASUREMENT MAIN_MSGu8EMS7_buf[6] "MAIN_MSGu8EMS7_buf[6]" UBYTE Id_0x00 1 2 0 255 ECU_ADDRESS 0x0 /end MEASUREMENT
/begin MEASUREMENT MAIN_MSGu8EMS7_buf[7] "MAIN_MSGu8EMS7_buf[7]" UBYTE Id_0x00 1 2 0 255 ECU_ADDRESS 0x0 /end MEASUREMENT
/begin MEASUREMENT MAIN_MSGu8EMS8_buf "-" UBYTE Id_0x00 1 2 0 255 MATRIX_DIM 8 1 1 ECU_ADDRESS 0x0 /end MEASUREMENT
/begin MEASUREMENT MAIN_MSGu8EMS8_buf[0] "MAIN_MSGu8EMS8_buf[0]" UBYTE Id_0x00 1 2 0 255 ECU_ADDRESS 0x0 /end MEASUREMENT
/begin MEASUREMENT MAIN_MSGu8EMS8_buf[1] "MAIN_MSGu8EMS8_buf[1]" UBYTE Id_0x00 1 2 0 255 ECU_ADDRESS 0x0 /end MEASUREMENT
/begin MEASUREMENT MAIN_MSGu8EMS8_buf[2] "MAIN_MSGu8EMS8_buf[2]" UBYTE Id_0x00 1 2 0 255 ECU_ADDRESS 0x0 /end MEASUREMENT
/begin MEASUREMENT MAIN_MSGu8EMS8_buf[3] "MAIN_MSGu8EMS8_buf[3]" UBYTE Id_0x00 1 2 0 255 ECU_ADDRESS 0x0 /end MEASUREMENT
/begin MEASUREMENT MAIN_MSGu8EMS8_buf[4] "MAIN_MSGu8EMS8_buf[4]" UBYTE Id_0x00 1 2 0 255 ECU_ADDRESS 0x0 /end MEASUREMENT
/begin MEASUREMENT MAIN_MSGu8EMS8_buf[5] "MAIN_MSGu8EMS8_buf[5]" UBYTE Id_0x00 1 2 0 255 ECU_ADDRESS 0x0 /end MEASUREMENT
/begin MEASUREMENT MAIN_MSGu8EMS8_buf[6] "MAIN_MSGu8EMS8_buf[6]" UBYTE Id_0x00 1 2 0 255 ECU_ADDRESS 0x0 /end MEASUREMENT
/begin MEASUREMENT MAIN_MSGu8EMS8_buf[7] "MAIN_MSGu8EMS8_buf[7]" UBYTE Id_0x00 1 2 0 255 ECU_ADDRESS 0x0 /end MEASUREMENT
/begin MEASUREMENT MAIN_MSGu8EMS_AccPedPos1NormRawRaw "..." UBYTE I_1 1 2 0 255 ECU_ADDRESS 0x0 /end MEASUREMENT
/begin MEASUREMENT MAIN_MSGu8EMS_CalcuLoadValueRaw "..." UBYTE I_1 1 2 0 255 ECU_ADDRESS 0x0 /end MEASUREMENT
/begin MEASUREMENT MAIN_MSGu8EMS_CheckSum_EMS1 "..." UBYTE I_1 1 2 0 255 ECU_ADDRESS 0x0 /end MEASUREMENT
/begin MEASUREMENT MAIN_MSGu8EMS_CheckSum_EMS2 "..." UBYTE I_1 1 2 0 255 ECU_ADDRESS 0x0 /end MEASUREMENT
/begin MEASUREMENT MAIN_MSGu8EMS_CheckSum_EMS7 "..." UBYTE I_1 1 2 0 255 ECU_ADDRESS 0x0 /end MEASUREMENT
/begin MEASUREMENT MAIN_MSGu8EMS_CheckSum_EMS8 "..." UBYTE I_1 1 2 0 255 ECU_ADDRESS 0x0 /end MEASUREMENT
/begin MEASUREMENT MAIN_MSGu8EMS_CheckSum_EMS_P3 "..." UBYTE I_1 1 2 0 255 ECU_ADDRESS 0x0 /end MEASUREMENT
/begin MEASUREMENT MAIN_MSGu8EMS_EngCoolantTempRaw "..." UBYTE I_1 1 2 0 255 ECU_ADDRESS 0x0 /end MEASUREMENT
/begin MEASUREMENT MAIN_MSGu8EMS_P3_buf "-" UBYTE Id_0x00 1 2 0 255 MATRIX_DIM 8 1 1 ECU_ADDRESS 0x0 /end MEASUREMENT
/begin MEASUREMENT MAIN_MSGu8EMS_P3_buf[0] "MAIN_MSGu8EMS_P3_buf[0]" UBYTE Id_0x00 1 2 0 255 ECU_ADDRESS 0x0 /end MEASUREMENT
/begin MEASUREMENT MAIN_MSGu8EMS_P3_buf[1] "MAIN_MSGu8EMS_P3_buf[1]" UBYTE Id_0x00 1 2 0 255 ECU_ADDRESS 0x0 /end MEASUREMENT
/begin MEASUREMENT MAIN_MSGu8EMS_P3_buf[2] "MAIN_MSGu8EMS_P3_buf[2]" UBYTE Id_0x00 1 2 0 255 ECU_ADDRESS 0x0 /end MEASUREMENT
/begin MEASUREMENT MAIN_MSGu8EMS_P3_buf[3] "MAIN_MSGu8EMS_P3_buf[3]" UBYTE Id_0x00 1 2 0 255 ECU_ADDRESS 0x0 /end MEASUREMENT
/begin MEASUREMENT MAIN_MSGu8EMS_P3_buf[4] "MAIN_MSGu8EMS_P3_buf[4]" UBYTE Id_0x00 1 2 0 255 ECU_ADDRESS 0x0 /end MEASUREMENT
/begin MEASUREMENT MAIN_MSGu8EMS_P3_buf[5] "MAIN_MSGu8EMS_P3_buf[5]" UBYTE Id_0x00 1 2 0 255 ECU_ADDRESS 0x0 /end MEASUREMENT
/begin MEASUREMENT MAIN_MSGu8EMS_P3_buf[6] "MAIN_MSGu8EMS_P3_buf[6]" UBYTE Id_0x00 1 2 0 255 ECU_ADDRESS 0x0 /end MEASUREMENT
/begin MEASUREMENT MAIN_MSGu8EMS_P3_buf[7] "MAIN_MSGu8EMS_P3_buf[7]" UBYTE Id_0x00 1 2 0 255 ECU_ADDRESS 0x0 /end MEASUREMENT
/begin MEASUREMENT MAIN_MSGu8EMS_PowertrainControlSt "..." UBYTE I_1 1 2 0 255 ECU_ADDRESS 0x0 /end MEASUREMENT
/begin MEASUREMENT MAIN_MSGu8EMS_RollingCount_EMS1 "..." UBYTE I_1 1 2 0 255 ECU_ADDRESS 0x0 /end MEASUREMENT
/begin MEASUREMENT MAIN_MSGu8EMS_RollingCount_EMS2 "..." UBYTE I_1 1 2 0 255 ECU_ADDRESS 0x0 /end MEASUREMENT
/begin MEASUREMENT MAIN_MSGu8EMS_RollingCount_EMS7 "..." UBYTE I_1 1 2 0 255 ECU_ADDRESS 0x0 /end MEASUREMENT
/begin MEASUREMENT MAIN_MSGu8EMS_RollingCount_EMS8 "..." UBYTE I_1 1 2 0 255 ECU_ADDRESS 0x0 /end MEASUREMENT
/begin MEASUREMENT MAIN_MSGu8EMS_RollingCount_EMS_P3 "..." UBYTE I_1 1 2 0 255 ECU_ADDRESS 0x0 /end MEASUREMENT
/begin MEASUREMENT MAIN_MSGu8GCU1_buf "-" UBYTE Id_0x00 1 2 0 255 MATRIX_DIM 8 1 1 ECU_ADDRESS 0x0 /end MEASUREMENT
/begin MEASUREMENT MAIN_MSGu8GCU1_buf[0] "MAIN_MSGu8GCU1_buf[0]" UBYTE Id_0x00 1 2 0 255 ECU_ADDRESS 0x0 /end MEASUREMENT
/begin MEASUREMENT MAIN_MSGu8GCU1_buf[1] "MAIN_MSGu8GCU1_buf[1]" UBYTE Id_0x00 1 2 0 255 ECU_ADDRESS 0x0 /end MEASUREMENT
/begin MEASUREMENT MAIN_MSGu8GCU1_buf[2] "MAIN_MSGu8GCU1_buf[2]" UBYTE Id_0x00 1 2 0 255 ECU_ADDRESS 0x0 /end MEASUREMENT
/begin MEASUREMENT MAIN_MSGu8GCU1_buf[3] "MAIN_MSGu8GCU1_buf[3]" UBYTE Id_0x00 1 2 0 255 ECU_ADDRESS 0x0 /end MEASUREMENT
/begin MEASUREMENT MAIN_MSGu8GCU1_buf[4] "MAIN_MSGu8GCU1_buf[4]" UBYTE Id_0x00 1 2 0 255 ECU_ADDRESS 0x0 /end MEASUREMENT
/begin MEASUREMENT MAIN_MSGu8GCU1_buf[5] "MAIN_MSGu8GCU1_buf[5]" UBYTE Id_0x00 1 2 0 255 ECU_ADDRESS 0x0 /end MEASUREMENT
/begin MEASUREMENT MAIN_MSGu8GCU1_buf[6] "MAIN_MSGu8GCU1_buf[6]" UBYTE Id_0x00 1 2 0 255 ECU_ADDRESS 0x0 /end MEASUREMENT
/begin MEASUREMENT MAIN_MSGu8GCU1_buf[7] "MAIN_MSGu8GCU1_buf[7]" UBYTE Id_0x00 1 2 0 255 ECU_ADDRESS 0x0 /end MEASUREMENT
/begin MEASUREMENT MAIN_MSGu8GCU2_buf "-" UBYTE Id_0x00 1 2 0 255 MATRIX_DIM 8 1 1 ECU_ADDRESS 0x0 /end MEASUREMENT
/begin MEASUREMENT MAIN_MSGu8GCU2_buf[0] "MAIN_MSGu8GCU2_buf[0]" UBYTE Id_0x00 1 2 0 255 ECU_ADDRESS 0x0 /end MEASUREMENT
/begin MEASUREMENT MAIN_MSGu8GCU2_buf[1] "MAIN_MSGu8GCU2_buf[1]" UBYTE Id_0x00 1 2 0 255 ECU_ADDRESS 0x0 /end MEASUREMENT
/begin MEASUREMENT MAIN_MSGu8GCU2_buf[2] "MAIN_MSGu8GCU2_buf[2]" UBYTE Id_0x00 1 2 0 255 ECU_ADDRESS 0x0 /end MEASUREMENT
/begin MEASUREMENT MAIN_MSGu8GCU2_buf[3] "MAIN_MSGu8GCU2_buf[3]" UBYTE Id_0x00 1 2 0 255 ECU_ADDRESS 0x0 /end MEASUREMENT
/begin MEASUREMENT MAIN_MSGu8GCU2_buf[4] "MAIN_MSGu8GCU2_buf[4]" UBYTE Id_0x00 1 2 0 255 ECU_ADDRESS 0x0 /end MEASUREMENT
/begin MEASUREMENT MAIN_MSGu8GCU2_buf[5] "MAIN_MSGu8GCU2_buf[5]" UBYTE Id_0x00 1 2 0 255 ECU_ADDRESS 0x0 /end MEASUREMENT
/begin MEASUREMENT MAIN_MSGu8GCU2_buf[6] "MAIN_MSGu8GCU2_buf[6]" UBYTE Id_0x00 1 2 0 255 ECU_ADDRESS 0x0 /end MEASUREMENT
/begin MEASUREMENT MAIN_MSGu8GCU2_buf[7] "MAIN_MSGu8GCU2_buf[7]" UBYTE Id_0x00 1 2 0 255 ECU_ADDRESS 0x0 /end MEASUREMENT
/begin MEASUREMENT MAIN_MSGu8GCU3_buf "-" UBYTE Id_0x00 1 2 0 255 MATRIX_DIM 8 1 1 ECU_ADDRESS 0x0 /end MEASUREMENT
/begin MEASUREMENT MAIN_MSGu8GCU3_buf[0] "MAIN_MSGu8GCU3_buf[0]" UBYTE Id_0x00 1 2 0 255 ECU_ADDRESS 0x0 /end MEASUREMENT
/begin MEASUREMENT MAIN_MSGu8GCU3_buf[1] "MAIN_MSGu8GCU3_buf[1]" UBYTE Id_0x00 1 2 0 255 ECU_ADDRESS 0x0 /end MEASUREMENT
/begin MEASUREMENT MAIN_MSGu8GCU3_buf[2] "MAIN_MSGu8GCU3_buf[2]" UBYTE Id_0x00 1 2 0 255 ECU_ADDRESS 0x0 /end MEASUREMENT
/begin MEASUREMENT MAIN_MSGu8GCU3_buf[3] "MAIN_MSGu8GCU3_buf[3]" UBYTE Id_0x00 1 2 0 255 ECU_ADDRESS 0x0 /end MEASUREMENT
/begin MEASUREMENT MAIN_MSGu8GCU3_buf[4] "MAIN_MSGu8GCU3_buf[4]" UBYTE Id_0x00 1 2 0 255 ECU_ADDRESS 0x0 /end MEASUREMENT
/begin MEASUREMENT MAIN_MSGu8GCU3_buf[5] "MAIN_MSGu8GCU3_buf[5]" UBYTE Id_0x00 1 2 0 255 ECU_ADDRESS 0x0 /end MEASUREMENT
/begin MEASUREMENT MAIN_MSGu8GCU3_buf[6] "MAIN_MSGu8GCU3_buf[6]" UBYTE Id_0x00 1 2 0 255 ECU_ADDRESS 0x0 /end MEASUREMENT
/begin MEASUREMENT MAIN_MSGu8GCU3_buf[7] "MAIN_MSGu8GCU3_buf[7]" UBYTE Id_0x00 1 2 0 255 ECU_ADDRESS 0x0 /end MEASUREMENT
/begin MEASUREMENT MAIN_MSGu8GCU4_buf "-" UBYTE Id_0x00 1 2 0 255 MATRIX_DIM 8 1 1 ECU_ADDRESS 0x0 /end MEASUREMENT
/begin MEASUREMENT MAIN_MSGu8GCU4_buf[0] "MAIN_MSGu8GCU4_buf[0]" UBYTE Id_0x00 1 2 0 255 ECU_ADDRESS 0x0 /end MEASUREMENT
/begin MEASUREMENT MAIN_MSGu8GCU4_buf[1] "MAIN_MSGu8GCU4_buf[1]" UBYTE Id_0x00 1 2 0 255 ECU_ADDRESS 0x0 /end MEASUREMENT
/begin MEASUREMENT MAIN_MSGu8GCU4_buf[2] "MAIN_MSGu8GCU4_buf[2]" UBYTE Id_0x00 1 2 0 255 ECU_ADDRESS 0x0 /end MEASUREMENT
/begin MEASUREMENT MAIN_MSGu8GCU4_buf[3] "MAIN_MSGu8GCU4_buf[3]" UBYTE Id_0x00 1 2 0 255 ECU_ADDRESS 0x0 /end MEASUREMENT
/begin MEASUREMENT MAIN_MSGu8GCU4_buf[4] "MAIN_MSGu8GCU4_buf[4]" UBYTE Id_0x00 1 2 0 255 ECU_ADDRESS 0x0 /end MEASUREMENT
/begin MEASUREMENT MAIN_MSGu8GCU4_buf[5] "MAIN_MSGu8GCU4_buf[5]" UBYTE Id_0x00 1 2 0 255 ECU_ADDRESS 0x0 /end MEASUREMENT
/begin MEASUREMENT MAIN_MSGu8GCU4_buf[6] "MAIN_MSGu8GCU4_buf[6]" UBYTE Id_0x00 1 2 0 255 ECU_ADDRESS 0x0 /end MEASUREMENT
/begin MEASUREMENT MAIN_MSGu8GCU4_buf[7] "MAIN_MSGu8GCU4_buf[7]" UBYTE Id_0x00 1 2 0 255 ECU_ADDRESS 0x0 /end MEASUREMENT
/begin MEASUREMENT MAIN_MSGu8GCU_CheckSum111 "..." UBYTE I_1 1 2 0 255 ECU_ADDRESS 0x0 /end MEASUREMENT
/begin MEASUREMENT MAIN_MSGu8GCU_CheckSum_GCU1 "..." UBYTE I_1 1 2 0 255 ECU_ADDRESS 0x0 /end MEASUREMENT
/begin MEASUREMENT MAIN_MSGu8GCU_CheckSum_GCU3 "..." UBYTE I_1 1 2 0 255 ECU_ADDRESS 0x0 /end MEASUREMENT
/begin MEASUREMENT MAIN_MSGu8GCU_ControllerTempRaw "..." UBYTE I_1 1 2 0 255 ECU_ADDRESS 0x0 /end MEASUREMENT
/begin MEASUREMENT MAIN_MSGu8GCU_Fault_buf "-" UBYTE Id_0x00 1 2 0 255 MATRIX_DIM 8 1 1 ECU_ADDRESS 0x0 /end MEASUREMENT
/begin MEASUREMENT MAIN_MSGu8GCU_Fault_buf[0] "MAIN_MSGu8GCU_Fault_buf[0]" UBYTE Id_0x00 1 2 0 255 ECU_ADDRESS 0x0 /end MEASUREMENT
/begin MEASUREMENT MAIN_MSGu8GCU_Fault_buf[1] "MAIN_MSGu8GCU_Fault_buf[1]" UBYTE Id_0x00 1 2 0 255 ECU_ADDRESS 0x0 /end MEASUREMENT
/begin MEASUREMENT MAIN_MSGu8GCU_Fault_buf[2] "MAIN_MSGu8GCU_Fault_buf[2]" UBYTE Id_0x00 1 2 0 255 ECU_ADDRESS 0x0 /end MEASUREMENT
/begin MEASUREMENT MAIN_MSGu8GCU_Fault_buf[3] "MAIN_MSGu8GCU_Fault_buf[3]" UBYTE Id_0x00 1 2 0 255 ECU_ADDRESS 0x0 /end MEASUREMENT
/begin MEASUREMENT MAIN_MSGu8GCU_Fault_buf[4] "MAIN_MSGu8GCU_Fault_buf[4]" UBYTE Id_0x00 1 2 0 255 ECU_ADDRESS 0x0 /end MEASUREMENT
/begin MEASUREMENT MAIN_MSGu8GCU_Fault_buf[5] "MAIN_MSGu8GCU_Fault_buf[5]" UBYTE Id_0x00 1 2 0 255 ECU_ADDRESS 0x0 /end MEASUREMENT
/begin MEASUREMENT MAIN_MSGu8GCU_Fault_buf[6] "MAIN_MSGu8GCU_Fault_buf[6]" UBYTE Id_0x00 1 2 0 255 ECU_ADDRESS 0x0 /end MEASUREMENT
/begin MEASUREMENT MAIN_MSGu8GCU_Fault_buf[7] "MAIN_MSGu8GCU_Fault_buf[7]" UBYTE Id_0x00 1 2 0 255 ECU_ADDRESS 0x0 /end MEASUREMENT
/begin MEASUREMENT MAIN_MSGu8GCU_GeneratorFaultLamp "..." UBYTE I_1 1 2 0 255 ECU_ADDRESS 0x0 /end MEASUREMENT
/begin MEASUREMENT MAIN_MSGu8GCU_GeneratorSt "..." UBYTE I_1 1 2 0 255 ECU_ADDRESS 0x0 /end MEASUREMENT
/begin MEASUREMENT MAIN_MSGu8GCU_GeneratorSysFaultLvl "..." UBYTE I_1 1 2 0 255 ECU_ADDRESS 0x0 /end MEASUREMENT
/begin MEASUREMENT MAIN_MSGu8GCU_GeneratorTempRaw "..." UBYTE I_1 1 2 0 255 ECU_ADDRESS 0x0 /end MEASUREMENT
/begin MEASUREMENT MAIN_MSGu8GCU_InverterWorkingState "..." UBYTE I_1 1 2 0 255 ECU_ADDRESS 0x0 /end MEASUREMENT
/begin MEASUREMENT MAIN_MSGu8GCU_RollingCount111 "..." UBYTE I_1 1 2 0 255 ECU_ADDRESS 0x0 /end MEASUREMENT
/begin MEASUREMENT MAIN_MSGu8GCU_RollingCount_GCU1 "..." UBYTE I_1 1 2 0 255 ECU_ADDRESS 0x0 /end MEASUREMENT
/begin MEASUREMENT MAIN_MSGu8GCU_RollingCount_GCU3 "..." UBYTE I_1 1 2 0 255 ECU_ADDRESS 0x0 /end MEASUREMENT
/begin MEASUREMENT MAIN_MSGu8GCU_TargetCoolingMotCntMode "..." UBYTE I_1 1 2 0 255 ECU_ADDRESS 0x0 /end MEASUREMENT
/begin MEASUREMENT MAIN_MSGu8GCU_TargetCoolingMotDuty "..." UBYTE I_1 1 2 0 255 ECU_ADDRESS 0x0 /end MEASUREMENT
/begin MEASUREMENT MAIN_MSGu8GW2_PwrMode "..." UBYTE I_3 1 2 0 255 ECU_ADDRESS 0x0 /end MEASUREMENT
/begin MEASUREMENT MAIN_MSGu8GW_ESC2_buf "-" UBYTE Id_0x00 1 2 0 255 MATRIX_DIM 8 1 1 ECU_ADDRESS 0x0 /end MEASUREMENT
/begin MEASUREMENT MAIN_MSGu8GW_ESC2_buf[0] "MAIN_MSGu8GW_ESC2_buf[0]" UBYTE Id_0x00 1 2 0 255 ECU_ADDRESS 0x0 /end MEASUREMENT
/begin MEASUREMENT MAIN_MSGu8GW_ESC2_buf[1] "MAIN_MSGu8GW_ESC2_buf[1]" UBYTE Id_0x00 1 2 0 255 ECU_ADDRESS 0x0 /end MEASUREMENT
/begin MEASUREMENT MAIN_MSGu8GW_ESC2_buf[2] "MAIN_MSGu8GW_ESC2_buf[2]" UBYTE Id_0x00 1 2 0 255 ECU_ADDRESS 0x0 /end MEASUREMENT
/begin MEASUREMENT MAIN_MSGu8GW_ESC2_buf[3] "MAIN_MSGu8GW_ESC2_buf[3]" UBYTE Id_0x00 1 2 0 255 ECU_ADDRESS 0x0 /end MEASUREMENT
/begin MEASUREMENT MAIN_MSGu8GW_ESC2_buf[4] "MAIN_MSGu8GW_ESC2_buf[4]" UBYTE Id_0x00 1 2 0 255 ECU_ADDRESS 0x0 /end MEASUREMENT
/begin MEASUREMENT MAIN_MSGu8GW_ESC2_buf[5] "MAIN_MSGu8GW_ESC2_buf[5]" UBYTE Id_0x00 1 2 0 255 ECU_ADDRESS 0x0 /end MEASUREMENT
/begin MEASUREMENT MAIN_MSGu8GW_ESC2_buf[6] "MAIN_MSGu8GW_ESC2_buf[6]" UBYTE Id_0x00 1 2 0 255 ECU_ADDRESS 0x0 /end MEASUREMENT
/begin MEASUREMENT MAIN_MSGu8GW_ESC2_buf[7] "MAIN_MSGu8GW_ESC2_buf[7]" UBYTE Id_0x00 1 2 0 255 ECU_ADDRESS 0x0 /end MEASUREMENT
/begin MEASUREMENT MAIN_MSGu8GW_ESC_CheckSum_ESC "..." UBYTE I_1 1 2 0 255 ECU_ADDRESS 0x0 /end MEASUREMENT
/begin MEASUREMENT MAIN_MSGu8GW_ESC_CheckSum_ESC2 "..." UBYTE I_1 1 2 0 255 ECU_ADDRESS 0x0 /end MEASUREMENT
/begin MEASUREMENT MAIN_MSGu8GW_ESC_RollingCount_ESC "..." UBYTE I_1 1 2 0 255 ECU_ADDRESS 0x0 /end MEASUREMENT
/begin MEASUREMENT MAIN_MSGu8GW_ESC_RollingCount_ESC2 "..." UBYTE I_1 1 2 0 255 ECU_ADDRESS 0x0 /end MEASUREMENT
/begin MEASUREMENT MAIN_MSGu8GW_ESC_WheelSpd_buf "-" UBYTE Id_0x00 1 2 0 255 MATRIX_DIM 8 1 1 ECU_ADDRESS 0x0 /end MEASUREMENT
/begin MEASUREMENT MAIN_MSGu8GW_ESC_WheelSpd_buf[0] "MAIN_MSGu8GW_ESC_WheelSpd_buf[0]" UBYTE Id_0x00 1 2 0 255 ECU_ADDRESS 0x0 /end MEASUREMENT
/begin MEASUREMENT MAIN_MSGu8GW_ESC_WheelSpd_buf[1] "MAIN_MSGu8GW_ESC_WheelSpd_buf[1]" UBYTE Id_0x00 1 2 0 255 ECU_ADDRESS 0x0 /end MEASUREMENT
/begin MEASUREMENT MAIN_MSGu8GW_ESC_WheelSpd_buf[2] "MAIN_MSGu8GW_ESC_WheelSpd_buf[2]" UBYTE Id_0x00 1 2 0 255 ECU_ADDRESS 0x0 /end MEASUREMENT
/begin MEASUREMENT MAIN_MSGu8GW_ESC_WheelSpd_buf[3] "MAIN_MSGu8GW_ESC_WheelSpd_buf[3]" UBYTE Id_0x00 1 2 0 255 ECU_ADDRESS 0x0 /end MEASUREMENT
/begin MEASUREMENT MAIN_MSGu8GW_ESC_WheelSpd_buf[4] "MAIN_MSGu8GW_ESC_WheelSpd_buf[4]" UBYTE Id_0x00 1 2 0 255 ECU_ADDRESS 0x0 /end MEASUREMENT
/begin MEASUREMENT MAIN_MSGu8GW_ESC_WheelSpd_buf[5] "MAIN_MSGu8GW_ESC_WheelSpd_buf[5]" UBYTE Id_0x00 1 2 0 255 ECU_ADDRESS 0x0 /end MEASUREMENT
/begin MEASUREMENT MAIN_MSGu8GW_ESC_WheelSpd_buf[6] "MAIN_MSGu8GW_ESC_WheelSpd_buf[6]" UBYTE Id_0x00 1 2 0 255 ECU_ADDRESS 0x0 /end MEASUREMENT
/begin MEASUREMENT MAIN_MSGu8GW_ESC_WheelSpd_buf[7] "MAIN_MSGu8GW_ESC_WheelSpd_buf[7]" UBYTE Id_0x00 1 2 0 255 ECU_ADDRESS 0x0 /end MEASUREMENT
/begin MEASUREMENT MAIN_MSGu8GW_IVI_buf "-" UBYTE Id_0x00 1 2 0 255 MATRIX_DIM 8 1 1 ECU_ADDRESS 0x0 /end MEASUREMENT
/begin MEASUREMENT MAIN_MSGu8GW_IVI_buf[0] "MAIN_MSGu8GW_IVI_buf[0]" UBYTE Id_0x00 1 2 0 255 ECU_ADDRESS 0x0 /end MEASUREMENT
/begin MEASUREMENT MAIN_MSGu8GW_IVI_buf[1] "MAIN_MSGu8GW_IVI_buf[1]" UBYTE Id_0x00 1 2 0 255 ECU_ADDRESS 0x0 /end MEASUREMENT
/begin MEASUREMENT MAIN_MSGu8GW_IVI_buf[2] "MAIN_MSGu8GW_IVI_buf[2]" UBYTE Id_0x00 1 2 0 255 ECU_ADDRESS 0x0 /end MEASUREMENT
/begin MEASUREMENT MAIN_MSGu8GW_IVI_buf[3] "MAIN_MSGu8GW_IVI_buf[3]" UBYTE Id_0x00 1 2 0 255 ECU_ADDRESS 0x0 /end MEASUREMENT
/begin MEASUREMENT MAIN_MSGu8GW_IVI_buf[4] "MAIN_MSGu8GW_IVI_buf[4]" UBYTE Id_0x00 1 2 0 255 ECU_ADDRESS 0x0 /end MEASUREMENT
/begin MEASUREMENT MAIN_MSGu8GW_IVI_buf[5] "MAIN_MSGu8GW_IVI_buf[5]" UBYTE Id_0x00 1 2 0 255 ECU_ADDRESS 0x0 /end MEASUREMENT
/begin MEASUREMENT MAIN_MSGu8GW_IVI_buf[6] "MAIN_MSGu8GW_IVI_buf[6]" UBYTE Id_0x00 1 2 0 255 ECU_ADDRESS 0x0 /end MEASUREMENT
/begin MEASUREMENT MAIN_MSGu8GW_IVI_buf[7] "MAIN_MSGu8GW_IVI_buf[7]" UBYTE Id_0x00 1 2 0 255 ECU_ADDRESS 0x0 /end MEASUREMENT
/begin MEASUREMENT MAIN_MSGu8GW_TBOX_Time_buf "-" UBYTE Id_0x00 1 2 0 255 MATRIX_DIM 8 1 1 ECU_ADDRESS 0x0 /end MEASUREMENT
/begin MEASUREMENT MAIN_MSGu8GW_TBOX_Time_buf[0] "MAIN_MSGu8GW_TBOX_Time_buf[0]" UBYTE Id_0x00 1 2 0 255 ECU_ADDRESS 0x0 /end MEASUREMENT
/begin MEASUREMENT MAIN_MSGu8GW_TBOX_Time_buf[1] "MAIN_MSGu8GW_TBOX_Time_buf[1]" UBYTE Id_0x00 1 2 0 255 ECU_ADDRESS 0x0 /end MEASUREMENT
/begin MEASUREMENT MAIN_MSGu8GW_TBOX_Time_buf[2] "MAIN_MSGu8GW_TBOX_Time_buf[2]" UBYTE Id_0x00 1 2 0 255 ECU_ADDRESS 0x0 /end MEASUREMENT
/begin MEASUREMENT MAIN_MSGu8GW_TBOX_Time_buf[3] "MAIN_MSGu8GW_TBOX_Time_buf[3]" UBYTE Id_0x00 1 2 0 255 ECU_ADDRESS 0x0 /end MEASUREMENT
/begin MEASUREMENT MAIN_MSGu8GW_TBOX_Time_buf[4] "MAIN_MSGu8GW_TBOX_Time_buf[4]" UBYTE Id_0x00 1 2 0 255 ECU_ADDRESS 0x0 /end MEASUREMENT
/begin MEASUREMENT MAIN_MSGu8GW_TBOX_Time_buf[5] "MAIN_MSGu8GW_TBOX_Time_buf[5]" UBYTE Id_0x00 1 2 0 255 ECU_ADDRESS 0x0 /end MEASUREMENT
/begin MEASUREMENT MAIN_MSGu8GW_TBOX_Time_buf[6] "MAIN_MSGu8GW_TBOX_Time_buf[6]" UBYTE Id_0x00 1 2 0 255 ECU_ADDRESS 0x0 /end MEASUREMENT
/begin MEASUREMENT MAIN_MSGu8GW_TBOX_Time_buf[7] "MAIN_MSGu8GW_TBOX_Time_buf[7]" UBYTE Id_0x00 1 2 0 255 ECU_ADDRESS 0x0 /end MEASUREMENT
/begin MEASUREMENT MAIN_MSGu8HTCU2_buf "-" UBYTE Id_0x00 1 2 0 255 MATRIX_DIM 8 1 1 ECU_ADDRESS 0x0 /end MEASUREMENT
/begin MEASUREMENT MAIN_MSGu8HTCU2_buf[0] "MAIN_MSGu8HTCU2_buf[0]" UBYTE Id_0x00 1 2 0 255 ECU_ADDRESS 0x0 /end MEASUREMENT
/begin MEASUREMENT MAIN_MSGu8HTCU2_buf[1] "MAIN_MSGu8HTCU2_buf[1]" UBYTE Id_0x00 1 2 0 255 ECU_ADDRESS 0x0 /end MEASUREMENT
/begin MEASUREMENT MAIN_MSGu8HTCU2_buf[2] "MAIN_MSGu8HTCU2_buf[2]" UBYTE Id_0x00 1 2 0 255 ECU_ADDRESS 0x0 /end MEASUREMENT
/begin MEASUREMENT MAIN_MSGu8HTCU2_buf[3] "MAIN_MSGu8HTCU2_buf[3]" UBYTE Id_0x00 1 2 0 255 ECU_ADDRESS 0x0 /end MEASUREMENT
/begin MEASUREMENT MAIN_MSGu8HTCU2_buf[4] "MAIN_MSGu8HTCU2_buf[4]" UBYTE Id_0x00 1 2 0 255 ECU_ADDRESS 0x0 /end MEASUREMENT
/begin MEASUREMENT MAIN_MSGu8HTCU2_buf[5] "MAIN_MSGu8HTCU2_buf[5]" UBYTE Id_0x00 1 2 0 255 ECU_ADDRESS 0x0 /end MEASUREMENT
/begin MEASUREMENT MAIN_MSGu8HTCU2_buf[6] "MAIN_MSGu8HTCU2_buf[6]" UBYTE Id_0x00 1 2 0 255 ECU_ADDRESS 0x0 /end MEASUREMENT
/begin MEASUREMENT MAIN_MSGu8HTCU2_buf[7] "MAIN_MSGu8HTCU2_buf[7]" UBYTE Id_0x00 1 2 0 255 ECU_ADDRESS 0x0 /end MEASUREMENT
/begin MEASUREMENT MAIN_MSGu8HTCU_CheckSum9E "..." UBYTE I_1 1 2 0 255 ECU_ADDRESS 0x0 /end MEASUREMENT
/begin MEASUREMENT MAIN_MSGu8HTCU_CoolingRequest "..." UBYTE I_1 1 2 0 255 ECU_ADDRESS 0x0 /end MEASUREMENT
/begin MEASUREMENT MAIN_MSGu8HTCU_CrankingAuthorizationEnable "..." UBYTE I_1 1 2 0 255 ECU_ADDRESS 0x0 /end MEASUREMENT
/begin MEASUREMENT MAIN_MSGu8HTCU_CurrentDrumPos "..." UBYTE I_1 1 2 0 255 ECU_ADDRESS 0x0 /end MEASUREMENT
/begin MEASUREMENT MAIN_MSGu8HTCU_Fault "..." UBYTE I_1 1 2 0 255 ECU_ADDRESS 0x0 /end MEASUREMENT
/begin MEASUREMENT MAIN_MSGu8HTCU_GearProgress "..." UBYTE I_1 1 2 0 255 ECU_ADDRESS 0x0 /end MEASUREMENT
/begin MEASUREMENT MAIN_MSGu8HTCU_GearShiftStatus "..." UBYTE I_1 1 2 0 255 ECU_ADDRESS 0x0 /end MEASUREMENT
/begin MEASUREMENT MAIN_MSGu8HTCU_RollingCount9E "..." UBYTE I_1 1 2 0 255 ECU_ADDRESS 0x0 /end MEASUREMENT
/begin MEASUREMENT MAIN_MSGu8HTCU_TransmissionFluidTempRaw "..." UBYTE I_1 1 2 0 255 ECU_ADDRESS 0x0 /end MEASUREMENT
/begin MEASUREMENT MAIN_MSGu8IBCM3_buf "-" UBYTE Id_0x00 1 2 0 255 MATRIX_DIM 8 1 1 ECU_ADDRESS 0x0 /end MEASUREMENT
/begin MEASUREMENT MAIN_MSGu8IBCM3_buf[0] "MAIN_MSGu8IBCM3_buf[0]" UBYTE Id_0x00 1 2 0 255 ECU_ADDRESS 0x0 /end MEASUREMENT
/begin MEASUREMENT MAIN_MSGu8IBCM3_buf[1] "MAIN_MSGu8IBCM3_buf[1]" UBYTE Id_0x00 1 2 0 255 ECU_ADDRESS 0x0 /end MEASUREMENT
/begin MEASUREMENT MAIN_MSGu8IBCM3_buf[2] "MAIN_MSGu8IBCM3_buf[2]" UBYTE Id_0x00 1 2 0 255 ECU_ADDRESS 0x0 /end MEASUREMENT
/begin MEASUREMENT MAIN_MSGu8IBCM3_buf[3] "MAIN_MSGu8IBCM3_buf[3]" UBYTE Id_0x00 1 2 0 255 ECU_ADDRESS 0x0 /end MEASUREMENT
/begin MEASUREMENT MAIN_MSGu8IBCM3_buf[4] "MAIN_MSGu8IBCM3_buf[4]" UBYTE Id_0x00 1 2 0 255 ECU_ADDRESS 0x0 /end MEASUREMENT
/begin MEASUREMENT MAIN_MSGu8IBCM3_buf[5] "MAIN_MSGu8IBCM3_buf[5]" UBYTE Id_0x00 1 2 0 255 ECU_ADDRESS 0x0 /end MEASUREMENT
/begin MEASUREMENT MAIN_MSGu8IBCM3_buf[6] "MAIN_MSGu8IBCM3_buf[6]" UBYTE Id_0x00 1 2 0 255 ECU_ADDRESS 0x0 /end MEASUREMENT
/begin MEASUREMENT MAIN_MSGu8IBCM3_buf[7] "MAIN_MSGu8IBCM3_buf[7]" UBYTE Id_0x00 1 2 0 255 ECU_ADDRESS 0x0 /end MEASUREMENT
/begin MEASUREMENT MAIN_MSGu8IBCM6_buf "-" UBYTE Id_0x00 1 2 0 255 MATRIX_DIM 8 1 1 ECU_ADDRESS 0x0 /end MEASUREMENT
/begin MEASUREMENT MAIN_MSGu8IBCM6_buf[0] "MAIN_MSGu8IBCM6_buf[0]" UBYTE Id_0x00 1 2 0 255 ECU_ADDRESS 0x0 /end MEASUREMENT
/begin MEASUREMENT MAIN_MSGu8IBCM6_buf[1] "MAIN_MSGu8IBCM6_buf[1]" UBYTE Id_0x00 1 2 0 255 ECU_ADDRESS 0x0 /end MEASUREMENT
/begin MEASUREMENT MAIN_MSGu8IBCM6_buf[2] "MAIN_MSGu8IBCM6_buf[2]" UBYTE Id_0x00 1 2 0 255 ECU_ADDRESS 0x0 /end MEASUREMENT
/begin MEASUREMENT MAIN_MSGu8IBCM6_buf[3] "MAIN_MSGu8IBCM6_buf[3]" UBYTE Id_0x00 1 2 0 255 ECU_ADDRESS 0x0 /end MEASUREMENT
/begin MEASUREMENT MAIN_MSGu8IBCM6_buf[4] "MAIN_MSGu8IBCM6_buf[4]" UBYTE Id_0x00 1 2 0 255 ECU_ADDRESS 0x0 /end MEASUREMENT
/begin MEASUREMENT MAIN_MSGu8IBCM6_buf[5] "MAIN_MSGu8IBCM6_buf[5]" UBYTE Id_0x00 1 2 0 255 ECU_ADDRESS 0x0 /end MEASUREMENT
/begin MEASUREMENT MAIN_MSGu8IBCM6_buf[6] "MAIN_MSGu8IBCM6_buf[6]" UBYTE Id_0x00 1 2 0 255 ECU_ADDRESS 0x0 /end MEASUREMENT
/begin MEASUREMENT MAIN_MSGu8IBCM6_buf[7] "MAIN_MSGu8IBCM6_buf[7]" UBYTE Id_0x00 1 2 0 255 ECU_ADDRESS 0x0 /end MEASUREMENT
/begin MEASUREMENT MAIN_MSGu8IBCM_IMMO_buf "-" UBYTE Id_0x00 1 2 0 255 MATRIX_DIM 8 1 1 ECU_ADDRESS 0x0 /end MEASUREMENT
/begin MEASUREMENT MAIN_MSGu8IBCM_IMMO_buf[0] "MAIN_MSGu8IBCM_IMMO_buf[0]" UBYTE Id_0x00 1 2 0 255 ECU_ADDRESS 0x0 /end MEASUREMENT
/begin MEASUREMENT MAIN_MSGu8IBCM_IMMO_buf[1] "MAIN_MSGu8IBCM_IMMO_buf[1]" UBYTE Id_0x00 1 2 0 255 ECU_ADDRESS 0x0 /end MEASUREMENT
/begin MEASUREMENT MAIN_MSGu8IBCM_IMMO_buf[2] "MAIN_MSGu8IBCM_IMMO_buf[2]" UBYTE Id_0x00 1 2 0 255 ECU_ADDRESS 0x0 /end MEASUREMENT
/begin MEASUREMENT MAIN_MSGu8IBCM_IMMO_buf[3] "MAIN_MSGu8IBCM_IMMO_buf[3]" UBYTE Id_0x00 1 2 0 255 ECU_ADDRESS 0x0 /end MEASUREMENT
/begin MEASUREMENT MAIN_MSGu8IBCM_IMMO_buf[4] "MAIN_MSGu8IBCM_IMMO_buf[4]" UBYTE Id_0x00 1 2 0 255 ECU_ADDRESS 0x0 /end MEASUREMENT
/begin MEASUREMENT MAIN_MSGu8IBCM_IMMO_buf[5] "MAIN_MSGu8IBCM_IMMO_buf[5]" UBYTE Id_0x00 1 2 0 255 ECU_ADDRESS 0x0 /end MEASUREMENT
/begin MEASUREMENT MAIN_MSGu8IBCM_IMMO_buf[6] "MAIN_MSGu8IBCM_IMMO_buf[6]" UBYTE Id_0x00 1 2 0 255 ECU_ADDRESS 0x0 /end MEASUREMENT
/begin MEASUREMENT MAIN_MSGu8IBCM_IMMO_buf[7] "MAIN_MSGu8IBCM_IMMO_buf[7]" UBYTE Id_0x00 1 2 0 255 ECU_ADDRESS 0x0 /end MEASUREMENT
/begin MEASUREMENT MAIN_MSGu8IC_CheckSum320 "..." UBYTE I_1 1 2 0 255 ECU_ADDRESS 0x0 /end MEASUREMENT
/begin MEASUREMENT MAIN_MSGu8IC_RollingCount320 "..." UBYTE I_1 1 2 0 255 ECU_ADDRESS 0x0 /end MEASUREMENT
/begin MEASUREMENT MAIN_MSGu8M2G1_Byte4 "..." UBYTE I_1 1 2 0 255 ECU_ADDRESS 0x0 /end MEASUREMENT
/begin MEASUREMENT MAIN_MSGu8M2G1_Byte5 "..." UBYTE I_1 1 2 0 255 ECU_ADDRESS 0x0 /end MEASUREMENT
/begin MEASUREMENT MAIN_MSGu8M2G1_Byte6 "..." UBYTE I_1 1 2 0 255 ECU_ADDRESS 0x0 /end MEASUREMENT
/begin MEASUREMENT MAIN_MSGu8M2G1_Byte7 "..." UBYTE I_1 1 2 0 255 ECU_ADDRESS 0x0 /end MEASUREMENT
/begin MEASUREMENT MAIN_MSGu8M2G2_Byte0 "..." UBYTE I_1 1 2 0 255 ECU_ADDRESS 0x0 /end MEASUREMENT
/begin MEASUREMENT MAIN_MSGu8M2G2_Byte1 "..." UBYTE I_1 1 2 0 255 ECU_ADDRESS 0x0 /end MEASUREMENT
/begin MEASUREMENT MAIN_MSGu8M2G2_Byte2 "..." UBYTE I_1 1 2 0 255 ECU_ADDRESS 0x0 /end MEASUREMENT
/begin MEASUREMENT MAIN_MSGu8M2G2_Byte3 "..." UBYTE I_1 1 2 0 255 ECU_ADDRESS 0x0 /end MEASUREMENT
/begin MEASUREMENT MAIN_MSGu8M2G2_Byte4 "..." UBYTE I_1 1 2 0 255 ECU_ADDRESS 0x0 /end MEASUREMENT
/begin MEASUREMENT MAIN_MSGu8M2G2_Byte5 "..." UBYTE I_1 1 2 0 255 ECU_ADDRESS 0x0 /end MEASUREMENT
/begin MEASUREMENT MAIN_MSGu8M2G2_Byte6 "..." UBYTE I_1 1 2 0 255 ECU_ADDRESS 0x0 /end MEASUREMENT
/begin MEASUREMENT MAIN_MSGu8M2G2_Byte7 "..." UBYTE I_1 1 2 0 255 ECU_ADDRESS 0x0 /end MEASUREMENT
/begin MEASUREMENT MAIN_MSGu8MCU1_buf "-" UBYTE Id_0x00 1 2 0 255 MATRIX_DIM 8 1 1 ECU_ADDRESS 0x0 /end MEASUREMENT
/begin MEASUREMENT MAIN_MSGu8MCU1_buf[0] "MAIN_MSGu8MCU1_buf[0]" UBYTE Id_0x00 1 2 0 255 ECU_ADDRESS 0x0 /end MEASUREMENT
/begin MEASUREMENT MAIN_MSGu8MCU1_buf[1] "MAIN_MSGu8MCU1_buf[1]" UBYTE Id_0x00 1 2 0 255 ECU_ADDRESS 0x0 /end MEASUREMENT
/begin MEASUREMENT MAIN_MSGu8MCU1_buf[2] "MAIN_MSGu8MCU1_buf[2]" UBYTE Id_0x00 1 2 0 255 ECU_ADDRESS 0x0 /end MEASUREMENT
/begin MEASUREMENT MAIN_MSGu8MCU1_buf[3] "MAIN_MSGu8MCU1_buf[3]" UBYTE Id_0x00 1 2 0 255 ECU_ADDRESS 0x0 /end MEASUREMENT
/begin MEASUREMENT MAIN_MSGu8MCU1_buf[4] "MAIN_MSGu8MCU1_buf[4]" UBYTE Id_0x00 1 2 0 255 ECU_ADDRESS 0x0 /end MEASUREMENT
/begin MEASUREMENT MAIN_MSGu8MCU1_buf[5] "MAIN_MSGu8MCU1_buf[5]" UBYTE Id_0x00 1 2 0 255 ECU_ADDRESS 0x0 /end MEASUREMENT
/begin MEASUREMENT MAIN_MSGu8MCU1_buf[6] "MAIN_MSGu8MCU1_buf[6]" UBYTE Id_0x00 1 2 0 255 ECU_ADDRESS 0x0 /end MEASUREMENT
/begin MEASUREMENT MAIN_MSGu8MCU1_buf[7] "MAIN_MSGu8MCU1_buf[7]" UBYTE Id_0x00 1 2 0 255 ECU_ADDRESS 0x0 /end MEASUREMENT
/begin MEASUREMENT MAIN_MSGu8MCU2_buf "-" UBYTE Id_0x00 1 2 0 255 MATRIX_DIM 8 1 1 ECU_ADDRESS 0x0 /end MEASUREMENT
/begin MEASUREMENT MAIN_MSGu8MCU2_buf[0] "MAIN_MSGu8MCU2_buf[0]" UBYTE Id_0x00 1 2 0 255 ECU_ADDRESS 0x0 /end MEASUREMENT
/begin MEASUREMENT MAIN_MSGu8MCU2_buf[1] "MAIN_MSGu8MCU2_buf[1]" UBYTE Id_0x00 1 2 0 255 ECU_ADDRESS 0x0 /end MEASUREMENT
/begin MEASUREMENT MAIN_MSGu8MCU2_buf[2] "MAIN_MSGu8MCU2_buf[2]" UBYTE Id_0x00 1 2 0 255 ECU_ADDRESS 0x0 /end MEASUREMENT
/begin MEASUREMENT MAIN_MSGu8MCU2_buf[3] "MAIN_MSGu8MCU2_buf[3]" UBYTE Id_0x00 1 2 0 255 ECU_ADDRESS 0x0 /end MEASUREMENT
/begin MEASUREMENT MAIN_MSGu8MCU2_buf[4] "MAIN_MSGu8MCU2_buf[4]" UBYTE Id_0x00 1 2 0 255 ECU_ADDRESS 0x0 /end MEASUREMENT
/begin MEASUREMENT MAIN_MSGu8MCU2_buf[5] "MAIN_MSGu8MCU2_buf[5]" UBYTE Id_0x00 1 2 0 255 ECU_ADDRESS 0x0 /end MEASUREMENT
/begin MEASUREMENT MAIN_MSGu8MCU2_buf[6] "MAIN_MSGu8MCU2_buf[6]" UBYTE Id_0x00 1 2 0 255 ECU_ADDRESS 0x0 /end MEASUREMENT
/begin MEASUREMENT MAIN_MSGu8MCU2_buf[7] "MAIN_MSGu8MCU2_buf[7]" UBYTE Id_0x00 1 2 0 255 ECU_ADDRESS 0x0 /end MEASUREMENT
/begin MEASUREMENT MAIN_MSGu8MCU3_buf "-" UBYTE Id_0x00 1 2 0 255 MATRIX_DIM 8 1 1 ECU_ADDRESS 0x0 /end MEASUREMENT
/begin MEASUREMENT MAIN_MSGu8MCU3_buf[0] "MAIN_MSGu8MCU3_buf[0]" UBYTE Id_0x00 1 2 0 255 ECU_ADDRESS 0x0 /end MEASUREMENT
/begin MEASUREMENT MAIN_MSGu8MCU3_buf[1] "MAIN_MSGu8MCU3_buf[1]" UBYTE Id_0x00 1 2 0 255 ECU_ADDRESS 0x0 /end MEASUREMENT
/begin MEASUREMENT MAIN_MSGu8MCU3_buf[2] "MAIN_MSGu8MCU3_buf[2]" UBYTE Id_0x00 1 2 0 255 ECU_ADDRESS 0x0 /end MEASUREMENT
/begin MEASUREMENT MAIN_MSGu8MCU3_buf[3] "MAIN_MSGu8MCU3_buf[3]" UBYTE Id_0x00 1 2 0 255 ECU_ADDRESS 0x0 /end MEASUREMENT
/begin MEASUREMENT MAIN_MSGu8MCU3_buf[4] "MAIN_MSGu8MCU3_buf[4]" UBYTE Id_0x00 1 2 0 255 ECU_ADDRESS 0x0 /end MEASUREMENT
/begin MEASUREMENT MAIN_MSGu8MCU3_buf[5] "MAIN_MSGu8MCU3_buf[5]" UBYTE Id_0x00 1 2 0 255 ECU_ADDRESS 0x0 /end MEASUREMENT
/begin MEASUREMENT MAIN_MSGu8MCU3_buf[6] "MAIN_MSGu8MCU3_buf[6]" UBYTE Id_0x00 1 2 0 255 ECU_ADDRESS 0x0 /end MEASUREMENT
/begin MEASUREMENT MAIN_MSGu8MCU3_buf[7] "MAIN_MSGu8MCU3_buf[7]" UBYTE Id_0x00 1 2 0 255 ECU_ADDRESS 0x0 /end MEASUREMENT
/begin MEASUREMENT MAIN_MSGu8MCU4_buf "-" UBYTE Id_0x00 1 2 0 255 MATRIX_DIM 8 1 1 ECU_ADDRESS 0x0 /end MEASUREMENT
/begin MEASUREMENT MAIN_MSGu8MCU4_buf[0] "MAIN_MSGu8MCU4_buf[0]" UBYTE Id_0x00 1 2 0 255 ECU_ADDRESS 0x0 /end MEASUREMENT
/begin MEASUREMENT MAIN_MSGu8MCU4_buf[1] "MAIN_MSGu8MCU4_buf[1]" UBYTE Id_0x00 1 2 0 255 ECU_ADDRESS 0x0 /end MEASUREMENT
/begin MEASUREMENT MAIN_MSGu8MCU4_buf[2] "MAIN_MSGu8MCU4_buf[2]" UBYTE Id_0x00 1 2 0 255 ECU_ADDRESS 0x0 /end MEASUREMENT
/begin MEASUREMENT MAIN_MSGu8MCU4_buf[3] "MAIN_MSGu8MCU4_buf[3]" UBYTE Id_0x00 1 2 0 255 ECU_ADDRESS 0x0 /end MEASUREMENT
/begin MEASUREMENT MAIN_MSGu8MCU4_buf[4] "MAIN_MSGu8MCU4_buf[4]" UBYTE Id_0x00 1 2 0 255 ECU_ADDRESS 0x0 /end MEASUREMENT
/begin MEASUREMENT MAIN_MSGu8MCU4_buf[5] "MAIN_MSGu8MCU4_buf[5]" UBYTE Id_0x00 1 2 0 255 ECU_ADDRESS 0x0 /end MEASUREMENT
/begin MEASUREMENT MAIN_MSGu8MCU4_buf[6] "MAIN_MSGu8MCU4_buf[6]" UBYTE Id_0x00 1 2 0 255 ECU_ADDRESS 0x0 /end MEASUREMENT
/begin MEASUREMENT MAIN_MSGu8MCU4_buf[7] "MAIN_MSGu8MCU4_buf[7]" UBYTE Id_0x00 1 2 0 255 ECU_ADDRESS 0x0 /end MEASUREMENT
/begin MEASUREMENT MAIN_MSGu8MCUF_Cali1 "..." UBYTE I_1 1 2 0 255 MATRIX_DIM 8 1 1 ECU_ADDRESS 0x0 /end MEASUREMENT
/begin MEASUREMENT MAIN_MSGu8MCUF_Cali1[0] "MAIN_MSGu8MCUF_Cali1[0]" UBYTE I_1 1 2 0 255 ECU_ADDRESS 0x0 /end MEASUREMENT
/begin MEASUREMENT MAIN_MSGu8MCUF_Cali1[1] "MAIN_MSGu8MCUF_Cali1[1]" UBYTE I_1 1 2 0 255 ECU_ADDRESS 0x0 /end MEASUREMENT
/begin MEASUREMENT MAIN_MSGu8MCUF_Cali1[2] "MAIN_MSGu8MCUF_Cali1[2]" UBYTE I_1 1 2 0 255 ECU_ADDRESS 0x0 /end MEASUREMENT
/begin MEASUREMENT MAIN_MSGu8MCUF_Cali1[3] "MAIN_MSGu8MCUF_Cali1[3]" UBYTE I_1 1 2 0 255 ECU_ADDRESS 0x0 /end MEASUREMENT
/begin MEASUREMENT MAIN_MSGu8MCUF_Cali1[4] "MAIN_MSGu8MCUF_Cali1[4]" UBYTE I_1 1 2 0 255 ECU_ADDRESS 0x0 /end MEASUREMENT
/begin MEASUREMENT MAIN_MSGu8MCUF_Cali1[5] "MAIN_MSGu8MCUF_Cali1[5]" UBYTE I_1 1 2 0 255 ECU_ADDRESS 0x0 /end MEASUREMENT
/begin MEASUREMENT MAIN_MSGu8MCUF_Cali1[6] "MAIN_MSGu8MCUF_Cali1[6]" UBYTE I_1 1 2 0 255 ECU_ADDRESS 0x0 /end MEASUREMENT
/begin MEASUREMENT MAIN_MSGu8MCUF_Cali1[7] "MAIN_MSGu8MCUF_Cali1[7]" UBYTE I_1 1 2 0 255 ECU_ADDRESS 0x0 /end MEASUREMENT
/begin MEASUREMENT MAIN_MSGu8MCUF_Cali2 "..." UBYTE I_1 1 2 0 255 MATRIX_DIM 8 1 1 ECU_ADDRESS 0x0 /end MEASUREMENT
/begin MEASUREMENT MAIN_MSGu8MCUF_Cali2[0] "MAIN_MSGu8MCUF_Cali2[0]" UBYTE I_1 1 2 0 255 ECU_ADDRESS 0x0 /end MEASUREMENT
/begin MEASUREMENT MAIN_MSGu8MCUF_Cali2[1] "MAIN_MSGu8MCUF_Cali2[1]" UBYTE I_1 1 2 0 255 ECU_ADDRESS 0x0 /end MEASUREMENT
/begin MEASUREMENT MAIN_MSGu8MCUF_Cali2[2] "MAIN_MSGu8MCUF_Cali2[2]" UBYTE I_1 1 2 0 255 ECU_ADDRESS 0x0 /end MEASUREMENT
/begin MEASUREMENT MAIN_MSGu8MCUF_Cali2[3] "MAIN_MSGu8MCUF_Cali2[3]" UBYTE I_1 1 2 0 255 ECU_ADDRESS 0x0 /end MEASUREMENT
/begin MEASUREMENT MAIN_MSGu8MCUF_Cali2[4] "MAIN_MSGu8MCUF_Cali2[4]" UBYTE I_1 1 2 0 255 ECU_ADDRESS 0x0 /end MEASUREMENT
/begin MEASUREMENT MAIN_MSGu8MCUF_Cali2[5] "MAIN_MSGu8MCUF_Cali2[5]" UBYTE I_1 1 2 0 255 ECU_ADDRESS 0x0 /end MEASUREMENT
/begin MEASUREMENT MAIN_MSGu8MCUF_Cali2[6] "MAIN_MSGu8MCUF_Cali2[6]" UBYTE I_1 1 2 0 255 ECU_ADDRESS 0x0 /end MEASUREMENT
/begin MEASUREMENT MAIN_MSGu8MCUF_Cali2[7] "MAIN_MSGu8MCUF_Cali2[7]" UBYTE I_1 1 2 0 255 ECU_ADDRESS 0x0 /end MEASUREMENT
/begin MEASUREMENT MAIN_MSGu8MCUF_Cali3 "..." UBYTE I_1 1 2 0 255 MATRIX_DIM 8 1 1 ECU_ADDRESS 0x0 /end MEASUREMENT
/begin MEASUREMENT MAIN_MSGu8MCUF_Cali3[0] "MAIN_MSGu8MCUF_Cali3[0]" UBYTE I_1 1 2 0 255 ECU_ADDRESS 0x0 /end MEASUREMENT
/begin MEASUREMENT MAIN_MSGu8MCUF_Cali3[1] "MAIN_MSGu8MCUF_Cali3[1]" UBYTE I_1 1 2 0 255 ECU_ADDRESS 0x0 /end MEASUREMENT
/begin MEASUREMENT MAIN_MSGu8MCUF_Cali3[2] "MAIN_MSGu8MCUF_Cali3[2]" UBYTE I_1 1 2 0 255 ECU_ADDRESS 0x0 /end MEASUREMENT
/begin MEASUREMENT MAIN_MSGu8MCUF_Cali3[3] "MAIN_MSGu8MCUF_Cali3[3]" UBYTE I_1 1 2 0 255 ECU_ADDRESS 0x0 /end MEASUREMENT
/begin MEASUREMENT MAIN_MSGu8MCUF_Cali3[4] "MAIN_MSGu8MCUF_Cali3[4]" UBYTE I_1 1 2 0 255 ECU_ADDRESS 0x0 /end MEASUREMENT
/begin MEASUREMENT MAIN_MSGu8MCUF_Cali3[5] "MAIN_MSGu8MCUF_Cali3[5]" UBYTE I_1 1 2 0 255 ECU_ADDRESS 0x0 /end MEASUREMENT
/begin MEASUREMENT MAIN_MSGu8MCUF_Cali3[6] "MAIN_MSGu8MCUF_Cali3[6]" UBYTE I_1 1 2 0 255 ECU_ADDRESS 0x0 /end MEASUREMENT
/begin MEASUREMENT MAIN_MSGu8MCUF_Cali3[7] "MAIN_MSGu8MCUF_Cali3[7]" UBYTE I_1 1 2 0 255 ECU_ADDRESS 0x0 /end MEASUREMENT
/begin MEASUREMENT MAIN_MSGu8MCUF_Cali4 "..." UBYTE I_1 1 2 0 255 MATRIX_DIM 8 1 1 ECU_ADDRESS 0x0 /end MEASUREMENT
/begin MEASUREMENT MAIN_MSGu8MCUF_Cali4[0] "MAIN_MSGu8MCUF_Cali4[0]" UBYTE I_1 1 2 0 255 ECU_ADDRESS 0x0 /end MEASUREMENT
/begin MEASUREMENT MAIN_MSGu8MCUF_Cali4[1] "MAIN_MSGu8MCUF_Cali4[1]" UBYTE I_1 1 2 0 255 ECU_ADDRESS 0x0 /end MEASUREMENT
/begin MEASUREMENT MAIN_MSGu8MCUF_Cali4[2] "MAIN_MSGu8MCUF_Cali4[2]" UBYTE I_1 1 2 0 255 ECU_ADDRESS 0x0 /end MEASUREMENT
/begin MEASUREMENT MAIN_MSGu8MCUF_Cali4[3] "MAIN_MSGu8MCUF_Cali4[3]" UBYTE I_1 1 2 0 255 ECU_ADDRESS 0x0 /end MEASUREMENT
/begin MEASUREMENT MAIN_MSGu8MCUF_Cali4[4] "MAIN_MSGu8MCUF_Cali4[4]" UBYTE I_1 1 2 0 255 ECU_ADDRESS 0x0 /end MEASUREMENT
/begin MEASUREMENT MAIN_MSGu8MCUF_Cali4[5] "MAIN_MSGu8MCUF_Cali4[5]" UBYTE I_1 1 2 0 255 ECU_ADDRESS 0x0 /end MEASUREMENT
/begin MEASUREMENT MAIN_MSGu8MCUF_Cali4[6] "MAIN_MSGu8MCUF_Cali4[6]" UBYTE I_1 1 2 0 255 ECU_ADDRESS 0x0 /end MEASUREMENT
/begin MEASUREMENT MAIN_MSGu8MCUF_Cali4[7] "MAIN_MSGu8MCUF_Cali4[7]" UBYTE I_1 1 2 0 255 ECU_ADDRESS 0x0 /end MEASUREMENT
/begin MEASUREMENT MAIN_MSGu8MCUR_Cali "..." UBYTE I_1 1 2 0 255 MATRIX_DIM 8 1 1 ECU_ADDRESS 0x0 /end MEASUREMENT
/begin MEASUREMENT MAIN_MSGu8MCUR_Cali[0] "MAIN_MSGu8MCUR_Cali[0]" UBYTE I_1 1 2 0 255 ECU_ADDRESS 0x0 /end MEASUREMENT
/begin MEASUREMENT MAIN_MSGu8MCUR_Cali[1] "MAIN_MSGu8MCUR_Cali[1]" UBYTE I_1 1 2 0 255 ECU_ADDRESS 0x0 /end MEASUREMENT
/begin MEASUREMENT MAIN_MSGu8MCUR_Cali[2] "MAIN_MSGu8MCUR_Cali[2]" UBYTE I_1 1 2 0 255 ECU_ADDRESS 0x0 /end MEASUREMENT
/begin MEASUREMENT MAIN_MSGu8MCUR_Cali[3] "MAIN_MSGu8MCUR_Cali[3]" UBYTE I_1 1 2 0 255 ECU_ADDRESS 0x0 /end MEASUREMENT
/begin MEASUREMENT MAIN_MSGu8MCUR_Cali[4] "MAIN_MSGu8MCUR_Cali[4]" UBYTE I_1 1 2 0 255 ECU_ADDRESS 0x0 /end MEASUREMENT
/begin MEASUREMENT MAIN_MSGu8MCUR_Cali[5] "MAIN_MSGu8MCUR_Cali[5]" UBYTE I_1 1 2 0 255 ECU_ADDRESS 0x0 /end MEASUREMENT
/begin MEASUREMENT MAIN_MSGu8MCUR_Cali[6] "MAIN_MSGu8MCUR_Cali[6]" UBYTE I_1 1 2 0 255 ECU_ADDRESS 0x0 /end MEASUREMENT
/begin MEASUREMENT MAIN_MSGu8MCUR_Cali[7] "MAIN_MSGu8MCUR_Cali[7]" UBYTE I_1 1 2 0 255 ECU_ADDRESS 0x0 /end MEASUREMENT
/begin MEASUREMENT MAIN_MSGu8MCU_CheckSum110 "..." UBYTE I_1 1 2 0 255 ECU_ADDRESS 0x0 /end MEASUREMENT
/begin MEASUREMENT MAIN_MSGu8MCU_CheckSum_112 "..." UBYTE I_1 1 2 0 255 ECU_ADDRESS 0x0 /end MEASUREMENT
/begin MEASUREMENT MAIN_MSGu8MCU_CheckSum_MCU3 "..." UBYTE I_1 1 2 0 255 ECU_ADDRESS 0x0 /end MEASUREMENT
/begin MEASUREMENT MAIN_MSGu8MCU_ControllerTempRaw "..." UBYTE I_1 1 2 0 255 ECU_ADDRESS 0x0 /end MEASUREMENT
/begin MEASUREMENT MAIN_MSGu8MCU_Fault_buf "-" UBYTE Id_0x00 1 2 0 255 MATRIX_DIM 8 1 1 ECU_ADDRESS 0x0 /end MEASUREMENT
/begin MEASUREMENT MAIN_MSGu8MCU_Fault_buf[0] "MAIN_MSGu8MCU_Fault_buf[0]" UBYTE Id_0x00 1 2 0 255 ECU_ADDRESS 0x0 /end MEASUREMENT
/begin MEASUREMENT MAIN_MSGu8MCU_Fault_buf[1] "MAIN_MSGu8MCU_Fault_buf[1]" UBYTE Id_0x00 1 2 0 255 ECU_ADDRESS 0x0 /end MEASUREMENT
/begin MEASUREMENT MAIN_MSGu8MCU_Fault_buf[2] "MAIN_MSGu8MCU_Fault_buf[2]" UBYTE Id_0x00 1 2 0 255 ECU_ADDRESS 0x0 /end MEASUREMENT
/begin MEASUREMENT MAIN_MSGu8MCU_Fault_buf[3] "MAIN_MSGu8MCU_Fault_buf[3]" UBYTE Id_0x00 1 2 0 255 ECU_ADDRESS 0x0 /end MEASUREMENT
/begin MEASUREMENT MAIN_MSGu8MCU_Fault_buf[4] "MAIN_MSGu8MCU_Fault_buf[4]" UBYTE Id_0x00 1 2 0 255 ECU_ADDRESS 0x0 /end MEASUREMENT
/begin MEASUREMENT MAIN_MSGu8MCU_Fault_buf[5] "MAIN_MSGu8MCU_Fault_buf[5]" UBYTE Id_0x00 1 2 0 255 ECU_ADDRESS 0x0 /end MEASUREMENT
/begin MEASUREMENT MAIN_MSGu8MCU_Fault_buf[6] "MAIN_MSGu8MCU_Fault_buf[6]" UBYTE Id_0x00 1 2 0 255 ECU_ADDRESS 0x0 /end MEASUREMENT
/begin MEASUREMENT MAIN_MSGu8MCU_Fault_buf[7] "MAIN_MSGu8MCU_Fault_buf[7]" UBYTE Id_0x00 1 2 0 255 ECU_ADDRESS 0x0 /end MEASUREMENT
/begin MEASUREMENT MAIN_MSGu8MCU_InverterWorkingState "..." UBYTE I_1 1 2 0 255 ECU_ADDRESS 0x0 /end MEASUREMENT
/begin MEASUREMENT MAIN_MSGu8MCU_MCU_MotorFaultLamp "..." UBYTE I_1 1 2 0 255 ECU_ADDRESS 0x0 /end MEASUREMENT
/begin MEASUREMENT MAIN_MSGu8MCU_McuPrevSlipFlg "..." UBYTE I_1 1 2 0 255 ECU_ADDRESS 0x0 /end MEASUREMENT
/begin MEASUREMENT MAIN_MSGu8MCU_MotorSt "..." UBYTE I_1 1 2 0 255 ECU_ADDRESS 0x0 /end MEASUREMENT
/begin MEASUREMENT MAIN_MSGu8MCU_MotorSysFaultLvl "..." UBYTE I_1 1 2 0 255 ECU_ADDRESS 0x0 /end MEASUREMENT
/begin MEASUREMENT MAIN_MSGu8MCU_MotorTempRaw "..." UBYTE I_1 1 2 0 255 ECU_ADDRESS 0x0 /end MEASUREMENT
/begin MEASUREMENT MAIN_MSGu8MCU_RollingCount110 "..." UBYTE I_1 1 2 0 255 ECU_ADDRESS 0x0 /end MEASUREMENT
/begin MEASUREMENT MAIN_MSGu8MCU_RollingCount_112 "..." UBYTE I_1 1 2 0 255 ECU_ADDRESS 0x0 /end MEASUREMENT
/begin MEASUREMENT MAIN_MSGu8MCU_RollingCount_MCU3 "..." UBYTE I_1 1 2 0 255 ECU_ADDRESS 0x0 /end MEASUREMENT
/begin MEASUREMENT MAIN_MSGu8MP5_TBOX_Time_Date "..." UBYTE I_1 1 2 0 255 ECU_ADDRESS 0x0 /end MEASUREMENT
/begin MEASUREMENT MAIN_MSGu8MP5_TBOX_Time_Hour "..." UBYTE I_1 1 2 0 255 ECU_ADDRESS 0x0 /end MEASUREMENT
/begin MEASUREMENT MAIN_MSGu8MP5_TBOX_Time_Minute "..." UBYTE I_1 1 2 0 255 ECU_ADDRESS 0x0 /end MEASUREMENT
/begin MEASUREMENT MAIN_MSGu8MP5_TBOX_Time_Month "..." UBYTE I_1 1 2 0 255 ECU_ADDRESS 0x0 /end MEASUREMENT
/begin MEASUREMENT MAIN_MSGu8MP5_TBOX_Time_Second "..." UBYTE I_1 1 2 0 255 ECU_ADDRESS 0x0 /end MEASUREMENT
/begin MEASUREMENT MAIN_MSGu8MP5_TBOX_Time_YearRaw "..." UBYTE I_1 1 2 0 255 ECU_ADDRESS 0x0 /end MEASUREMENT
/begin MEASUREMENT MAIN_MSGu8MTCUGCU_buf "-" UBYTE Id_0x00 1 2 0 255 MATRIX_DIM 8 1 1 ECU_ADDRESS 0x0 /end MEASUREMENT
/begin MEASUREMENT MAIN_MSGu8MTCUGCU_buf[0] "MAIN_MSGu8MTCUGCU_buf[0]" UBYTE Id_0x00 1 2 0 255 ECU_ADDRESS 0x0 /end MEASUREMENT
/begin MEASUREMENT MAIN_MSGu8MTCUGCU_buf[1] "MAIN_MSGu8MTCUGCU_buf[1]" UBYTE Id_0x00 1 2 0 255 ECU_ADDRESS 0x0 /end MEASUREMENT
/begin MEASUREMENT MAIN_MSGu8MTCUGCU_buf[2] "MAIN_MSGu8MTCUGCU_buf[2]" UBYTE Id_0x00 1 2 0 255 ECU_ADDRESS 0x0 /end MEASUREMENT
/begin MEASUREMENT MAIN_MSGu8MTCUGCU_buf[3] "MAIN_MSGu8MTCUGCU_buf[3]" UBYTE Id_0x00 1 2 0 255 ECU_ADDRESS 0x0 /end MEASUREMENT
/begin MEASUREMENT MAIN_MSGu8MTCUGCU_buf[4] "MAIN_MSGu8MTCUGCU_buf[4]" UBYTE Id_0x00 1 2 0 255 ECU_ADDRESS 0x0 /end MEASUREMENT
/begin MEASUREMENT MAIN_MSGu8MTCUGCU_buf[5] "MAIN_MSGu8MTCUGCU_buf[5]" UBYTE Id_0x00 1 2 0 255 ECU_ADDRESS 0x0 /end MEASUREMENT
/begin MEASUREMENT MAIN_MSGu8MTCUGCU_buf[6] "MAIN_MSGu8MTCUGCU_buf[6]" UBYTE Id_0x00 1 2 0 255 ECU_ADDRESS 0x0 /end MEASUREMENT
/begin MEASUREMENT MAIN_MSGu8MTCUGCU_buf[7] "MAIN_MSGu8MTCUGCU_buf[7]" UBYTE Id_0x00 1 2 0 255 ECU_ADDRESS 0x0 /end MEASUREMENT
/begin MEASUREMENT MAIN_MSGu8MTCUMCU_buf "-" UBYTE Id_0x00 1 2 0 255 MATRIX_DIM 8 1 1 ECU_ADDRESS 0x0 /end MEASUREMENT
/begin MEASUREMENT MAIN_MSGu8MTCUMCU_buf[0] "MAIN_MSGu8MTCUMCU_buf[0]" UBYTE Id_0x00 1 2 0 255 ECU_ADDRESS 0x0 /end MEASUREMENT
/begin MEASUREMENT MAIN_MSGu8MTCUMCU_buf[1] "MAIN_MSGu8MTCUMCU_buf[1]" UBYTE Id_0x00 1 2 0 255 ECU_ADDRESS 0x0 /end MEASUREMENT
/begin MEASUREMENT MAIN_MSGu8MTCUMCU_buf[2] "MAIN_MSGu8MTCUMCU_buf[2]" UBYTE Id_0x00 1 2 0 255 ECU_ADDRESS 0x0 /end MEASUREMENT
/begin MEASUREMENT MAIN_MSGu8MTCUMCU_buf[3] "MAIN_MSGu8MTCUMCU_buf[3]" UBYTE Id_0x00 1 2 0 255 ECU_ADDRESS 0x0 /end MEASUREMENT
/begin MEASUREMENT MAIN_MSGu8MTCUMCU_buf[4] "MAIN_MSGu8MTCUMCU_buf[4]" UBYTE Id_0x00 1 2 0 255 ECU_ADDRESS 0x0 /end MEASUREMENT
/begin MEASUREMENT MAIN_MSGu8MTCUMCU_buf[5] "MAIN_MSGu8MTCUMCU_buf[5]" UBYTE Id_0x00 1 2 0 255 ECU_ADDRESS 0x0 /end MEASUREMENT
/begin MEASUREMENT MAIN_MSGu8MTCUMCU_buf[6] "MAIN_MSGu8MTCUMCU_buf[6]" UBYTE Id_0x00 1 2 0 255 ECU_ADDRESS 0x0 /end MEASUREMENT
/begin MEASUREMENT MAIN_MSGu8MTCUMCU_buf[7] "MAIN_MSGu8MTCUMCU_buf[7]" UBYTE Id_0x00 1 2 0 255 ECU_ADDRESS 0x0 /end MEASUREMENT
/begin MEASUREMENT MAIN_MSGu8MTCU_DevelopFrame_buf "-" UBYTE Id_0x00 1 2 0 255 MATRIX_DIM 8 1 1 ECU_ADDRESS 0x0 /end MEASUREMENT
/begin MEASUREMENT MAIN_MSGu8MTCU_DevelopFrame_buf[0] "MAIN_MSGu8MTCU_DevelopFrame_buf[0]" UBYTE Id_0x00 1 2 0 255 ECU_ADDRESS 0x0 /end MEASUREMENT
/begin MEASUREMENT MAIN_MSGu8MTCU_DevelopFrame_buf[1] "MAIN_MSGu8MTCU_DevelopFrame_buf[1]" UBYTE Id_0x00 1 2 0 255 ECU_ADDRESS 0x0 /end MEASUREMENT
/begin MEASUREMENT MAIN_MSGu8MTCU_DevelopFrame_buf[2] "MAIN_MSGu8MTCU_DevelopFrame_buf[2]" UBYTE Id_0x00 1 2 0 255 ECU_ADDRESS 0x0 /end MEASUREMENT
/begin MEASUREMENT MAIN_MSGu8MTCU_DevelopFrame_buf[3] "MAIN_MSGu8MTCU_DevelopFrame_buf[3]" UBYTE Id_0x00 1 2 0 255 ECU_ADDRESS 0x0 /end MEASUREMENT
/begin MEASUREMENT MAIN_MSGu8MTCU_DevelopFrame_buf[4] "MAIN_MSGu8MTCU_DevelopFrame_buf[4]" UBYTE Id_0x00 1 2 0 255 ECU_ADDRESS 0x0 /end MEASUREMENT
/begin MEASUREMENT MAIN_MSGu8MTCU_DevelopFrame_buf[5] "MAIN_MSGu8MTCU_DevelopFrame_buf[5]" UBYTE Id_0x00 1 2 0 255 ECU_ADDRESS 0x0 /end MEASUREMENT
/begin MEASUREMENT MAIN_MSGu8MTCU_DevelopFrame_buf[6] "MAIN_MSGu8MTCU_DevelopFrame_buf[6]" UBYTE Id_0x00 1 2 0 255 ECU_ADDRESS 0x0 /end MEASUREMENT
/begin MEASUREMENT MAIN_MSGu8MTCU_DevelopFrame_buf[7] "MAIN_MSGu8MTCU_DevelopFrame_buf[7]" UBYTE Id_0x00 1 2 0 255 ECU_ADDRESS 0x0 /end MEASUREMENT
/begin MEASUREMENT MAIN_MSGu8MTCU_EngineAuthResul_buf "-" UBYTE Id_0x00 1 2 0 255 MATRIX_DIM 8 1 1 ECU_ADDRESS 0x0 /end MEASUREMENT
/begin MEASUREMENT MAIN_MSGu8MTCU_EngineAuthResul_buf[0] "MAIN_MSGu8MTCU_EngineAuthResul_buf[0]" UBYTE Id_0x00 1 2 0 255 ECU_ADDRESS 0x0 /end MEASUREMENT
/begin MEASUREMENT MAIN_MSGu8MTCU_EngineAuthResul_buf[1] "MAIN_MSGu8MTCU_EngineAuthResul_buf[1]" UBYTE Id_0x00 1 2 0 255 ECU_ADDRESS 0x0 /end MEASUREMENT
/begin MEASUREMENT MAIN_MSGu8MTCU_EngineAuthResul_buf[2] "MAIN_MSGu8MTCU_EngineAuthResul_buf[2]" UBYTE Id_0x00 1 2 0 255 ECU_ADDRESS 0x0 /end MEASUREMENT
/begin MEASUREMENT MAIN_MSGu8MTCU_EngineAuthResul_buf[3] "MAIN_MSGu8MTCU_EngineAuthResul_buf[3]" UBYTE Id_0x00 1 2 0 255 ECU_ADDRESS 0x0 /end MEASUREMENT
/begin MEASUREMENT MAIN_MSGu8MTCU_EngineAuthResul_buf[4] "MAIN_MSGu8MTCU_EngineAuthResul_buf[4]" UBYTE Id_0x00 1 2 0 255 ECU_ADDRESS 0x0 /end MEASUREMENT
/begin MEASUREMENT MAIN_MSGu8MTCU_EngineAuthResul_buf[5] "MAIN_MSGu8MTCU_EngineAuthResul_buf[5]" UBYTE Id_0x00 1 2 0 255 ECU_ADDRESS 0x0 /end MEASUREMENT
/begin MEASUREMENT MAIN_MSGu8MTCU_EngineAuthResul_buf[6] "MAIN_MSGu8MTCU_EngineAuthResul_buf[6]" UBYTE Id_0x00 1 2 0 255 ECU_ADDRESS 0x0 /end MEASUREMENT
/begin MEASUREMENT MAIN_MSGu8MTCU_EngineAuthResul_buf[7] "MAIN_MSGu8MTCU_EngineAuthResul_buf[7]" UBYTE Id_0x00 1 2 0 255 ECU_ADDRESS 0x0 /end MEASUREMENT
/begin MEASUREMENT MAIN_MSGu8MTCU_HTCU1_buf "-" UBYTE Id_0x00 1 2 0 255 MATRIX_DIM 8 1 1 ECU_ADDRESS 0x0 /end MEASUREMENT
/begin MEASUREMENT MAIN_MSGu8MTCU_HTCU1_buf[0] "MAIN_MSGu8MTCU_HTCU1_buf[0]" UBYTE Id_0x00 1 2 0 255 ECU_ADDRESS 0x0 /end MEASUREMENT
/begin MEASUREMENT MAIN_MSGu8MTCU_HTCU1_buf[1] "MAIN_MSGu8MTCU_HTCU1_buf[1]" UBYTE Id_0x00 1 2 0 255 ECU_ADDRESS 0x0 /end MEASUREMENT
/begin MEASUREMENT MAIN_MSGu8MTCU_HTCU1_buf[2] "MAIN_MSGu8MTCU_HTCU1_buf[2]" UBYTE Id_0x00 1 2 0 255 ECU_ADDRESS 0x0 /end MEASUREMENT
/begin MEASUREMENT MAIN_MSGu8MTCU_HTCU1_buf[3] "MAIN_MSGu8MTCU_HTCU1_buf[3]" UBYTE Id_0x00 1 2 0 255 ECU_ADDRESS 0x0 /end MEASUREMENT
/begin MEASUREMENT MAIN_MSGu8MTCU_HTCU1_buf[4] "MAIN_MSGu8MTCU_HTCU1_buf[4]" UBYTE Id_0x00 1 2 0 255 ECU_ADDRESS 0x0 /end MEASUREMENT
/begin MEASUREMENT MAIN_MSGu8MTCU_HTCU1_buf[5] "MAIN_MSGu8MTCU_HTCU1_buf[5]" UBYTE Id_0x00 1 2 0 255 ECU_ADDRESS 0x0 /end MEASUREMENT
/begin MEASUREMENT MAIN_MSGu8MTCU_HTCU1_buf[6] "MAIN_MSGu8MTCU_HTCU1_buf[6]" UBYTE Id_0x00 1 2 0 255 ECU_ADDRESS 0x0 /end MEASUREMENT
/begin MEASUREMENT MAIN_MSGu8MTCU_HTCU1_buf[7] "MAIN_MSGu8MTCU_HTCU1_buf[7]" UBYTE Id_0x00 1 2 0 255 ECU_ADDRESS 0x0 /end MEASUREMENT
/begin MEASUREMENT MAIN_MSGu8MTCU_IMMO_buf "-" UBYTE Id_0x00 1 2 0 255 MATRIX_DIM 8 1 1 ECU_ADDRESS 0x0 /end MEASUREMENT
/begin MEASUREMENT MAIN_MSGu8MTCU_IMMO_buf[0] "MAIN_MSGu8MTCU_IMMO_buf[0]" UBYTE Id_0x00 1 2 0 255 ECU_ADDRESS 0x0 /end MEASUREMENT
/begin MEASUREMENT MAIN_MSGu8MTCU_IMMO_buf[1] "MAIN_MSGu8MTCU_IMMO_buf[1]" UBYTE Id_0x00 1 2 0 255 ECU_ADDRESS 0x0 /end MEASUREMENT
/begin MEASUREMENT MAIN_MSGu8MTCU_IMMO_buf[2] "MAIN_MSGu8MTCU_IMMO_buf[2]" UBYTE Id_0x00 1 2 0 255 ECU_ADDRESS 0x0 /end MEASUREMENT
/begin MEASUREMENT MAIN_MSGu8MTCU_IMMO_buf[3] "MAIN_MSGu8MTCU_IMMO_buf[3]" UBYTE Id_0x00 1 2 0 255 ECU_ADDRESS 0x0 /end MEASUREMENT
/begin MEASUREMENT MAIN_MSGu8MTCU_IMMO_buf[4] "MAIN_MSGu8MTCU_IMMO_buf[4]" UBYTE Id_0x00 1 2 0 255 ECU_ADDRESS 0x0 /end MEASUREMENT
/begin MEASUREMENT MAIN_MSGu8MTCU_IMMO_buf[5] "MAIN_MSGu8MTCU_IMMO_buf[5]" UBYTE Id_0x00 1 2 0 255 ECU_ADDRESS 0x0 /end MEASUREMENT
/begin MEASUREMENT MAIN_MSGu8MTCU_IMMO_buf[6] "MAIN_MSGu8MTCU_IMMO_buf[6]" UBYTE Id_0x00 1 2 0 255 ECU_ADDRESS 0x0 /end MEASUREMENT
/begin MEASUREMENT MAIN_MSGu8MTCU_IMMO_buf[7] "MAIN_MSGu8MTCU_IMMO_buf[7]" UBYTE Id_0x00 1 2 0 255 ECU_ADDRESS 0x0 /end MEASUREMENT
/begin MEASUREMENT MAIN_MSGu8MTCU_OPC_test6_buf "-" UBYTE Id_0x00 1 2 0 255 MATRIX_DIM 8 1 1 ECU_ADDRESS 0x0 /end MEASUREMENT
/begin MEASUREMENT MAIN_MSGu8MTCU_OPC_test6_buf[0] "MAIN_MSGu8MTCU_OPC_test6_buf[0]" UBYTE Id_0x00 1 2 0 255 ECU_ADDRESS 0x0 /end MEASUREMENT
/begin MEASUREMENT MAIN_MSGu8MTCU_OPC_test6_buf[1] "MAIN_MSGu8MTCU_OPC_test6_buf[1]" UBYTE Id_0x00 1 2 0 255 ECU_ADDRESS 0x0 /end MEASUREMENT
/begin MEASUREMENT MAIN_MSGu8MTCU_OPC_test6_buf[2] "MAIN_MSGu8MTCU_OPC_test6_buf[2]" UBYTE Id_0x00 1 2 0 255 ECU_ADDRESS 0x0 /end MEASUREMENT
/begin MEASUREMENT MAIN_MSGu8MTCU_OPC_test6_buf[3] "MAIN_MSGu8MTCU_OPC_test6_buf[3]" UBYTE Id_0x00 1 2 0 255 ECU_ADDRESS 0x0 /end MEASUREMENT
/begin MEASUREMENT MAIN_MSGu8MTCU_OPC_test6_buf[4] "MAIN_MSGu8MTCU_OPC_test6_buf[4]" UBYTE Id_0x00 1 2 0 255 ECU_ADDRESS 0x0 /end MEASUREMENT
/begin MEASUREMENT MAIN_MSGu8MTCU_OPC_test6_buf[5] "MAIN_MSGu8MTCU_OPC_test6_buf[5]" UBYTE Id_0x00 1 2 0 255 ECU_ADDRESS 0x0 /end MEASUREMENT
/begin MEASUREMENT MAIN_MSGu8MTCU_OPC_test6_buf[6] "MAIN_MSGu8MTCU_OPC_test6_buf[6]" UBYTE Id_0x00 1 2 0 255 ECU_ADDRESS 0x0 /end MEASUREMENT
/begin MEASUREMENT MAIN_MSGu8MTCU_OPC_test6_buf[7] "MAIN_MSGu8MTCU_OPC_test6_buf[7]" UBYTE Id_0x00 1 2 0 255 ECU_ADDRESS 0x0 /end MEASUREMENT
/begin MEASUREMENT MAIN_MSGu8McuDTC "..." UBYTE I_1 1 2 0 255 ECU_ADDRESS 0x0 /end MEASUREMENT
/begin MEASUREMENT MAIN_MSGu8McuMotSN "..." UBYTE I_1 1 2 0 255 ECU_ADDRESS 0x0 /end MEASUREMENT
/begin MEASUREMENT MAIN_MSGu8McuMotSubFltLevel "..." UBYTE I_1 1 2 0 255 ECU_ADDRESS 0x0 /end MEASUREMENT
/begin MEASUREMENT MAIN_MSGu8McuSoftMajorVer "..." UBYTE I_1 1 2 0 255 ECU_ADDRESS 0x0 /end MEASUREMENT
/begin MEASUREMENT MAIN_MSGu8McuSoftMinorVer "..." UBYTE I_1 1 2 0 255 ECU_ADDRESS 0x0 /end MEASUREMENT
/begin MEASUREMENT MAIN_MSGu8OPC1_buf "-" UBYTE Id_0x00 1 2 0 255 MATRIX_DIM 8 1 1 ECU_ADDRESS 0x0 /end MEASUREMENT
/begin MEASUREMENT MAIN_MSGu8OPC1_buf[0] "MAIN_MSGu8OPC1_buf[0]" UBYTE Id_0x00 1 2 0 255 ECU_ADDRESS 0x0 /end MEASUREMENT
/begin MEASUREMENT MAIN_MSGu8OPC1_buf[1] "MAIN_MSGu8OPC1_buf[1]" UBYTE Id_0x00 1 2 0 255 ECU_ADDRESS 0x0 /end MEASUREMENT
/begin MEASUREMENT MAIN_MSGu8OPC1_buf[2] "MAIN_MSGu8OPC1_buf[2]" UBYTE Id_0x00 1 2 0 255 ECU_ADDRESS 0x0 /end MEASUREMENT
/begin MEASUREMENT MAIN_MSGu8OPC1_buf[3] "MAIN_MSGu8OPC1_buf[3]" UBYTE Id_0x00 1 2 0 255 ECU_ADDRESS 0x0 /end MEASUREMENT
/begin MEASUREMENT MAIN_MSGu8OPC1_buf[4] "MAIN_MSGu8OPC1_buf[4]" UBYTE Id_0x00 1 2 0 255 ECU_ADDRESS 0x0 /end MEASUREMENT
/begin MEASUREMENT MAIN_MSGu8OPC1_buf[5] "MAIN_MSGu8OPC1_buf[5]" UBYTE Id_0x00 1 2 0 255 ECU_ADDRESS 0x0 /end MEASUREMENT
/begin MEASUREMENT MAIN_MSGu8OPC1_buf[6] "MAIN_MSGu8OPC1_buf[6]" UBYTE Id_0x00 1 2 0 255 ECU_ADDRESS 0x0 /end MEASUREMENT
/begin MEASUREMENT MAIN_MSGu8OPC1_buf[7] "MAIN_MSGu8OPC1_buf[7]" UBYTE Id_0x00 1 2 0 255 ECU_ADDRESS 0x0 /end MEASUREMENT
/begin MEASUREMENT MAIN_MSGu8OPC_CheckSum3E7 "..." UBYTE I_1 1 2 0 255 ECU_ADDRESS 0x0 /end MEASUREMENT
/begin MEASUREMENT MAIN_MSGu8OPC_ErrLvlSts "..." UBYTE I_1 1 2 0 255 ECU_ADDRESS 0x0 /end MEASUREMENT
/begin MEASUREMENT MAIN_MSGu8OPC_RollingCount3E7 "..." UBYTE I_1 1 2 0 255 ECU_ADDRESS 0x0 /end MEASUREMENT
/begin MEASUREMENT MAIN_MSGu8OTA_EstimatedUpgradeTime "..." UBYTE I_1 1 2 0 255 ECU_ADDRESS 0x0 /end MEASUREMENT
/begin MEASUREMENT MAIN_MSGu8PwModOffCnt "MAIN_MSGu8PwModOffCnt" UBYTE I_1 1 2 0 255 ECU_ADDRESS 0x0 /end MEASUREMENT
/begin MEASUREMENT MAIN_MSGu8PwModOnCnt "MAIN_MSGu8PwModOnCnt" UBYTE I_1 1 2 0 255 ECU_ADDRESS 0x0 /end MEASUREMENT
/begin MEASUREMENT MAIN_MSGu8RollingCounter30A "..." UBYTE I_1 1 2 0 255 ECU_ADDRESS 0x0 /end MEASUREMENT
/begin MEASUREMENT MAIN_MSGu8TBOX_OTAInfo_buf "-" UBYTE Id_0x00 1 2 0 255 MATRIX_DIM 8 1 1 ECU_ADDRESS 0x0 /end MEASUREMENT
/begin MEASUREMENT MAIN_MSGu8TBOX_OTAInfo_buf[0] "MAIN_MSGu8TBOX_OTAInfo_buf[0]" UBYTE Id_0x00 1 2 0 255 ECU_ADDRESS 0x0 /end MEASUREMENT
/begin MEASUREMENT MAIN_MSGu8TBOX_OTAInfo_buf[1] "MAIN_MSGu8TBOX_OTAInfo_buf[1]" UBYTE Id_0x00 1 2 0 255 ECU_ADDRESS 0x0 /end MEASUREMENT
/begin MEASUREMENT MAIN_MSGu8TBOX_OTAInfo_buf[2] "MAIN_MSGu8TBOX_OTAInfo_buf[2]" UBYTE Id_0x00 1 2 0 255 ECU_ADDRESS 0x0 /end MEASUREMENT
/begin MEASUREMENT MAIN_MSGu8TBOX_OTAInfo_buf[3] "MAIN_MSGu8TBOX_OTAInfo_buf[3]" UBYTE Id_0x00 1 2 0 255 ECU_ADDRESS 0x0 /end MEASUREMENT
/begin MEASUREMENT MAIN_MSGu8TBOX_OTAInfo_buf[4] "MAIN_MSGu8TBOX_OTAInfo_buf[4]" UBYTE Id_0x00 1 2 0 255 ECU_ADDRESS 0x0 /end MEASUREMENT
/begin MEASUREMENT MAIN_MSGu8TBOX_OTAInfo_buf[5] "MAIN_MSGu8TBOX_OTAInfo_buf[5]" UBYTE Id_0x00 1 2 0 255 ECU_ADDRESS 0x0 /end MEASUREMENT
/begin MEASUREMENT MAIN_MSGu8TBOX_OTAInfo_buf[6] "MAIN_MSGu8TBOX_OTAInfo_buf[6]" UBYTE Id_0x00 1 2 0 255 ECU_ADDRESS 0x0 /end MEASUREMENT
/begin MEASUREMENT MAIN_MSGu8TBOX_OTAInfo_buf[7] "MAIN_MSGu8TBOX_OTAInfo_buf[7]" UBYTE Id_0x00 1 2 0 255 ECU_ADDRESS 0x0 /end MEASUREMENT
/begin MEASUREMENT MAIN_MSGu8TCU_ClutchProgress "..." UBYTE I_1 1 2 0 255 ECU_ADDRESS 0x0 /end MEASUREMENT
/begin MEASUREMENT MAIN_MSGu8VCU2_buf "-" UBYTE Id_0x00 1 2 0 255 MATRIX_DIM 8 1 1 ECU_ADDRESS 0x0 /end MEASUREMENT
/begin MEASUREMENT MAIN_MSGu8VCU2_buf[0] "MAIN_MSGu8VCU2_buf[0]" UBYTE Id_0x00 1 2 0 255 ECU_ADDRESS 0x0 /end MEASUREMENT
/begin MEASUREMENT MAIN_MSGu8VCU2_buf[1] "MAIN_MSGu8VCU2_buf[1]" UBYTE Id_0x00 1 2 0 255 ECU_ADDRESS 0x0 /end MEASUREMENT
/begin MEASUREMENT MAIN_MSGu8VCU2_buf[2] "MAIN_MSGu8VCU2_buf[2]" UBYTE Id_0x00 1 2 0 255 ECU_ADDRESS 0x0 /end MEASUREMENT
/begin MEASUREMENT MAIN_MSGu8VCU2_buf[3] "MAIN_MSGu8VCU2_buf[3]" UBYTE Id_0x00 1 2 0 255 ECU_ADDRESS 0x0 /end MEASUREMENT
/begin MEASUREMENT MAIN_MSGu8VCU2_buf[4] "MAIN_MSGu8VCU2_buf[4]" UBYTE Id_0x00 1 2 0 255 ECU_ADDRESS 0x0 /end MEASUREMENT
/begin MEASUREMENT MAIN_MSGu8VCU2_buf[5] "MAIN_MSGu8VCU2_buf[5]" UBYTE Id_0x00 1 2 0 255 ECU_ADDRESS 0x0 /end MEASUREMENT
/begin MEASUREMENT MAIN_MSGu8VCU2_buf[6] "MAIN_MSGu8VCU2_buf[6]" UBYTE Id_0x00 1 2 0 255 ECU_ADDRESS 0x0 /end MEASUREMENT
/begin MEASUREMENT MAIN_MSGu8VCU2_buf[7] "MAIN_MSGu8VCU2_buf[7]" UBYTE Id_0x00 1 2 0 255 ECU_ADDRESS 0x0 /end MEASUREMENT
/begin MEASUREMENT MAIN_MSGu8VCUCtrlDCDC_buf "-" UBYTE Id_0x00 1 2 0 255 MATRIX_DIM 8 1 1 ECU_ADDRESS 0x0 /end MEASUREMENT
/begin MEASUREMENT MAIN_MSGu8VCUCtrlDCDC_buf[0] "MAIN_MSGu8VCUCtrlDCDC_buf[0]" UBYTE Id_0x00 1 2 0 255 ECU_ADDRESS 0x0 /end MEASUREMENT
/begin MEASUREMENT MAIN_MSGu8VCUCtrlDCDC_buf[1] "MAIN_MSGu8VCUCtrlDCDC_buf[1]" UBYTE Id_0x00 1 2 0 255 ECU_ADDRESS 0x0 /end MEASUREMENT
/begin MEASUREMENT MAIN_MSGu8VCUCtrlDCDC_buf[2] "MAIN_MSGu8VCUCtrlDCDC_buf[2]" UBYTE Id_0x00 1 2 0 255 ECU_ADDRESS 0x0 /end MEASUREMENT
/begin MEASUREMENT MAIN_MSGu8VCUCtrlDCDC_buf[3] "MAIN_MSGu8VCUCtrlDCDC_buf[3]" UBYTE Id_0x00 1 2 0 255 ECU_ADDRESS 0x0 /end MEASUREMENT
/begin MEASUREMENT MAIN_MSGu8VCUCtrlDCDC_buf[4] "MAIN_MSGu8VCUCtrlDCDC_buf[4]" UBYTE Id_0x00 1 2 0 255 ECU_ADDRESS 0x0 /end MEASUREMENT
/begin MEASUREMENT MAIN_MSGu8VCUCtrlDCDC_buf[5] "MAIN_MSGu8VCUCtrlDCDC_buf[5]" UBYTE Id_0x00 1 2 0 255 ECU_ADDRESS 0x0 /end MEASUREMENT
/begin MEASUREMENT MAIN_MSGu8VCUCtrlDCDC_buf[6] "MAIN_MSGu8VCUCtrlDCDC_buf[6]" UBYTE Id_0x00 1 2 0 255 ECU_ADDRESS 0x0 /end MEASUREMENT
/begin MEASUREMENT MAIN_MSGu8VCUCtrlDCDC_buf[7] "MAIN_MSGu8VCUCtrlDCDC_buf[7]" UBYTE Id_0x00 1 2 0 255 ECU_ADDRESS 0x0 /end MEASUREMENT
/begin MEASUREMENT MAIN_MSGu8VCUCtrlMotor_buf "-" UBYTE Id_0x00 1 2 0 255 MATRIX_DIM 8 1 1 ECU_ADDRESS 0x0 /end MEASUREMENT
/begin MEASUREMENT MAIN_MSGu8VCUCtrlMotor_buf[0] "MAIN_MSGu8VCUCtrlMotor_buf[0]" UBYTE Id_0x00 1 2 0 255 ECU_ADDRESS 0x0 /end MEASUREMENT
/begin MEASUREMENT MAIN_MSGu8VCUCtrlMotor_buf[1] "MAIN_MSGu8VCUCtrlMotor_buf[1]" UBYTE Id_0x00 1 2 0 255 ECU_ADDRESS 0x0 /end MEASUREMENT
/begin MEASUREMENT MAIN_MSGu8VCUCtrlMotor_buf[2] "MAIN_MSGu8VCUCtrlMotor_buf[2]" UBYTE Id_0x00 1 2 0 255 ECU_ADDRESS 0x0 /end MEASUREMENT
/begin MEASUREMENT MAIN_MSGu8VCUCtrlMotor_buf[3] "MAIN_MSGu8VCUCtrlMotor_buf[3]" UBYTE Id_0x00 1 2 0 255 ECU_ADDRESS 0x0 /end MEASUREMENT
/begin MEASUREMENT MAIN_MSGu8VCUCtrlMotor_buf[4] "MAIN_MSGu8VCUCtrlMotor_buf[4]" UBYTE Id_0x00 1 2 0 255 ECU_ADDRESS 0x0 /end MEASUREMENT
/begin MEASUREMENT MAIN_MSGu8VCUCtrlMotor_buf[5] "MAIN_MSGu8VCUCtrlMotor_buf[5]" UBYTE Id_0x00 1 2 0 255 ECU_ADDRESS 0x0 /end MEASUREMENT
/begin MEASUREMENT MAIN_MSGu8VCUCtrlMotor_buf[6] "MAIN_MSGu8VCUCtrlMotor_buf[6]" UBYTE Id_0x00 1 2 0 255 ECU_ADDRESS 0x0 /end MEASUREMENT
/begin MEASUREMENT MAIN_MSGu8VCUCtrlMotor_buf[7] "MAIN_MSGu8VCUCtrlMotor_buf[7]" UBYTE Id_0x00 1 2 0 255 ECU_ADDRESS 0x0 /end MEASUREMENT
/begin MEASUREMENT MAIN_MSGu8VCU_AccPedPosRaw "..." UBYTE I_1 1 2 0 255 ECU_ADDRESS 0x0 /end MEASUREMENT
/begin MEASUREMENT MAIN_MSGu8VCU_AccPedal_buf "-" UBYTE Id_0x00 1 2 0 255 MATRIX_DIM 8 1 1 ECU_ADDRESS 0x0 /end MEASUREMENT
/begin MEASUREMENT MAIN_MSGu8VCU_AccPedal_buf[0] "MAIN_MSGu8VCU_AccPedal_buf[0]" UBYTE Id_0x00 1 2 0 255 ECU_ADDRESS 0x0 /end MEASUREMENT
/begin MEASUREMENT MAIN_MSGu8VCU_AccPedal_buf[1] "MAIN_MSGu8VCU_AccPedal_buf[1]" UBYTE Id_0x00 1 2 0 255 ECU_ADDRESS 0x0 /end MEASUREMENT
/begin MEASUREMENT MAIN_MSGu8VCU_AccPedal_buf[2] "MAIN_MSGu8VCU_AccPedal_buf[2]" UBYTE Id_0x00 1 2 0 255 ECU_ADDRESS 0x0 /end MEASUREMENT
/begin MEASUREMENT MAIN_MSGu8VCU_AccPedal_buf[3] "MAIN_MSGu8VCU_AccPedal_buf[3]" UBYTE Id_0x00 1 2 0 255 ECU_ADDRESS 0x0 /end MEASUREMENT
/begin MEASUREMENT MAIN_MSGu8VCU_AccPedal_buf[4] "MAIN_MSGu8VCU_AccPedal_buf[4]" UBYTE Id_0x00 1 2 0 255 ECU_ADDRESS 0x0 /end MEASUREMENT
/begin MEASUREMENT MAIN_MSGu8VCU_AccPedal_buf[5] "MAIN_MSGu8VCU_AccPedal_buf[5]" UBYTE Id_0x00 1 2 0 255 ECU_ADDRESS 0x0 /end MEASUREMENT
/begin MEASUREMENT MAIN_MSGu8VCU_AccPedal_buf[6] "MAIN_MSGu8VCU_AccPedal_buf[6]" UBYTE Id_0x00 1 2 0 255 ECU_ADDRESS 0x0 /end MEASUREMENT
/begin MEASUREMENT MAIN_MSGu8VCU_AccPedal_buf[7] "MAIN_MSGu8VCU_AccPedal_buf[7]" UBYTE Id_0x00 1 2 0 255 ECU_ADDRESS 0x0 /end MEASUREMENT
/begin MEASUREMENT MAIN_MSGu8VCU_CapacitorDischarge "..." UBYTE I_1 1 2 0 255 ECU_ADDRESS 0x0 /end MEASUREMENT
/begin MEASUREMENT MAIN_MSGu8VCU_CheckSum "..." UBYTE I_1 1 2 0 255 ECU_ADDRESS 0x0 /end MEASUREMENT
/begin MEASUREMENT MAIN_MSGu8VCU_CheckSumCB "..." UBYTE I_1 1 2 0 255 ECU_ADDRESS 0x0 /end MEASUREMENT
/begin MEASUREMENT MAIN_MSGu8VCU_CheckSumDF "..." UBYTE I_1 1 2 0 255 ECU_ADDRESS 0x0 /end MEASUREMENT
/begin MEASUREMENT MAIN_MSGu8VCU_CheckSumF0 "..." UBYTE I_1 1 2 0 255 ECU_ADDRESS 0x0 /end MEASUREMENT
/begin MEASUREMENT MAIN_MSGu8VCU_DCDCActivation "..." UBYTE I_1 1 2 0 255 ECU_ADDRESS 0x0 /end MEASUREMENT
/begin MEASUREMENT MAIN_MSGu8VCU_DCDCVoltageReqRaw "..." UBYTE I_1 1 2 0 255 ECU_ADDRESS 0x0 /end MEASUREMENT
/begin MEASUREMENT MAIN_MSGu8VCU_EMWorkMod "..." UBYTE I_1 1 2 0 255 ECU_ADDRESS 0x0 /end MEASUREMENT
/begin MEASUREMENT MAIN_MSGu8VCU_EngRunningStatusExpanded "..." UBYTE I_1 1 2 0 255 ECU_ADDRESS 0x0 /end MEASUREMENT
/begin MEASUREMENT MAIN_MSGu8VCU_Fault "..." UBYTE I_1 1 2 0 255 ECU_ADDRESS 0x0 /end MEASUREMENT
/begin MEASUREMENT MAIN_MSGu8VCU_GearFeedback "..." UBYTE I_1 1 2 0 255 ECU_ADDRESS 0x0 /end MEASUREMENT
/begin MEASUREMENT MAIN_MSGu8VCU_GeneratorStCtrl "..." UBYTE I_1 1 2 0 255 ECU_ADDRESS 0x0 /end MEASUREMENT
/begin MEASUREMENT MAIN_MSGu8VCU_HandBrakSts "..." UBYTE I_1 1 2 0 255 ECU_ADDRESS 0x0 /end MEASUREMENT
/begin MEASUREMENT MAIN_MSGu8VCU_MTCU_buf "-" UBYTE Id_0x00 1 2 0 255 MATRIX_DIM 8 1 1 ECU_ADDRESS 0x0 /end MEASUREMENT
/begin MEASUREMENT MAIN_MSGu8VCU_MTCU_buf[0] "MAIN_MSGu8VCU_MTCU_buf[0]" UBYTE Id_0x00 1 2 0 255 ECU_ADDRESS 0x0 /end MEASUREMENT
/begin MEASUREMENT MAIN_MSGu8VCU_MTCU_buf[1] "MAIN_MSGu8VCU_MTCU_buf[1]" UBYTE Id_0x00 1 2 0 255 ECU_ADDRESS 0x0 /end MEASUREMENT
/begin MEASUREMENT MAIN_MSGu8VCU_MTCU_buf[2] "MAIN_MSGu8VCU_MTCU_buf[2]" UBYTE Id_0x00 1 2 0 255 ECU_ADDRESS 0x0 /end MEASUREMENT
/begin MEASUREMENT MAIN_MSGu8VCU_MTCU_buf[3] "MAIN_MSGu8VCU_MTCU_buf[3]" UBYTE Id_0x00 1 2 0 255 ECU_ADDRESS 0x0 /end MEASUREMENT
/begin MEASUREMENT MAIN_MSGu8VCU_MTCU_buf[4] "MAIN_MSGu8VCU_MTCU_buf[4]" UBYTE Id_0x00 1 2 0 255 ECU_ADDRESS 0x0 /end MEASUREMENT
/begin MEASUREMENT MAIN_MSGu8VCU_MTCU_buf[5] "MAIN_MSGu8VCU_MTCU_buf[5]" UBYTE Id_0x00 1 2 0 255 ECU_ADDRESS 0x0 /end MEASUREMENT
/begin MEASUREMENT MAIN_MSGu8VCU_MTCU_buf[6] "MAIN_MSGu8VCU_MTCU_buf[6]" UBYTE Id_0x00 1 2 0 255 ECU_ADDRESS 0x0 /end MEASUREMENT
/begin MEASUREMENT MAIN_MSGu8VCU_MTCU_buf[7] "MAIN_MSGu8VCU_MTCU_buf[7]" UBYTE Id_0x00 1 2 0 255 ECU_ADDRESS 0x0 /end MEASUREMENT
/begin MEASUREMENT MAIN_MSGu8VCU_McuEnableReq "..." UBYTE I_1 1 2 0 255 ECU_ADDRESS 0x0 /end MEASUREMENT
/begin MEASUREMENT MAIN_MSGu8VCU_MotorStCtrl "..." UBYTE I_1 1 2 0 255 ECU_ADDRESS 0x0 /end MEASUREMENT
/begin MEASUREMENT MAIN_MSGu8VCU_RollingCount "..." UBYTE I_1 1 2 0 255 ECU_ADDRESS 0x0 /end MEASUREMENT
/begin MEASUREMENT MAIN_MSGu8VCU_RollingCountCB "..." UBYTE I_1 1 2 0 255 ECU_ADDRESS 0x0 /end MEASUREMENT
/begin MEASUREMENT MAIN_MSGu8VCU_RollingCountDF "..." UBYTE I_1 1 2 0 255 ECU_ADDRESS 0x0 /end MEASUREMENT
/begin MEASUREMENT MAIN_MSGu8VCU_RollingCountF0 "..." UBYTE I_1 1 2 0 255 ECU_ADDRESS 0x0 /end MEASUREMENT
/begin MEASUREMENT MAIN_MSGu8VCU_ePTReady "..." UBYTE I_1 1 2 0 255 ECU_ADDRESS 0x0 /end MEASUREMENT
/begin MEASUREMENT MAIN_MSGu8VCUtoDisplay_buf "-" UBYTE Id_0x00 1 2 0 255 MATRIX_DIM 8 1 1 ECU_ADDRESS 0x0 /end MEASUREMENT
/begin MEASUREMENT MAIN_MSGu8VCUtoDisplay_buf[0] "MAIN_MSGu8VCUtoDisplay_buf[0]" UBYTE Id_0x00 1 2 0 255 ECU_ADDRESS 0x0 /end MEASUREMENT
/begin MEASUREMENT MAIN_MSGu8VCUtoDisplay_buf[1] "MAIN_MSGu8VCUtoDisplay_buf[1]" UBYTE Id_0x00 1 2 0 255 ECU_ADDRESS 0x0 /end MEASUREMENT
/begin MEASUREMENT MAIN_MSGu8VCUtoDisplay_buf[2] "MAIN_MSGu8VCUtoDisplay_buf[2]" UBYTE Id_0x00 1 2 0 255 ECU_ADDRESS 0x0 /end MEASUREMENT
/begin MEASUREMENT MAIN_MSGu8VCUtoDisplay_buf[3] "MAIN_MSGu8VCUtoDisplay_buf[3]" UBYTE Id_0x00 1 2 0 255 ECU_ADDRESS 0x0 /end MEASUREMENT
/begin MEASUREMENT MAIN_MSGu8VCUtoDisplay_buf[4] "MAIN_MSGu8VCUtoDisplay_buf[4]" UBYTE Id_0x00 1 2 0 255 ECU_ADDRESS 0x0 /end MEASUREMENT
/begin MEASUREMENT MAIN_MSGu8VCUtoDisplay_buf[5] "MAIN_MSGu8VCUtoDisplay_buf[5]" UBYTE Id_0x00 1 2 0 255 ECU_ADDRESS 0x0 /end MEASUREMENT
/begin MEASUREMENT MAIN_MSGu8VCUtoDisplay_buf[6] "MAIN_MSGu8VCUtoDisplay_buf[6]" UBYTE Id_0x00 1 2 0 255 ECU_ADDRESS 0x0 /end MEASUREMENT
/begin MEASUREMENT MAIN_MSGu8VCUtoDisplay_buf[7] "MAIN_MSGu8VCUtoDisplay_buf[7]" UBYTE Id_0x00 1 2 0 255 ECU_ADDRESS 0x0 /end MEASUREMENT
/begin MEASUREMENT MAIN_MSGu8VECU_ShiftSpeedType "..." UBYTE I_1 1 2 0 255 ECU_ADDRESS 0x0 /end MEASUREMENT
/begin MEASUREMENT MAIN_MSGu8VECU_TargetDrumPos "..." UBYTE I_1 1 2 0 255 ECU_ADDRESS 0x0 /end MEASUREMENT
/begin MEASUREMENT MAIN_TCUf32CAP_AvrgCurrentPhys "..." FLOAT32_IEEE I_37 1 2 -3.402823466E+038 3.402823466E+038 ECU_ADDRESS 0x0 /end MEASUREMENT
/begin MEASUREMENT MAIN_TCUf32CAP_DutyCyclePhys "..." FLOAT32_IEEE I_37 1 2 -3.402823466E+038 3.402823466E+038 ECU_ADDRESS 0x0 /end MEASUREMENT
/begin MEASUREMENT MAIN_TCUf32CAP_MotSpeedPhys "..." FLOAT32_IEEE I_37 1 2 -3.402823466E+038 3.402823466E+038 ECU_ADDRESS 0x0 /end MEASUREMENT
/begin MEASUREMENT MAIN_TCUf32CAP_TargetDutyCyclePhys "..." FLOAT32_IEEE I_41 1 2 -3.402823466E+038 3.402823466E+038 ECU_ADDRESS 0x0 /end MEASUREMENT
/begin MEASUREMENT MAIN_TCUu8CAP_TargetMotSts "..." UBYTE I_1 1 2 0 255 ECU_ADDRESS 0x0 /end MEASUREMENT
/begin MEASUREMENT MAIN_TotalTime "MAIN_TotalTime" ULONG I_1 1 2 0 4294967295 ECU_ADDRESS 0x0 /end MEASUREMENT
/begin MEASUREMENT MAIN_as32OCTrimNvm "-" SLONG Id_0x00 1 2 -2147483648 2147483647 MATRIX_DIM 5 1 1 ECU_ADDRESS 0x0 /end MEASUREMENT
/begin MEASUREMENT MAIN_as32OCTrimNvm[0] "MAIN_as32OCTrimNvm[0]" SLONG Id_0x00 1 2 -2147483648 2147483647 ECU_ADDRESS 0x0 /end MEASUREMENT
/begin MEASUREMENT MAIN_as32OCTrimNvm[1] "MAIN_as32OCTrimNvm[1]" SLONG Id_0x00 1 2 -2147483648 2147483647 ECU_ADDRESS 0x0 /end MEASUREMENT
/begin MEASUREMENT MAIN_as32OCTrimNvm[2] "MAIN_as32OCTrimNvm[2]" SLONG Id_0x00 1 2 -2147483648 2147483647 ECU_ADDRESS 0x0 /end MEASUREMENT
/begin MEASUREMENT MAIN_as32OCTrimNvm[3] "MAIN_as32OCTrimNvm[3]" SLONG Id_0x00 1 2 -2147483648 2147483647 ECU_ADDRESS 0x0 /end MEASUREMENT
/begin MEASUREMENT MAIN_as32OCTrimNvm[4] "MAIN_as32OCTrimNvm[4]" SLONG Id_0x00 1 2 -2147483648 2147483647 ECU_ADDRESS 0x0 /end MEASUREMENT
/begin MEASUREMENT MAIN_au8ErrCode "-" UBYTE F_1_p0_4 1 2 0 255 MATRIX_DIM 20 1 1 ECU_ADDRESS 0x0 /end MEASUREMENT
/begin MEASUREMENT MAIN_au8ErrCode[0] "MAIN_au8ErrCode[0]" UBYTE F_1_p0_4 1 2 0 255 ECU_ADDRESS 0x0 /end MEASUREMENT
/begin MEASUREMENT MAIN_au8ErrCode[10] "MAIN_au8ErrCode[10]" UBYTE F_1_p0_4 1 2 0 255 ECU_ADDRESS 0x0 /end MEASUREMENT
/begin MEASUREMENT MAIN_au8ErrCode[11] "MAIN_au8ErrCode[11]" UBYTE F_1_p0_4 1 2 0 255 ECU_ADDRESS 0x0 /end MEASUREMENT
/begin MEASUREMENT MAIN_au8ErrCode[12] "MAIN_au8ErrCode[12]" UBYTE F_1_p0_4 1 2 0 255 ECU_ADDRESS 0x0 /end MEASUREMENT
/begin MEASUREMENT MAIN_au8ErrCode[13] "MAIN_au8ErrCode[13]" UBYTE F_1_p0_4 1 2 0 255 ECU_ADDRESS 0x0 /end MEASUREMENT
/begin MEASUREMENT MAIN_au8ErrCode[14] "MAIN_au8ErrCode[14]" UBYTE F_1_p0_4 1 2 0 255 ECU_ADDRESS 0x0 /end MEASUREMENT
/begin MEASUREMENT MAIN_au8ErrCode[15] "MAIN_au8ErrCode[15]" UBYTE F_1_p0_4 1 2 0 255 ECU_ADDRESS 0x0 /end MEASUREMENT
/begin MEASUREMENT MAIN_au8ErrCode[16] "MAIN_au8ErrCode[16]" UBYTE F_1_p0_4 1 2 0 255 ECU_ADDRESS 0x0 /end MEASUREMENT
/begin MEASUREMENT MAIN_au8ErrCode[17] "MAIN_au8ErrCode[17]" UBYTE F_1_p0_4 1 2 0 255 ECU_ADDRESS 0x0 /end MEASUREMENT
/begin MEASUREMENT MAIN_au8ErrCode[18] "MAIN_au8ErrCode[18]" UBYTE F_1_p0_4 1 2 0 255 ECU_ADDRESS 0x0 /end MEASUREMENT
/begin MEASUREMENT MAIN_au8ErrCode[19] "MAIN_au8ErrCode[19]" UBYTE F_1_p0_4 1 2 0 255 ECU_ADDRESS 0x0 /end MEASUREMENT
/begin MEASUREMENT MAIN_au8ErrCode[1] "MAIN_au8ErrCode[1]" UBYTE F_1_p0_4 1 2 0 255 ECU_ADDRESS 0x0 /end MEASUREMENT
/begin MEASUREMENT MAIN_au8ErrCode[2] "MAIN_au8ErrCode[2]" UBYTE F_1_p0_4 1 2 0 255 ECU_ADDRESS 0x0 /end MEASUREMENT
/begin MEASUREMENT MAIN_au8ErrCode[3] "MAIN_au8ErrCode[3]" UBYTE F_1_p0_4 1 2 0 255 ECU_ADDRESS 0x0 /end MEASUREMENT
/begin MEASUREMENT MAIN_au8ErrCode[4] "MAIN_au8ErrCode[4]" UBYTE F_1_p0_4 1 2 0 255 ECU_ADDRESS 0x0 /end MEASUREMENT
/begin MEASUREMENT MAIN_au8ErrCode[5] "MAIN_au8ErrCode[5]" UBYTE F_1_p0_4 1 2 0 255 ECU_ADDRESS 0x0 /end MEASUREMENT
/begin MEASUREMENT MAIN_au8ErrCode[6] "MAIN_au8ErrCode[6]" UBYTE F_1_p0_4 1 2 0 255 ECU_ADDRESS 0x0 /end MEASUREMENT
/begin MEASUREMENT MAIN_au8ErrCode[7] "MAIN_au8ErrCode[7]" UBYTE F_1_p0_4 1 2 0 255 ECU_ADDRESS 0x0 /end MEASUREMENT
/begin MEASUREMENT MAIN_au8ErrCode[8] "MAIN_au8ErrCode[8]" UBYTE F_1_p0_4 1 2 0 255 ECU_ADDRESS 0x0 /end MEASUREMENT
/begin MEASUREMENT MAIN_au8ErrCode[9] "MAIN_au8ErrCode[9]" UBYTE F_1_p0_4 1 2 0 255 ECU_ADDRESS 0x0 /end MEASUREMENT
/begin MEASUREMENT MAIN_bAkdAfterAscReq "..." UBYTE Bool_ON_OFF 1 2 0 1 BIT_MASK 0x01 ECU_ADDRESS 0x0 /end MEASUREMENT
/begin MEASUREMENT MAIN_bAntiSlopGearEna "..." UBYTE Bool_ON_OFF 1 2 0 1 BIT_MASK 0x01 ECU_ADDRESS 0x0 /end MEASUREMENT
/begin MEASUREMENT MAIN_bAscFlag "Flag ESM started" UBYTE Bool_ON_OFF 1 2 0 1 BIT_MASK 0x01 ECU_ADDRESS 0x0 /end MEASUREMENT
/begin MEASUREMENT MAIN_bBswReadySts "BSW Power on check finish flag." UBYTE Bool_ON_OFF 1 2 0 1 BIT_MASK 0x01 ECU_ADDRESS 0x0 /end MEASUREMENT
/begin MEASUREMENT MAIN_bESMStarted "Flag ESM started" UBYTE Bool_ON_OFF 1 2 0 1 BIT_MASK 0x01 ECU_ADDRESS 0x0 /end MEASUREMENT
/begin MEASUREMENT MAIN_bFTInitFinshFlg "FT Initilize finished flag" UBYTE Bool_ON_OFF 1 2 0 1 BIT_MASK 0x01 ECU_ADDRESS 0x0 /end MEASUREMENT
/begin MEASUREMENT MAIN_bMcuMilStatus "..." UBYTE Bool_ON_OFF 1 2 0 1 BIT_MASK 0x01 ECU_ADDRESS 0x0 /end MEASUREMENT
/begin MEASUREMENT MAIN_bOCStoreManualReq "..." UBYTE Bool_ON_OFF 1 2 0 1 BIT_MASK 0x01 ECU_ADDRESS 0x0 /end MEASUREMENT
/begin MEASUREMENT MAIN_bOcDataStoreEna "..." UBYTE Bool_ON_OFF 1 2 0 1 BIT_MASK 0x01 ECU_ADDRESS 0x0 /end MEASUREMENT
/begin MEASUREMENT MAIN_bOcFailureFlg "..." UBYTE Bool_ON_OFF 1 2 0 1 BIT_MASK 0x01 ECU_ADDRESS 0x0 /end MEASUREMENT
/begin MEASUREMENT MAIN_bOcFinshFlg "..." UBYTE Bool_ON_OFF 1 2 0 1 BIT_MASK 0x01 ECU_ADDRESS 0x0 /end MEASUREMENT
/begin MEASUREMENT MAIN_bOcModeEna "OC mode enable flag" UBYTE Bool_ON_OFF 1 2 0 1 BIT_MASK 0x01 ECU_ADDRESS 0x0 /end MEASUREMENT
/begin MEASUREMENT MAIN_bOcNotRatFlg "..." UBYTE Bool_ON_OFF 1 2 0 1 BIT_MASK 0x01 ECU_ADDRESS 0x0 /end MEASUREMENT
/begin MEASUREMENT MAIN_bOcRdResultFlag "..." UBYTE Bool_ON_OFF 1 2 0 1 BIT_MASK 0x01 ECU_ADDRESS 0x0 /end MEASUREMENT
/begin MEASUREMENT MAIN_bOcStartFlag "..." UBYTE Bool_ON_OFF 1 2 0 1 BIT_MASK 0x01 ECU_ADDRESS 0x0 /end MEASUREMENT
/begin MEASUREMENT MAIN_bPosAccessLock "Must be Volatile variable." UBYTE Bool_ON_OFF 1 2 0 1 BIT_MASK 0x01 ECU_ADDRESS 0x0 /end MEASUREMENT
/begin MEASUREMENT MAIN_bProgConditionOk "..." UBYTE Bool_ON_OFF 1 2 0 1 BIT_MASK 0x01 ECU_ADDRESS 0x0 /end MEASUREMENT
/begin MEASUREMENT MAIN_bResExcFltDetEna "..." UBYTE Bool_ON_OFF 1 2 0 1 BIT_MASK 0x01 ECU_ADDRESS 0x0 /end MEASUREMENT
/begin MEASUREMENT MAIN_bSlopSlideTimoutFlg "..." UBYTE Bool_ON_OFF 1 2 0 1 BIT_MASK 0x01 ECU_ADDRESS 0x0 /end MEASUREMENT
/begin MEASUREMENT MAIN_bSoftOvBhvFlg "..." UBYTE Bool_ON_OFF 1 2 0 1 BIT_MASK 0x01 ECU_ADDRESS 0x0 /end MEASUREMENT
/begin MEASUREMENT MAIN_bSoftOvCurrPhsUFlg "..." UBYTE Bool_ON_OFF 1 2 0 1 BIT_MASK 0x01 ECU_ADDRESS 0x0 /end MEASUREMENT
/begin MEASUREMENT MAIN_bSoftOvCurrPhsVFlg "..." UBYTE Bool_ON_OFF 1 2 0 1 BIT_MASK 0x01 ECU_ADDRESS 0x0 /end MEASUREMENT
/begin MEASUREMENT MAIN_bSoftOvCurrPhsWFlg "..." UBYTE Bool_ON_OFF 1 2 0 1 BIT_MASK 0x01 ECU_ADDRESS 0x0 /end MEASUREMENT
/begin MEASUREMENT MAIN_bSpdReadyEst "..." UBYTE Bool_ON_OFF 1 2 0 1 BIT_MASK 0x01 ECU_ADDRESS 0x0 /end MEASUREMENT
/begin MEASUREMENT MAIN_bSpeedReadyFlg "..." UBYTE Bool_ON_OFF 1 2 0 1 BIT_MASK 0x01 ECU_ADDRESS 0x0 /end MEASUREMENT
/begin MEASUREMENT MAIN_bTcuStuckFlag "..." UBYTE Bool_ON_OFF 1 2 0 1 BIT_MASK 0x01 ECU_ADDRESS 0x0 /end MEASUREMENT
/begin MEASUREMENT MAIN_bTeachInCompleteFlg "..." UBYTE Bool_ON_OFF 1 2 0 1 BIT_MASK 0x01 ECU_ADDRESS 0x0 /end MEASUREMENT
/begin MEASUREMENT MAIN_bVSIStarted "Flag VSI started" UBYTE Bool_ON_OFF 1 2 0 1 BIT_MASK 0x01 ECU_ADDRESS 0x0 /end MEASUREMENT
/begin MEASUREMENT MAIN_f32AntiSsEnaBrakPos "..." FLOAT32_IEEE I_45 1 2 -3.402823466E+038 3.402823466E+038 ECU_ADDRESS 0x0 /end MEASUREMENT
/begin MEASUREMENT MAIN_f32BldcCurrentPos "..." FLOAT32_IEEE F_100_p0_5 1 2 -3.402823466E+038 3.402823466E+038 ECU_ADDRESS 0x0 /end MEASUREMENT
/begin MEASUREMENT MAIN_f32BldcCurrentPosRolCnt "..." FLOAT32_IEEE F_100_p0_5 1 2 -3.402823466E+038 3.402823466E+038 ECU_ADDRESS 0x0 /end MEASUREMENT
/begin MEASUREMENT MAIN_f32BldcDuty "..." FLOAT32_IEEE F_100_p0_5 1 2 -3.402823466E+038 3.402823466E+038 ECU_ADDRESS 0x0 /end MEASUREMENT
/begin MEASUREMENT MAIN_f32BldcHallCapPos "..." FLOAT32_IEEE F_100_p0_5 1 2 -3.402823466E+038 3.402823466E+038 ECU_ADDRESS 0x0 /end MEASUREMENT
/begin MEASUREMENT MAIN_f32BldcHallCapPosErr "..." FLOAT32_IEEE F_100_p0_5 1 2 -3.402823466E+038 3.402823466E+038 ECU_ADDRESS 0x0 /end MEASUREMENT
/begin MEASUREMENT MAIN_f32BldcHallCapPosPre "..." FLOAT32_IEEE F_100_p0_5 1 2 -3.402823466E+038 3.402823466E+038 ECU_ADDRESS 0x0 /end MEASUREMENT
/begin MEASUREMENT MAIN_f32BldcPositionDuty "..." FLOAT32_IEEE F_100_p0_5 1 2 -3.402823466E+038 3.402823466E+038 ECU_ADDRESS 0x0 /end MEASUREMENT
/begin MEASUREMENT MAIN_f32CpuLoadCore0 "..." FLOAT32_IEEE F_1_p0_21 1 2 -3.402823466E+038 3.402823466E+038 ECU_ADDRESS 0x0 /end MEASUREMENT
/begin MEASUREMENT MAIN_f32CpuLoadCore1 "..." FLOAT32_IEEE F_1_p0_21 1 2 -3.402823466E+038 3.402823466E+038 ECU_ADDRESS 0x0 /end MEASUREMENT
/begin MEASUREMENT MAIN_f32CpuLoadCore2 "..." FLOAT32_IEEE F_1_p0_21 1 2 -3.402823466E+038 3.402823466E+038 ECU_ADDRESS 0x0 /end MEASUREMENT
/begin MEASUREMENT MAIN_f32CpuLoadMaxCore0 "..." FLOAT32_IEEE F_1_p0_21 1 2 -3.402823466E+038 3.402823466E+038 ECU_ADDRESS 0x0 /end MEASUREMENT
/begin MEASUREMENT MAIN_f32CpuLoadMaxCore1 "..." FLOAT32_IEEE F_1_p0_21 1 2 -3.402823466E+038 3.402823466E+038 ECU_ADDRESS 0x0 /end MEASUREMENT
/begin MEASUREMENT MAIN_f32CpuLoadMaxCore2 "..." FLOAT32_IEEE F_1_p0_21 1 2 -3.402823466E+038 3.402823466E+038 ECU_ADDRESS 0x0 /end MEASUREMENT
/begin MEASUREMENT MAIN_f32ElecSpeedRds "..." FLOAT32_IEEE F_1_p0_21 1 2 -3.402823466E+038 3.402823466E+038 ECU_ADDRESS 0x0 /end MEASUREMENT
/begin MEASUREMENT MAIN_f32EmailElecSpeedRds "..." FLOAT32_IEEE F_1_p0_21 1 2 -3.402823466E+038 3.402823466E+038 ECU_ADDRESS 0x0 /end MEASUREMENT
/begin MEASUREMENT MAIN_f32EmailErrThetaRdSurPi "..." FLOAT32_IEEE F_1_p0_21 1 2 -3.402823466E+038 3.402823466E+038 ECU_ADDRESS 0x0 /end MEASUREMENT
/begin MEASUREMENT MAIN_f32EmailMecaSpeedRds "..." FLOAT32_IEEE F_1_p0_21 1 2 -3.402823466E+038 3.402823466E+038 ECU_ADDRESS 0x0 /end MEASUREMENT
/begin MEASUREMENT MAIN_f32EmailMecaSpeedRpm "..." FLOAT32_IEEE F_1_p0_21 1 2 -3.402823466E+038 3.402823466E+038 ECU_ADDRESS 0x0 /end MEASUREMENT
/begin MEASUREMENT MAIN_f32EmailNextThetaElecRdSurPi "..." FLOAT32_IEEE F_1_p0_21 1 2 -3.402823466E+038 3.402823466E+038 ECU_ADDRESS 0x0 /end MEASUREMENT
/begin MEASUREMENT MAIN_f32EmailThetaElecRdSurPi "..." FLOAT32_IEEE F_1_p0_21 1 2 -3.402823466E+038 3.402823466E+038 ECU_ADDRESS 0x0 /end MEASUREMENT
/begin MEASUREMENT MAIN_f32ErrThetaRdSurPi "..." FLOAT32_IEEE F_1_p0_21 1 2 -3.402823466E+038 3.402823466E+038 ECU_ADDRESS 0x0 /end MEASUREMENT
/begin MEASUREMENT MAIN_f32EstTempRatioScale "..." FLOAT32_IEEE F_1_p0_4 1 2 -3.402823466E+038 3.402823466E+038 ECU_ADDRESS 0x0 /end MEASUREMENT
/begin MEASUREMENT MAIN_f32IdDeltaAvg "..." FLOAT32_IEEE F_1_p0_4 1 2 -3.402823466E+038 3.402823466E+038 ECU_ADDRESS 0x0 /end MEASUREMENT
/begin MEASUREMENT MAIN_f32IdDeltaSum "..." FLOAT32_IEEE F_1_p0_4 1 2 -3.402823466E+038 3.402823466E+038 ECU_ADDRESS 0x0 /end MEASUREMENT
/begin MEASUREMENT MAIN_f32IdQuality "..." FLOAT32_IEEE F_1_p0_40 1 2 -3.402823466E+038 3.402823466E+038 ECU_ADDRESS 0x0 /end MEASUREMENT
/begin MEASUREMENT MAIN_f32IqDeltaAvg "..." FLOAT32_IEEE F_1_p0_4 1 2 -3.402823466E+038 3.402823466E+038 ECU_ADDRESS 0x0 /end MEASUREMENT
/begin MEASUREMENT MAIN_f32IqDeltaSum "..." FLOAT32_IEEE F_1_p0_4 1 2 -3.402823466E+038 3.402823466E+038 ECU_ADDRESS 0x0 /end MEASUREMENT
/begin MEASUREMENT MAIN_f32IqQuality "..." FLOAT32_IEEE F_1_p0_40 1 2 -3.402823466E+038 3.402823466E+038 ECU_ADDRESS 0x0 /end MEASUREMENT
/begin MEASUREMENT MAIN_f32IuFrequency "..." FLOAT32_IEEE F_1_p0_46 1 2 -3.402823466E+038 3.402823466E+038 ECU_ADDRESS 0x0 /end MEASUREMENT
/begin MEASUREMENT MAIN_f32IuPeriod "..." FLOAT32_IEEE F_1_p0_47 1 2 -3.402823466E+038 3.402823466E+038 ECU_ADDRESS 0x0 /end MEASUREMENT
/begin MEASUREMENT MAIN_f32MecaSpeedRds "..." FLOAT32_IEEE F_1_p0_21 1 2 -3.402823466E+038 3.402823466E+038 ECU_ADDRESS 0x0 /end MEASUREMENT
/begin MEASUREMENT MAIN_f32MecaSpeedRpm "..." FLOAT32_IEEE F_1_p0_21 1 2 -3.402823466E+038 3.402823466E+038 ECU_ADDRESS 0x0 /end MEASUREMENT
/begin MEASUREMENT MAIN_f32MotSpdEst "..." FLOAT32_IEEE F_1_p0_47 1 2 -3.402823466E+038 3.402823466E+038 ECU_ADDRESS 0x0 /end MEASUREMENT
/begin MEASUREMENT MAIN_f32PWMDutyUPhys "..." FLOAT32_IEEE F_100_p0_5 1 2 -3.402823466E+038 3.402823466E+038 ECU_ADDRESS 0x0 /end MEASUREMENT
/begin MEASUREMENT MAIN_f32PWMDutyVPhys "..." FLOAT32_IEEE F_100_p0_5 1 2 -3.402823466E+038 3.402823466E+038 ECU_ADDRESS 0x0 /end MEASUREMENT
/begin MEASUREMENT MAIN_f32PWMDutyWPhys "..." FLOAT32_IEEE F_100_p0_5 1 2 -3.402823466E+038 3.402823466E+038 ECU_ADDRESS 0x0 /end MEASUREMENT
/begin MEASUREMENT MAIN_f32ShiftDrumInitPos "..." FLOAT32_IEEE F_100_p0_5 1 2 -3.402823466E+038 3.402823466E+038 ECU_ADDRESS 0x0 /end MEASUREMENT
/begin MEASUREMENT MAIN_f32ShiftDrumTermPos "..." FLOAT32_IEEE F_100_p0_5 1 2 -3.402823466E+038 3.402823466E+038 ECU_ADDRESS 0x0 /end MEASUREMENT
/begin MEASUREMENT MAIN_f32TcReadPosDuty "..." FLOAT32_IEEE F_100_p0_5 1 2 -3.402823466E+038 3.402823466E+038 ECU_ADDRESS 0x0 /end MEASUREMENT
/begin MEASUREMENT MAIN_f32ThetaElecRdSurPi "..." FLOAT32_IEEE F_1_p0_21 1 2 -3.402823466E+038 3.402823466E+038 ECU_ADDRESS 0x0 /end MEASUREMENT
/begin MEASUREMENT MAIN_f32VsiPwmPeriod "..." FLOAT32_IEEE F_1000000_p0_49 1 2 -3.402823466E+038 3.402823466E+038 ECU_ADDRESS 0x0 /end MEASUREMENT
/begin MEASUREMENT MAIN_s16BldcHallDirFdb "MAIN_s16BldcHallDirFdb" SBYTE I_1 1 2 -128 127 ECU_ADDRESS 0x0 /end MEASUREMENT
/begin MEASUREMENT MAIN_s32DeltTimDiff "..." SLONG F_0v01_p0_12 1 2 -21474836.48 21474836.47 ECU_ADDRESS 0x0 /end MEASUREMENT
/begin MEASUREMENT MAIN_s32Email2PosTreqDiff "..." SLONG I_1 1 2 -2147483648 2147483647 ECU_ADDRESS 0x0 /end MEASUREMENT
/begin MEASUREMENT MAIN_s32PosA2BDeltTimMax "..." SLONG F_0v1_p0_50 1 2 -214748364.8 214748364.7 ECU_ADDRESS 0x0 /end MEASUREMENT
/begin MEASUREMENT MAIN_s32PosA2BDeltTimMin "..." SLONG F_0v1_p0_50 1 2 -214748364.8 214748364.7 ECU_ADDRESS 0x0 /end MEASUREMENT
/begin MEASUREMENT MAIN_s32PosA2BDeltTime "..." SLONG F_0v1_p0_50 1 2 -214748364.8 214748364.7 ECU_ADDRESS 0x0 /end MEASUREMENT
/begin MEASUREMENT MAIN_u16AntiSsBrakTimCnt "..." UWORD I_1 1 2 0 65535 ECU_ADDRESS 0x0 /end MEASUREMENT
/begin MEASUREMENT MAIN_u16AntiSsEnaBrakCnt "..." UWORD I_1 1 2 0 65535 ECU_ADDRESS 0x0 /end MEASUREMENT
/begin MEASUREMENT MAIN_u16AntiSsValidCnt "..." UWORD I_1 1 2 0 65535 ECU_ADDRESS 0x0 /end MEASUREMENT
/begin MEASUREMENT MAIN_u16BldcIbatAdcV01 "MAIN_u16BldcIbatAdcV01" UWORD I_1 1 2 0 65535 ECU_ADDRESS 0x0 /end MEASUREMENT
/begin MEASUREMENT MAIN_u16BldcIbatAdcVR0 "MAIN_u16BldcIbatAdcVR0" UWORD I_1 1 2 0 65535 ECU_ADDRESS 0x0 /end MEASUREMENT
/begin MEASUREMENT MAIN_u16BldcOilPressAdc "MAIN_u16BldcOilPressAdc" UWORD I_1 1 2 0 65535 ECU_ADDRESS 0x0 /end MEASUREMENT
/begin MEASUREMENT MAIN_u16BldcOilTempAdc "MAIN_u16BldcOilTempAdc" UWORD I_1 1 2 0 65535 ECU_ADDRESS 0x0 /end MEASUREMENT
/begin MEASUREMENT MAIN_u16BrakRelsDelayCnt "..." UWORD I_1 1 2 0 65535 ECU_ADDRESS 0x0 /end MEASUREMENT
/begin MEASUREMENT MAIN_u16Cnt1 "MAIN_u16Cnt1" UWORD I_1 1 2 0 65535 ECU_ADDRESS 0x0 /end MEASUREMENT
/begin MEASUREMENT MAIN_u16Cnt10 "MAIN_u16Cnt10" UWORD I_1 1 2 0 65535 ECU_ADDRESS 0x0 /end MEASUREMENT
/begin MEASUREMENT MAIN_u16Cnt100 "MAIN_u16Cnt100" UWORD I_1 1 2 0 65535 ECU_ADDRESS 0x0 /end MEASUREMENT
/begin MEASUREMENT MAIN_u16Cnt1000 "MAIN_u16Cnt1000" UWORD I_1 1 2 0 65535 ECU_ADDRESS 0x0 /end MEASUREMENT
/begin MEASUREMENT MAIN_u16Cnt2 "MAIN_u16Cnt2" UWORD I_1 1 2 0 65535 ECU_ADDRESS 0x0 /end MEASUREMENT
/begin MEASUREMENT MAIN_u16Cnt20 "MAIN_u16Cnt20" UWORD I_1 1 2 0 65535 ECU_ADDRESS 0x0 /end MEASUREMENT
/begin MEASUREMENT MAIN_u16Cnt200 "MAIN_u16Cnt200" UWORD I_1 1 2 0 65535 ECU_ADDRESS 0x0 /end MEASUREMENT
/begin MEASUREMENT MAIN_u16Cnt2000 "MAIN_u16Cnt2000" UWORD I_1 1 2 0 65535 ECU_ADDRESS 0x0 /end MEASUREMENT
/begin MEASUREMENT MAIN_u16Cnt30 "MAIN_u16Cnt30" UWORD I_1 1 2 0 65535 ECU_ADDRESS 0x0 /end MEASUREMENT
/begin MEASUREMENT MAIN_u16Cnt4 "MAIN_u16Cnt4" UWORD I_1 1 2 0 65535 ECU_ADDRESS 0x0 /end MEASUREMENT
/begin MEASUREMENT MAIN_u16Cnt5 "MAIN_u16Cnt5" UWORD I_1 1 2 0 65535 ECU_ADDRESS 0x0 /end MEASUREMENT
/begin MEASUREMENT MAIN_u16Cnt50 "MAIN_u16Cnt50" UWORD I_1 1 2 0 65535 ECU_ADDRESS 0x0 /end MEASUREMENT
/begin MEASUREMENT MAIN_u16Cnt500 "MAIN_u16Cnt500" UWORD I_1 1 2 0 65535 ECU_ADDRESS 0x0 /end MEASUREMENT
/begin MEASUREMENT MAIN_u16FaultDelayCnt "MAIN_u16FaultDelayCnt" UWORD I_1 1 2 0 65535 ECU_ADDRESS 0x0 /end MEASUREMENT
/begin MEASUREMENT MAIN_u16FpgaFltClrCnt "MAIN_u16FpgaFltClrCnt" UWORD I_1 1 2 0 65535 ECU_ADDRESS 0x0 /end MEASUREMENT
/begin MEASUREMENT MAIN_u16HandBrkRelsDelay "..." UWORD I_1 1 2 0 65535 ECU_ADDRESS 0x0 /end MEASUREMENT
/begin MEASUREMENT MAIN_u16IdqDeltaSumCnt "MAIN_u16IdqDeltaSumCnt" UWORD I_1 1 2 0 65535 ECU_ADDRESS 0x0 /end MEASUREMENT
/begin MEASUREMENT MAIN_u16IuCycleCnt "..." UWORD I_1 1 2 0 65535 ECU_ADDRESS 0x0 /end MEASUREMENT
/begin MEASUREMENT MAIN_u16IuMiddleCnt "..." UWORD I_1 1 2 0 65535 ECU_ADDRESS 0x0 /end MEASUREMENT
/begin MEASUREMENT MAIN_u16IuMiddleSum "..." UWORD I_1 1 2 0 65535 ECU_ADDRESS 0x0 /end MEASUREMENT
/begin MEASUREMENT MAIN_u16IuNegtiveCnt "..." UWORD I_1 1 2 0 65535 ECU_ADDRESS 0x0 /end MEASUREMENT
/begin MEASUREMENT MAIN_u16IuNegtiveSum "..." UWORD I_1 1 2 0 65535 ECU_ADDRESS 0x0 /end MEASUREMENT
/begin COMPU_METHOD I_1 "" RAT_FUNC "%9.2" "-" COEFFS 0 1 0 0 0 1 /end COMPU_METHOD
/begin COMPU_METHOD I_3 "" RAT_FUNC "%9.2" "" COEFFS 0 1 0 0 0 1 /end COMPU_METHOD
/begin COMPU_METHOD F_1_p0_4 "" RAT_FUNC "%9.2" "-" COEFFS 0 1 0 0 0 1 /end COMPU_METHOD
/begin COMPU_METHOD F_100_p0_5 "" RAT_FUNC "%9.2" "%" COEFFS 0 1 0 0 0 100 /end COMPU_METHOD
/begin COMPU_METHOD F_0v01_p0_12 "" RAT_FUNC "%9.2" "ï¿½s" COEFFS 0 1 0 0 0 0.01 /end COMPU_METHOD
/begin COMPU_METHOD I_15 "" RAT_FUNC "%9.2" "V" COEFFS 0 1 0 0 0 1 /end COMPU_METHOD
/begin COMPU_METHOD F_1_p0_21 "" RAT_FUNC "%9.2" "RPM" COEFFS 0 1 0 0 0 1 /end COMPU_METHOD
/begin COMPU_METHOD I_37 "" RAT_FUNC "%9.2" "A" COEFFS 0 1 0 0 0 1 /end COMPU_METHOD
/begin COMPU_METHOD F_1_p0_38 "" RAT_FUNC "%9.2" "degree" COEFFS 0 1 0 0 0 1 /end COMPU_METHOD
/begin COMPU_METHOD F_1_p0_39 "" RAT_FUNC "%9.2" "Nm" COEFFS 0 1 0 0 0 1 /end COMPU_METHOD
/begin COMPU_METHOD F_1_p0_40 "" RAT_FUNC "%9.2" "%" COEFFS 0 1 0 0 0 1 /end COMPU_METHOD
/begin COMPU_METHOD I_41 "" RAT_FUNC "%9.2" "Kmh" COEFFS 0 1 0 0 0 1 /end COMPU_METHOD
/begin COMPU_METHOD F_0v0061035156_p0_43 "" RAT_FUNC "%9.3" "%" COEFFS 0 1 0 0 0 0.00610352 /end COMPU_METHOD
/begin COMPU_METHOD I_45 "" RAT_FUNC "%9.2" "%" COEFFS 0 1 0 0 0 1 /end COMPU_METHOD
/begin COMPU_METHOD F_1_p0_46 "" RAT_FUNC "%9.2" "Hz" COEFFS 0 1 0 0 0 1 /end COMPU_METHOD
/begin COMPU_METHOD F_1_p0_47 "" RAT_FUNC "%9.2" "s" COEFFS 0 1 0 0 0 1 /end COMPU_METHOD
/begin COMPU_METHOD F_1000000_p0_49 "" RAT_FUNC "%9.2" "us" COEFFS 0 1 0 0 0 1e+006 /end COMPU_METHOD
/begin COMPU_METHOD F_0v1_p0_50 "" RAT_FUNC "%9.2" "ï¿½s" COEFFS 0 1 0 0 0 0.1 /end COMPU_METHOD
/begin COMPU_METHOD F_0v055_p0_53 "" RAT_FUNC "%9.2" "ï¿½s" COEFFS 0 1 0 0 0 0.055 /end COMPU_METHOD
/begin COMPU_METHOD F_0v02_p0_54 "" RAT_FUNC "%9.2" "ï¿½s" COEFFS 0 1 0 0 0 0.02 /end COMPU_METHOD
/begin COMPU_METHOD Id_0x00 "" RAT_FUNC "%9.2" "." COEFFS 0 1 0 0 0 1 /end COMPU_METHOD
/begin COMPU_METHOD Bool_ON_OFF "" TAB_VERB "%8.4" "." COMPU_TAB_REF Bool_ON_OFF_table /end COMPU_METHOD
/begin COMPU_VTAB Bool_ON_OFF_table "" TAB_VERB 2 0 "OFF" 1 "ON" /end COMPU_VTAB
/begin FUNCTION MAIN ""
 /begin OUT_MEASUREMENT GMAIN_au8ErrCode[9] GMAIN_bAkdAfterAscReq GMAIN_bAntiSlopGearEna GMAIN_bAscFlag GMAIN_bBswReadySts GMAIN_bESMStarted GMAIN_bFTInitFinshFlg GMAIN_bMcuMilStatus GMAIN_bOcDataStoreEna GMAIN_bOcFailureFlg GMAIN_bOcFinshFlg GMAIN_bOcModeEna GMAIN_bOcNotRatFlg GMAIN_bOcRdResultFlag GMAIN_bOcStartFlag GMAIN_bOCStoreManualReq GMAIN_bPosAccessLock GMAIN_bProgConditionOk GMAIN_bResExcFltDetEna GMAIN_bSlopSlideTimoutFlg GMAIN_bSoftOvBhvFlg GMAIN_bSoftOvCurrPhsUFlg GMAIN_bSoftOvCurrPhsVFlg GMAIN_bSoftOvCurrPhsWFlg GMAIN_bSpdReadyEst GMAIN_bSpeedReadyFlg GMAIN_bTcuStuckFlag GMAIN_bTeachInCompleteFlg GMAIN_bVSIStarted GMAIN_ESMGo2StartupIEvent GMAIN_f32AntiSsEnaBrakPos GMAIN_f32BldcCurrentPos GMAIN_f32BldcCurrentPosRolCnt GMAIN_f32BldcDuty GMAIN_f32BldcHallCapPos GMAIN_f32BldcHallCapPosErr GMAIN_f32BldcHallCapPosPre GMAIN_f32BldcPositionDuty GMAIN_f32CpuLoadCore0 GMAIN_f32CpuLoadCore1 GMAIN_f32CpuLoadCore2 GMAIN_f32CpuLoadMaxCore0 GMAIN_f32CpuLoadMaxCore1 GMAIN_f32CpuLoadMaxCore2 GMAIN_f32ElecSpeedRds GMAIN_f32EmailElecSpeedRds GMAIN_f32EmailErrThetaRdSurPi GMAIN_f32EmailMecaSpeedRds GMAIN_f32EmailMecaSpeedRpm GMAIN_f32EmailNextThetaElecRdSurPi GMAIN_f32EmailThetaElecRdSurPi GMAIN_f32ErrThetaRdSurPi GMAIN_f32EstTempRatioScale GMAIN_f32IdDeltaAvg GMAIN_f32IdDeltaSum GMAIN_f32IdQuality GMAIN_f32IqDeltaAvg GMAIN_f32IqDeltaSum GMAIN_f32IqQuality GMAIN_f32IuFrequency GMAIN_f32IuPeriod GMAIN_f32MecaSpeedRds GMAIN_f32MecaSpeedRpm GMAIN_f32MotSpdEst GMAIN_f32PWMDutyUPhys GMAIN_f32PWMDutyVPhys GMAIN_f32PWMDutyWPhys GMAIN_f32ShiftDrumInitPos GMAIN_f32ShiftDrumTermPos GMAIN_f32TcReadPosDuty GMAIN_f32ThetaElecRdSurPi GMAIN_f32VsiPwmPeriod GMAIN_MSGbFMCU1_ActTrqValid GMAIN_MSGbFMCU2_DischrgAllowed GMAIN_MSGbRMCU4_McuOverTemp GMAIN_MSGbRMCU4_MilReq GMAIN_MSGbRMCU4_MoterFault GMAIN_MSGbRMCU4_MoterOverTemp GMAIN_MSGbTCU_P1OverTempWarn GMAIN_MSGbTCU_P3OverTempWarn GMAIN_MSGbVCU_FmcuAkdReq GMAIN_MSGf32CAP_PhsCurLoadPhys GMAIN_MSGf32DCU_OilPressurePhys GMAIN_MSGf32MCU_LvVoltPhys GMAIN_MSGf32VCU7_12VBatVoltPhys GMAIN_MSGf32VCU_AccPedPosPhys GMAIN_MSGf32VCU_BrakPedPosPhys GMAIN_MSGu16DCU_OilPressureRaw GMAIN_MSGu16EMS_EngActualFlwTorqueRaw GMAIN_MSGu16TCU_ClutchActTorqRaw GMAIN_MSGu8BMS_MainNegConnSts GMAIN_MSGu8BMS_MainPosConnSts GMAIN_MSGu8CompileDay GMAIN_MSGu8CompileMonth GMAIN_MSGu8CompileYear GMAIN_MSGu8DCU_OfsAlCalSts GMAIN_MSGu8DEV_Fault0 GMAIN_MSGu8DEV_Fault1 GMAIN_MSGu8DEV_Fault10 GMAIN_MSGu8DEV_Fault11 GMAIN_MSGu8DEV_Fault12 GMAIN_MSGu8DEV_Fault13 GMAIN_MSGu8DEV_Fault14 GMAIN_MSGu8DEV_Fault15 GMAIN_MSGu8DEV_Fault2 GMAIN_MSGu8DEV_Fault3 GMAIN_MSGu8DEV_Fault4 GMAIN_MSGu8DEV_Fault5 GMAIN_MSGu8DEV_Fault6 GMAIN_MSGu8DEV_Fault7 GMAIN_MSGu8DEV_Fault8 GMAIN_MSGu8DEV_Fault9 GMAIN_MSGu8FMCU8_HtcuLimpHomeSts GMAIN_MSGu8GW2_PwrMode GMAIN_MSGu8MCU_McuEnableSts GMAIN_MSGu8MCU_McuPrevSlipFlg GMAIN_MSGu8MCU_PwrActvMod GMAIN_MSGu8McuActvDischgFlt GMAIN_MSGu8McuBusUVFlt GMAIN_MSGu8McuCANComFlt GMAIN_MSGu8McuDcHVCurSensFlt GMAIN_MSGu8McuHVLoopFlt GMAIN_MSGu8McuHwCapOVFlt GMAIN_MSGu8McuIgbtFlt GMAIN_MSGu8McuInvtTempSensErr GMAIN_MSGu8McuLVVoltFlt GMAIN_MSGu8McuMemoryFlt GMAIN_MSGu8McuMotLockRotErr GMAIN_MSGu8McuMotSN GMAIN_MSGu8McuMotSpdHighAlarm GMAIN_MSGu8McuMotSubFltLevel GMAIN_MSGu8McuMotSysOVCAlarm GMAIN_MSGu8McuMotTempHighAlarm GMAIN_MSGu8McuMotTempSensErr GMAIN_MSGu8McuResolverFlt GMAIN_MSGu8McuSoftCapOVFlt GMAIN_MSGu8McuSoftMajorVer GMAIN_MSGu8McuSoftMinorVer GMAIN_MSGu8McuTempHighAlarm GMAIN_MSGu8McuUCurSensFlt GMAIN_MSGu8McuVCurSensFlt GMAIN_MSGu8McuWCurSensFlt GMAIN_MSGu8PwModOffCnt GMAIN_MSGu8PwModOnCnt GMAIN_MSGu8TCU_ClutchProgress GMAIN_MSGu8VCU_AccPedPosRaw GMAIN_MSGu8VCU_EMWorkMod GMAIN_MSGu8VCU_ePTReady GMAIN_MSGu8VCU_HandBrakSts GMAIN_MSGu8VCU_McuEnableReq GMAIN_s16BldcHallDirFdb GMAIN_s32DeltTimDiff GMAIN_s32Email2PosTreqDiff GMAIN_s32PosA2BDeltTime GMAIN_s32PosA2BDeltTimMax GMAIN_s32PosA2BDeltTimMin GMAIN_TCUf32CAP_AvrgCurrentPhys GMAIN_TCUf32CAP_DutyCyclePhys GMAIN_TCUf32CAP_MotSpeedPhys GMAIN_TCUf32CAP_TargetDutyCyclePhys GMAIN_TCUu8CAP_TargetMotSts GMAIN_TotalTime GMAIN_u16AntiSsBrakTimCnt GMAIN_u16AntiSsEnaBrakCnt GMAIN_u16AntiSsValidCnt GMAIN_u16BldcIbatAdcV01 GMAIN_u16BldcIbatAdcVR0 GMAIN_u16BldcOilPressAdc GMAIN_u16BldcOilTempAdc GMAIN_u16BrakRelsDelayCnt GMAIN_u16Cnt1 GMAIN_u16Cnt10 GMAIN_u16Cnt100 GMAIN_u16Cnt1000 GMAIN_u16Cnt2 GMAIN_u16Cnt20 GMAIN_u16Cnt200 GMAIN_u16Cnt2000 GMAIN_u16Cnt30 GMAIN_u16Cnt4 GMAIN_u16Cnt5 GMAIN_u16Cnt50 GMAIN_u16Cnt500 GMAIN_u16FaultDelayCnt GMAIN_u16FpgaFltClrCnt GMAIN_u16HandBrkRelsDelay GMAIN_u16IdqDeltaSumCnt GMAIN_u16IuCycleCnt GMAIN_u16IuMiddleCnt GMAIN_u16IuMiddleSum GMAIN_u16IuNegtiveCnt GMAIN_u16IuNegtiveSum GMAIN_u16IuPositiveCnt GMAIN_u16IuPositiveSum GMAIN_u16MotorStallCnt GMAIN_u16OverVolHighDelay GMAIN_u16OverVolLowDelay GMAIN_u16OverVolMidDelay GMAIN_u16PWMPeriodVal GMAIN_u16RandomNum GMAIN_u16ResCosADVal GMAIN_u16ResSinADVal GMAIN_u16SlopSlideTimCnt GMAIN_u16SlopSpdConfirmCnt GMAIN_u16SpdReadyEstCnt GMAIN_u16T12CntVal GMAIN_u16TeachInWrtDelayCnt GMAIN_u16VadcBhv GMAIN_u16VadcPhaseCurU GMAIN_u16VadcPhaseCurV GMAIN_u16VadcPhaseCurW GMAIN_u32BldcDeltTime GMAIN_u32BldcPattnTreatCnt GMAIN_u32BldcPwmTreatCnt GMAIN_u32BldcTimStampA GMAIN_u32BldcTimStampB GMAIN_u32EmailCkreq GMAIN_u32EmailPosATimeStamp GMAIN_u32IuCycleTim GMAIN_u32PosATimeStamp GMAIN_u32PosBTimeStamp GMAIN_u32PosTreatCkreq GMAIN_u32TestVar2 GMAIN_u32TestVar4 GMAIN_u32WaitValueVSISafeTreatment GMAIN_u32WaitValueVSITreatment GMAIN_u8BldcFaultLevel GMAIN_u8BldcHallStt GMAIN_u8BldcHallSttPre GMAIN_u8BldcMotDir GMAIN_u8ErrCodNum GMAIN_u8ErrCodRdIdx GMAIN_u8ErrCodWrIdx GMAIN_u8FaultSum GMAIN_u8OcState GMAIN_u8OcStsRptDelayCnt GMAIN_u8OverVolIndex GMAIN_u8PrevGearPos GMAIN_u8TcFaultCodeL3 GMAIN_u8TcFaultCodeL5 GMAIN_u8TestVar1 GMAIN_u8TrigOcByUser GMAIN_u8UdsSwVerSup GMAIN_u8UdsSwVerSup[0] GMAIN_u8UdsSwVerSup[10] GMAIN_u8UdsSwVerSup[11] GMAIN_u8UdsSwVerSup[12] GMAIN_u8UdsSwVerSup[13] GMAIN_u8UdsSwVerSup[14] GMAIN_u8UdsSwVerSup[15] GMAIN_u8UdsSwVerSup[16] GMAIN_u8UdsSwVerSup[17] GMAIN_u8UdsSwVerSup[18] GMAIN_u8UdsSwVerSup[19] GMAIN_u8UdsSwVerSup[1] GMAIN_u8UdsSwVerSup[20] GMAIN_u8UdsSwVerSup[2] GMAIN_u8UdsSwVerSup[3] GMAIN_u8UdsSwVerSup[4] GMAIN_u8UdsSwVerSup[5] GMAIN_u8UdsSwVerSup[6] GMAIN_u8UdsSwVerSup[7] GMAIN_u8UdsSwVerSup[8] GMAIN_u8UdsSwVerSup[9] GMAIN_u8UdsSwVerVeh GMAIN_u8UdsSwVerVeh[0] GMAIN_u8UdsSwVerVeh[10] GMAIN_u8UdsSwVerVeh[11] GMAIN_u8UdsSwVerVeh[12] GMAIN_u8UdsSwVerVeh[1] GMAIN_u8UdsSwVerVeh[2] GMAIN_u8UdsSwVerVeh[3] GMAIN_u8UdsSwVerVeh[4] GMAIN_u8UdsSwVerVeh[5] GMAIN_u8UdsSwVerVeh[6] GMAIN_u8UdsSwVerVeh[7] GMAIN_u8UdsSwVerVeh[8] GMAIN_u8UdsSwVerVeh[9] GMAIN_VSITxsPwmUl GMAIN_VSITxsPwmUlOn GMAIN_VSITxsPwmUr GMAIN_VSITxsPwmUrOn GMAIN_VSITxsPwmVl GMAIN_VSITxsPwmVlOn GMAIN_VSITxsPwmVr GMAIN_VSITxsPwmVrOn GMAIN_VSITxsPwmWl GMAIN_VSITxsPwmWlOn GMAIN_VSITxsPwmWr GMAIN_VSITxsPwmWrOn GOs_Task_BackGround_Counter GOs_Task_Idle_Counter HARD_bDioWriteTestEna MAIN_as32OCTrimNvm MAIN_as32OCTrimNvm[0] MAIN_as32OCTrimNvm[1] MAIN_as32OCTrimNvm[2] MAIN_as32OCTrimNvm[3] MAIN_as32OCTrimNvm[4] MAIN_au8ErrCode MAIN_au8ErrCode[0] MAIN_au8ErrCode[10] MAIN_au8ErrCode[11] MAIN_au8ErrCode[12] MAIN_au8ErrCode[13] MAIN_au8ErrCode[14] MAIN_au8ErrCode[15] MAIN_au8ErrCode[16] MAIN_au8ErrCode[17] MAIN_au8ErrCode[18] MAIN_au8ErrCode[19] MAIN_au8ErrCode[1] MAIN_au8ErrCode[2] MAIN_au8ErrCode[3] MAIN_au8ErrCode[4] MAIN_au8ErrCode[5] MAIN_au8ErrCode[6] MAIN_au8ErrCode[7] MAIN_au8ErrCode[8] MAIN_au8ErrCode[9] MAIN_bAkdAfterAscReq MAIN_bAntiSlopGearEna MAIN_bAscFlag MAIN_bBswReadySts MAIN_bESMStarted MAIN_bFTInitFinshFlg MAIN_bMcuMilStatus MAIN_bOcDataStoreEna MAIN_bOcFailureFlg MAIN_bOcFinshFlg MAIN_bOcModeEna MAIN_bOcNotRatFlg MAIN_bOcRdResultFlag MAIN_bOcStartFlag MAIN_bOCStoreManualReq MAIN_bPosAccessLock MAIN_bProgConditionOk MAIN_bResExcFltDetEna MAIN_bSlopSlideTimoutFlg MAIN_bSoftOvBhvFlg MAIN_bSoftOvCurrPhsUFlg MAIN_bSoftOvCurrPhsVFlg MAIN_bSoftOvCurrPhsWFlg MAIN_bSpdReadyEst MAIN_bSpeedReadyFlg MAIN_bTcuStuckFlag MAIN_bTeachInCompleteFlg MAIN_bVSIStarted MAIN_ESMGo2StartupIEvent MAIN_f32AntiSsEnaBrakPos MAIN_f32BldcCurrentPos MAIN_f32BldcCurrentPosRolCnt MAIN_f32BldcDuty MAIN_f32BldcHallCapPos MAIN_f32BldcHallCapPosErr MAIN_f32BldcHallCapPosPre MAIN_f32BldcPositionDuty MAIN_f32CpuLoadCore0 MAIN_f32CpuLoadCore1 MAIN_f32CpuLoadCore2 MAIN_f32CpuLoadMaxCore0 MAIN_f32CpuLoadMaxCore1 MAIN_f32CpuLoadMaxCore2 MAIN_f32ElecSpeedRds MAIN_f32EmailElecSpeedRds MAIN_f32EmailErrThetaRdSurPi MAIN_f32EmailMecaSpeedRds MAIN_f32EmailMecaSpeedRpm MAIN_f32EmailNextThetaElecRdSurPi MAIN_f32EmailThetaElecRdSurPi MAIN_f32ErrThetaRdSurPi MAIN_f32EstTempRatioScale MAIN_f32IdDeltaAvg MAIN_f32IdDeltaSum MAIN_f32IdQuality MAIN_f32IqDeltaAvg MAIN_f32IqDeltaSum MAIN_f32IqQuality MAIN_f32IuFrequency MAIN_f32IuPeriod MAIN_f32MecaSpeedRds MAIN_f32MecaSpeedRpm MAIN_f32MotSpdEst MAIN_f32PWMDutyUPhys MAIN_f32PWMDutyVPhys MAIN_f32PWMDutyWPhys MAIN_f32ShiftDrumInitPos MAIN_f32ShiftDrumTermPos MAIN_f32TcReadPosDuty MAIN_f32ThetaElecRdSurPi MAIN_f32VsiPwmPeriod MAIN_MSGbBMS_MotorPowerOnFinishSig MAIN_MSGbCCP_DrvOverCurrent MAIN_MSGbCCP_DrvOverTemp MAIN_MSGbCCP_DrvOverVoltage MAIN_MSGbCCP_DrvUnderVoltage MAIN_MSGbCCP_FetShorted MAIN_MSGbCCP_HALFault MAIN_MSGbCCP_HALOrderInvalid MAIN_MSGbCCP_HALOverVolt MAIN_MSGbCCP_HALUndefined MAIN_MSGbCCP_HALUnderVolt MAIN_MSGbCCP_HwOverCurrent MAIN_MSGbCCP_PhasePerf MAIN_MSGbCCP_PhaseShortHigh MAIN_MSGbCCP_PhaseShortLow MAIN_MSGbCCP_PhaseVoltHigh MAIN_MSGbCCP_StuckFlag MAIN_MSGbCCP_SwOverCurrent MAIN_MSGbCCP_ThermalShutDown MAIN_MSGbEMS_DrivingCycle MAIN_MSGbEMS_EngineCoolantTempValid MAIN_MSGbEMS_EngSpdSignalFailure MAIN_MSGbEMS_OBDDenoGeneral MAIN_MSGbEMS_OBDDenoGenValid MAIN_MSGbEMS_OBDDenoSpecial MAIN_MSGbEMS_OBDDenoSpecValid MAIN_MSGbEMS_OBDFaultClrInhi MAIN_MSGbEMS_OBDPDTCClrSt MAIN_MSGbEMS_WarmUpCycle MAIN_MSGbFMCU1_ActTrqValid MAIN_MSGbFMCU2_DischrgAllowed MAIN_MSGbGCU_12V_VoltFault MAIN_MSGbGCU_ActiveDischrgFault MAIN_MSGbGCU_Aftermastercmd MAIN_MSGbGCU_Busoff MAIN_MSGbGCU_CAN_LostFrames MAIN_MSGbGCU_HVConnectionAllowed MAIN_MSGbGCU_IGBT_HighTempPwrLim MAIN_MSGbGCU_IGBT_ModuleFault MAIN_MSGbGCU_IGBT_Overheating MAIN_MSGbGCU_MCU_HardwOverCurrent MAIN_MSGbGCU_MCUTempSnsrDiscnct MAIN_MSGbGCU_MCUTempSnsrShortCircuit MAIN_MSGbGCU_ModeCmdFault MAIN_MSGbGCU_Motor_Overheating MAIN_MSGbGCU_MotorHighTempPwrLim MAIN_MSGbGCU_MotorOverSpd_NegPwrLim MAIN_MSGbGCU_MotorOverSpd_PosiPwrLim MAIN_MSGbGCU_MotorOverSpdNeg MAIN_MSGbGCU_MotorOverSpdPosi MAIN_MSGbGCU_MotorTempSnsrDiscnct MAIN_MSGbGCU_MotorTempSnsrShortCircuit MAIN_MSGbGCU_PDCU_CmdFault MAIN_MSGbGCU_RotatExcitationFault MAIN_MSGbGCU_RotatSigGCU_ault MAIN_MSGbGCU_U_OverCurrent MAIN_MSGbGCU_V_OverCurrent MAIN_MSGbGCU_VoltBelowAllwLowerLim MAIN_MSGbGCU_VoltBelowAllwLowPwrLim MAIN_MSGbGCU_VoltExceedAllwUpperLim MAIN_MSGbGCU_VoltExceedAllwUpPwrLim MAIN_MSGbGCU_W_OverCurrent MAIN_MSGbGW_ESC_FLWHeelSpdFault MAIN_MSGbGW_ESC_FRWHeelSpdFault MAIN_MSGbGW_ESC_RLWHeelSpdFault MAIN_MSGbGW_ESC_RRWHeelSpdFault MAIN_MSGbGW_ESC_VehSpdValidFlag MAIN_MSGbHTCU_ATFailure MAIN_MSGbHTCU_EngineStopStartAllowed MAIN_MSGbHTCU_EngineStopStartRequest MAIN_MSGbHTCU_ShiftDrumTeachinInProgs MAIN_MSGbHTCU_ShiftDrumTeachinReq MAIN_MSGbHTCU_SlaveRequestAfterrun MAIN_MSGbHTCU_TorqueLimitationFlag MAIN_MSGbHTCU_TransmissionMILReq MAIN_MSGbMCU_12V_VoltFault MAIN_MSGbMCU_ActiveDischrgFault MAIN_MSGbMCU_Busoff MAIN_MSGbMCU_CAN_LostFrames MAIN_MSGbMCU_EngineAuthResultResp MAIN_MSGbMCU_HighVoltConnectionAllowed MAIN_MSGbMCU_IGBT_HighTempPwrLim MAIN_MSGbMCU_IGBT_ModuleFault MAIN_MSGbMCU_IGBT_Overheating MAIN_MSGbMCU_MCU_HardwOverCurrent MAIN_MSGbMCU_MCUTempSnsrDiscnct MAIN_MSGbMCU_MCUTempSnsrShortCircuit MAIN_MSGbMCU_ModeCmdFault MAIN_MSGbMCU_Motor_Overheating MAIN_MSGbMCU_MotorHighTempPwrLim MAIN_MSGbMCU_MotorOverSpd_NegPwrLim MAIN_MSGbMCU_MotorOverSpd_PosiPwrLim MAIN_MSGbMCU_MotorOverSpdNeg MAIN_MSGbMCU_MotorOverSpdPosi MAIN_MSGbMCU_MotorTempSnsrDiscnct MAIN_MSGbMCU_MotorTempSnsrShortCircuit MAIN_MSGbMCU_PDCU_CmdFault MAIN_MSGbMCU_RotatExcitationFault MAIN_MSGbMCU_RotatSigMCU_ault MAIN_MSGbMCU_U_OverCurrent MAIN_MSGbMCU_V_OverCurrent MAIN_MSGbMCU_VoltBelowAllwLowerLim MAIN_MSGbMCU_VoltBelowAllwLowPwrLim MAIN_MSGbMCU_VoltExceedAllwUpperLim MAIN_MSGbMCU_VoltExceedAllwUpPwrLim MAIN_MSGbMCU_W_OverCurrent MAIN_MSGbMP5_TBOX_Time_Valid MAIN_MSGbOPC_CANComFailure MAIN_MSGbOPC_DriverCircuitFailure MAIN_MSGbOPC_HighTempDePwrFlag MAIN_MSGbOPC_LimitCurrentFlag MAIN_MSGbOPC_LowVoltage MAIN_MSGbOPC_MotorStallingFailure MAIN_MSGbOPC_OverCurrent MAIN_MSGbOPC_OverTemperatue MAIN_MSGbOPC_OverVoltage MAIN_MSGbOPC_SensorFailure MAIN_MSGbRMCU4_MilReq MAIN_MSGbRMCU4_MoterFault MAIN_MSGbTbox_OTAModeStatus MAIN_MSGbTCU_P1OverTempWarn MAIN_MSGbTCU_P3OverTempWarn MAIN_MSGbVCU_DrivingPermit MAIN_MSGbVCU_FmcuAkdReq MAIN_MSGbVCU_GeneratorAlloweWork MAIN_MSGbVCU_MotorAlloweWork MAIN_MSGbVCU_PropulsionActive MAIN_MSGbVECU_AfterMasterCmd MAIN_MSGbVECU_ShiftDrumTeachinAllwd_flg MAIN_MSGbVECU_ShiftDrumTeachinTrig MAIN_MSGf32AC_AmbTemp MAIN_MSGf32BCM_BattVolt MAIN_MSGf32BMS_Current MAIN_MSGf32BMS_HVBLongTimChargeLim MAIN_MSGf32BMS_HVBLongTimDischargeLim MAIN_MSGf32BMS_HVBShortTimChargeLim MAIN_MSGf32BMS_HVBShortTimDischargerLim MAIN_MSGf32BMS_SOC MAIN_MSGf32CAP_PhsCurLoadPhys MAIN_MSGf32CCP_5VSupplyPhys MAIN_MSGf32CCP_AvrgCurrentPhys MAIN_MSGf32CCP_BenchDutyCyclePhys MAIN_MSGf32CCP_DcCurrentPhys MAIN_MSGf32CCP_DutyCyclePhys MAIN_MSGf32CCP_MotSpeedPhys MAIN_MSGf32CCP_PhsCurLoadPhys MAIN_MSGf32CCP_PwrStgActPosIncPhys MAIN_MSGf32CCP_PwrStgTempPhys MAIN_MSGf32CCP_TargetDutyCyclePhys MAIN_MSGf32DCU_OilPressurePhys MAIN_MSGf32EMS_AccPedPos1NormRaw MAIN_MSGf32EMS_CalcuLoadValue MAIN_MSGf32EMS_EngActualFlwTorque MAIN_MSGf32EMS_EngCoolantTemp MAIN_MSGf32EMS_EngSpd MAIN_MSGf32GCU_ControllerTemp MAIN_MSGf32GCU_GeneratorDCCurrent MAIN_MSGf32GCU_GeneratorDCVolt MAIN_MSGf32GCU_GeneratorMaxPosTorque MAIN_MSGf32GCU_GeneratorMaxSpd MAIN_MSGf32GCU_GeneratorMinNegTorque MAIN_MSGf32GCU_GeneratorSpd MAIN_MSGf32GCU_GeneratorTemp MAIN_MSGf32GCU_GeneratorTorqueFeedback MAIN_MSGf32GCU_MotorPower MAIN_MSGf32GW_ESC_BrakeOilPress MAIN_MSGf32GW_ESC_FrontLeftWHeelSpd MAIN_MSGf32GW_ESC_FrontRightWHeelSpd MAIN_MSGf32GW_ESC_RearLeftWheelSpd MAIN_MSGf32GW_ESC_RearRightWheelSpd MAIN_MSGf32GW_ESC_VehSpd MAIN_MSGf32HTCU_AcDrumAngle MAIN_MSGf32HTCU_CalShiftForce MAIN_MSGf32HTCU_CCPSpd MAIN_MSGf32HTCU_TorqueLimitation MAIN_MSGf32HTCU_TransmissionFluidTemp MAIN_MSGf32MCU_ControllerTemp MAIN_MSGf32MCU_LvVoltPhys MAIN_MSGf32MCU_MotorDCCurrent MAIN_MSGf32MCU_MotorDCVolt1 MAIN_MSGf32MCU_MotorMaxPositiveTorque MAIN_MSGf32MCU_MotorMaxSpd MAIN_MSGf32MCU_MotorMinNegativeTorque MAIN_MSGf32MCU_MotorPower MAIN_MSGf32MCU_MotorSpeed MAIN_MSGf32MCU_MotorTemp MAIN_MSGf32MCU_MotorTorqueFeedback MAIN_MSGf32MP5_TBOX_Time_Year MAIN_MSGf32VCU7_12VBatVoltPhys MAIN_MSGf32VCU_AccPedPosPhys MAIN_MSGf32VCU_BrakPedPosPhys MAIN_MSGf32VCU_DCDCVoltageReq MAIN_MSGf32VCU_GeneratorSpeedCmd MAIN_MSGf32VCU_GeneratorTorqueCmd MAIN_MSGf32VCU_MotorTorqueCmd MAIN_MSGf32VCU_TargetDriveTrq MAIN_MSGf32VECU_MotorSpeedCmd MAIN_MSGu16BCM_BattVoltRaw MAIN_MSGu16BMS_CurrentRaw MAIN_MSGu16BMS_HVBLongTimChargeLimRaw MAIN_MSGu16BMS_HVBLongTimDischargeLimRaw MAIN_MSGu16BMS_HVBShortTimChargeLimRaw MAIN_MSGu16BMS_HVBShortTimDischargerLimRaw MAIN_MSGu16BMS_SOCRaw MAIN_MSGu16BMS_Voltage MAIN_MSGu16CCp_AvrgCurrentRaw MAIN_MSGu16CCp_DcCurrentRaw MAIN_MSGu16CCp_DutyCycleRaw MAIN_MSGu16CCp_MotSpeedRaw MAIN_MSGu16CCp_PhsCurLoadRaw MAIN_MSGu16CCp_PwrStgActPosIncRaw MAIN_MSGu16DCU_OilPressureRaw MAIN_MSGu16EMS_EngActualFlwTorqueRaw MAIN_MSGu16EMS_EngSpdRaw MAIN_MSGu16GCU_GeneratorDCCurrentRaw MAIN_MSGu16GCU_GeneratorDCVoltRaw MAIN_MSGu16GCU_GeneratorMaxPosTorqueRaw MAIN_MSGu16GCU_GeneratorMaxSpdRaw MAIN_MSGu16GCU_GeneratorMinNegTorqueRaw MAIN_MSGu16GCU_GeneratorSpdRaw MAIN_MSGu16GCU_GeneratorTorqueFeedbackRaw MAIN_MSGu16GCU_MotorPowerRaw MAIN_MSGu16GCU_SpdSet MAIN_MSGu16GW_ESC_BrakeOilPressRaw MAIN_MSGu16GW_ESC_FrontLeftWHeelSpdRaw MAIN_MSGu16GW_ESC_FrontRightWHeelSpdRaw MAIN_MSGu16GW_ESC_RearLeftWheelSpdRaw MAIN_MSGu16GW_ESC_RearRightWheelSpdRaw MAIN_MSGu16GW_ESC_VehSpdRaw MAIN_MSGu16HTCU_AcDrumAngleRaw MAIN_MSGu16HTCU_CalShiftForceRaw MAIN_MSGu16HTCU_CCPSpdRaw MAIN_MSGu16HTCU_DevelopFrame1 MAIN_MSGu16HTCU_DevelopFrame2 MAIN_MSGu16HTCU_DevelopFrame3 MAIN_MSGu16HTCU_DevelopFrame4 MAIN_MSGu16HTCU_TorqueLimitationRaw MAIN_MSGu16MCU_MotorDCCurrentRaw MAIN_MSGu16MCU_MotorDCVolt1Raw MAIN_MSGu16MCU_MotorMaxPositiveTorqueRaw MAIN_MSGu16MCU_MotorMaxSpdRaw MAIN_MSGu16MCU_MotorMinNegativeTorqueRaw MAIN_MSGu16MCU_MotorPowerRaw MAIN_MSGu16MCU_MotorSpeedRaw MAIN_MSGu16MCU_MotorTorqueFeedbackRaw MAIN_MSGu16OPC_SpdAct MAIN_MSGu16TCU_ClutchActTorqRaw MAIN_MSGu16VCU_DevelopSignal1 MAIN_MSGu16VCU_DevelopSignal2 MAIN_MSGu16VCU_DevelopSignal3 MAIN_MSGu16VCU_DevelopSignal4 MAIN_MSGu16VCU_GeneratorSpeedCmdRaw MAIN_MSGu16VCU_GeneratorTorqueCmdRaw MAIN_MSGu16VCU_MotorTorqueCmdRaw MAIN_MSGu16VCU_TargetDriveTrqRaw MAIN_MSGu16VECU_MotorSpeedCmdRaw MAIN_MSGu32IBCM_IMMOdata MAIN_MSGu32IC_TotalOdmeter MAIN_MSGu32MCU_ImmoData MAIN_MSGu8AC1_buf MAIN_MSGu8AC1_buf[0] MAIN_MSGu8AC1_buf[1] MAIN_MSGu8AC1_buf[2] MAIN_MSGu8AC1_buf[3] MAIN_MSGu8AC1_buf[4] MAIN_MSGu8AC1_buf[5] MAIN_MSGu8AC1_buf[6] MAIN_MSGu8AC1_buf[7] MAIN_MSGu8AC_AmbTempRaw MAIN_MSGu8BCM_IgnitionSt MAIN_MSGu8BMS1_buf MAIN_MSGu8BMS1_buf[0] MAIN_MSGu8BMS1_buf[1] MAIN_MSGu8BMS1_buf[2] MAIN_MSGu8BMS1_buf[3] MAIN_MSGu8BMS1_buf[4] MAIN_MSGu8BMS1_buf[5] MAIN_MSGu8BMS1_buf[6] MAIN_MSGu8BMS1_buf[7] MAIN_MSGu8BMS3_buf MAIN_MSGu8BMS3_buf[0] MAIN_MSGu8BMS3_buf[1] MAIN_MSGu8BMS3_buf[2] MAIN_MSGu8BMS3_buf[3] MAIN_MSGu8BMS3_buf[4] MAIN_MSGu8BMS3_buf[5] MAIN_MSGu8BMS3_buf[6] MAIN_MSGu8BMS3_buf[7] MAIN_MSGu8BMS4_buf MAIN_MSGu8BMS4_buf[0] MAIN_MSGu8BMS4_buf[1] MAIN_MSGu8BMS4_buf[2] MAIN_MSGu8BMS4_buf[3] MAIN_MSGu8BMS4_buf[4] MAIN_MSGu8BMS4_buf[5] MAIN_MSGu8BMS4_buf[6] MAIN_MSGu8BMS4_buf[7] MAIN_MSGu8BMS7_buf MAIN_MSGu8BMS7_buf[0] MAIN_MSGu8BMS7_buf[1] MAIN_MSGu8BMS7_buf[2] MAIN_MSGu8BMS7_buf[3] MAIN_MSGu8BMS7_buf[4] MAIN_MSGu8BMS7_buf[5] MAIN_MSGu8BMS7_buf[6] MAIN_MSGu8BMS7_buf[7] MAIN_MSGu8BMS_MainNegConnSts MAIN_MSGu8BMS_MainPosConnSts MAIN_MSGu8BMS_SOCCalculate MAIN_MSGu8CCp_5VSupplyRaw MAIN_MSGu8CCP_CurrentSts MAIN_MSGu8CCP_FaultCode MAIN_MSGu8CCP_FaultLevel MAIN_MSGu8CCP_PwrStgMode MAIN_MSGu8CCP_PwrStgPosSts MAIN_MSGu8CCP_PwrStgSts MAIN_MSGu8CCp_PwrStgTempRaw MAIN_MSGu8CCP_TargetMotSts MAIN_MSGu8Checksum30A MAIN_MSGu8CompileDay MAIN_MSGu8CompileMonth MAIN_MSGu8CompileYear MAIN_MSGu8DCU_FltLev MAIN_MSGu8DCU_OfsAlCalSts MAIN_MSGu8DEV_Fault0 MAIN_MSGu8DEV_Fault1 MAIN_MSGu8DEV_Fault10 MAIN_MSGu8DEV_Fault11 MAIN_MSGu8DEV_Fault12 MAIN_MSGu8DEV_Fault13 MAIN_MSGu8DEV_Fault14 MAIN_MSGu8DEV_Fault15 MAIN_MSGu8DEV_Fault2 MAIN_MSGu8DEV_Fault3 MAIN_MSGu8DEV_Fault4 MAIN_MSGu8DEV_Fault5 MAIN_MSGu8DEV_Fault6 MAIN_MSGu8DEV_Fault7 MAIN_MSGu8DEV_Fault8 MAIN_MSGu8DEV_Fault9 MAIN_MSGu8EMS0_buf MAIN_MSGu8EMS0_buf[0] MAIN_MSGu8EMS0_buf[1] MAIN_MSGu8EMS0_buf[2] MAIN_MSGu8EMS0_buf[3] MAIN_MSGu8EMS0_buf[4] MAIN_MSGu8EMS0_buf[5] MAIN_MSGu8EMS0_buf[6] MAIN_MSGu8EMS0_buf[7] MAIN_MSGu8EMS1_buf MAIN_MSGu8EMS1_buf[0] MAIN_MSGu8EMS1_buf[1] MAIN_MSGu8EMS1_buf[2] MAIN_MSGu8EMS1_buf[3] MAIN_MSGu8EMS1_buf[4] MAIN_MSGu8EMS1_buf[5] MAIN_MSGu8EMS1_buf[6] MAIN_MSGu8EMS1_buf[7] MAIN_MSGu8EMS2_buf MAIN_MSGu8EMS2_buf[0] MAIN_MSGu8EMS2_buf[1] MAIN_MSGu8EMS2_buf[2] MAIN_MSGu8EMS2_buf[3] MAIN_MSGu8EMS2_buf[4] MAIN_MSGu8EMS2_buf[5] MAIN_MSGu8EMS2_buf[6] MAIN_MSGu8EMS2_buf[7] MAIN_MSGu8EMS7_buf MAIN_MSGu8EMS7_buf[0] MAIN_MSGu8EMS7_buf[1] MAIN_MSGu8EMS7_buf[2] MAIN_MSGu8EMS7_buf[3] MAIN_MSGu8EMS7_buf[4] MAIN_MSGu8EMS7_buf[5] MAIN_MSGu8EMS7_buf[6] MAIN_MSGu8EMS7_buf[7] MAIN_MSGu8EMS8_buf MAIN_MSGu8EMS8_buf[0] MAIN_MSGu8EMS8_buf[1] MAIN_MSGu8EMS8_buf[2] MAIN_MSGu8EMS8_buf[3] MAIN_MSGu8EMS8_buf[4] MAIN_MSGu8EMS8_buf[5] MAIN_MSGu8EMS8_buf[6] MAIN_MSGu8EMS8_buf[7] MAIN_MSGu8EMS_AccPedPos1NormRawRaw MAIN_MSGu8EMS_CalcuLoadValueRaw MAIN_MSGu8EMS_CheckSum_EMS1 MAIN_MSGu8EMS_CheckSum_EMS2 MAIN_MSGu8EMS_CheckSum_EMS7 MAIN_MSGu8EMS_CheckSum_EMS8 MAIN_MSGu8EMS_CheckSum_EMS_P3 MAIN_MSGu8EMS_EngCoolantTempRaw MAIN_MSGu8EMS_P3_buf MAIN_MSGu8EMS_P3_buf[0] MAIN_MSGu8EMS_P3_buf[1] MAIN_MSGu8EMS_P3_buf[2] MAIN_MSGu8EMS_P3_buf[3] MAIN_MSGu8EMS_P3_buf[4] MAIN_MSGu8EMS_P3_buf[5] MAIN_MSGu8EMS_P3_buf[6] MAIN_MSGu8EMS_P3_buf[7] MAIN_MSGu8EMS_PowertrainControlSt MAIN_MSGu8EMS_RollingCount_EMS1 MAIN_MSGu8EMS_RollingCount_EMS2 MAIN_MSGu8EMS_RollingCount_EMS7 MAIN_MSGu8EMS_RollingCount_EMS8 MAIN_MSGu8EMS_RollingCount_EMS_P3 MAIN_MSGu8GCU1_buf MAIN_MSGu8GCU1_buf[0] MAIN_MSGu8GCU1_buf[1] MAIN_MSGu8GCU1_buf[2] MAIN_MSGu8GCU1_buf[3] MAIN_MSGu8GCU1_buf[4] MAIN_MSGu8GCU1_buf[5] MAIN_MSGu8GCU1_buf[6] MAIN_MSGu8GCU1_buf[7] MAIN_MSGu8GCU2_buf MAIN_MSGu8GCU2_buf[0] MAIN_MSGu8GCU2_buf[1] MAIN_MSGu8GCU2_buf[2] MAIN_MSGu8GCU2_buf[3] MAIN_MSGu8GCU2_buf[4] MAIN_MSGu8GCU2_buf[5] MAIN_MSGu8GCU2_buf[6] MAIN_MSGu8GCU2_buf[7] MAIN_MSGu8GCU3_buf MAIN_MSGu8GCU3_buf[0] MAIN_MSGu8GCU3_buf[1] MAIN_MSGu8GCU3_buf[2] MAIN_MSGu8GCU3_buf[3] MAIN_MSGu8GCU3_buf[4] MAIN_MSGu8GCU3_buf[5] MAIN_MSGu8GCU3_buf[6] MAIN_MSGu8GCU3_buf[7] MAIN_MSGu8GCU4_buf MAIN_MSGu8GCU4_buf[0] MAIN_MSGu8GCU4_buf[1] MAIN_MSGu8GCU4_buf[2] MAIN_MSGu8GCU4_buf[3] MAIN_MSGu8GCU4_buf[4] MAIN_MSGu8GCU4_buf[5] MAIN_MSGu8GCU4_buf[6] MAIN_MSGu8GCU4_buf[7] MAIN_MSGu8GCU_CheckSum111 MAIN_MSGu8GCU_CheckSum_GCU1 MAIN_MSGu8GCU_CheckSum_GCU3 MAIN_MSGu8GCU_ControllerTempRaw MAIN_MSGu8GCU_Fault_buf MAIN_MSGu8GCU_Fault_buf[0] MAIN_MSGu8GCU_Fault_buf[1] MAIN_MSGu8GCU_Fault_buf[2] MAIN_MSGu8GCU_Fault_buf[3] MAIN_MSGu8GCU_Fault_buf[4] MAIN_MSGu8GCU_Fault_buf[5] MAIN_MSGu8GCU_Fault_buf[6] MAIN_MSGu8GCU_Fault_buf[7] MAIN_MSGu8GCU_GeneratorFaultLamp MAIN_MSGu8GCU_GeneratorSt MAIN_MSGu8GCU_GeneratorSysFaultLvl MAIN_MSGu8GCU_GeneratorTempRaw MAIN_MSGu8GCU_InverterWorkingState MAIN_MSGu8GCU_RollingCount111 MAIN_MSGu8GCU_RollingCount_GCU1 MAIN_MSGu8GCU_RollingCount_GCU3 MAIN_MSGu8GCU_TargetCoolingMotCntMode MAIN_MSGu8GCU_TargetCoolingMotDuty MAIN_MSGu8GW2_PwrMode MAIN_MSGu8GW_ESC2_buf MAIN_MSGu8GW_ESC2_buf[0] MAIN_MSGu8GW_ESC2_buf[1] MAIN_MSGu8GW_ESC2_buf[2] MAIN_MSGu8GW_ESC2_buf[3] MAIN_MSGu8GW_ESC2_buf[4] MAIN_MSGu8GW_ESC2_buf[5] MAIN_MSGu8GW_ESC2_buf[6] MAIN_MSGu8GW_ESC2_buf[7] MAIN_MSGu8GW_ESC_CheckSum_ESC MAIN_MSGu8GW_ESC_CheckSum_ESC2 MAIN_MSGu8GW_ESC_RollingCount_ESC MAIN_MSGu8GW_ESC_RollingCount_ESC2 MAIN_MSGu8GW_ESC_WheelSpd_buf MAIN_MSGu8GW_ESC_WheelSpd_buf[0] MAIN_MSGu8GW_ESC_WheelSpd_buf[1] MAIN_MSGu8GW_ESC_WheelSpd_buf[2] MAIN_MSGu8GW_ESC_WheelSpd_buf[3] MAIN_MSGu8GW_ESC_WheelSpd_buf[4] MAIN_MSGu8GW_ESC_WheelSpd_buf[5] MAIN_MSGu8GW_ESC_WheelSpd_buf[6] MAIN_MSGu8GW_ESC_WheelSpd_buf[7] MAIN_MSGu8GW_IVI_buf MAIN_MSGu8GW_IVI_buf[0] MAIN_MSGu8GW_IVI_buf[1] MAIN_MSGu8GW_IVI_buf[2] MAIN_MSGu8GW_IVI_buf[3] MAIN_MSGu8GW_IVI_buf[4] MAIN_MSGu8GW_IVI_buf[5] MAIN_MSGu8GW_IVI_buf[6] MAIN_MSGu8GW_IVI_buf[7] MAIN_MSGu8GW_TBOX_Time_buf MAIN_MSGu8GW_TBOX_Time_buf[0] MAIN_MSGu8GW_TBOX_Time_buf[1] MAIN_MSGu8GW_TBOX_Time_buf[2] MAIN_MSGu8GW_TBOX_Time_buf[3] MAIN_MSGu8GW_TBOX_Time_buf[4] MAIN_MSGu8GW_TBOX_Time_buf[5] MAIN_MSGu8GW_TBOX_Time_buf[6] MAIN_MSGu8GW_TBOX_Time_buf[7] MAIN_MSGu8HTCU2_buf MAIN_MSGu8HTCU2_buf[0] MAIN_MSGu8HTCU2_buf[1] MAIN_MSGu8HTCU2_buf[2] MAIN_MSGu8HTCU2_buf[3] MAIN_MSGu8HTCU2_buf[4] MAIN_MSGu8HTCU2_buf[5] MAIN_MSGu8HTCU2_buf[6] MAIN_MSGu8HTCU2_buf[7] MAIN_MSGu8HTCU_CheckSum9E MAIN_MSGu8HTCU_CoolingRequest MAIN_MSGu8HTCU_CrankingAuthorizationEnable MAIN_MSGu8HTCU_CurrentDrumPos MAIN_MSGu8HTCU_Fault MAIN_MSGu8HTCU_GearProgress MAIN_MSGu8HTCU_GearShiftStatus MAIN_MSGu8HTCU_RollingCount9E MAIN_MSGu8HTCU_TransmissionFluidTempRaw MAIN_MSGu8IBCM3_buf MAIN_MSGu8IBCM3_buf[0] MAIN_MSGu8IBCM3_buf[1] MAIN_MSGu8IBCM3_buf[2] MAIN_MSGu8IBCM3_buf[3] MAIN_MSGu8IBCM3_buf[4] MAIN_MSGu8IBCM3_buf[5] MAIN_MSGu8IBCM3_buf[6] MAIN_MSGu8IBCM3_buf[7] MAIN_MSGu8IBCM6_buf MAIN_MSGu8IBCM6_buf[0] MAIN_MSGu8IBCM6_buf[1] MAIN_MSGu8IBCM6_buf[2] MAIN_MSGu8IBCM6_buf[3] MAIN_MSGu8IBCM6_buf[4] MAIN_MSGu8IBCM6_buf[5] MAIN_MSGu8IBCM6_buf[6] MAIN_MSGu8IBCM6_buf[7] MAIN_MSGu8IBCM_IMMO_buf MAIN_MSGu8IBCM_IMMO_buf[0] MAIN_MSGu8IBCM_IMMO_buf[1] MAIN_MSGu8IBCM_IMMO_buf[2] MAIN_MSGu8IBCM_IMMO_buf[3] MAIN_MSGu8IBCM_IMMO_buf[4] MAIN_MSGu8IBCM_IMMO_buf[5] MAIN_MSGu8IBCM_IMMO_buf[6] MAIN_MSGu8IBCM_IMMO_buf[7] MAIN_MSGu8IC_CheckSum320 MAIN_MSGu8IC_RollingCount320 MAIN_MSGu8M2G1_Byte4 MAIN_MSGu8M2G1_Byte5 MAIN_MSGu8M2G1_Byte6 MAIN_MSGu8M2G1_Byte7 MAIN_MSGu8M2G2_Byte0 MAIN_MSGu8M2G2_Byte1 MAIN_MSGu8M2G2_Byte2 MAIN_MSGu8M2G2_Byte3 MAIN_MSGu8M2G2_Byte4 MAIN_MSGu8M2G2_Byte5 MAIN_MSGu8M2G2_Byte6 MAIN_MSGu8M2G2_Byte7 MAIN_MSGu8MCU1_buf MAIN_MSGu8MCU1_buf[0] MAIN_MSGu8MCU1_buf[1] MAIN_MSGu8MCU1_buf[2] MAIN_MSGu8MCU1_buf[3] MAIN_MSGu8MCU1_buf[4] MAIN_MSGu8MCU1_buf[5] MAIN_MSGu8MCU1_buf[6] MAIN_MSGu8MCU1_buf[7] MAIN_MSGu8MCU2_buf MAIN_MSGu8MCU2_buf[0] MAIN_MSGu8MCU2_buf[1] MAIN_MSGu8MCU2_buf[2] MAIN_MSGu8MCU2_buf[3] MAIN_MSGu8MCU2_buf[4] MAIN_MSGu8MCU2_buf[5] MAIN_MSGu8MCU2_buf[6] MAIN_MSGu8MCU2_buf[7] MAIN_MSGu8MCU3_buf MAIN_MSGu8MCU3_buf[0] MAIN_MSGu8MCU3_buf[1] MAIN_MSGu8MCU3_buf[2] MAIN_MSGu8MCU3_buf[3] MAIN_MSGu8MCU3_buf[4] MAIN_MSGu8MCU3_buf[5] MAIN_MSGu8MCU3_buf[6] MAIN_MSGu8MCU3_buf[7] MAIN_MSGu8MCU4_buf MAIN_MSGu8MCU4_buf[0] MAIN_MSGu8MCU4_buf[1] MAIN_MSGu8MCU4_buf[2] MAIN_MSGu8MCU4_buf[3] MAIN_MSGu8MCU4_buf[4] MAIN_MSGu8MCU4_buf[5] MAIN_MSGu8MCU4_buf[6] MAIN_MSGu8MCU4_buf[7] MAIN_MSGu8MCU_CheckSum110 MAIN_MSGu8MCU_CheckSum_112 MAIN_MSGu8MCU_CheckSum_MCU3 MAIN_MSGu8MCU_ControllerTempRaw MAIN_MSGu8MCU_Fault_buf MAIN_MSGu8MCU_Fault_buf[0] MAIN_MSGu8MCU_Fault_buf[1] MAIN_MSGu8MCU_Fault_buf[2] MAIN_MSGu8MCU_Fault_buf[3] MAIN_MSGu8MCU_Fault_buf[4] MAIN_MSGu8MCU_Fault_buf[5] MAIN_MSGu8MCU_Fault_buf[6] MAIN_MSGu8MCU_Fault_buf[7] MAIN_MSGu8MCU_InverterWorkingState MAIN_MSGu8MCU_MCU_MotorFaultLamp MAIN_MSGu8MCU_McuPrevSlipFlg MAIN_MSGu8MCU_MotorSt MAIN_MSGu8MCU_MotorSysFaultLvl MAIN_MSGu8MCU_MotorTempRaw MAIN_MSGu8MCU_RollingCount110 MAIN_MSGu8MCU_RollingCount_112 MAIN_MSGu8MCU_RollingCount_MCU3 MAIN_MSGu8McuDTC MAIN_MSGu8MCUF_Cali1 MAIN_MSGu8MCUF_Cali1[0] MAIN_MSGu8MCUF_Cali1[1] MAIN_MSGu8MCUF_Cali1[2] MAIN_MSGu8MCUF_Cali1[3] MAIN_MSGu8MCUF_Cali1[4] MAIN_MSGu8MCUF_Cali1[5] MAIN_MSGu8MCUF_Cali1[6] MAIN_MSGu8MCUF_Cali1[7] MAIN_MSGu8MCUF_Cali2 MAIN_MSGu8MCUF_Cali2[0] MAIN_MSGu8MCUF_Cali2[1] MAIN_MSGu8MCUF_Cali2[2] MAIN_MSGu8MCUF_Cali2[3] MAIN_MSGu8MCUF_Cali2[4] MAIN_MSGu8MCUF_Cali2[5] MAIN_MSGu8MCUF_Cali2[6] MAIN_MSGu8MCUF_Cali2[7] MAIN_MSGu8MCUF_Cali3 MAIN_MSGu8MCUF_Cali3[0] MAIN_MSGu8MCUF_Cali3[1] MAIN_MSGu8MCUF_Cali3[2] MAIN_MSGu8MCUF_Cali3[3] MAIN_MSGu8MCUF_Cali3[4] MAIN_MSGu8MCUF_Cali3[5] MAIN_MSGu8MCUF_Cali3[6] MAIN_MSGu8MCUF_Cali3[7] MAIN_MSGu8MCUF_Cali4 MAIN_MSGu8MCUF_Cali4[0] MAIN_MSGu8MCUF_Cali4[1] MAIN_MSGu8MCUF_Cali4[2] MAIN_MSGu8MCUF_Cali4[3] MAIN_MSGu8MCUF_Cali4[4] MAIN_MSGu8MCUF_Cali4[5] MAIN_MSGu8MCUF_Cali4[6] MAIN_MSGu8MCUF_Cali4[7] MAIN_MSGu8McuMotSN MAIN_MSGu8McuMotSubFltLevel MAIN_MSGu8MCUR_Cali MAIN_MSGu8MCUR_Cali[0] MAIN_MSGu8MCUR_Cali[1] MAIN_MSGu8MCUR_Cali[2] MAIN_MSGu8MCUR_Cali[3] MAIN_MSGu8MCUR_Cali[4] MAIN_MSGu8MCUR_Cali[5] MAIN_MSGu8MCUR_Cali[6] MAIN_MSGu8MCUR_Cali[7] MAIN_MSGu8McuSoftMajorVer MAIN_MSGu8McuSoftMinorVer MAIN_MSGu8MP5_TBOX_Time_Date MAIN_MSGu8MP5_TBOX_Time_Hour MAIN_MSGu8MP5_TBOX_Time_Minute MAIN_MSGu8MP5_TBOX_Time_Month MAIN_MSGu8MP5_TBOX_Time_Second MAIN_MSGu8MP5_TBOX_Time_YearRaw MAIN_MSGu8MTCU_DevelopFrame_buf MAIN_MSGu8MTCU_DevelopFrame_buf[0] MAIN_MSGu8MTCU_DevelopFrame_buf[1] MAIN_MSGu8MTCU_DevelopFrame_buf[2] MAIN_MSGu8MTCU_DevelopFrame_buf[3] MAIN_MSGu8MTCU_DevelopFrame_buf[4] MAIN_MSGu8MTCU_DevelopFrame_buf[5] MAIN_MSGu8MTCU_DevelopFrame_buf[6] MAIN_MSGu8MTCU_DevelopFrame_buf[7] MAIN_MSGu8MTCU_EngineAuthResul_buf MAIN_MSGu8MTCU_EngineAuthResul_buf[0] MAIN_MSGu8MTCU_EngineAuthResul_buf[1] MAIN_MSGu8MTCU_EngineAuthResul_buf[2] MAIN_MSGu8MTCU_EngineAuthResul_buf[3] MAIN_MSGu8MTCU_EngineAuthResul_buf[4] MAIN_MSGu8MTCU_EngineAuthResul_buf[5] MAIN_MSGu8MTCU_EngineAuthResul_buf[6] MAIN_MSGu8MTCU_EngineAuthResul_buf[7] MAIN_MSGu8MTCU_HTCU1_buf MAIN_MSGu8MTCU_HTCU1_buf[0] MAIN_MSGu8MTCU_HTCU1_buf[1] MAIN_MSGu8MTCU_HTCU1_buf[2] MAIN_MSGu8MTCU_HTCU1_buf[3] MAIN_MSGu8MTCU_HTCU1_buf[4] MAIN_MSGu8MTCU_HTCU1_buf[5] MAIN_MSGu8MTCU_HTCU1_buf[6] MAIN_MSGu8MTCU_HTCU1_buf[7] MAIN_MSGu8MTCU_IMMO_buf MAIN_MSGu8MTCU_IMMO_buf[0] MAIN_MSGu8MTCU_IMMO_buf[1] MAIN_MSGu8MTCU_IMMO_buf[2] MAIN_MSGu8MTCU_IMMO_buf[3] MAIN_MSGu8MTCU_IMMO_buf[4] MAIN_MSGu8MTCU_IMMO_buf[5] MAIN_MSGu8MTCU_IMMO_buf[6] MAIN_MSGu8MTCU_IMMO_buf[7] MAIN_MSGu8MTCU_OPC_test6_buf MAIN_MSGu8MTCU_OPC_test6_buf[0] MAIN_MSGu8MTCU_OPC_test6_buf[1] MAIN_MSGu8MTCU_OPC_test6_buf[2] MAIN_MSGu8MTCU_OPC_test6_buf[3] MAIN_MSGu8MTCU_OPC_test6_buf[4] MAIN_MSGu8MTCU_OPC_test6_buf[5] MAIN_MSGu8MTCU_OPC_test6_buf[6] MAIN_MSGu8MTCU_OPC_test6_buf[7] MAIN_MSGu8MTCUGCU_buf MAIN_MSGu8MTCUGCU_buf[0] MAIN_MSGu8MTCUGCU_buf[1] MAIN_MSGu8MTCUGCU_buf[2] MAIN_MSGu8MTCUGCU_buf[3] MAIN_MSGu8MTCUGCU_buf[4] MAIN_MSGu8MTCUGCU_buf[5] MAIN_MSGu8MTCUGCU_buf[6] MAIN_MSGu8MTCUGCU_buf[7] MAIN_MSGu8MTCUMCU_buf MAIN_MSGu8MTCUMCU_buf[0] MAIN_MSGu8MTCUMCU_buf[1] MAIN_MSGu8MTCUMCU_buf[2] MAIN_MSGu8MTCUMCU_buf[3] MAIN_MSGu8MTCUMCU_buf[4] MAIN_MSGu8MTCUMCU_buf[5] MAIN_MSGu8MTCUMCU_buf[6] MAIN_MSGu8MTCUMCU_buf[7] MAIN_MSGu8OPC1_buf MAIN_MSGu8OPC1_buf[0] MAIN_MSGu8OPC1_buf[1] MAIN_MSGu8OPC1_buf[2] MAIN_MSGu8OPC1_buf[3] MAIN_MSGu8OPC1_buf[4] MAIN_MSGu8OPC1_buf[5] MAIN_MSGu8OPC1_buf[6] MAIN_MSGu8OPC1_buf[7] MAIN_MSGu8OPC_CheckSum3E7 MAIN_MSGu8OPC_ErrLvlSts MAIN_MSGu8OPC_RollingCount3E7 MAIN_MSGu8OTA_EstimatedUpgradeTime MAIN_MSGu8PwModOffCnt MAIN_MSGu8PwModOnCnt MAIN_MSGu8RollingCounter30A MAIN_MSGu8TBOX_OTAInfo_buf MAIN_MSGu8TBOX_OTAInfo_buf[0] MAIN_MSGu8TBOX_OTAInfo_buf[1] MAIN_MSGu8TBOX_OTAInfo_buf[2] MAIN_MSGu8TBOX_OTAInfo_buf[3] MAIN_MSGu8TBOX_OTAInfo_buf[4] MAIN_MSGu8TBOX_OTAInfo_buf[5] MAIN_MSGu8TBOX_OTAInfo_buf[6] MAIN_MSGu8TBOX_OTAInfo_buf[7] MAIN_MSGu8TCU_ClutchProgress MAIN_MSGu8VCU2_buf MAIN_MSGu8VCU2_buf[0] MAIN_MSGu8VCU2_buf[1] MAIN_MSGu8VCU2_buf[2] MAIN_MSGu8VCU2_buf[3] MAIN_MSGu8VCU2_buf[4] MAIN_MSGu8VCU2_buf[5] MAIN_MSGu8VCU2_buf[6] MAIN_MSGu8VCU2_buf[7] MAIN_MSGu8VCU_AccPedal_buf MAIN_MSGu8VCU_AccPedal_buf[0] MAIN_MSGu8VCU_AccPedal_buf[1] MAIN_MSGu8VCU_AccPedal_buf[2] MAIN_MSGu8VCU_AccPedal_buf[3] MAIN_MSGu8VCU_AccPedal_buf[4] MAIN_MSGu8VCU_AccPedal_buf[5] MAIN_MSGu8VCU_AccPedal_buf[6] MAIN_MSGu8VCU_AccPedal_buf[7] MAIN_MSGu8VCU_AccPedPosRaw MAIN_MSGu8VCU_CapacitorDischarge MAIN_MSGu8VCU_CheckSum MAIN_MSGu8VCU_CheckSumCB MAIN_MSGu8VCU_CheckSumDF MAIN_MSGu8VCU_CheckSumF0 MAIN_MSGu8VCU_DCDCActivation MAIN_MSGu8VCU_DCDCVoltageReqRaw MAIN_MSGu8VCU_EMWorkMod MAIN_MSGu8VCU_EngRunningStatusExpanded MAIN_MSGu8VCU_ePTReady MAIN_MSGu8VCU_Fault MAIN_MSGu8VCU_GearFeedback MAIN_MSGu8VCU_GeneratorStCtrl MAIN_MSGu8VCU_HandBrakSts MAIN_MSGu8VCU_McuEnableReq MAIN_MSGu8VCU_MotorStCtrl MAIN_MSGu8VCU_MTCU_buf MAIN_MSGu8VCU_MTCU_buf[0] MAIN_MSGu8VCU_MTCU_buf[1] MAIN_MSGu8VCU_MTCU_buf[2] MAIN_MSGu8VCU_MTCU_buf[3] MAIN_MSGu8VCU_MTCU_buf[4] MAIN_MSGu8VCU_MTCU_buf[5] MAIN_MSGu8VCU_MTCU_buf[6] MAIN_MSGu8VCU_MTCU_buf[7] MAIN_MSGu8VCU_RollingCount MAIN_MSGu8VCU_RollingCountCB MAIN_MSGu8VCU_RollingCountDF MAIN_MSGu8VCU_RollingCountF0 MAIN_MSGu8VCUCtrlDCDC_buf MAIN_MSGu8VCUCtrlDCDC_buf[0] MAIN_MSGu8VCUCtrlDCDC_buf[1] MAIN_MSGu8VCUCtrlDCDC_buf[2] MAIN_MSGu8VCUCtrlDCDC_buf[3] MAIN_MSGu8VCUCtrlDCDC_buf[4] MAIN_MSGu8VCUCtrlDCDC_buf[5] MAIN_MSGu8VCUCtrlDCDC_buf[6] MAIN_MSGu8VCUCtrlDCDC_buf[7] MAIN_MSGu8VCUCtrlMotor_buf MAIN_MSGu8VCUCtrlMotor_buf[0] MAIN_MSGu8VCUCtrlMotor_buf[1] MAIN_MSGu8VCUCtrlMotor_buf[2] MAIN_MSGu8VCUCtrlMotor_buf[3] MAIN_MSGu8VCUCtrlMotor_buf[4] MAIN_MSGu8VCUCtrlMotor_buf[5] MAIN_MSGu8VCUCtrlMotor_buf[6] MAIN_MSGu8VCUCtrlMotor_buf[7] MAIN_MSGu8VCUtoDisplay_buf MAIN_MSGu8VCUtoDisplay_buf[0] MAIN_MSGu8VCUtoDisplay_buf[1] MAIN_MSGu8VCUtoDisplay_buf[2] MAIN_MSGu8VCUtoDisplay_buf[3] MAIN_MSGu8VCUtoDisplay_buf[4] MAIN_MSGu8VCUtoDisplay_buf[5] MAIN_MSGu8VCUtoDisplay_buf[6] MAIN_MSGu8VCUtoDisplay_buf[7] MAIN_MSGu8VECU_ShiftSpeedType MAIN_MSGu8VECU_TargetDrumPos MAIN_s16BldcHallDirFdb MAIN_s32DeltTimDiff MAIN_s32Email2PosTreqDiff MAIN_s32PosA2BDeltTime MAIN_s32PosA2BDeltTimMax MAIN_s32PosA2BDeltTimMin MAIN_TCUf32CAP_AvrgCurrentPhys MAIN_TCUf32CAP_DutyCyclePhys MAIN_TCUf32CAP_MotSpeedPhys MAIN_TCUf32CAP_TargetDutyCyclePhys MAIN_TCUu8CAP_TargetMotSts MAIN_TotalTime MAIN_u16AntiSsBrakTimCnt MAIN_u16AntiSsEnaBrakCnt MAIN_u16AntiSsValidCnt MAIN_u16BldcIbatAdcV01 MAIN_u16BldcIbatAdcVR0 MAIN_u16BldcOilPressAdc MAIN_u16BldcOilTempAdc MAIN_u16BrakRelsDelayCnt MAIN_u16Cnt1 MAIN_u16Cnt10 MAIN_u16Cnt100 MAIN_u16Cnt1000 MAIN_u16Cnt2 MAIN_u16Cnt20 MAIN_u16Cnt200 MAIN_u16Cnt2000 MAIN_u16Cnt30 MAIN_u16Cnt4 MAIN_u16Cnt5 MAIN_u16Cnt50 MAIN_u16Cnt500 MAIN_u16FaultDelayCnt MAIN_u16FpgaFltClrCnt MAIN_u16HandBrkRelsDelay MAIN_u16IdqDeltaSumCnt MAIN_u16IuCycleCnt MAIN_u16IuMiddleCnt MAIN_u16IuMiddleSum MAIN_u16IuNegtiveCnt MAIN_u16IuNegtiveSum /end OUT_MEASUREMENT
/end FUNCTION
/end MODULE
/end PROJECT
