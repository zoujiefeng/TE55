ASAP2_VERSION 1 3
/begin PROJECT D_TC387_PLATFORM_0_0 "D_TC387_PLATFORM_0_0"
/begin HEADER "" VERSION "5210.00" PROJECT_NO D0 /end HEADER
/begin MODULE D_TC387_PLATFORM_0_0 "Invt"
/begin MOD_COMMON "" DEPOSIT ABSOLUTE ALIGNMENT_BYTE 1 ALIGNMENT_WORD 2 ALIGNMENT_LONG 4 ALIGNMENT_FLOAT32_IEEE 4 ALIGNMENT_FLOAT64_IEEE 8 BYTE_ORDER MSB_LAST /end MOD_COMMON
/begin RECORD_LAYOUT DATA_RECORD_UBYTE FNC_VALUES 1 UBYTE ROW_DIR DIRECT /end RECORD_LAYOUT
/begin RECORD_LAYOUT DATA_RECORD_UWORD FNC_VALUES 1 UWORD ROW_DIR DIRECT /end RECORD_LAYOUT
/begin RECORD_LAYOUT DATA_RECORD_SWORD FNC_VALUES 1 SWORD ROW_DIR DIRECT /end RECORD_LAYOUT
/begin RECORD_LAYOUT DATA_RECORD_ULONG FNC_VALUES 1 ULONG ROW_DIR DIRECT /end RECORD_LAYOUT
/begin RECORD_LAYOUT DATA_RECORD_FLOAT32_IEEE FNC_VALUES 1 FLOAT32_IEEE ROW_DIR DIRECT /end RECORD_LAYOUT
/begin RECORD_LAYOUT DATA_RECORD_FLOAT64_IEEE FNC_VALUES 1 FLOAT64_IEEE ROW_DIR DIRECT /end RECORD_LAYOUT
/begin CHARACTERISTIC FRecord_ku32TimeBeforeFaultOccurC "Spare" VALUE 0x0000 DATA_RECORD_ULONG 4294967295 F_1_m20000_35 -20000 4294947295 /end CHARACTERISTIC
/begin CHARACTERISTIC FaultBSW_COM_BusOff_CAN1Dec "FaultBSW_COM_BusOff_CAN1Dec" VALUE 0x0000 DATA_RECORD_UBYTE 255 I_1 0 255 /end CHARACTERISTIC
/begin CHARACTERISTIC FaultBSW_COM_BusOff_CAN1FailMod "FaultBSW_COM_BusOff_CAN1FailMod" VALUE 0x0000 DATA_RECORD_UBYTE 255 I_1 0 255 /end CHARACTERISTIC
/begin CHARACTERISTIC FaultBSW_COM_BusOff_CAN1Inc "FaultBSW_COM_BusOff_CAN1Inc" VALUE 0x0000 DATA_RECORD_UBYTE 255 I_1 0 255 /end CHARACTERISTIC
/begin CHARACTERISTIC FaultBSW_COM_ChecksumErrVCUDec "FaultBSW_COM_ChecksumErrVCUDec" VALUE 0x0001 DATA_RECORD_UBYTE 255 I_1 0 255 /end CHARACTERISTIC
/begin CHARACTERISTIC FaultBSW_COM_ChecksumErrVCUFailMod "FaultBSW_COM_ChecksumErrVCUFailMod" VALUE 0x0001 DATA_RECORD_UBYTE 255 I_1 0 255 /end CHARACTERISTIC
/begin CHARACTERISTIC FaultBSW_COM_ChecksumErrVCUInc "FaultBSW_COM_ChecksumErrVCUInc" VALUE 0x0001 DATA_RECORD_UBYTE 255 I_1 0 255 /end CHARACTERISTIC
/begin CHARACTERISTIC FaultBSW_COM_InterFaultVCUDec "FaultBSW_COM_InterFaultVCUDec" VALUE 0x0002 DATA_RECORD_UBYTE 255 I_1 0 255 /end CHARACTERISTIC
/begin CHARACTERISTIC FaultBSW_COM_InterFaultVCUFailMod "FaultBSW_COM_InterFaultVCUFailMod" VALUE 0x0002 DATA_RECORD_UBYTE 255 I_1 0 255 /end CHARACTERISTIC
/begin CHARACTERISTIC FaultBSW_COM_InterFaultVCUInc "FaultBSW_COM_InterFaultVCUInc" VALUE 0x0002 DATA_RECORD_UBYTE 255 I_1 0 255 /end CHARACTERISTIC
/begin CHARACTERISTIC FaultBSW_COM_RollCntErrVCUDec "FaultBSW_COM_RollCntErrVCUDec" VALUE 0x0003 DATA_RECORD_UBYTE 255 I_1 0 255 /end CHARACTERISTIC
/begin CHARACTERISTIC FaultBSW_COM_RollCntErrVCUFailMod "FaultBSW_COM_RollCntErrVCUFailMod" VALUE 0x0003 DATA_RECORD_UBYTE 255 I_1 0 255 /end CHARACTERISTIC
/begin CHARACTERISTIC FaultBSW_COM_RollCntErrVCUInc "FaultBSW_COM_RollCntErrVCUInc" VALUE 0x0003 DATA_RECORD_UBYTE 255 I_1 0 255 /end CHARACTERISTIC
/begin CHARACTERISTIC FaultBSW_COM_TimoutRxBCMDec "FaultBSW_COM_TimoutRxBCMDec" VALUE 0x0004 DATA_RECORD_UBYTE 255 I_1 0 255 /end CHARACTERISTIC
/begin CHARACTERISTIC FaultBSW_COM_TimoutRxBCMFailMod "FaultBSW_COM_TimoutRxBCMFailMod" VALUE 0x0004 DATA_RECORD_UBYTE 255 I_1 0 255 /end CHARACTERISTIC
/begin CHARACTERISTIC FaultBSW_COM_TimoutRxBCMInc "FaultBSW_COM_TimoutRxBCMInc" VALUE 0x0004 DATA_RECORD_UBYTE 255 I_1 0 255 /end CHARACTERISTIC
/begin CHARACTERISTIC FaultBSW_COM_TimoutRxBMSHDec "FaultBSW_COM_TimoutRxBMSHDec" VALUE 0x0005 DATA_RECORD_UBYTE 255 I_1 0 255 /end CHARACTERISTIC
/begin CHARACTERISTIC FaultBSW_COM_TimoutRxBMSHFailMod "FaultBSW_COM_TimoutRxBMSHFailMod" VALUE 0x0005 DATA_RECORD_UBYTE 255 I_1 0 255 /end CHARACTERISTIC
/begin CHARACTERISTIC FaultBSW_COM_TimoutRxBMSHInc "FaultBSW_COM_TimoutRxBMSHInc" VALUE 0x0005 DATA_RECORD_UBYTE 255 I_1 0 255 /end CHARACTERISTIC
/begin CHARACTERISTIC FaultBSW_COM_TimoutRxEMSDec "FaultBSW_COM_TimoutRxEMSDec" VALUE 0x0006 DATA_RECORD_UBYTE 255 I_1 0 255 /end CHARACTERISTIC
/begin CHARACTERISTIC FaultBSW_COM_TimoutRxEMSFailMod "FaultBSW_COM_TimoutRxEMSFailMod" VALUE 0x0006 DATA_RECORD_UBYTE 255 I_1 0 255 /end CHARACTERISTIC
/begin CHARACTERISTIC FaultBSW_COM_TimoutRxEMSInc "FaultBSW_COM_TimoutRxEMSInc" VALUE 0x0006 DATA_RECORD_UBYTE 255 I_1 0 255 /end CHARACTERISTIC
/begin CHARACTERISTIC FaultBSW_COM_TimoutRxGCUDec "FaultBSW_COM_TimoutRxGCUDec" VALUE 0x0007 DATA_RECORD_UBYTE 255 I_1 0 255 /end CHARACTERISTIC
/begin CHARACTERISTIC FaultBSW_COM_TimoutRxGCUFailMod "FaultBSW_COM_TimoutRxGCUFailMod" VALUE 0x0007 DATA_RECORD_UBYTE 255 I_1 0 255 /end CHARACTERISTIC
/begin CHARACTERISTIC FaultBSW_COM_TimoutRxGCUInc "FaultBSW_COM_TimoutRxGCUInc" VALUE 0x0007 DATA_RECORD_UBYTE 255 I_1 0 255 /end CHARACTERISTIC
/begin CHARACTERISTIC FaultBSW_COM_TimoutRxIPCDec "FaultBSW_COM_TimoutRxIPCDec" VALUE 0x0008 DATA_RECORD_UBYTE 255 I_1 0 255 /end CHARACTERISTIC
/begin CHARACTERISTIC FaultBSW_COM_TimoutRxIPCFailMod "FaultBSW_COM_TimoutRxIPCFailMod" VALUE 0x0008 DATA_RECORD_UBYTE 255 I_1 0 255 /end CHARACTERISTIC
/begin CHARACTERISTIC FaultBSW_COM_TimoutRxIPCInc "FaultBSW_COM_TimoutRxIPCInc" VALUE 0x0008 DATA_RECORD_UBYTE 255 I_1 0 255 /end CHARACTERISTIC
/begin CHARACTERISTIC FaultBSW_COM_TimoutRxTBOXDec "FaultBSW_COM_TimoutRxTBOXDec" VALUE 0x0009 DATA_RECORD_UBYTE 255 I_1 0 255 /end CHARACTERISTIC
/begin CHARACTERISTIC FaultBSW_COM_TimoutRxTBOXFailMod "FaultBSW_COM_TimoutRxTBOXFailMod" VALUE 0x0009 DATA_RECORD_UBYTE 255 I_1 0 255 /end CHARACTERISTIC
/begin CHARACTERISTIC FaultBSW_COM_TimoutRxTBOXInc "FaultBSW_COM_TimoutRxTBOXInc" VALUE 0x0009 DATA_RECORD_UBYTE 255 I_1 0 255 /end CHARACTERISTIC
/begin CHARACTERISTIC FaultBSW_COM_TimoutRxVCUDec "FaultBSW_COM_TimoutRxVCUDec" VALUE 0x000A DATA_RECORD_UBYTE 255 I_1 0 255 /end CHARACTERISTIC
/begin CHARACTERISTIC FaultBSW_COM_TimoutRxVCUFailMod "FaultBSW_COM_TimoutRxVCUFailMod" VALUE 0x000A DATA_RECORD_UBYTE 255 I_1 0 255 /end CHARACTERISTIC
/begin CHARACTERISTIC FaultBSW_COM_TimoutRxVCUInc "FaultBSW_COM_TimoutRxVCUInc" VALUE 0x000A DATA_RECORD_UBYTE 255 I_1 0 255 /end CHARACTERISTIC
/begin CHARACTERISTIC FaultBSW_HW2_FPGA_OverVoltVBatDec "FaultBSW_HW2_FPGA_OverVoltVBatDec" VALUE 0x000B DATA_RECORD_UBYTE 255 I_1 0 255 /end CHARACTERISTIC
/begin CHARACTERISTIC FaultBSW_HW2_FPGA_OverVoltVBatFailMod "FaultBSW_HW2_FPGA_OverVoltVBatFailMod" VALUE 0x000B DATA_RECORD_UBYTE 255 I_1 0 255 /end CHARACTERISTIC
/begin CHARACTERISTIC FaultBSW_HW2_FPGA_OverVoltVBatInc "FaultBSW_HW2_FPGA_OverVoltVBatInc" VALUE 0x000B DATA_RECORD_UBYTE 255 I_1 0 255 /end CHARACTERISTIC
/begin CHARACTERISTIC FaultBSW_HW2_SafeTlib_PreRunDec "FaultBSW_HW2_SafeTlib_PreRunDec" VALUE 0x000C DATA_RECORD_UBYTE 255 I_1 0 255 /end CHARACTERISTIC
/begin CHARACTERISTIC FaultBSW_HW2_SafeTlib_PreRunFailMod "FaultBSW_HW2_SafeTlib_PreRunFailMod" VALUE 0x000C DATA_RECORD_UBYTE 255 I_1 0 255 /end CHARACTERISTIC
/begin CHARACTERISTIC FaultBSW_HW2_SafeTlib_PreRunInc "FaultBSW_HW2_SafeTlib_PreRunInc" VALUE 0x000C DATA_RECORD_UBYTE 255 I_1 0 255 /end CHARACTERISTIC
/begin CHARACTERISTIC FaultBSW_HW_EasAckFailDec "FaultBSW_HW_EasAckFailDec" VALUE 0x000D DATA_RECORD_UBYTE 255 I_1 0 255 /end CHARACTERISTIC
/begin CHARACTERISTIC FaultBSW_HW_EasAckFailFailMod "FaultBSW_HW_EasAckFailFailMod" VALUE 0x000D DATA_RECORD_UBYTE 255 I_1 0 255 /end CHARACTERISTIC
/begin CHARACTERISTIC FaultBSW_HW_EasAckFailInc "FaultBSW_HW_EasAckFailInc" VALUE 0x000D DATA_RECORD_UBYTE 255 I_1 0 255 /end CHARACTERISTIC
/begin CHARACTERISTIC FaultBSW_HW_FPGA_IGBT_HDec "FaultBSW_HW_FPGA_IGBT_HDec" VALUE 0x000E DATA_RECORD_UBYTE 255 I_1 0 255 /end CHARACTERISTIC
/begin CHARACTERISTIC FaultBSW_HW_FPGA_IGBT_HFailMod "FaultBSW_HW_FPGA_IGBT_HFailMod" VALUE 0x000E DATA_RECORD_UBYTE 255 I_1 0 255 /end CHARACTERISTIC
/begin CHARACTERISTIC FaultBSW_HW_FPGA_IGBT_HInc "FaultBSW_HW_FPGA_IGBT_HInc" VALUE 0x000E DATA_RECORD_UBYTE 255 I_1 0 255 /end CHARACTERISTIC
/begin CHARACTERISTIC FaultBSW_HW_FPGA_IGBT_LDec "FaultBSW_HW_FPGA_IGBT_LDec" VALUE 0x000F DATA_RECORD_UBYTE 255 I_1 0 255 /end CHARACTERISTIC
/begin CHARACTERISTIC FaultBSW_HW_FPGA_IGBT_LFailMod "FaultBSW_HW_FPGA_IGBT_LFailMod" VALUE 0x000F DATA_RECORD_UBYTE 255 I_1 0 255 /end CHARACTERISTIC
/begin CHARACTERISTIC FaultBSW_HW_FPGA_IGBT_LInc "FaultBSW_HW_FPGA_IGBT_LInc" VALUE 0x000F DATA_RECORD_UBYTE 255 I_1 0 255 /end CHARACTERISTIC
/begin CHARACTERISTIC FaultBSW_HW_FPGA_OverUnderCurUIDec "FaultBSW_HW_FPGA_OverUnderCurUIDec" VALUE 0x0010 DATA_RECORD_UBYTE 255 I_1 0 255 /end CHARACTERISTIC
/begin CHARACTERISTIC FaultBSW_HW_FPGA_OverUnderCurUIFailMod "FaultBSW_HW_FPGA_OverUnderCurUIFailMod" VALUE 0x0010 DATA_RECORD_UBYTE 255 I_1 0 255 /end CHARACTERISTIC
/begin CHARACTERISTIC FaultBSW_HW_FPGA_OverUnderCurUIInc "FaultBSW_HW_FPGA_OverUnderCurUIInc" VALUE 0x0010 DATA_RECORD_UBYTE 255 I_1 0 255 /end CHARACTERISTIC
/begin CHARACTERISTIC FaultBSW_HW_FPGA_OverUnderCurVIDec "FaultBSW_HW_FPGA_OverUnderCurVIDec" VALUE 0x0011 DATA_RECORD_UBYTE 255 I_1 0 255 /end CHARACTERISTIC
/begin CHARACTERISTIC FaultBSW_HW_FPGA_OverUnderCurVIFailMod "FaultBSW_HW_FPGA_OverUnderCurVIFailMod" VALUE 0x0011 DATA_RECORD_UBYTE 255 I_1 0 255 /end CHARACTERISTIC
/begin CHARACTERISTIC FaultBSW_HW_FPGA_OverUnderCurVIInc "FaultBSW_HW_FPGA_OverUnderCurVIInc" VALUE 0x0011 DATA_RECORD_UBYTE 255 I_1 0 255 /end CHARACTERISTIC
/begin CHARACTERISTIC FaultBSW_HW_FPGA_OverUnderCurWIDec "FaultBSW_HW_FPGA_OverUnderCurWIDec" VALUE 0x0012 DATA_RECORD_UBYTE 255 I_1 0 255 /end CHARACTERISTIC
/begin CHARACTERISTIC FaultBSW_HW_FPGA_OverUnderCurWIFailMod "FaultBSW_HW_FPGA_OverUnderCurWIFailMod" VALUE 0x0012 DATA_RECORD_UBYTE 255 I_1 0 255 /end CHARACTERISTIC
/begin CHARACTERISTIC FaultBSW_HW_FPGA_OverUnderCurWIInc "FaultBSW_HW_FPGA_OverUnderCurWIInc" VALUE 0x0012 DATA_RECORD_UBYTE 255 I_1 0 255 /end CHARACTERISTIC
/begin CHARACTERISTIC FaultBSW_HW_OCDataNotRationalDec "FaultBSW_HW_OCDataNotRationalDec" VALUE 0x0013 DATA_RECORD_UBYTE 255 I_1 0 255 /end CHARACTERISTIC
/begin CHARACTERISTIC FaultBSW_HW_OCDataNotRationalFailMod "FaultBSW_HW_OCDataNotRationalFailMod" VALUE 0x0013 DATA_RECORD_UBYTE 255 I_1 0 255 /end CHARACTERISTIC
/begin CHARACTERISTIC FaultBSW_HW_OCDataNotRationalInc "FaultBSW_HW_OCDataNotRationalInc" VALUE 0x0013 DATA_RECORD_UBYTE 255 I_1 0 255 /end CHARACTERISTIC
/begin CHARACTERISTIC FaultBSW_SYS_RstHotDec "FaultBSW_SYS_RstHotDec" VALUE 0x0014 DATA_RECORD_UBYTE 255 I_1 0 255 /end CHARACTERISTIC
/begin CHARACTERISTIC FaultBSW_SYS_RstHotFailMod "FaultBSW_SYS_RstHotFailMod" VALUE 0x0014 DATA_RECORD_UBYTE 255 I_1 0 255 /end CHARACTERISTIC
/begin CHARACTERISTIC FaultBSW_SYS_RstHotInc "FaultBSW_SYS_RstHotInc" VALUE 0x0014 DATA_RECORD_UBYTE 255 I_1 0 255 /end CHARACTERISTIC
/begin CHARACTERISTIC FaultBSW_SYS_StackOverflowDec "FaultBSW_SYS_StackOverflowDec" VALUE 0x0015 DATA_RECORD_UBYTE 255 I_1 0 255 /end CHARACTERISTIC
/begin CHARACTERISTIC FaultBSW_SYS_StackOverflowFailMod "FaultBSW_SYS_StackOverflowFailMod" VALUE 0x0015 DATA_RECORD_UBYTE 255 I_1 0 255 /end CHARACTERISTIC
/begin CHARACTERISTIC FaultBSW_SYS_StackOverflowInc "FaultBSW_SYS_StackOverflowInc" VALUE 0x0015 DATA_RECORD_UBYTE 255 I_1 0 255 /end CHARACTERISTIC
/begin CHARACTERISTIC FaultBSW_VSI_TimeoutTCalcDec "FaultBSW_VSI_TimeoutTCalcDec" VALUE 0x0016 DATA_RECORD_UBYTE 255 I_1 0 255 /end CHARACTERISTIC
/begin CHARACTERISTIC FaultBSW_VSI_TimeoutTCalcFailMod "FaultBSW_VSI_TimeoutTCalcFailMod" VALUE 0x0016 DATA_RECORD_UBYTE 255 I_1 0 255 /end CHARACTERISTIC
/begin CHARACTERISTIC FaultBSW_VSI_TimeoutTCalcInc "FaultBSW_VSI_TimeoutTCalcInc" VALUE 0x0016 DATA_RECORD_UBYTE 255 I_1 0 255 /end CHARACTERISTIC
/begin CHARACTERISTIC FaultFSEVBHV_OverVoltageDec "FaultFSEVBHV_OverVoltageDec" VALUE 0x0017 DATA_RECORD_UBYTE 255 I_1 0 255 /end CHARACTERISTIC
/begin CHARACTERISTIC FaultFSEVBHV_OverVoltageFailMod "FaultFSEVBHV_OverVoltageFailMod" VALUE 0x0017 DATA_RECORD_UBYTE 255 I_1 0 255 /end CHARACTERISTIC
/begin CHARACTERISTIC FaultFSEVBHV_OverVoltageInc "FaultFSEVBHV_OverVoltageInc" VALUE 0x0017 DATA_RECORD_UBYTE 255 I_1 0 255 /end CHARACTERISTIC
/begin CHARACTERISTIC FaultFSEVBHV_SampleVolOutRngHDec "FaultFSEVBHV_SampleVolOutRngHDec" VALUE 0x0018 DATA_RECORD_UBYTE 255 I_1 0 255 /end CHARACTERISTIC
/begin CHARACTERISTIC FaultFSEVBHV_SampleVolOutRngHFailMod "FaultFSEVBHV_SampleVolOutRngHFailMod" VALUE 0x0018 DATA_RECORD_UBYTE 255 I_1 0 255 /end CHARACTERISTIC
/begin CHARACTERISTIC FaultFSEVBHV_SampleVolOutRngHInc "FaultFSEVBHV_SampleVolOutRngHInc" VALUE 0x0018 DATA_RECORD_UBYTE 255 I_1 0 255 /end CHARACTERISTIC
/begin CHARACTERISTIC FaultFSEVBHV_SampleVolOutRngLDec "FaultFSEVBHV_SampleVolOutRngLDec" VALUE 0x0019 DATA_RECORD_UBYTE 255 I_1 0 255 /end CHARACTERISTIC
/begin CHARACTERISTIC FaultFSEVBHV_SampleVolOutRngLFailMod "FaultFSEVBHV_SampleVolOutRngLFailMod" VALUE 0x0019 DATA_RECORD_UBYTE 255 I_1 0 255 /end CHARACTERISTIC
/begin CHARACTERISTIC FaultFSEVBHV_SampleVolOutRngLInc "FaultFSEVBHV_SampleVolOutRngLInc" VALUE 0x0019 DATA_RECORD_UBYTE 255 I_1 0 255 /end CHARACTERISTIC
/begin CHARACTERISTIC FaultFSEVBHV_UnderVoltageDec "FaultFSEVBHV_UnderVoltageDec" VALUE 0x001A DATA_RECORD_UBYTE 255 I_1 0 255 /end CHARACTERISTIC
/begin CHARACTERISTIC FaultFSEVBHV_UnderVoltageFailMod "FaultFSEVBHV_UnderVoltageFailMod" VALUE 0x001A DATA_RECORD_UBYTE 255 I_1 0 255 /end CHARACTERISTIC
/begin CHARACTERISTIC FaultFSEVBHV_UnderVoltageInc "FaultFSEVBHV_UnderVoltageInc" VALUE 0x001A DATA_RECORD_UBYTE 255 I_1 0 255 /end CHARACTERISTIC
/begin CHARACTERISTIC FaultFSEVBHV_UnderVoltageWarnDec "FaultFSEVBHV_UnderVoltageWarnDec" VALUE 0x001E DATA_RECORD_UBYTE 255 I_1 0 255 /end CHARACTERISTIC
/begin CHARACTERISTIC FaultFSEVBHV_UnderVoltageWarnFailMod "FaultFSEVBHV_UnderVoltageWarnFailMod" VALUE 0x001E DATA_RECORD_UBYTE 255 I_1 0 255 /end CHARACTERISTIC
/begin CHARACTERISTIC FaultFSEVBHV_UnderVoltageWarnInc "FaultFSEVBHV_UnderVoltageWarnInc" VALUE 0x001E DATA_RECORD_UBYTE 255 I_1 0 255 /end CHARACTERISTIC
/begin CHARACTERISTIC FaultFSEVBHV_VolNotRationalDec "FaultFSEVBHV_VolNotRationalDec" VALUE 0x001B DATA_RECORD_UBYTE 255 I_1 0 255 /end CHARACTERISTIC
/begin CHARACTERISTIC FaultFSEVBHV_VolNotRationalFailMod "FaultFSEVBHV_VolNotRationalFailMod" VALUE 0x001B DATA_RECORD_UBYTE 255 I_1 0 255 /end CHARACTERISTIC
/begin CHARACTERISTIC FaultFSEVBHV_VolNotRationalInc "FaultFSEVBHV_VolNotRationalInc" VALUE 0x001B DATA_RECORD_UBYTE 255 I_1 0 255 /end CHARACTERISTIC
/begin CHARACTERISTIC FaultFSEVBHV_VoltageGndDec "FaultFSEVBHV_VoltageGndDec" VALUE 0x001C DATA_RECORD_UBYTE 255 I_1 0 255 /end CHARACTERISTIC
/begin CHARACTERISTIC FaultFSEVBHV_VoltageGndFailMod "FaultFSEVBHV_VoltageGndFailMod" VALUE 0x001C DATA_RECORD_UBYTE 255 I_1 0 255 /end CHARACTERISTIC
/begin CHARACTERISTIC FaultFSEVBHV_VoltageGndInc "FaultFSEVBHV_VoltageGndInc" VALUE 0x001C DATA_RECORD_UBYTE 255 I_1 0 255 /end CHARACTERISTIC
/begin CHARACTERISTIC FaultFSEVBHV_VoltageVccDec "FaultFSEVBHV_VoltageVccDec" VALUE 0x001D DATA_RECORD_UBYTE 255 I_1 0 255 /end CHARACTERISTIC
/begin CHARACTERISTIC FaultFSEVBHV_VoltageVccFailMod "FaultFSEVBHV_VoltageVccFailMod" VALUE 0x001D DATA_RECORD_UBYTE 255 I_1 0 255 /end CHARACTERISTIC
/begin CHARACTERISTIC FaultFSEVBHV_VoltageVccInc "FaultFSEVBHV_VoltageVccInc" VALUE 0x001D DATA_RECORD_UBYTE 255 I_1 0 255 /end CHARACTERISTIC
/begin CHARACTERISTIC FaultFSEVBLV_OverVoltageDec "FaultFSEVBLV_OverVoltageDec" VALUE 0x001F DATA_RECORD_UBYTE 255 I_1 0 255 /end CHARACTERISTIC
/begin CHARACTERISTIC FaultFSEVBLV_OverVoltageFailMod "FaultFSEVBLV_OverVoltageFailMod" VALUE 0x001F DATA_RECORD_UBYTE 255 I_1 0 255 /end CHARACTERISTIC
/begin CHARACTERISTIC FaultFSEVBLV_OverVoltageInc "FaultFSEVBLV_OverVoltageInc" VALUE 0x001F DATA_RECORD_UBYTE 255 I_1 0 255 /end CHARACTERISTIC
/begin CHARACTERISTIC FaultFSEVBLV_P5VRefADCFltDec "FaultFSEVBLV_P5VRefADCFltDec" VALUE 0x0020 DATA_RECORD_UBYTE 255 I_1 0 255 /end CHARACTERISTIC
/begin CHARACTERISTIC FaultFSEVBLV_P5VRefADCFltFailMod "FaultFSEVBLV_P5VRefADCFltFailMod" VALUE 0x0020 DATA_RECORD_UBYTE 255 I_1 0 255 /end CHARACTERISTIC
/begin CHARACTERISTIC FaultFSEVBLV_P5VRefADCFltInc "FaultFSEVBLV_P5VRefADCFltInc" VALUE 0x0020 DATA_RECORD_UBYTE 255 I_1 0 255 /end CHARACTERISTIC
/begin CHARACTERISTIC FaultFSEVBLV_UnderVoltageDec "FaultFSEVBLV_UnderVoltageDec" VALUE 0x0021 DATA_RECORD_UBYTE 255 I_1 0 255 /end CHARACTERISTIC
/begin CHARACTERISTIC FaultFSEVBLV_UnderVoltageFailMod "FaultFSEVBLV_UnderVoltageFailMod" VALUE 0x0021 DATA_RECORD_UBYTE 255 I_1 0 255 /end CHARACTERISTIC
/begin CHARACTERISTIC FaultFSEVBLV_UnderVoltageInc "FaultFSEVBLV_UnderVoltageInc" VALUE 0x0021 DATA_RECORD_UBYTE 255 I_1 0 255 /end CHARACTERISTIC
/begin CHARACTERISTIC FaultFSEVBLV_UnderVoltageWarnDec "FaultFSEVBLV_UnderVoltageWarnDec" VALUE 0x0024 DATA_RECORD_UBYTE 255 I_1 0 255 /end CHARACTERISTIC
/begin CHARACTERISTIC FaultFSEVBLV_UnderVoltageWarnFailMod "FaultFSEVBLV_UnderVoltageWarnFailMod" VALUE 0x0024 DATA_RECORD_UBYTE 255 I_1 0 255 /end CHARACTERISTIC
/begin CHARACTERISTIC FaultFSEVBLV_UnderVoltageWarnInc "FaultFSEVBLV_UnderVoltageWarnInc" VALUE 0x0024 DATA_RECORD_UBYTE 255 I_1 0 255 /end CHARACTERISTIC
/begin CHARACTERISTIC FaultFSEVBLV_VoltageGndDec "FaultFSEVBLV_VoltageGndDec" VALUE 0x0022 DATA_RECORD_UBYTE 255 I_1 0 255 /end CHARACTERISTIC
/begin CHARACTERISTIC FaultFSEVBLV_VoltageGndFailMod "FaultFSEVBLV_VoltageGndFailMod" VALUE 0x0022 DATA_RECORD_UBYTE 255 I_1 0 255 /end CHARACTERISTIC
/begin CHARACTERISTIC FaultFSEVBLV_VoltageGndInc "FaultFSEVBLV_VoltageGndInc" VALUE 0x0022 DATA_RECORD_UBYTE 255 I_1 0 255 /end CHARACTERISTIC
/begin CHARACTERISTIC FaultFSEVBLV_VoltageVccDec "FaultFSEVBLV_VoltageVccDec" VALUE 0x0023 DATA_RECORD_UBYTE 255 I_1 0 255 /end CHARACTERISTIC
/begin CHARACTERISTIC FaultFSEVBLV_VoltageVccFailMod "FaultFSEVBLV_VoltageVccFailMod" VALUE 0x0023 DATA_RECORD_UBYTE 255 I_1 0 255 /end CHARACTERISTIC
/begin CHARACTERISTIC FaultFSEVBLV_VoltageVccInc "FaultFSEVBLV_VoltageVccInc" VALUE 0x0023 DATA_RECORD_UBYTE 255 I_1 0 255 /end CHARACTERISTIC
/begin CHARACTERISTIC FaultFSEVETA_DrvTempRationDec "FaultFSEVETA_DrvTempRationDec" VALUE 0x0025 DATA_RECORD_UBYTE 255 I_1 0 255 /end CHARACTERISTIC
/begin CHARACTERISTIC FaultFSEVETA_DrvTempRationFailMod "FaultFSEVETA_DrvTempRationFailMod" VALUE 0x0025 DATA_RECORD_UBYTE 255 I_1 0 255 /end CHARACTERISTIC
/begin CHARACTERISTIC FaultFSEVETA_DrvTempRationInc "FaultFSEVETA_DrvTempRationInc" VALUE 0x0025 DATA_RECORD_UBYTE 255 I_1 0 255 /end CHARACTERISTIC
/begin CHARACTERISTIC FaultFSEVETA_IgbtTempRationalDec "FaultFSEVETA_IgbtTempRationalDec" VALUE 0x0026 DATA_RECORD_UBYTE 255 I_1 0 255 /end CHARACTERISTIC
/begin CHARACTERISTIC FaultFSEVETA_IgbtTempRationalFailMod "FaultFSEVETA_IgbtTempRationalFailMod" VALUE 0x0026 DATA_RECORD_UBYTE 255 I_1 0 255 /end CHARACTERISTIC
/begin CHARACTERISTIC FaultFSEVETA_IgbtTempRationalInc "FaultFSEVETA_IgbtTempRationalInc" VALUE 0x0026 DATA_RECORD_UBYTE 255 I_1 0 255 /end CHARACTERISTIC
/begin CHARACTERISTIC FaultFSEVETA_OverTempDrvLeftDec "FaultFSEVETA_OverTempDrvLeftDec" VALUE 0x0029 DATA_RECORD_UBYTE 255 I_1 0 255 /end CHARACTERISTIC
/begin CHARACTERISTIC FaultFSEVETA_OverTempDrvLeftFailMod "FaultFSEVETA_OverTempDrvLeftFailMod" VALUE 0x0029 DATA_RECORD_UBYTE 255 I_1 0 255 /end CHARACTERISTIC
/begin CHARACTERISTIC FaultFSEVETA_OverTempDrvLeftInc "FaultFSEVETA_OverTempDrvLeftInc" VALUE 0x0029 DATA_RECORD_UBYTE 255 I_1 0 255 /end CHARACTERISTIC
/begin CHARACTERISTIC FaultFSEVETA_OverTempIgbtLeftDec "FaultFSEVETA_OverTempIgbtLeftDec" VALUE 0x002A DATA_RECORD_UBYTE 255 I_1 0 255 /end CHARACTERISTIC
/begin CHARACTERISTIC FaultFSEVETA_OverTempIgbtLeftFailMod "FaultFSEVETA_OverTempIgbtLeftFailMod" VALUE 0x002A DATA_RECORD_UBYTE 255 I_1 0 255 /end CHARACTERISTIC
/begin CHARACTERISTIC FaultFSEVETA_OverTempIgbtLeftInc "FaultFSEVETA_OverTempIgbtLeftInc" VALUE 0x002A DATA_RECORD_UBYTE 255 I_1 0 255 /end CHARACTERISTIC
/begin CHARACTERISTIC FaultFSEVETA_OverTempNTC1CmdBoardDec "FaultFSEVETA_OverTempNTC1CmdBoardDec" VALUE 0x002B DATA_RECORD_UBYTE 255 I_1 0 255 /end CHARACTERISTIC
/begin CHARACTERISTIC FaultFSEVETA_OverTempNTC1CmdBoardFailMod "FaultFSEVETA_OverTempNTC1CmdBoardFailMod" VALUE 0x002B DATA_RECORD_UBYTE 255 I_1 0 255 /end CHARACTERISTIC
/begin CHARACTERISTIC FaultFSEVETA_OverTempNTC1CmdBoardInc "FaultFSEVETA_OverTempNTC1CmdBoardInc" VALUE 0x002B DATA_RECORD_UBYTE 255 I_1 0 255 /end CHARACTERISTIC
/begin CHARACTERISTIC FaultFSEVETA_SampleIgbtTempOutRngHDec "FaultFSEVETA_SampleIgbtTempOutRngHDec" VALUE 0x0027 DATA_RECORD_UBYTE 255 I_1 0 255 /end CHARACTERISTIC
/begin CHARACTERISTIC FaultFSEVETA_SampleIgbtTempOutRngHFailMod "FaultFSEVETA_SampleIgbtTempOutRngHFailMod" VALUE 0x0027 DATA_RECORD_UBYTE 255 I_1 0 255 /end CHARACTERISTIC
/begin CHARACTERISTIC FaultFSEVETA_SampleIgbtTempOutRngHInc "FaultFSEVETA_SampleIgbtTempOutRngHInc" VALUE 0x0027 DATA_RECORD_UBYTE 255 I_1 0 255 /end CHARACTERISTIC
/begin CHARACTERISTIC FaultFSEVETA_SampleIgbtTempOutRngLDec "FaultFSEVETA_SampleIgbtTempOutRngLDec" VALUE 0x0028 DATA_RECORD_UBYTE 255 I_1 0 255 /end CHARACTERISTIC
/begin CHARACTERISTIC FaultFSEVETA_SampleIgbtTempOutRngLFailMod "FaultFSEVETA_SampleIgbtTempOutRngLFailMod" VALUE 0x0028 DATA_RECORD_UBYTE 255 I_1 0 255 /end CHARACTERISTIC
/begin CHARACTERISTIC FaultFSEVETA_SampleIgbtTempOutRngLInc "FaultFSEVETA_SampleIgbtTempOutRngLInc" VALUE 0x0028 DATA_RECORD_UBYTE 255 I_1 0 255 /end CHARACTERISTIC
/begin CHARACTERISTIC FaultFSEVETA_TempDrvBoardLeftGndDec "FaultFSEVETA_TempDrvBoardLeftGndDec" VALUE 0x002C DATA_RECORD_UBYTE 255 I_1 0 255 /end CHARACTERISTIC
/begin CHARACTERISTIC FaultFSEVETA_TempDrvBoardLeftGndFailMod "FaultFSEVETA_TempDrvBoardLeftGndFailMod" VALUE 0x002C DATA_RECORD_UBYTE 255 I_1 0 255 /end CHARACTERISTIC
/begin CHARACTERISTIC FaultFSEVETA_TempDrvBoardLeftGndInc "FaultFSEVETA_TempDrvBoardLeftGndInc" VALUE 0x002C DATA_RECORD_UBYTE 255 I_1 0 255 /end CHARACTERISTIC
/begin CHARACTERISTIC FaultFSEVETA_TempDrvBoardLeftVccDec "FaultFSEVETA_TempDrvBoardLeftVccDec" VALUE 0x002D DATA_RECORD_UBYTE 255 I_1 0 255 /end CHARACTERISTIC
/begin CHARACTERISTIC FaultFSEVETA_TempDrvBoardLeftVccFailMod "FaultFSEVETA_TempDrvBoardLeftVccFailMod" VALUE 0x002D DATA_RECORD_UBYTE 255 I_1 0 255 /end CHARACTERISTIC
/begin CHARACTERISTIC FaultFSEVETA_TempDrvBoardLeftVccInc "FaultFSEVETA_TempDrvBoardLeftVccInc" VALUE 0x002D DATA_RECORD_UBYTE 255 I_1 0 255 /end CHARACTERISTIC
/begin CHARACTERISTIC FaultFSEVETA_TempIgbtLeftGndDec "FaultFSEVETA_TempIgbtLeftGndDec" VALUE 0x002E DATA_RECORD_UBYTE 255 I_1 0 255 /end CHARACTERISTIC
/begin CHARACTERISTIC FaultFSEVETA_TempIgbtLeftGndFailMod "FaultFSEVETA_TempIgbtLeftGndFailMod" VALUE 0x002E DATA_RECORD_UBYTE 255 I_1 0 255 /end CHARACTERISTIC
/begin CHARACTERISTIC FaultFSEVETA_TempIgbtLeftGndInc "FaultFSEVETA_TempIgbtLeftGndInc" VALUE 0x002E DATA_RECORD_UBYTE 255 I_1 0 255 /end CHARACTERISTIC
/begin CHARACTERISTIC FaultFSEVETA_TempIgbtLeftVccDec "FaultFSEVETA_TempIgbtLeftVccDec" VALUE 0x002F DATA_RECORD_UBYTE 255 I_1 0 255 /end CHARACTERISTIC
/begin CHARACTERISTIC FaultFSEVETA_TempIgbtLeftVccFailMod "FaultFSEVETA_TempIgbtLeftVccFailMod" VALUE 0x002F DATA_RECORD_UBYTE 255 I_1 0 255 /end CHARACTERISTIC
/begin CHARACTERISTIC FaultFSEVETA_TempIgbtLeftVccInc "FaultFSEVETA_TempIgbtLeftVccInc" VALUE 0x002F DATA_RECORD_UBYTE 255 I_1 0 255 /end CHARACTERISTIC
/begin CHARACTERISTIC FaultFSEVETA_TempNTC1CmdBoardGndDec "FaultFSEVETA_TempNTC1CmdBoardGndDec" VALUE 0x0030 DATA_RECORD_UBYTE 255 I_1 0 255 /end CHARACTERISTIC
/begin CHARACTERISTIC FaultFSEVETA_TempNTC1CmdBoardGndFailMod "FaultFSEVETA_TempNTC1CmdBoardGndFailMod" VALUE 0x0030 DATA_RECORD_UBYTE 255 I_1 0 255 /end CHARACTERISTIC
/begin CHARACTERISTIC FaultFSEVETA_TempNTC1CmdBoardGndInc "FaultFSEVETA_TempNTC1CmdBoardGndInc" VALUE 0x0030 DATA_RECORD_UBYTE 255 I_1 0 255 /end CHARACTERISTIC
/begin CHARACTERISTIC FaultFSEVETA_TempNTC1CmdBoardVccDec "FaultFSEVETA_TempNTC1CmdBoardVccDec" VALUE 0x0031 DATA_RECORD_UBYTE 255 I_1 0 255 /end CHARACTERISTIC
/begin CHARACTERISTIC FaultFSEVETA_TempNTC1CmdBoardVccFailMod "FaultFSEVETA_TempNTC1CmdBoardVccFailMod" VALUE 0x0031 DATA_RECORD_UBYTE 255 I_1 0 255 /end CHARACTERISTIC
/begin CHARACTERISTIC FaultFSEVETA_TempNTC1CmdBoardVccInc "FaultFSEVETA_TempNTC1CmdBoardVccInc" VALUE 0x0031 DATA_RECORD_UBYTE 255 I_1 0 255 /end CHARACTERISTIC
/begin CHARACTERISTIC FaultFSEVETA_UnderTempDrvLeftDec "FaultFSEVETA_UnderTempDrvLeftDec" VALUE 0x0032 DATA_RECORD_UBYTE 255 I_1 0 255 /end CHARACTERISTIC
/begin CHARACTERISTIC FaultFSEVETA_UnderTempDrvLeftFailMod "FaultFSEVETA_UnderTempDrvLeftFailMod" VALUE 0x0032 DATA_RECORD_UBYTE 255 I_1 0 255 /end CHARACTERISTIC
/begin CHARACTERISTIC FaultFSEVETA_UnderTempDrvLeftInc "FaultFSEVETA_UnderTempDrvLeftInc" VALUE 0x0032 DATA_RECORD_UBYTE 255 I_1 0 255 /end CHARACTERISTIC
/begin CHARACTERISTIC FaultFSEVETA_UnderTempIgbtLeftDec "FaultFSEVETA_UnderTempIgbtLeftDec" VALUE 0x0033 DATA_RECORD_UBYTE 255 I_1 0 255 /end CHARACTERISTIC
/begin CHARACTERISTIC FaultFSEVETA_UnderTempIgbtLeftFailMod "FaultFSEVETA_UnderTempIgbtLeftFailMod" VALUE 0x0033 DATA_RECORD_UBYTE 255 I_1 0 255 /end CHARACTERISTIC
/begin CHARACTERISTIC FaultFSEVETA_UnderTempIgbtLeftInc "FaultFSEVETA_UnderTempIgbtLeftInc" VALUE 0x0033 DATA_RECORD_UBYTE 255 I_1 0 255 /end CHARACTERISTIC
/begin CHARACTERISTIC FaultFSEVETA_UnderTempNTC1CmdBoardDec "FaultFSEVETA_UnderTempNTC1CmdBoardDec" VALUE 0x0034 DATA_RECORD_UBYTE 255 I_1 0 255 /end CHARACTERISTIC
/begin CHARACTERISTIC FaultFSEVETA_UnderTempNTC1CmdBoardFailMod "FaultFSEVETA_UnderTempNTC1CmdBoardFailMod" VALUE 0x0034 DATA_RECORD_UBYTE 255 I_1 0 255 /end CHARACTERISTIC
/begin CHARACTERISTIC FaultFSEVETA_UnderTempNTC1CmdBoardInc "FaultFSEVETA_UnderTempNTC1CmdBoardInc" VALUE 0x0034 DATA_RECORD_UBYTE 255 I_1 0 255 /end CHARACTERISTIC
/begin CHARACTERISTIC FaultFSMTMTA_OverTempWdgHead1Dec "FaultFSMTMTA_OverTempWdgHead1Dec" VALUE 0x0035 DATA_RECORD_UBYTE 255 I_1 0 255 /end CHARACTERISTIC
/begin CHARACTERISTIC FaultFSMTMTA_OverTempWdgHead1FailMod "FaultFSMTMTA_OverTempWdgHead1FailMod" VALUE 0x0035 DATA_RECORD_UBYTE 255 I_1 0 255 /end CHARACTERISTIC
/begin CHARACTERISTIC FaultFSMTMTA_OverTempWdgHead1Inc "FaultFSMTMTA_OverTempWdgHead1Inc" VALUE 0x0035 DATA_RECORD_UBYTE 255 I_1 0 255 /end CHARACTERISTIC
/begin CHARACTERISTIC FaultFSMTMTA_TempWindHead1OutRngHDec "FaultFSMTMTA_TempWindHead1OutRngHDec" VALUE 0x0036 DATA_RECORD_UBYTE 255 I_1 0 255 /end CHARACTERISTIC
/begin CHARACTERISTIC FaultFSMTMTA_TempWindHead1OutRngHFailMod "FaultFSMTMTA_TempWindHead1OutRngHFailMod" VALUE 0x0036 DATA_RECORD_UBYTE 255 I_1 0 255 /end CHARACTERISTIC
/begin CHARACTERISTIC FaultFSMTMTA_TempWindHead1OutRngHInc "FaultFSMTMTA_TempWindHead1OutRngHInc" VALUE 0x0036 DATA_RECORD_UBYTE 255 I_1 0 255 /end CHARACTERISTIC
/begin CHARACTERISTIC FaultFSMTMTA_TempWindHead1OutRngLDec "FaultFSMTMTA_TempWindHead1OutRngLDec" VALUE 0x0037 DATA_RECORD_UBYTE 255 I_1 0 255 /end CHARACTERISTIC
/begin CHARACTERISTIC FaultFSMTMTA_TempWindHead1OutRngLFailMod "FaultFSMTMTA_TempWindHead1OutRngLFailMod" VALUE 0x0037 DATA_RECORD_UBYTE 255 I_1 0 255 /end CHARACTERISTIC
/begin CHARACTERISTIC FaultFSMTMTA_TempWindHead1OutRngLInc "FaultFSMTMTA_TempWindHead1OutRngLInc" VALUE 0x0037 DATA_RECORD_UBYTE 255 I_1 0 255 /end CHARACTERISTIC
/begin CHARACTERISTIC FaultFSMTMTA_TempWindingHead1GndDec "FaultFSMTMTA_TempWindingHead1GndDec" VALUE 0x0038 DATA_RECORD_UBYTE 255 I_1 0 255 /end CHARACTERISTIC
/begin CHARACTERISTIC FaultFSMTMTA_TempWindingHead1GndFailMod "FaultFSMTMTA_TempWindingHead1GndFailMod" VALUE 0x0038 DATA_RECORD_UBYTE 255 I_1 0 255 /end CHARACTERISTIC
/begin CHARACTERISTIC FaultFSMTMTA_TempWindingHead1GndInc "FaultFSMTMTA_TempWindingHead1GndInc" VALUE 0x0038 DATA_RECORD_UBYTE 255 I_1 0 255 /end CHARACTERISTIC
/begin CHARACTERISTIC FaultFSMTMTA_TempWindingHead1VccDec "FaultFSMTMTA_TempWindingHead1VccDec" VALUE 0x0039 DATA_RECORD_UBYTE 255 I_1 0 255 /end CHARACTERISTIC
/begin CHARACTERISTIC FaultFSMTMTA_TempWindingHead1VccFailMod "FaultFSMTMTA_TempWindingHead1VccFailMod" VALUE 0x0039 DATA_RECORD_UBYTE 255 I_1 0 255 /end CHARACTERISTIC
/begin CHARACTERISTIC FaultFSMTMTA_TempWindingHead1VccInc "FaultFSMTMTA_TempWindingHead1VccInc" VALUE 0x0039 DATA_RECORD_UBYTE 255 I_1 0 255 /end CHARACTERISTIC
/begin CHARACTERISTIC FaultFSMTMTA_UnderTempWdgHead1Dec "FaultFSMTMTA_UnderTempWdgHead1Dec" VALUE 0x003A DATA_RECORD_UBYTE 255 I_1 0 255 /end CHARACTERISTIC
/begin CHARACTERISTIC FaultFSMTMTA_UnderTempWdgHead1FailMod "FaultFSMTMTA_UnderTempWdgHead1FailMod" VALUE 0x003A DATA_RECORD_UBYTE 255 I_1 0 255 /end CHARACTERISTIC
/begin CHARACTERISTIC FaultFSMTMTA_UnderTempWdgHead1Inc "FaultFSMTMTA_UnderTempWdgHead1Inc" VALUE 0x003A DATA_RECORD_UBYTE 255 I_1 0 255 /end CHARACTERISTIC
/begin CHARACTERISTIC FaultFSMTRDG_ExcGenerationDec "FaultFSMTRDG_ExcGenerationDec" VALUE 0x003B DATA_RECORD_UBYTE 255 I_1 0 255 /end CHARACTERISTIC
/begin CHARACTERISTIC FaultFSMTRDG_ExcGenerationFailMod "FaultFSMTRDG_ExcGenerationFailMod" VALUE 0x003B DATA_RECORD_UBYTE 255 I_1 0 255 /end CHARACTERISTIC
/begin CHARACTERISTIC FaultFSMTRDG_ExcGenerationInc "FaultFSMTRDG_ExcGenerationInc" VALUE 0x003B DATA_RECORD_UBYTE 255 I_1 0 255 /end CHARACTERISTIC
/begin CHARACTERISTIC FaultFSMTRDG_ExcSignalGNDDec "FaultFSMTRDG_ExcSignalGNDDec" VALUE 0x003C DATA_RECORD_UBYTE 255 I_1 0 255 /end CHARACTERISTIC
/begin CHARACTERISTIC FaultFSMTRDG_ExcSignalGNDFailMod "FaultFSMTRDG_ExcSignalGNDFailMod" VALUE 0x003C DATA_RECORD_UBYTE 255 I_1 0 255 /end CHARACTERISTIC
/begin CHARACTERISTIC FaultFSMTRDG_ExcSignalGNDInc "FaultFSMTRDG_ExcSignalGNDInc" VALUE 0x003C DATA_RECORD_UBYTE 255 I_1 0 255 /end CHARACTERISTIC
/begin CHARACTERISTIC FaultFSMTRDG_ExcSignalVCCDec "FaultFSMTRDG_ExcSignalVCCDec" VALUE 0x003D DATA_RECORD_UBYTE 255 I_1 0 255 /end CHARACTERISTIC
/begin CHARACTERISTIC FaultFSMTRDG_ExcSignalVCCFailMod "FaultFSMTRDG_ExcSignalVCCFailMod" VALUE 0x003D DATA_RECORD_UBYTE 255 I_1 0 255 /end CHARACTERISTIC
/begin CHARACTERISTIC FaultFSMTRDG_ExcSignalVCCInc "FaultFSMTRDG_ExcSignalVCCInc" VALUE 0x003D DATA_RECORD_UBYTE 255 I_1 0 255 /end CHARACTERISTIC
/begin CHARACTERISTIC FaultFSMTRDG_SinCosHLGndDec "FaultFSMTRDG_SinCosHLGndDec" VALUE 0x003E DATA_RECORD_UBYTE 255 I_1 0 255 /end CHARACTERISTIC
/begin CHARACTERISTIC FaultFSMTRDG_SinCosHLGndFailMod "FaultFSMTRDG_SinCosHLGndFailMod" VALUE 0x003E DATA_RECORD_UBYTE 255 I_1 0 255 /end CHARACTERISTIC
/begin CHARACTERISTIC FaultFSMTRDG_SinCosHLGndInc "FaultFSMTRDG_SinCosHLGndInc" VALUE 0x003E DATA_RECORD_UBYTE 255 I_1 0 255 /end CHARACTERISTIC
/begin CHARACTERISTIC FaultFSMTRDG_SinCosHLOpenDec "FaultFSMTRDG_SinCosHLOpenDec" VALUE 0x003F DATA_RECORD_UBYTE 255 I_1 0 255 /end CHARACTERISTIC
/begin CHARACTERISTIC FaultFSMTRDG_SinCosHLOpenFailMod "FaultFSMTRDG_SinCosHLOpenFailMod" VALUE 0x003F DATA_RECORD_UBYTE 255 I_1 0 255 /end CHARACTERISTIC
/begin CHARACTERISTIC FaultFSMTRDG_SinCosHLOpenInc "FaultFSMTRDG_SinCosHLOpenInc" VALUE 0x003F DATA_RECORD_UBYTE 255 I_1 0 255 /end CHARACTERISTIC
/begin CHARACTERISTIC FaultFSMTRDG_SinCosHLVccDec "FaultFSMTRDG_SinCosHLVccDec" VALUE 0x0040 DATA_RECORD_UBYTE 255 I_1 0 255 /end CHARACTERISTIC
/begin CHARACTERISTIC FaultFSMTRDG_SinCosHLVccFailMod "FaultFSMTRDG_SinCosHLVccFailMod" VALUE 0x0040 DATA_RECORD_UBYTE 255 I_1 0 255 /end CHARACTERISTIC
/begin CHARACTERISTIC FaultFSMTRDG_SinCosHLVccInc "FaultFSMTRDG_SinCosHLVccInc" VALUE 0x0040 DATA_RECORD_UBYTE 255 I_1 0 255 /end CHARACTERISTIC
/begin CHARACTERISTIC FaultFSSMACS_AkdFailFlagDec "FaultFSSMACS_AkdFailFlagDec" VALUE 0x0041 DATA_RECORD_UBYTE 255 I_1 0 255 /end CHARACTERISTIC
/begin CHARACTERISTIC FaultFSSMACS_AkdFailFlagFailMod "FaultFSSMACS_AkdFailFlagFailMod" VALUE 0x0041 DATA_RECORD_UBYTE 255 I_1 0 255 /end CHARACTERISTIC
/begin CHARACTERISTIC FaultFSSMACS_AkdFailFlagInc "FaultFSSMACS_AkdFailFlagInc" VALUE 0x0041 DATA_RECORD_UBYTE 255 I_1 0 255 /end CHARACTERISTIC
/begin CHARACTERISTIC FaultFTASBDS_BattVoltDeratingActDec "FaultFTASBDS_BattVoltDeratingActDec" VALUE 0x0042 DATA_RECORD_UBYTE 255 I_1 0 255 /end CHARACTERISTIC
/begin CHARACTERISTIC FaultFTASBDS_BattVoltDeratingActFailMod "FaultFTASBDS_BattVoltDeratingActFailMod" VALUE 0x0042 DATA_RECORD_UBYTE 255 I_1 0 255 /end CHARACTERISTIC
/begin CHARACTERISTIC FaultFTASBDS_BattVoltDeratingActInc "FaultFTASBDS_BattVoltDeratingActInc" VALUE 0x0042 DATA_RECORD_UBYTE 255 I_1 0 255 /end CHARACTERISTIC
/begin CHARACTERISTIC FaultFTASETP_EstPmDeratingActDec "FaultFTASETP_EstPmDeratingActDec" VALUE 0x0043 DATA_RECORD_UBYTE 255 I_1 0 255 /end CHARACTERISTIC
/begin CHARACTERISTIC FaultFTASETP_EstPmDeratingActFailMod "FaultFTASETP_EstPmDeratingActFailMod" VALUE 0x0043 DATA_RECORD_UBYTE 255 I_1 0 255 /end CHARACTERISTIC
/begin CHARACTERISTIC FaultFTASETP_EstPmDeratingActInc "FaultFTASETP_EstPmDeratingActInc" VALUE 0x0043 DATA_RECORD_UBYTE 255 I_1 0 255 /end CHARACTERISTIC
/begin CHARACTERISTIC FaultFTASETP_PmDeratingActDec "FaultFTASETP_PmDeratingActDec" VALUE 0x0044 DATA_RECORD_UBYTE 255 I_1 0 255 /end CHARACTERISTIC
/begin CHARACTERISTIC FaultFTASETP_PmDeratingActFailMod "FaultFTASETP_PmDeratingActFailMod" VALUE 0x0044 DATA_RECORD_UBYTE 255 I_1 0 255 /end CHARACTERISTIC
/begin CHARACTERISTIC FaultFTASETP_PmDeratingActInc "FaultFTASETP_PmDeratingActInc" VALUE 0x0044 DATA_RECORD_UBYTE 255 I_1 0 255 /end CHARACTERISTIC
/begin CHARACTERISTIC FaultFTASMTP_Wndg1DeratingActDec "FaultFTASMTP_Wndg1DeratingActDec" VALUE 0x0045 DATA_RECORD_UBYTE 255 I_1 0 255 /end CHARACTERISTIC
/begin CHARACTERISTIC FaultFTASMTP_Wndg1DeratingActFailMod "FaultFTASMTP_Wndg1DeratingActFailMod" VALUE 0x0045 DATA_RECORD_UBYTE 255 I_1 0 255 /end CHARACTERISTIC
/begin CHARACTERISTIC FaultFTASMTP_Wndg1DeratingActInc "FaultFTASMTP_Wndg1DeratingActInc" VALUE 0x0045 DATA_RECORD_UBYTE 255 I_1 0 255 /end CHARACTERISTIC
/begin CHARACTERISTIC FaultFTASOSP_MotorSpdDeratingActDec "FaultFTASOSP_MotorSpdDeratingActDec" VALUE 0x0046 DATA_RECORD_UBYTE 255 I_1 0 255 /end CHARACTERISTIC
/begin CHARACTERISTIC FaultFTASOSP_MotorSpdDeratingActFailMod "FaultFTASOSP_MotorSpdDeratingActFailMod" VALUE 0x0046 DATA_RECORD_UBYTE 255 I_1 0 255 /end CHARACTERISTIC
/begin CHARACTERISTIC FaultFTASOSP_MotorSpdDeratingActInc "FaultFTASOSP_MotorSpdDeratingActInc" VALUE 0x0046 DATA_RECORD_UBYTE 255 I_1 0 255 /end CHARACTERISTIC
/begin CHARACTERISTIC FaultFTCMSCS_CtrlSatTimoutDec "FaultFTCMSCS_CtrlSatTimoutDec" VALUE 0x0047 DATA_RECORD_UBYTE 255 I_1 0 255 /end CHARACTERISTIC
/begin CHARACTERISTIC FaultFTCMSCS_CtrlSatTimoutFailMod "FaultFTCMSCS_CtrlSatTimoutFailMod" VALUE 0x0047 DATA_RECORD_UBYTE 255 I_1 0 255 /end CHARACTERISTIC
/begin CHARACTERISTIC FaultFTCMSCS_CtrlSatTimoutInc "FaultFTCMSCS_CtrlSatTimoutInc" VALUE 0x0047 DATA_RECORD_UBYTE 255 I_1 0 255 /end CHARACTERISTIC
/begin CHARACTERISTIC FaultFTCMSCS_SpdOvershootDec "FaultFTCMSCS_SpdOvershootDec" VALUE 0x0048 DATA_RECORD_UBYTE 255 I_1 0 255 /end CHARACTERISTIC
/begin CHARACTERISTIC FaultFTCMSCS_SpdOvershootFailMod "FaultFTCMSCS_SpdOvershootFailMod" VALUE 0x0048 DATA_RECORD_UBYTE 255 I_1 0 255 /end CHARACTERISTIC
/begin CHARACTERISTIC FaultFTCMSCS_SpdOvershootInc "FaultFTCMSCS_SpdOvershootInc" VALUE 0x0048 DATA_RECORD_UBYTE 255 I_1 0 255 /end CHARACTERISTIC
/begin CHARACTERISTIC FaultFTCMSCS_ZeroSpeedTimoutDec "FaultFTCMSCS_ZeroSpeedTimoutDec" VALUE 0x0049 DATA_RECORD_UBYTE 255 I_1 0 255 /end CHARACTERISTIC
/begin CHARACTERISTIC FaultFTCMSCS_ZeroSpeedTimoutFailMod "FaultFTCMSCS_ZeroSpeedTimoutFailMod" VALUE 0x0049 DATA_RECORD_UBYTE 255 I_1 0 255 /end CHARACTERISTIC
/begin CHARACTERISTIC FaultFTCMSCS_ZeroSpeedTimoutInc "FaultFTCMSCS_ZeroSpeedTimoutInc" VALUE 0x0049 DATA_RECORD_UBYTE 255 I_1 0 255 /end CHARACTERISTIC
/begin CHARACTERISTIC FaultFTCMTCS_VoltageMarginLowDec "FaultFTCMTCS_VoltageMarginLowDec" VALUE 0x004A DATA_RECORD_UBYTE 255 I_1 0 255 /end CHARACTERISTIC
/begin CHARACTERISTIC FaultFTCMTCS_VoltageMarginLowFailMod "FaultFTCMTCS_VoltageMarginLowFailMod" VALUE 0x004A DATA_RECORD_UBYTE 255 I_1 0 255 /end CHARACTERISTIC
/begin CHARACTERISTIC FaultFTCMTCS_VoltageMarginLowInc "FaultFTCMTCS_VoltageMarginLowInc" VALUE 0x004A DATA_RECORD_UBYTE 255 I_1 0 255 /end CHARACTERISTIC
/begin CHARACTERISTIC FaultFTEVEIT_EstOverTempDec "FaultFTEVEIT_EstOverTempDec" VALUE 0x004B DATA_RECORD_UBYTE 255 I_1 0 255 /end CHARACTERISTIC
/begin CHARACTERISTIC FaultFTEVEIT_EstOverTempFailMod "FaultFTEVEIT_EstOverTempFailMod" VALUE 0x004B DATA_RECORD_UBYTE 255 I_1 0 255 /end CHARACTERISTIC
/begin CHARACTERISTIC FaultFTEVEIT_EstOverTempInc "FaultFTEVEIT_EstOverTempInc" VALUE 0x004B DATA_RECORD_UBYTE 255 I_1 0 255 /end CHARACTERISTIC
/begin CHARACTERISTIC FaultFTMTLCS_CurSenrPhaU_GNDDec "FaultFTMTLCS_CurSenrPhaU_GNDDec" VALUE 0x004D DATA_RECORD_UBYTE 255 I_1 0 255 /end CHARACTERISTIC
/begin CHARACTERISTIC FaultFTMTLCS_CurSenrPhaU_GNDFailMod "FaultFTMTLCS_CurSenrPhaU_GNDFailMod" VALUE 0x004D DATA_RECORD_UBYTE 255 I_1 0 255 /end CHARACTERISTIC
/begin CHARACTERISTIC FaultFTMTLCS_CurSenrPhaU_GNDInc "FaultFTMTLCS_CurSenrPhaU_GNDInc" VALUE 0x004D DATA_RECORD_UBYTE 255 I_1 0 255 /end CHARACTERISTIC
/begin CHARACTERISTIC FaultFTMTLCS_CurSenrPhaU_OutRngHDec "FaultFTMTLCS_CurSenrPhaU_OutRngHDec" VALUE 0x004E DATA_RECORD_UBYTE 255 I_1 0 255 /end CHARACTERISTIC
/begin CHARACTERISTIC FaultFTMTLCS_CurSenrPhaU_OutRngHFailMod "FaultFTMTLCS_CurSenrPhaU_OutRngHFailMod" VALUE 0x004E DATA_RECORD_UBYTE 255 I_1 0 255 /end CHARACTERISTIC
/begin CHARACTERISTIC FaultFTMTLCS_CurSenrPhaU_OutRngHInc "FaultFTMTLCS_CurSenrPhaU_OutRngHInc" VALUE 0x004E DATA_RECORD_UBYTE 255 I_1 0 255 /end CHARACTERISTIC
/begin CHARACTERISTIC FaultFTMTLCS_CurSenrPhaU_OutRngLDec "FaultFTMTLCS_CurSenrPhaU_OutRngLDec" VALUE 0x004F DATA_RECORD_UBYTE 255 I_1 0 255 /end CHARACTERISTIC
/begin CHARACTERISTIC FaultFTMTLCS_CurSenrPhaU_OutRngLFailMod "FaultFTMTLCS_CurSenrPhaU_OutRngLFailMod" VALUE 0x004F DATA_RECORD_UBYTE 255 I_1 0 255 /end CHARACTERISTIC
/begin CHARACTERISTIC FaultFTMTLCS_CurSenrPhaU_OutRngLInc "FaultFTMTLCS_CurSenrPhaU_OutRngLInc" VALUE 0x004F DATA_RECORD_UBYTE 255 I_1 0 255 /end CHARACTERISTIC
/begin CHARACTERISTIC FaultFTMTLCS_CurSenrPhaU_VCCDec "FaultFTMTLCS_CurSenrPhaU_VCCDec" VALUE 0x0050 DATA_RECORD_UBYTE 255 I_1 0 255 /end CHARACTERISTIC
/begin CHARACTERISTIC FaultFTMTLCS_CurSenrPhaU_VCCFailMod "FaultFTMTLCS_CurSenrPhaU_VCCFailMod" VALUE 0x0050 DATA_RECORD_UBYTE 255 I_1 0 255 /end CHARACTERISTIC
/begin CHARACTERISTIC FaultFTMTLCS_CurSenrPhaU_VCCInc "FaultFTMTLCS_CurSenrPhaU_VCCInc" VALUE 0x0050 DATA_RECORD_UBYTE 255 I_1 0 255 /end CHARACTERISTIC
/begin CHARACTERISTIC FaultFTMTLCS_CurSenrPhaV_GNDDec "FaultFTMTLCS_CurSenrPhaV_GNDDec" VALUE 0x0051 DATA_RECORD_UBYTE 255 I_1 0 255 /end CHARACTERISTIC
/begin CHARACTERISTIC FaultFTMTLCS_CurSenrPhaV_GNDFailMod "FaultFTMTLCS_CurSenrPhaV_GNDFailMod" VALUE 0x0051 DATA_RECORD_UBYTE 255 I_1 0 255 /end CHARACTERISTIC
/begin CHARACTERISTIC FaultFTMTLCS_CurSenrPhaV_GNDInc "FaultFTMTLCS_CurSenrPhaV_GNDInc" VALUE 0x0051 DATA_RECORD_UBYTE 255 I_1 0 255 /end CHARACTERISTIC
/begin CHARACTERISTIC FaultFTMTLCS_CurSenrPhaV_OutRngHDec "FaultFTMTLCS_CurSenrPhaV_OutRngHDec" VALUE 0x0052 DATA_RECORD_UBYTE 255 I_1 0 255 /end CHARACTERISTIC
/begin CHARACTERISTIC FaultFTMTLCS_CurSenrPhaV_OutRngHFailMod "FaultFTMTLCS_CurSenrPhaV_OutRngHFailMod" VALUE 0x0052 DATA_RECORD_UBYTE 255 I_1 0 255 /end CHARACTERISTIC
/begin CHARACTERISTIC FaultFTMTLCS_CurSenrPhaV_OutRngHInc "FaultFTMTLCS_CurSenrPhaV_OutRngHInc" VALUE 0x0052 DATA_RECORD_UBYTE 255 I_1 0 255 /end CHARACTERISTIC
/begin CHARACTERISTIC FaultFTMTLCS_CurSenrPhaV_OutRngLDec "FaultFTMTLCS_CurSenrPhaV_OutRngLDec" VALUE 0x0053 DATA_RECORD_UBYTE 255 I_1 0 255 /end CHARACTERISTIC
/begin CHARACTERISTIC FaultFTMTLCS_CurSenrPhaV_OutRngLFailMod "FaultFTMTLCS_CurSenrPhaV_OutRngLFailMod" VALUE 0x0053 DATA_RECORD_UBYTE 255 I_1 0 255 /end CHARACTERISTIC
/begin CHARACTERISTIC FaultFTMTLCS_CurSenrPhaV_OutRngLInc "FaultFTMTLCS_CurSenrPhaV_OutRngLInc" VALUE 0x0053 DATA_RECORD_UBYTE 255 I_1 0 255 /end CHARACTERISTIC
/begin CHARACTERISTIC FaultFTMTLCS_CurSenrPhaV_VCCDec "FaultFTMTLCS_CurSenrPhaV_VCCDec" VALUE 0x0054 DATA_RECORD_UBYTE 255 I_1 0 255 /end CHARACTERISTIC
/begin CHARACTERISTIC FaultFTMTLCS_CurSenrPhaV_VCCFailMod "FaultFTMTLCS_CurSenrPhaV_VCCFailMod" VALUE 0x0054 DATA_RECORD_UBYTE 255 I_1 0 255 /end CHARACTERISTIC
/begin CHARACTERISTIC FaultFTMTLCS_CurSenrPhaV_VCCInc "FaultFTMTLCS_CurSenrPhaV_VCCInc" VALUE 0x0054 DATA_RECORD_UBYTE 255 I_1 0 255 /end CHARACTERISTIC
/begin CHARACTERISTIC FaultFTMTLCS_CurSenrPhaW_GNDDec "FaultFTMTLCS_CurSenrPhaW_GNDDec" VALUE 0x0055 DATA_RECORD_UBYTE 255 I_1 0 255 /end CHARACTERISTIC
/begin CHARACTERISTIC FaultFTMTLCS_CurSenrPhaW_GNDFailMod "FaultFTMTLCS_CurSenrPhaW_GNDFailMod" VALUE 0x0055 DATA_RECORD_UBYTE 255 I_1 0 255 /end CHARACTERISTIC
/begin CHARACTERISTIC FaultFTMTLCS_CurSenrPhaW_GNDInc "FaultFTMTLCS_CurSenrPhaW_GNDInc" VALUE 0x0055 DATA_RECORD_UBYTE 255 I_1 0 255 /end CHARACTERISTIC
/begin CHARACTERISTIC FaultFTMTLCS_CurSenrPhaW_OutRngHDec "FaultFTMTLCS_CurSenrPhaW_OutRngHDec" VALUE 0x0056 DATA_RECORD_UBYTE 255 I_1 0 255 /end CHARACTERISTIC
/begin CHARACTERISTIC FaultFTMTLCS_CurSenrPhaW_OutRngHFailMod "FaultFTMTLCS_CurSenrPhaW_OutRngHFailMod" VALUE 0x0056 DATA_RECORD_UBYTE 255 I_1 0 255 /end CHARACTERISTIC
/begin CHARACTERISTIC FaultFTMTLCS_CurSenrPhaW_OutRngHInc "FaultFTMTLCS_CurSenrPhaW_OutRngHInc" VALUE 0x0056 DATA_RECORD_UBYTE 255 I_1 0 255 /end CHARACTERISTIC
/begin CHARACTERISTIC FaultFTMTLCS_CurSenrPhaW_OutRngLDec "FaultFTMTLCS_CurSenrPhaW_OutRngLDec" VALUE 0x0057 DATA_RECORD_UBYTE 255 I_1 0 255 /end CHARACTERISTIC
/begin CHARACTERISTIC FaultFTMTLCS_CurSenrPhaW_OutRngLFailMod "FaultFTMTLCS_CurSenrPhaW_OutRngLFailMod" VALUE 0x0057 DATA_RECORD_UBYTE 255 I_1 0 255 /end CHARACTERISTIC
/begin CHARACTERISTIC FaultFTMTLCS_CurSenrPhaW_OutRngLInc "FaultFTMTLCS_CurSenrPhaW_OutRngLInc" VALUE 0x0057 DATA_RECORD_UBYTE 255 I_1 0 255 /end CHARACTERISTIC
/begin CHARACTERISTIC FaultFTMTLCS_CurSenrPhaW_VCCDec "FaultFTMTLCS_CurSenrPhaW_VCCDec" VALUE 0x0058 DATA_RECORD_UBYTE 255 I_1 0 255 /end CHARACTERISTIC
/begin CHARACTERISTIC FaultFTMTLCS_CurSenrPhaW_VCCFailMod "FaultFTMTLCS_CurSenrPhaW_VCCFailMod" VALUE 0x0058 DATA_RECORD_UBYTE 255 I_1 0 255 /end CHARACTERISTIC
/begin CHARACTERISTIC FaultFTMTLCS_CurSenrPhaW_VCCInc "FaultFTMTLCS_CurSenrPhaW_VCCInc" VALUE 0x0058 DATA_RECORD_UBYTE 255 I_1 0 255 /end CHARACTERISTIC
/begin CHARACTERISTIC FaultFTMTLCS_CurrentSumErrorDec "FaultFTMTLCS_CurrentSumErrorDec" VALUE 0x004C DATA_RECORD_UBYTE 255 I_1 0 255 /end CHARACTERISTIC
/begin CHARACTERISTIC FaultFTMTLCS_CurrentSumErrorFailMod "FaultFTMTLCS_CurrentSumErrorFailMod" VALUE 0x004C DATA_RECORD_UBYTE 255 I_1 0 255 /end CHARACTERISTIC
/begin CHARACTERISTIC FaultFTMTLCS_CurrentSumErrorInc "FaultFTMTLCS_CurrentSumErrorInc" VALUE 0x004C DATA_RECORD_UBYTE 255 I_1 0 255 /end CHARACTERISTIC
/begin CHARACTERISTIC FaultSDMTMEP_CosGndDec "FaultSDMTMEP_CosGndDec" VALUE 0x0059 DATA_RECORD_UBYTE 255 I_1 0 255 /end CHARACTERISTIC
/begin CHARACTERISTIC FaultSDMTMEP_CosGndFailMod "FaultSDMTMEP_CosGndFailMod" VALUE 0x0059 DATA_RECORD_UBYTE 255 I_1 0 255 /end CHARACTERISTIC
/begin CHARACTERISTIC FaultSDMTMEP_CosGndInc "FaultSDMTMEP_CosGndInc" VALUE 0x0059 DATA_RECORD_UBYTE 255 I_1 0 255 /end CHARACTERISTIC
/begin CHARACTERISTIC FaultSDMTMEP_CosOutRangeHighDec "FaultSDMTMEP_CosOutRangeHighDec" VALUE 0x005A DATA_RECORD_UBYTE 255 I_1 0 255 /end CHARACTERISTIC
/begin CHARACTERISTIC FaultSDMTMEP_CosOutRangeHighFailMod "FaultSDMTMEP_CosOutRangeHighFailMod" VALUE 0x005A DATA_RECORD_UBYTE 255 I_1 0 255 /end CHARACTERISTIC
/begin CHARACTERISTIC FaultSDMTMEP_CosOutRangeHighInc "FaultSDMTMEP_CosOutRangeHighInc" VALUE 0x005A DATA_RECORD_UBYTE 255 I_1 0 255 /end CHARACTERISTIC
/begin CHARACTERISTIC FaultSDMTMEP_CosOutRangeLowDec "FaultSDMTMEP_CosOutRangeLowDec" VALUE 0x005B DATA_RECORD_UBYTE 255 I_1 0 255 /end CHARACTERISTIC
/begin CHARACTERISTIC FaultSDMTMEP_CosOutRangeLowFailMod "FaultSDMTMEP_CosOutRangeLowFailMod" VALUE 0x005B DATA_RECORD_UBYTE 255 I_1 0 255 /end CHARACTERISTIC
/begin CHARACTERISTIC FaultSDMTMEP_CosOutRangeLowInc "FaultSDMTMEP_CosOutRangeLowInc" VALUE 0x005B DATA_RECORD_UBYTE 255 I_1 0 255 /end CHARACTERISTIC
/begin CHARACTERISTIC FaultSDMTMEP_CosVccDec "FaultSDMTMEP_CosVccDec" VALUE 0x005C DATA_RECORD_UBYTE 255 I_1 0 255 /end CHARACTERISTIC
/begin CHARACTERISTIC FaultSDMTMEP_CosVccFailMod "FaultSDMTMEP_CosVccFailMod" VALUE 0x005C DATA_RECORD_UBYTE 255 I_1 0 255 /end CHARACTERISTIC
/begin CHARACTERISTIC FaultSDMTMEP_CosVccInc "FaultSDMTMEP_CosVccInc" VALUE 0x005C DATA_RECORD_UBYTE 255 I_1 0 255 /end CHARACTERISTIC
/begin CHARACTERISTIC FaultSDMTMEP_OverSpeedDec "FaultSDMTMEP_OverSpeedDec" VALUE 0x005D DATA_RECORD_UBYTE 255 I_1 0 255 /end CHARACTERISTIC
/begin CHARACTERISTIC FaultSDMTMEP_OverSpeedFailMod "FaultSDMTMEP_OverSpeedFailMod" VALUE 0x005D DATA_RECORD_UBYTE 255 I_1 0 255 /end CHARACTERISTIC
/begin CHARACTERISTIC FaultSDMTMEP_OverSpeedInc "FaultSDMTMEP_OverSpeedInc" VALUE 0x005D DATA_RECORD_UBYTE 255 I_1 0 255 /end CHARACTERISTIC
/begin CHARACTERISTIC FaultSDMTMEP_ResSquaSumErrByFTDec "FaultSDMTMEP_ResSquaSumErrByFTDec" VALUE 0x005E DATA_RECORD_UBYTE 255 I_1 0 255 /end CHARACTERISTIC
/begin CHARACTERISTIC FaultSDMTMEP_ResSquaSumErrByFTFailMod "FaultSDMTMEP_ResSquaSumErrByFTFailMod" VALUE 0x005E DATA_RECORD_UBYTE 255 I_1 0 255 /end CHARACTERISTIC
/begin CHARACTERISTIC FaultSDMTMEP_ResSquaSumErrByFTInc "FaultSDMTMEP_ResSquaSumErrByFTInc" VALUE 0x005E DATA_RECORD_UBYTE 255 I_1 0 255 /end CHARACTERISTIC
/begin CHARACTERISTIC FaultSDMTMEP_SinGndDec "FaultSDMTMEP_SinGndDec" VALUE 0x005F DATA_RECORD_UBYTE 255 I_1 0 255 /end CHARACTERISTIC
/begin CHARACTERISTIC FaultSDMTMEP_SinGndFailMod "FaultSDMTMEP_SinGndFailMod" VALUE 0x005F DATA_RECORD_UBYTE 255 I_1 0 255 /end CHARACTERISTIC
/begin CHARACTERISTIC FaultSDMTMEP_SinGndInc "FaultSDMTMEP_SinGndInc" VALUE 0x005F DATA_RECORD_UBYTE 255 I_1 0 255 /end CHARACTERISTIC
/begin CHARACTERISTIC FaultSDMTMEP_SinOutRangeHighDec "FaultSDMTMEP_SinOutRangeHighDec" VALUE 0x0060 DATA_RECORD_UBYTE 255 I_1 0 255 /end CHARACTERISTIC
/begin CHARACTERISTIC FaultSDMTMEP_SinOutRangeHighFailMod "FaultSDMTMEP_SinOutRangeHighFailMod" VALUE 0x0060 DATA_RECORD_UBYTE 255 I_1 0 255 /end CHARACTERISTIC
/begin CHARACTERISTIC FaultSDMTMEP_SinOutRangeHighInc "FaultSDMTMEP_SinOutRangeHighInc" VALUE 0x0060 DATA_RECORD_UBYTE 255 I_1 0 255 /end CHARACTERISTIC
/begin CHARACTERISTIC FaultSDMTMEP_SinOutRangeLowDec "FaultSDMTMEP_SinOutRangeLowDec" VALUE 0x0061 DATA_RECORD_UBYTE 255 I_1 0 255 /end CHARACTERISTIC
/begin CHARACTERISTIC FaultSDMTMEP_SinOutRangeLowFailMod "FaultSDMTMEP_SinOutRangeLowFailMod" VALUE 0x0061 DATA_RECORD_UBYTE 255 I_1 0 255 /end CHARACTERISTIC
/begin CHARACTERISTIC FaultSDMTMEP_SinOutRangeLowInc "FaultSDMTMEP_SinOutRangeLowInc" VALUE 0x0061 DATA_RECORD_UBYTE 255 I_1 0 255 /end CHARACTERISTIC
/begin CHARACTERISTIC FaultSDMTMEP_SinVccDec "FaultSDMTMEP_SinVccDec" VALUE 0x0062 DATA_RECORD_UBYTE 255 I_1 0 255 /end CHARACTERISTIC
/begin CHARACTERISTIC FaultSDMTMEP_SinVccFailMod "FaultSDMTMEP_SinVccFailMod" VALUE 0x0062 DATA_RECORD_UBYTE 255 I_1 0 255 /end CHARACTERISTIC
/begin CHARACTERISTIC FaultSDMTMEP_SinVccInc "FaultSDMTMEP_SinVccInc" VALUE 0x0062 DATA_RECORD_UBYTE 255 I_1 0 255 /end CHARACTERISTIC
/begin CHARACTERISTIC FaultSDMTMEP_UnderSpeedDec "FaultSDMTMEP_UnderSpeedDec" VALUE 0x0063 DATA_RECORD_UBYTE 255 I_1 0 255 /end CHARACTERISTIC
/begin CHARACTERISTIC FaultSDMTMEP_UnderSpeedFailMod "FaultSDMTMEP_UnderSpeedFailMod" VALUE 0x0063 DATA_RECORD_UBYTE 255 I_1 0 255 /end CHARACTERISTIC
/begin CHARACTERISTIC FaultSDMTMEP_UnderSpeedInc "FaultSDMTMEP_UnderSpeedInc" VALUE 0x0063 DATA_RECORD_UBYTE 255 I_1 0 255 /end CHARACTERISTIC
/begin CHARACTERISTIC FaultTCUCAP0_CAPPressureHDec "FaultTCUCAP0_CAPPressureHDec" VALUE 0x0064 DATA_RECORD_UBYTE 255 I_1 0 255 /end CHARACTERISTIC
/begin CHARACTERISTIC FaultTCUCAP0_CAPPressureHFailMod "FaultTCUCAP0_CAPPressureHFailMod" VALUE 0x0064 DATA_RECORD_UBYTE 255 I_1 0 255 /end CHARACTERISTIC
/begin CHARACTERISTIC FaultTCUCAP0_CAPPressureHInc "FaultTCUCAP0_CAPPressureHInc" VALUE 0x0064 DATA_RECORD_UBYTE 255 I_1 0 255 /end CHARACTERISTIC
/begin CHARACTERISTIC FaultTCUCAP0_CAPPressureLDec "FaultTCUCAP0_CAPPressureLDec" VALUE 0x0065 DATA_RECORD_UBYTE 255 I_1 0 255 /end CHARACTERISTIC
/begin CHARACTERISTIC FaultTCUCAP0_CAPPressureLFailMod "FaultTCUCAP0_CAPPressureLFailMod" VALUE 0x0065 DATA_RECORD_UBYTE 255 I_1 0 255 /end CHARACTERISTIC
/begin CHARACTERISTIC FaultTCUCAP0_CAPPressureLInc "FaultTCUCAP0_CAPPressureLInc" VALUE 0x0065 DATA_RECORD_UBYTE 255 I_1 0 255 /end CHARACTERISTIC
/begin CHARACTERISTIC FaultTCUCAP0_CAPPressureOverHDec "FaultTCUCAP0_CAPPressureOverHDec" VALUE 0x0066 DATA_RECORD_UBYTE 255 I_1 0 255 /end CHARACTERISTIC
/begin CHARACTERISTIC FaultTCUCAP0_CAPPressureOverHFailMod "FaultTCUCAP0_CAPPressureOverHFailMod" VALUE 0x0066 DATA_RECORD_UBYTE 255 I_1 0 255 /end CHARACTERISTIC
/begin CHARACTERISTIC FaultTCUCAP0_CAPPressureOverHInc "FaultTCUCAP0_CAPPressureOverHInc" VALUE 0x0066 DATA_RECORD_UBYTE 255 I_1 0 255 /end CHARACTERISTIC
/begin CHARACTERISTIC FaultTCUCAP0_CAPSlipDec "FaultTCUCAP0_CAPSlipDec" VALUE 0x0067 DATA_RECORD_UBYTE 255 I_1 0 255 /end CHARACTERISTIC
/begin CHARACTERISTIC FaultTCUCAP0_CAPSlipFailMod "FaultTCUCAP0_CAPSlipFailMod" VALUE 0x0067 DATA_RECORD_UBYTE 255 I_1 0 255 /end CHARACTERISTIC
/begin CHARACTERISTIC FaultTCUCAP0_CAPSlipInc "FaultTCUCAP0_CAPSlipInc" VALUE 0x0067 DATA_RECORD_UBYTE 255 I_1 0 255 /end CHARACTERISTIC
/begin CHARACTERISTIC FaultTCUCAP0_DragMomentHDec "FaultTCUCAP0_DragMomentHDec" VALUE 0x0068 DATA_RECORD_UBYTE 255 I_1 0 255 /end CHARACTERISTIC
/begin CHARACTERISTIC FaultTCUCAP0_DragMomentHFailMod "FaultTCUCAP0_DragMomentHFailMod" VALUE 0x0068 DATA_RECORD_UBYTE 255 I_1 0 255 /end CHARACTERISTIC
/begin CHARACTERISTIC FaultTCUCAP0_DragMomentHInc "FaultTCUCAP0_DragMomentHInc" VALUE 0x0068 DATA_RECORD_UBYTE 255 I_1 0 255 /end CHARACTERISTIC
/begin CHARACTERISTIC FaultTCUCAP0_HLSinInvalidDec "FaultTCUCAP0_HLSinInvalidDec" VALUE 0x0069 DATA_RECORD_UBYTE 255 I_1 0 255 /end CHARACTERISTIC
/begin CHARACTERISTIC FaultTCUCAP0_HLSinInvalidFailMod "FaultTCUCAP0_HLSinInvalidFailMod" VALUE 0x0069 DATA_RECORD_UBYTE 255 I_1 0 255 /end CHARACTERISTIC
/begin CHARACTERISTIC FaultTCUCAP0_HLSinInvalidInc "FaultTCUCAP0_HLSinInvalidInc" VALUE 0x0069 DATA_RECORD_UBYTE 255 I_1 0 255 /end CHARACTERISTIC
/begin CHARACTERISTIC FaultTCUCAP0_HLSinUndefineDec "FaultTCUCAP0_HLSinUndefineDec" VALUE 0x006A DATA_RECORD_UBYTE 255 I_1 0 255 /end CHARACTERISTIC
/begin CHARACTERISTIC FaultTCUCAP0_HLSinUndefineFailMod "FaultTCUCAP0_HLSinUndefineFailMod" VALUE 0x006A DATA_RECORD_UBYTE 255 I_1 0 255 /end CHARACTERISTIC
/begin CHARACTERISTIC FaultTCUCAP0_HLSinUndefineInc "FaultTCUCAP0_HLSinUndefineInc" VALUE 0x006A DATA_RECORD_UBYTE 255 I_1 0 255 /end CHARACTERISTIC
/begin CHARACTERISTIC FaultTCUCAP0_HLSupplyHDec "FaultTCUCAP0_HLSupplyHDec" VALUE 0x006B DATA_RECORD_UBYTE 255 I_1 0 255 /end CHARACTERISTIC
/begin CHARACTERISTIC FaultTCUCAP0_HLSupplyHFailMod "FaultTCUCAP0_HLSupplyHFailMod" VALUE 0x006B DATA_RECORD_UBYTE 255 I_1 0 255 /end CHARACTERISTIC
/begin CHARACTERISTIC FaultTCUCAP0_HLSupplyHInc "FaultTCUCAP0_HLSupplyHInc" VALUE 0x006B DATA_RECORD_UBYTE 255 I_1 0 255 /end CHARACTERISTIC
/begin CHARACTERISTIC FaultTCUCAP0_HLSupplyLDec "FaultTCUCAP0_HLSupplyLDec" VALUE 0x006C DATA_RECORD_UBYTE 255 I_1 0 255 /end CHARACTERISTIC
/begin CHARACTERISTIC FaultTCUCAP0_HLSupplyLFailMod "FaultTCUCAP0_HLSupplyLFailMod" VALUE 0x006C DATA_RECORD_UBYTE 255 I_1 0 255 /end CHARACTERISTIC
/begin CHARACTERISTIC FaultTCUCAP0_HLSupplyLInc "FaultTCUCAP0_HLSupplyLInc" VALUE 0x006C DATA_RECORD_UBYTE 255 I_1 0 255 /end CHARACTERISTIC
/begin CHARACTERISTIC FaultTCUCAP0_MotorPhaseVolHDec "FaultTCUCAP0_MotorPhaseVolHDec" VALUE 0x006D DATA_RECORD_UBYTE 255 I_1 0 255 /end CHARACTERISTIC
/begin CHARACTERISTIC FaultTCUCAP0_MotorPhaseVolHFailMod "FaultTCUCAP0_MotorPhaseVolHFailMod" VALUE 0x006D DATA_RECORD_UBYTE 255 I_1 0 255 /end CHARACTERISTIC
/begin CHARACTERISTIC FaultTCUCAP0_MotorPhaseVolHInc "FaultTCUCAP0_MotorPhaseVolHInc" VALUE 0x006D DATA_RECORD_UBYTE 255 I_1 0 255 /end CHARACTERISTIC
/begin CHARACTERISTIC FaultTCUCAP0_PressureRationalDec "FaultTCUCAP0_PressureRationalDec" VALUE 0x006E DATA_RECORD_UBYTE 255 I_1 0 255 /end CHARACTERISTIC
/begin CHARACTERISTIC FaultTCUCAP0_PressureRationalFailMod "FaultTCUCAP0_PressureRationalFailMod" VALUE 0x006E DATA_RECORD_UBYTE 255 I_1 0 255 /end CHARACTERISTIC
/begin CHARACTERISTIC FaultTCUCAP0_PressureRationalInc "FaultTCUCAP0_PressureRationalInc" VALUE 0x006E DATA_RECORD_UBYTE 255 I_1 0 255 /end CHARACTERISTIC
/begin CHARACTERISTIC FaultTCUCAP0_SenSigOpenOrGNDDec "FaultTCUCAP0_SenSigOpenOrGNDDec" VALUE 0x006F DATA_RECORD_UBYTE 255 I_1 0 255 /end CHARACTERISTIC
/begin CHARACTERISTIC FaultTCUCAP0_SenSigOpenOrGNDFailMod "FaultTCUCAP0_SenSigOpenOrGNDFailMod" VALUE 0x006F DATA_RECORD_UBYTE 255 I_1 0 255 /end CHARACTERISTIC
/begin CHARACTERISTIC FaultTCUCAP0_SenSigOpenOrGNDInc "FaultTCUCAP0_SenSigOpenOrGNDInc" VALUE 0x006F DATA_RECORD_UBYTE 255 I_1 0 255 /end CHARACTERISTIC
/begin CHARACTERISTIC FaultTCUCAP0_SenSigVCCDec "FaultTCUCAP0_SenSigVCCDec" VALUE 0x0070 DATA_RECORD_UBYTE 255 I_1 0 255 /end CHARACTERISTIC
/begin CHARACTERISTIC FaultTCUCAP0_SenSigVCCFailMod "FaultTCUCAP0_SenSigVCCFailMod" VALUE 0x0070 DATA_RECORD_UBYTE 255 I_1 0 255 /end CHARACTERISTIC
/begin CHARACTERISTIC FaultTCUCAP0_SenSigVCCInc "FaultTCUCAP0_SenSigVCCInc" VALUE 0x0070 DATA_RECORD_UBYTE 255 I_1 0 255 /end CHARACTERISTIC
/begin CHARACTERISTIC FaultTCUCAP0_SensorPerforErrDec "FaultTCUCAP0_SensorPerforErrDec" VALUE 0x0071 DATA_RECORD_UBYTE 255 I_1 0 255 /end CHARACTERISTIC
/begin CHARACTERISTIC FaultTCUCAP0_SensorPerforErrFailMod "FaultTCUCAP0_SensorPerforErrFailMod" VALUE 0x0071 DATA_RECORD_UBYTE 255 I_1 0 255 /end CHARACTERISTIC
/begin CHARACTERISTIC FaultTCUCAP0_SensorPerforErrInc "FaultTCUCAP0_SensorPerforErrInc" VALUE 0x0071 DATA_RECORD_UBYTE 255 I_1 0 255 /end CHARACTERISTIC
/begin CHARACTERISTIC FaultTCUCAP1_COM_GCUDec "FaultTCUCAP1_COM_GCUDec" VALUE 0x0072 DATA_RECORD_UBYTE 255 I_1 0 255 /end CHARACTERISTIC
/begin CHARACTERISTIC FaultTCUCAP1_COM_GCUFailMod "FaultTCUCAP1_COM_GCUFailMod" VALUE 0x0072 DATA_RECORD_UBYTE 255 I_1 0 255 /end CHARACTERISTIC
/begin CHARACTERISTIC FaultTCUCAP1_COM_GCUInc "FaultTCUCAP1_COM_GCUInc" VALUE 0x0072 DATA_RECORD_UBYTE 255 I_1 0 255 /end CHARACTERISTIC
/begin CHARACTERISTIC FaultTCUCAP1_DriverTempHDec "FaultTCUCAP1_DriverTempHDec" VALUE 0x0073 DATA_RECORD_UBYTE 255 I_1 0 255 /end CHARACTERISTIC
/begin CHARACTERISTIC FaultTCUCAP1_DriverTempHFailMod "FaultTCUCAP1_DriverTempHFailMod" VALUE 0x0073 DATA_RECORD_UBYTE 255 I_1 0 255 /end CHARACTERISTIC
/begin CHARACTERISTIC FaultTCUCAP1_DriverTempHInc "FaultTCUCAP1_DriverTempHInc" VALUE 0x0073 DATA_RECORD_UBYTE 255 I_1 0 255 /end CHARACTERISTIC
/begin CHARACTERISTIC FaultTCUCAP1_FETShortDec "FaultTCUCAP1_FETShortDec" VALUE 0x0074 DATA_RECORD_UBYTE 255 I_1 0 255 /end CHARACTERISTIC
/begin CHARACTERISTIC FaultTCUCAP1_FETShortFailMod "FaultTCUCAP1_FETShortFailMod" VALUE 0x0074 DATA_RECORD_UBYTE 255 I_1 0 255 /end CHARACTERISTIC
/begin CHARACTERISTIC FaultTCUCAP1_FETShortInc "FaultTCUCAP1_FETShortInc" VALUE 0x0074 DATA_RECORD_UBYTE 255 I_1 0 255 /end CHARACTERISTIC
/begin CHARACTERISTIC FaultTCUCAP1_HWOverCurDec "FaultTCUCAP1_HWOverCurDec" VALUE 0x0075 DATA_RECORD_UBYTE 255 I_1 0 255 /end CHARACTERISTIC
/begin CHARACTERISTIC FaultTCUCAP1_HWOverCurFailMod "FaultTCUCAP1_HWOverCurFailMod" VALUE 0x0075 DATA_RECORD_UBYTE 255 I_1 0 255 /end CHARACTERISTIC
/begin CHARACTERISTIC FaultTCUCAP1_HWOverCurInc "FaultTCUCAP1_HWOverCurInc" VALUE 0x0075 DATA_RECORD_UBYTE 255 I_1 0 255 /end CHARACTERISTIC
/begin CHARACTERISTIC FaultTCUCAP1_MotorPhaseDriveErrDec "FaultTCUCAP1_MotorPhaseDriveErrDec" VALUE 0x0076 DATA_RECORD_UBYTE 255 I_1 0 255 /end CHARACTERISTIC
/begin CHARACTERISTIC FaultTCUCAP1_MotorPhaseDriveErrFailMod "FaultTCUCAP1_MotorPhaseDriveErrFailMod" VALUE 0x0076 DATA_RECORD_UBYTE 255 I_1 0 255 /end CHARACTERISTIC
/begin CHARACTERISTIC FaultTCUCAP1_MotorPhaseDriveErrInc "FaultTCUCAP1_MotorPhaseDriveErrInc" VALUE 0x0076 DATA_RECORD_UBYTE 255 I_1 0 255 /end CHARACTERISTIC
/begin CHARACTERISTIC FaultTCUCAP1_MotorStallDec "FaultTCUCAP1_MotorStallDec" VALUE 0x0077 DATA_RECORD_UBYTE 255 I_1 0 255 /end CHARACTERISTIC
/begin CHARACTERISTIC FaultTCUCAP1_MotorStallFailMod "FaultTCUCAP1_MotorStallFailMod" VALUE 0x0077 DATA_RECORD_UBYTE 255 I_1 0 255 /end CHARACTERISTIC
/begin CHARACTERISTIC FaultTCUCAP1_MotorStallInc "FaultTCUCAP1_MotorStallInc" VALUE 0x0077 DATA_RECORD_UBYTE 255 I_1 0 255 /end CHARACTERISTIC
/begin CHARACTERISTIC FaultTCUCAP1_OverVoltageDec "FaultTCUCAP1_OverVoltageDec" VALUE 0x0078 DATA_RECORD_UBYTE 255 I_1 0 255 /end CHARACTERISTIC
/begin CHARACTERISTIC FaultTCUCAP1_OverVoltageFailMod "FaultTCUCAP1_OverVoltageFailMod" VALUE 0x0078 DATA_RECORD_UBYTE 255 I_1 0 255 /end CHARACTERISTIC
/begin CHARACTERISTIC FaultTCUCAP1_OverVoltageInc "FaultTCUCAP1_OverVoltageInc" VALUE 0x0078 DATA_RECORD_UBYTE 255 I_1 0 255 /end CHARACTERISTIC
/begin CHARACTERISTIC FaultTCUCAP1_PhaseDetectGNDDec "FaultTCUCAP1_PhaseDetectGNDDec" VALUE 0x0079 DATA_RECORD_UBYTE 255 I_1 0 255 /end CHARACTERISTIC
/begin CHARACTERISTIC FaultTCUCAP1_PhaseDetectGNDFailMod "FaultTCUCAP1_PhaseDetectGNDFailMod" VALUE 0x0079 DATA_RECORD_UBYTE 255 I_1 0 255 /end CHARACTERISTIC
/begin CHARACTERISTIC FaultTCUCAP1_PhaseDetectGNDInc "FaultTCUCAP1_PhaseDetectGNDInc" VALUE 0x0079 DATA_RECORD_UBYTE 255 I_1 0 255 /end CHARACTERISTIC
/begin CHARACTERISTIC FaultTCUCAP1_PhaseDetectVCCDec "FaultTCUCAP1_PhaseDetectVCCDec" VALUE 0x007A DATA_RECORD_UBYTE 255 I_1 0 255 /end CHARACTERISTIC
/begin CHARACTERISTIC FaultTCUCAP1_PhaseDetectVCCFailMod "FaultTCUCAP1_PhaseDetectVCCFailMod" VALUE 0x007A DATA_RECORD_UBYTE 255 I_1 0 255 /end CHARACTERISTIC
/begin CHARACTERISTIC FaultTCUCAP1_PhaseDetectVCCInc "FaultTCUCAP1_PhaseDetectVCCInc" VALUE 0x007A DATA_RECORD_UBYTE 255 I_1 0 255 /end CHARACTERISTIC
/begin CHARACTERISTIC FaultTCUCAP1_SWOverCurDec "FaultTCUCAP1_SWOverCurDec" VALUE 0x007B DATA_RECORD_UBYTE 255 I_1 0 255 /end CHARACTERISTIC
/begin CHARACTERISTIC FaultTCUCAP1_SWOverCurFailMod "FaultTCUCAP1_SWOverCurFailMod" VALUE 0x007B DATA_RECORD_UBYTE 255 I_1 0 255 /end CHARACTERISTIC
/begin CHARACTERISTIC FaultTCUCAP1_SWOverCurInc "FaultTCUCAP1_SWOverCurInc" VALUE 0x007B DATA_RECORD_UBYTE 255 I_1 0 255 /end CHARACTERISTIC
/begin CHARACTERISTIC FaultTCUCAP1_ThermalShutDownDec "FaultTCUCAP1_ThermalShutDownDec" VALUE 0x007C DATA_RECORD_UBYTE 255 I_1 0 255 /end CHARACTERISTIC
/begin CHARACTERISTIC FaultTCUCAP1_ThermalShutDownFailMod "FaultTCUCAP1_ThermalShutDownFailMod" VALUE 0x007C DATA_RECORD_UBYTE 255 I_1 0 255 /end CHARACTERISTIC
/begin CHARACTERISTIC FaultTCUCAP1_ThermalShutDownInc "FaultTCUCAP1_ThermalShutDownInc" VALUE 0x007C DATA_RECORD_UBYTE 255 I_1 0 255 /end CHARACTERISTIC
/begin CHARACTERISTIC FaultTCUCAP1_ThermalWarningDec "FaultTCUCAP1_ThermalWarningDec" VALUE 0x007D DATA_RECORD_UBYTE 255 I_1 0 255 /end CHARACTERISTIC
/begin CHARACTERISTIC FaultTCUCAP1_ThermalWarningFailMod "FaultTCUCAP1_ThermalWarningFailMod" VALUE 0x007D DATA_RECORD_UBYTE 255 I_1 0 255 /end CHARACTERISTIC
/begin CHARACTERISTIC FaultTCUCAP1_ThermalWarningInc "FaultTCUCAP1_ThermalWarningInc" VALUE 0x007D DATA_RECORD_UBYTE 255 I_1 0 255 /end CHARACTERISTIC
/begin CHARACTERISTIC FaultTCUCAP1_UnderVoltageDec "FaultTCUCAP1_UnderVoltageDec" VALUE 0x007E DATA_RECORD_UBYTE 255 I_1 0 255 /end CHARACTERISTIC
/begin CHARACTERISTIC FaultTCUCAP1_UnderVoltageFailMod "FaultTCUCAP1_UnderVoltageFailMod" VALUE 0x007E DATA_RECORD_UBYTE 255 I_1 0 255 /end CHARACTERISTIC
/begin CHARACTERISTIC FaultTCUCAP1_UnderVoltageInc "FaultTCUCAP1_UnderVoltageInc" VALUE 0x007E DATA_RECORD_UBYTE 255 I_1 0 255 /end CHARACTERISTIC
/begin CHARACTERISTIC FaultTCUCCP_OilMotorRationalDec "FaultTCUCCP_OilMotorRationalDec" VALUE 0x007F DATA_RECORD_UBYTE 255 I_1 0 255 /end CHARACTERISTIC
/begin CHARACTERISTIC FaultTCUCCP_OilMotorRationalFailMod "FaultTCUCCP_OilMotorRationalFailMod" VALUE 0x007F DATA_RECORD_UBYTE 255 I_1 0 255 /end CHARACTERISTIC
/begin CHARACTERISTIC FaultTCUCCP_OilMotorRationalInc "FaultTCUCCP_OilMotorRationalInc" VALUE 0x007F DATA_RECORD_UBYTE 255 I_1 0 255 /end CHARACTERISTIC
/begin CHARACTERISTIC FaultTCUCCP_OilMotorStallDec "FaultTCUCCP_OilMotorStallDec" VALUE 0x0080 DATA_RECORD_UBYTE 255 I_1 0 255 /end CHARACTERISTIC
/begin CHARACTERISTIC FaultTCUCCP_OilMotorStallFailMod "FaultTCUCCP_OilMotorStallFailMod" VALUE 0x0080 DATA_RECORD_UBYTE 255 I_1 0 255 /end CHARACTERISTIC
/begin CHARACTERISTIC FaultTCUCCP_OilMotorStallInc "FaultTCUCCP_OilMotorStallInc" VALUE 0x0080 DATA_RECORD_UBYTE 255 I_1 0 255 /end CHARACTERISTIC
/begin CHARACTERISTIC FaultTCUCCP_OilSenRationalL1Dec "FaultTCUCCP_OilSenRationalL1Dec" VALUE 0x0081 DATA_RECORD_UBYTE 255 I_1 0 255 /end CHARACTERISTIC
/begin CHARACTERISTIC FaultTCUCCP_OilSenRationalL1FailMod "FaultTCUCCP_OilSenRationalL1FailMod" VALUE 0x0081 DATA_RECORD_UBYTE 255 I_1 0 255 /end CHARACTERISTIC
/begin CHARACTERISTIC FaultTCUCCP_OilSenRationalL1Inc "FaultTCUCCP_OilSenRationalL1Inc" VALUE 0x0081 DATA_RECORD_UBYTE 255 I_1 0 255 /end CHARACTERISTIC
/begin CHARACTERISTIC FaultTCUCCP_OilSenRationalL2Dec "FaultTCUCCP_OilSenRationalL2Dec" VALUE 0x0082 DATA_RECORD_UBYTE 255 I_1 0 255 /end CHARACTERISTIC
/begin CHARACTERISTIC FaultTCUCCP_OilSenRationalL2FailMod "FaultTCUCCP_OilSenRationalL2FailMod" VALUE 0x0082 DATA_RECORD_UBYTE 255 I_1 0 255 /end CHARACTERISTIC
/begin CHARACTERISTIC FaultTCUCCP_OilSenRationalL2Inc "FaultTCUCCP_OilSenRationalL2Inc" VALUE 0x0082 DATA_RECORD_UBYTE 255 I_1 0 255 /end CHARACTERISTIC
/begin CHARACTERISTIC FaultTCUCCP_OilTempRationalHDec "FaultTCUCCP_OilTempRationalHDec" VALUE 0x0083 DATA_RECORD_UBYTE 255 I_1 0 255 /end CHARACTERISTIC
/begin CHARACTERISTIC FaultTCUCCP_OilTempRationalHFailMod "FaultTCUCCP_OilTempRationalHFailMod" VALUE 0x0083 DATA_RECORD_UBYTE 255 I_1 0 255 /end CHARACTERISTIC
/begin CHARACTERISTIC FaultTCUCCP_OilTempRationalHInc "FaultTCUCCP_OilTempRationalHInc" VALUE 0x0083 DATA_RECORD_UBYTE 255 I_1 0 255 /end CHARACTERISTIC
/begin CHARACTERISTIC FaultTCUCCP_OilTempRationalLDec "FaultTCUCCP_OilTempRationalLDec" VALUE 0x0084 DATA_RECORD_UBYTE 255 I_1 0 255 /end CHARACTERISTIC
/begin CHARACTERISTIC FaultTCUCCP_OilTempRationalLFailMod "FaultTCUCCP_OilTempRationalLFailMod" VALUE 0x0084 DATA_RECORD_UBYTE 255 I_1 0 255 /end CHARACTERISTIC
/begin CHARACTERISTIC FaultTCUCCP_OilTempRationalLInc "FaultTCUCCP_OilTempRationalLInc" VALUE 0x0084 DATA_RECORD_UBYTE 255 I_1 0 255 /end CHARACTERISTIC
/begin CHARACTERISTIC GCCU6_bAlimFreqChgEnaC "..." VALUE 0x0000 DATA_RECORD_UBYTE 1 Bool_ON_OFF 0 1 BIT_MASK 0x01 /end CHARACTERISTIC
/begin CHARACTERISTIC GCCU6_bDualSmpEnaC "..." VALUE 0x0000 DATA_RECORD_UBYTE 1 Bool_ON_OFF 0 1 BIT_MASK 0x01 /end CHARACTERISTIC
/begin CHARACTERISTIC GCCU6_bHwOvcFltDetEnaC "..." VALUE 0x0000 DATA_RECORD_UBYTE 1 Bool_ON_OFF 0 1 BIT_MASK 0x01 /end CHARACTERISTIC
/begin CHARACTERISTIC GCCU6_bHwPinAscEnaC "..." VALUE 0x0000 DATA_RECORD_UBYTE 1 Bool_ON_OFF 0 1 BIT_MASK 0x01 /end CHARACTERISTIC
/begin CHARACTERISTIC GCCU6_f32DrvClkDutyThdHighC "..." VALUE 0x0000 DATA_RECORD_FLOAT32_IEEE 3.402823466E+038 F_1_p0_4 -3.402823466E+038 3.402823466E+038 /end CHARACTERISTIC
/begin CHARACTERISTIC GCCU6_f32DrvClkDutyThdLowC "..." VALUE 0x0000 DATA_RECORD_FLOAT32_IEEE 3.402823466E+038 F_1_p0_4 -3.402823466E+038 3.402823466E+038 /end CHARACTERISTIC
/begin CHARACTERISTIC GCCU6_kbDrvBdClkEnaC "..." VALUE 0x0000 DATA_RECORD_UBYTE 1 Bool_ON_OFF 0 1 BIT_MASK 0x01 /end CHARACTERISTIC
/begin CHARACTERISTIC GCCU6_kf32MidPointDutyHC "..." VALUE 0x0000 DATA_RECORD_FLOAT32_IEEE 3.402823466E+038 F_1_p0_4 -3.402823466E+038 3.402823466E+038 /end CHARACTERISTIC
/begin CHARACTERISTIC GCCU6_kf32MidPointDutyLC "..." VALUE 0x0000 DATA_RECORD_FLOAT32_IEEE 3.402823466E+038 F_1_p0_4 -3.402823466E+038 3.402823466E+038 /end CHARACTERISTIC
/begin CHARACTERISTIC GCCU6_ku16AlimDutyCycRawC "..." VALUE 0x0000 DATA_RECORD_UWORD 65535 F_1_p0_4 0 65535 /end CHARACTERISTIC
/begin CHARACTERISTIC GCCU6_ku32AlimFreqRawC "..." VALUE 0x0000 DATA_RECORD_ULONG 4294967295 F_1_p0_4 0 4294967295 /end CHARACTERISTIC
/begin CHARACTERISTIC GCCU6_ku8AscRecoverCntMaxC "..." VALUE 0x0000 DATA_RECORD_UBYTE 255 F_1_p0_4 0 255 /end CHARACTERISTIC
/begin CHARACTERISTIC GCCU6_ku8PwmMidPointFaultC "..." VALUE 0x0000 DATA_RECORD_UBYTE 255 F_1_p0_4 0 255 /end CHARACTERISTIC
/begin CHARACTERISTIC GFaultEraseRequestC "GFaultEraseRequestC" VALUE 0x0000 DATA_RECORD_UWORD 65535 I_1 0 65535 /end CHARACTERISTIC
/begin CHARACTERISTIC HARDPTG_s16AmplitudeC "HARDPTG_s16AmplitudeC" VALUE 0x0000 DATA_RECORD_SWORD 200 F_0v0030518044_p0_55 -100.0015259 99.9984741 /end CHARACTERISTIC
/begin CHARACTERISTIC HARDPTG_s16ContinuousRequestC "HARDPTG_s16ContinuousRequestC" VALUE 0x0000 DATA_RECORD_SWORD 100 F_0v0015259022_p0_56 -50.00076295 49.99923705 /end CHARACTERISTIC
/begin CHARACTERISTIC HARDPTG_s16OffsetC "HARDPTG_s16OffsetC" VALUE 0x0000 DATA_RECORD_SWORD 200 F_0v0030518044_p0_55 -100.0015259 99.9984741 /end CHARACTERISTIC
/begin CHARACTERISTIC HARDPTG_s16SlewRateC "HARDPTG_s16SlewRateC" VALUE 0x0000 DATA_RECORD_SWORD 200 F_0v0030518044_p0_55 -100.0015259 99.9984741 /end CHARACTERISTIC
/begin CHARACTERISTIC HARDPTG_u16PulseDutyCycleC "HARDPTG_u16PulseDutyCycleC" VALUE 0x0000 DATA_RECORD_UWORD 99.9984741 D_2_0v01_p0_57 0.00152590219 100 /end CHARACTERISTIC
/begin CHARACTERISTIC HARDPTG_u32FrequenceC "Sous-multiple de la période SPI VSI" VALUE 0x0000 DATA_RECORD_ULONG 4294967295 F_1_p0_4 0 4294967295 /end CHARACTERISTIC
/begin CHARACTERISTIC HARD_bPtgEnablePhaseShiftingC "HARD_bPtgEnablePhaseShiftingC" VALUE 0x0000 DATA_RECORD_UBYTE 1 Bool_ON_OFF 0 1 BIT_MASK 0x01 /end CHARACTERISTIC
/begin CHARACTERISTIC HARD_u16PtgUSignalShiftC "HARD_u16PtgUSignalShiftC" VALUE 0x0000 DATA_RECORD_UWORD 1.999969482 F_0v0000305176_p0_61 0 1.999969482 /end CHARACTERISTIC
/begin CHARACTERISTIC HARD_u16PtgVSignalShiftC "HARD_u16PtgVSignalShiftC" VALUE 0x0000 DATA_RECORD_UWORD 1.999969482 F_0v0000305176_p0_61 0 1.999969482 /end CHARACTERISTIC
/begin CHARACTERISTIC HARD_u16PtgWSignalShiftC "HARD_u16PtgWSignalShiftC" VALUE 0x0000 DATA_RECORD_UWORD 1.999969482 F_0v0000305176_p0_61 0 1.999969482 /end CHARACTERISTIC
/begin MEASUREMENT ADCTotalTime "ADCTotalTime" ULONG I_1 1 2 0 4294967295 ECU_ADDRESS 0x0 /end MEASUREMENT
/begin MEASUREMENT ASWNM_bFullComSts "..." UBYTE Bool_ON_OFF 1 2 0 1 BIT_MASK 0x01 ECU_ADDRESS 0x0 /end MEASUREMENT
/begin MEASUREMENT ASWNM_u8CurrentState "..." UBYTE Id_0x00 1 2 0 255 MATRIX_DIM 21 1 1 ECU_ADDRESS 0x0 /end MEASUREMENT
/begin MEASUREMENT ASWNM_u8CurrentState[0] "ASWNM_u8CurrentState[0]" UBYTE Id_0x00 1 2 0 255 ECU_ADDRESS 0x0 /end MEASUREMENT
/begin MEASUREMENT ASWNM_u8CurrentState[10] "ASWNM_u8CurrentState[10]" UBYTE Id_0x00 1 2 0 255 ECU_ADDRESS 0x0 /end MEASUREMENT
/begin MEASUREMENT ASWNM_u8CurrentState[11] "ASWNM_u8CurrentState[11]" UBYTE Id_0x00 1 2 0 255 ECU_ADDRESS 0x0 /end MEASUREMENT
/begin MEASUREMENT ASWNM_u8CurrentState[12] "ASWNM_u8CurrentState[12]" UBYTE Id_0x00 1 2 0 255 ECU_ADDRESS 0x0 /end MEASUREMENT
/begin MEASUREMENT ASWNM_u8CurrentState[13] "ASWNM_u8CurrentState[13]" UBYTE Id_0x00 1 2 0 255 ECU_ADDRESS 0x0 /end MEASUREMENT
/begin MEASUREMENT ASWNM_u8CurrentState[14] "ASWNM_u8CurrentState[14]" UBYTE Id_0x00 1 2 0 255 ECU_ADDRESS 0x0 /end MEASUREMENT
/begin MEASUREMENT ASWNM_u8CurrentState[15] "ASWNM_u8CurrentState[15]" UBYTE Id_0x00 1 2 0 255 ECU_ADDRESS 0x0 /end MEASUREMENT
/begin MEASUREMENT ASWNM_u8CurrentState[16] "ASWNM_u8CurrentState[16]" UBYTE Id_0x00 1 2 0 255 ECU_ADDRESS 0x0 /end MEASUREMENT
/begin MEASUREMENT ASWNM_u8CurrentState[17] "ASWNM_u8CurrentState[17]" UBYTE Id_0x00 1 2 0 255 ECU_ADDRESS 0x0 /end MEASUREMENT
/begin MEASUREMENT ASWNM_u8CurrentState[18] "ASWNM_u8CurrentState[18]" UBYTE Id_0x00 1 2 0 255 ECU_ADDRESS 0x0 /end MEASUREMENT
/begin MEASUREMENT ASWNM_u8CurrentState[19] "ASWNM_u8CurrentState[19]" UBYTE Id_0x00 1 2 0 255 ECU_ADDRESS 0x0 /end MEASUREMENT
/begin MEASUREMENT ASWNM_u8CurrentState[1] "ASWNM_u8CurrentState[1]" UBYTE Id_0x00 1 2 0 255 ECU_ADDRESS 0x0 /end MEASUREMENT
/begin MEASUREMENT ASWNM_u8CurrentState[20] "ASWNM_u8CurrentState[20]" UBYTE Id_0x00 1 2 0 255 ECU_ADDRESS 0x0 /end MEASUREMENT
/begin MEASUREMENT ASWNM_u8CurrentState[2] "ASWNM_u8CurrentState[2]" UBYTE Id_0x00 1 2 0 255 ECU_ADDRESS 0x0 /end MEASUREMENT
/begin MEASUREMENT ASWNM_u8CurrentState[3] "ASWNM_u8CurrentState[3]" UBYTE Id_0x00 1 2 0 255 ECU_ADDRESS 0x0 /end MEASUREMENT
/begin MEASUREMENT ASWNM_u8CurrentState[4] "ASWNM_u8CurrentState[4]" UBYTE Id_0x00 1 2 0 255 ECU_ADDRESS 0x0 /end MEASUREMENT
/begin MEASUREMENT ASWNM_u8CurrentState[5] "ASWNM_u8CurrentState[5]" UBYTE Id_0x00 1 2 0 255 ECU_ADDRESS 0x0 /end MEASUREMENT
/begin MEASUREMENT ASWNM_u8CurrentState[6] "ASWNM_u8CurrentState[6]" UBYTE Id_0x00 1 2 0 255 ECU_ADDRESS 0x0 /end MEASUREMENT
/begin MEASUREMENT ASWNM_u8CurrentState[7] "ASWNM_u8CurrentState[7]" UBYTE Id_0x00 1 2 0 255 ECU_ADDRESS 0x0 /end MEASUREMENT
/begin MEASUREMENT ASWNM_u8CurrentState[8] "ASWNM_u8CurrentState[8]" UBYTE Id_0x00 1 2 0 255 ECU_ADDRESS 0x0 /end MEASUREMENT
/begin MEASUREMENT ASWNM_u8CurrentState[9] "ASWNM_u8CurrentState[9]" UBYTE Id_0x00 1 2 0 255 ECU_ADDRESS 0x0 /end MEASUREMENT
/begin MEASUREMENT Calibration_debut "Calibration_debut" UWORD I_1 1 2 0 65535 ECU_ADDRESS 0x0 /end MEASUREMENT
/begin MEASUREMENT Core0_f32Asw100msLoad "..." FLOAT32_IEEE F_1_p0_21 1 2 -3.402823466E+038 3.402823466E+038 ECU_ADDRESS 0x0 /end MEASUREMENT
/begin MEASUREMENT Core0_f32Asw10msLoad "..." FLOAT32_IEEE F_1_p0_21 1 2 -3.402823466E+038 3.402823466E+038 ECU_ADDRESS 0x0 /end MEASUREMENT
/begin MEASUREMENT Core0_f32Bsw100msLoad "..." FLOAT32_IEEE F_1_p0_21 1 2 -3.402823466E+038 3.402823466E+038 ECU_ADDRESS 0x0 /end MEASUREMENT
/begin MEASUREMENT Core0_f32Bsw10msLoad "..." FLOAT32_IEEE F_1_p0_21 1 2 -3.402823466E+038 3.402823466E+038 ECU_ADDRESS 0x0 /end MEASUREMENT
/begin MEASUREMENT Core0_f32Bsw1msLoad "..." FLOAT32_IEEE F_1_p0_21 1 2 -3.402823466E+038 3.402823466E+038 ECU_ADDRESS 0x0 /end MEASUREMENT
/begin MEASUREMENT Core0_f32Bsw50msLoad "..." FLOAT32_IEEE F_1_p0_21 1 2 -3.402823466E+038 3.402823466E+038 ECU_ADDRESS 0x0 /end MEASUREMENT
/begin MEASUREMENT Core0_f32ModReqLoad "..." FLOAT32_IEEE F_1_p0_21 1 2 -3.402823466E+038 3.402823466E+038 ECU_ADDRESS 0x0 /end MEASUREMENT
/begin MEASUREMENT Core0_f32VsiTreatmentLoad "..." FLOAT32_IEEE F_1_p0_21 1 2 -3.402823466E+038 3.402823466E+038 ECU_ADDRESS 0x0 /end MEASUREMENT
/begin MEASUREMENT Core1_f32Asw10msLoad "..." FLOAT32_IEEE F_1_p0_21 1 2 -3.402823466E+038 3.402823466E+038 ECU_ADDRESS 0x0 /end MEASUREMENT
/begin MEASUREMENT Core1_f32Asw1msLoad "..." FLOAT32_IEEE F_1_p0_21 1 2 -3.402823466E+038 3.402823466E+038 ECU_ADDRESS 0x0 /end MEASUREMENT
/begin MEASUREMENT Core1_f32Bsw10msLoad "..." FLOAT32_IEEE F_1_p0_21 1 2 -3.402823466E+038 3.402823466E+038 ECU_ADDRESS 0x0 /end MEASUREMENT
/begin MEASUREMENT Core1_f32PosTreatmentLoad "..." FLOAT32_IEEE F_1_p0_21 1 2 -3.402823466E+038 3.402823466E+038 ECU_ADDRESS 0x0 /end MEASUREMENT
/begin MEASUREMENT Core2_f32Asw10msLoad "..." FLOAT32_IEEE F_1_p0_21 1 2 -3.402823466E+038 3.402823466E+038 ECU_ADDRESS 0x0 /end MEASUREMENT
/begin MEASUREMENT Core2_f32Asw1msLoad "..." FLOAT32_IEEE F_1_p0_21 1 2 -3.402823466E+038 3.402823466E+038 ECU_ADDRESS 0x0 /end MEASUREMENT
/begin MEASUREMENT Core2_f32BldcTreatmentLoad "..." FLOAT32_IEEE F_1_p0_21 1 2 -3.402823466E+038 3.402823466E+038 ECU_ADDRESS 0x0 /end MEASUREMENT
/begin MEASUREMENT Core2_f32Bsw10msLoad "..." FLOAT32_IEEE F_1_p0_21 1 2 -3.402823466E+038 3.402823466E+038 ECU_ADDRESS 0x0 /end MEASUREMENT
/begin MEASUREMENT FAULT_FF_bFrameLock_FF1 "FAULT_FF_bFrameLock_FF1" UBYTE Bool_ON_OFF 1 2 0 1 BIT_MASK 0x01 ECU_ADDRESS 0x0 /end MEASUREMENT
/begin MEASUREMENT FF_FF1_BMS_HVBusVolt "FF_FF1_BMS_HVBusVolt" UWORD F_1_p0_4 1 2 0 65535 ECU_ADDRESS 0x36 /end MEASUREMENT
/begin MEASUREMENT FF_FF1_BatteryVoltage "FF_FF1_BatteryVoltage" UWORD F_1_p0_4 1 2 0 65535 ECU_ADDRESS 0x2 /end MEASUREMENT
/begin MEASUREMENT FF_FF1_CosScaled "FF_FF1_CosScaled" UWORD F_1_p0_4 1 2 0 65535 ECU_ADDRESS 0x4E /end MEASUREMENT
/begin MEASUREMENT FF_FF1_DC_Current "FF_FF1_DC_Current" UWORD F_1_p0_4 1 2 0 65535 ECU_ADDRESS 0x30 /end MEASUREMENT
/begin MEASUREMENT FF_FF1_DrivingPermission "FF_FF1_DrivingPermission" UBYTE F_1_p0_4 1 2 0 255 ECU_ADDRESS 0x12 /end MEASUREMENT
/begin MEASUREMENT FF_FF1_EngineSpeed "FF_FF1_EngineSpeed" UWORD F_1_p0_4 1 2 0 65535 ECU_ADDRESS 0x10 /end MEASUREMENT
/begin MEASUREMENT FF_FF1_EstimTempSecFild "FF_FF1_EstimTempSecFild" UWORD F_1_p0_4 1 2 0 65535 ECU_ADDRESS 0x70 /end MEASUREMENT
/begin MEASUREMENT FF_FF1_ExcVoltageFild "FF_FF1_ExcVoltageFild" UWORD F_1_p0_4 1 2 0 65535 ECU_ADDRESS 0x50 /end MEASUREMENT
/begin MEASUREMENT FF_FF1_ExcitationDiag "FF_FF1_ExcitationDiag" UWORD F_1_p0_4 1 2 0 65535 ECU_ADDRESS 0x52 /end MEASUREMENT
/begin MEASUREMENT FF_FF1_FPGA_FaultA "FF_FF1_FPGA_FaultA" UWORD F_1_p0_4 1 2 0 65535 ECU_ADDRESS 0x3A /end MEASUREMENT
/begin MEASUREMENT FF_FF1_FPGA_FaultB "FF_FF1_FPGA_FaultB" UWORD F_1_p0_4 1 2 0 65535 ECU_ADDRESS 0x3C /end MEASUREMENT
/begin MEASUREMENT FF_FF1_FTModeReq "FF_FF1_FTModeReq" UWORD F_1_p0_4 1 2 0 65535 ECU_ADDRESS 0x46 /end MEASUREMENT
/begin MEASUREMENT FF_FF1_FT_AclState "FF_FF1_FT_AclState" UWORD F_1_p0_4 1 2 0 65535 ECU_ADDRESS 0x48 /end MEASUREMENT
/begin MEASUREMENT FF_FF1_GlbRealTimeDay "FF_FF1_GlbRealTimeDay" UBYTE F_1_p0_4 1 2 0 255 ECU_ADDRESS 0xD /end MEASUREMENT
/begin MEASUREMENT FF_FF1_GlbRealTimeHour "FF_FF1_GlbRealTimeHour" UBYTE F_1_p0_4 1 2 0 255 ECU_ADDRESS 0xC /end MEASUREMENT
/begin MEASUREMENT FF_FF1_GlbRealTimeMinute "FF_FF1_GlbRealTimeMinute" UBYTE F_1_p0_4 1 2 0 255 ECU_ADDRESS 0xB /end MEASUREMENT
/begin MEASUREMENT FF_FF1_GlbRealTimeMonth "FF_FF1_GlbRealTimeMonth" UBYTE F_1_p0_4 1 2 0 255 ECU_ADDRESS 0xE /end MEASUREMENT
/begin MEASUREMENT FF_FF1_GlbRealTimeSec "FF_FF1_GlbRealTimeSec" UBYTE F_1_p0_4 1 2 0 255 ECU_ADDRESS 0xA /end MEASUREMENT
/begin MEASUREMENT FF_FF1_GlbRealTimeYear "FF_FF1_GlbRealTimeYear" UBYTE F_1_p0_4 1 2 0 255 ECU_ADDRESS 0xF /end MEASUREMENT
/begin MEASUREMENT FF_FF1_HV_VoltageFild "FF_FF1_HV_VoltageFild" UWORD F_1_p0_4 1 2 0 65535 ECU_ADDRESS 0x1E /end MEASUREMENT
/begin MEASUREMENT FF_FF1_I0dq3_1 "FF_FF1_I0dq3_1" UWORD F_1_p0_4 1 2 0 65535 ECU_ADDRESS 0x68 /end MEASUREMENT
/begin MEASUREMENT FF_FF1_I0dq3_2 "FF_FF1_I0dq3_2" UWORD F_1_p0_4 1 2 0 65535 ECU_ADDRESS 0x6A /end MEASUREMENT
/begin MEASUREMENT FF_FF1_IGBTStatus "FF_FF1_IGBTStatus" UBYTE F_1_p0_4 1 2 0 255 ECU_ADDRESS 0x1C /end MEASUREMENT
/begin MEASUREMENT FF_FF1_IPUMode "FF_FF1_IPUMode" UBYTE F_1_p0_4 1 2 0 255 ECU_ADDRESS 0x24 /end MEASUREMENT
/begin MEASUREMENT FF_FF1_ISGCurrentTorq "FF_FF1_ISGCurrentTorq" UWORD F_1_p0_4 1 2 0 65535 ECU_ADDRESS 0x32 /end MEASUREMENT
/begin MEASUREMENT FF_FF1_IgnitionSwSig "FF_FF1_IgnitionSwSig" UBYTE F_1_p0_4 1 2 0 255 ECU_ADDRESS 0x0 /end MEASUREMENT
/begin MEASUREMENT FF_FF1_Iu "FF_FF1_Iu" UWORD F_1_p0_4 1 2 0 65535 ECU_ADDRESS 0x16 /end MEASUREMENT
/begin MEASUREMENT FF_FF1_Iv "FF_FF1_Iv" UWORD F_1_p0_4 1 2 0 65535 ECU_ADDRESS 0x18 /end MEASUREMENT
/begin MEASUREMENT FF_FF1_Iw "FF_FF1_Iw" UWORD F_1_p0_4 1 2 0 65535 ECU_ADDRESS 0x1A /end MEASUREMENT
/begin MEASUREMENT FF_FF1_MCU_HVBusVolt "FF_FF1_MCU_HVBusVolt" UWORD F_1_p0_4 1 2 0 65535 ECU_ADDRESS 0x38 /end MEASUREMENT
/begin MEASUREMENT FF_FF1_MaxMinTorqueDrtVect "FF_FF1_MaxMinTorqueDrtVect" UWORD F_1_p0_4 1 2 0 65535 ECU_ADDRESS 0x54 /end MEASUREMENT
/begin MEASUREMENT FF_FF1_MecaSpeedRpm "FF_FF1_MecaSpeedRpm" UWORD F_1_p0_4 1 2 0 65535 ECU_ADDRESS 0x22 /end MEASUREMENT
/begin MEASUREMENT FF_FF1_MecaTorqueMaxMin "FF_FF1_MecaTorqueMaxMin" UWORD F_1_p0_4 1 2 0 65535 ECU_ADDRESS 0x4A /end MEASUREMENT
/begin MEASUREMENT FF_FF1_MotTemp "FF_FF1_MotTemp" UBYTE F_1_p0_4 1 2 0 255 ECU_ADDRESS 0x20 /end MEASUREMENT
/begin MEASUREMENT FF_FF1_ParkVoltageTgt "FF_FF1_ParkVoltageTgt" UWORD F_1_p0_4 1 2 0 65535 ECU_ADDRESS 0x5C /end MEASUREMENT
/begin MEASUREMENT FF_FF1_RMS_Cur_U "FF_FF1_RMS_Cur_U" UWORD F_1_p0_4 1 2 0 65535 ECU_ADDRESS 0x28 /end MEASUREMENT
/begin MEASUREMENT FF_FF1_RMS_Cur_V "FF_FF1_RMS_Cur_V" UWORD F_1_p0_4 1 2 0 65535 ECU_ADDRESS 0x2A /end MEASUREMENT
/begin MEASUREMENT FF_FF1_RMS_Cur_W "FF_FF1_RMS_Cur_W" UWORD F_1_p0_4 1 2 0 65535 ECU_ADDRESS 0x2C /end MEASUREMENT
/begin MEASUREMENT FF_FF1_ResolNext2ThetaRdByPi "FF_FF1_ResolNext2ThetaRdByPi" UWORD F_1_p0_4 1 2 0 65535 ECU_ADDRESS 0x56 /end MEASUREMENT
/begin MEASUREMENT FF_FF1_RstStartUpCnt "FF_FF1_RstStartUpCnt" UWORD F_1_p0_4 1 2 0 65535 ECU_ADDRESS 0x3E /end MEASUREMENT
/begin MEASUREMENT FF_FF1_SOC "FF_FF1_SOC" UBYTE F_1_p0_4 1 2 0 255 ECU_ADDRESS 0x13 /end MEASUREMENT
/begin MEASUREMENT FF_FF1_SinScaled "FF_FF1_SinScaled" UWORD F_1_p0_4 1 2 0 65535 ECU_ADDRESS 0x4C /end MEASUREMENT
/begin MEASUREMENT FF_FF1_TempCmdBoard "FF_FF1_TempCmdBoard" UBYTE F_1_p0_4 1 2 0 255 ECU_ADDRESS 0x26 /end MEASUREMENT
/begin MEASUREMENT FF_FF1_TempCoolingFild "FF_FF1_TempCoolingFild" UBYTE F_1_p0_4 1 2 0 255 ECU_ADDRESS 0x14 /end MEASUREMENT
/begin MEASUREMENT FF_FF1_TempDrvBoard "FF_FF1_TempDrvBoard" UWORD F_1_p0_4 1 2 0 65535 ECU_ADDRESS 0x6C /end MEASUREMENT
/begin MEASUREMENT FF_FF1_TempIgbt "FF_FF1_TempIgbt" UWORD F_1_p0_4 1 2 0 65535 ECU_ADDRESS 0x6E /end MEASUREMENT
/begin MEASUREMENT FF_FF1_TimestampIgn "FF_FF1_TimestampIgn" UWORD F_1_p0_4 1 2 0 65535 ECU_ADDRESS 0x40 /end MEASUREMENT
/begin MEASUREMENT FF_FF1_TimestampLife_H "FF_FF1_TimestampLife_H" UWORD F_1_p0_4 1 2 0 65535 ECU_ADDRESS 0x42 /end MEASUREMENT
/begin MEASUREMENT FF_FF1_TimestampLife_L "FF_FF1_TimestampLife_L" UWORD F_1_p0_4 1 2 0 65535 ECU_ADDRESS 0x44 /end MEASUREMENT
/begin MEASUREMENT FF_FF1_TotalMiles_H "FF_FF1_TotalMiles_H" UWORD F_1_p0_4 1 2 0 65535 ECU_ADDRESS 0x4 /end MEASUREMENT
/begin MEASUREMENT FF_FF1_TotalMiles_L "FF_FF1_TotalMiles_L" UWORD F_1_p0_4 1 2 0 65535 ECU_ADDRESS 0x6 /end MEASUREMENT
/begin MEASUREMENT FF_FF1_UM1dTgt "FF_FF1_UM1dTgt" UWORD F_1_p0_4 1 2 0 65535 ECU_ADDRESS 0x58 /end MEASUREMENT
/begin MEASUREMENT FF_FF1_UM1qTgt "FF_FF1_UM1qTgt" UWORD F_1_p0_4 1 2 0 65535 ECU_ADDRESS 0x5A /end MEASUREMENT
/begin MEASUREMENT FF_FF1_VCU_AllowTorq "FF_FF1_VCU_AllowTorq" UBYTE F_1_p0_4 1 2 0 255 ECU_ADDRESS 0x34 /end MEASUREMENT
/begin MEASUREMENT FF_FF1_VCU_DCU_ModeReq "FF_FF1_VCU_DCU_ModeReq" UBYTE F_1_p0_4 1 2 0 255 ECU_ADDRESS 0x25 /end MEASUREMENT
/begin MEASUREMENT FF_FF1_VCU_DCU_TorqSet "FF_FF1_VCU_DCU_TorqSet" UWORD F_1_p0_4 1 2 0 65535 ECU_ADDRESS 0x2E /end MEASUREMENT
/begin MEASUREMENT FF_FF1_VehicleSpd "FF_FF1_VehicleSpd" UWORD F_1_p0_4 1 2 0 65535 ECU_ADDRESS 0x8 /end MEASUREMENT
/begin MEASUREMENT FF_FF1_i0dqTgt3_1 "FF_FF1_i0dqTgt3_1" UWORD F_1_p0_4 1 2 0 65535 ECU_ADDRESS 0x64 /end MEASUREMENT
/begin MEASUREMENT FF_FF1_i0dqTgt3_2 "FF_FF1_i0dqTgt3_2" UWORD F_1_p0_4 1 2 0 65535 ECU_ADDRESS 0x66 /end MEASUREMENT
/begin MEASUREMENT FF_FF1_idCorTgt "FF_FF1_idCorTgt" UWORD F_1_p0_4 1 2 0 65535 ECU_ADDRESS 0x62 /end MEASUREMENT
/begin MEASUREMENT FF_FF1_idLutTgt "FF_FF1_idLutTgt" UWORD F_1_p0_4 1 2 0 65535 ECU_ADDRESS 0x60 /end MEASUREMENT
/begin MEASUREMENT FF_FF1_iqLutTgt "FF_FF1_iqLutTgt" UWORD F_1_p0_4 1 2 0 65535 ECU_ADDRESS 0x5E /end MEASUREMENT
/begin MEASUREMENT FRecord_u8ClearReq "..." UBYTE I_1 1 2 0 255 ECU_ADDRESS 0x0 /end MEASUREMENT
/begin MEASUREMENT FRecord_u8EventWriteState "..." UBYTE I_1 1 2 0 255 ECU_ADDRESS 0x0 /end MEASUREMENT
/begin MEASUREMENT FRecord_u8FRLockedStatus "..." UBYTE I_1 1 2 0 255 ECU_ADDRESS 0x0 /end MEASUREMENT
/begin MEASUREMENT FRecord_u8FRStoreState "..." UBYTE I_1 1 2 0 255 ECU_ADDRESS 0x0 /end MEASUREMENT
/begin MEASUREMENT FRecord_u8HeadWriteState "..." UBYTE I_1 1 2 0 255 ECU_ADDRESS 0x0 /end MEASUREMENT
/begin MEASUREMENT FaultTCUCAP0_CAPPressureHAut "FaultTCUCAP0_CAPPressureHAut" UBYTE Bool_ON_OFF 1 2 0 1 BIT_MASK 0x01 ECU_ADDRESS 0x36 /end MEASUREMENT
/begin MEASUREMENT FaultTCUCAP0_CAPPressureHCounter "FaultTCUCAP0_CAPPressureHCount" UBYTE I_1 1 2 0 255 ECU_ADDRESS 0x44 /end MEASUREMENT
/begin MEASUREMENT FaultTCUCAP0_CAPPressureHDetected "FaultTCUCAP0_CAPPressureHDetected" UBYTE Bool_ON_OFF 1 2 0 1 BIT_MASK 0x01 ECU_ADDRESS 0x36 /end MEASUREMENT
/begin MEASUREMENT FaultTCUCAP0_CAPPressureHLogged "FaultTCUCAP0_CAPPressureHLogged" UBYTE Bool_ON_OFF 1 2 0 1 BIT_MASK 0x01 ECU_ADDRESS 0x36 /end MEASUREMENT
/begin MEASUREMENT FaultTCUCAP0_CAPPressureLAut "FaultTCUCAP0_CAPPressureLAut" UBYTE Bool_ON_OFF 1 2 0 1 BIT_MASK 0x02 ECU_ADDRESS 0x36 /end MEASUREMENT
/begin MEASUREMENT FaultTCUCAP0_CAPPressureLCounter "FaultTCUCAP0_CAPPressureLCount" UBYTE I_1 1 2 0 255 ECU_ADDRESS 0x45 /end MEASUREMENT
/begin MEASUREMENT FaultTCUCAP0_CAPPressureLDetected "FaultTCUCAP0_CAPPressureLDetected" UBYTE Bool_ON_OFF 1 2 0 1 BIT_MASK 0x02 ECU_ADDRESS 0x36 /end MEASUREMENT
/begin MEASUREMENT FaultTCUCAP0_CAPPressureLLogged "FaultTCUCAP0_CAPPressureLLogged" UBYTE Bool_ON_OFF 1 2 0 1 BIT_MASK 0x02 ECU_ADDRESS 0x36 /end MEASUREMENT
/begin MEASUREMENT FaultTCUCAP0_CAPPressureOverHAut "FaultTCUCAP0_CAPPressureOverHAut" UBYTE Bool_ON_OFF 1 2 0 1 BIT_MASK 0x04 ECU_ADDRESS 0x36 /end MEASUREMENT
/begin MEASUREMENT FaultTCUCAP0_CAPPressureOverHCounter "FaultTCUCAP0_CAPPressureOverHCount" UBYTE I_1 1 2 0 255 ECU_ADDRESS 0x46 /end MEASUREMENT
/begin MEASUREMENT FaultTCUCAP0_CAPPressureOverHDetected "FaultTCUCAP0_CAPPressureOverHDetected" UBYTE Bool_ON_OFF 1 2 0 1 BIT_MASK 0x04 ECU_ADDRESS 0x36 /end MEASUREMENT
/begin MEASUREMENT FaultTCUCAP0_CAPPressureOverHLogged "FaultTCUCAP0_CAPPressureOverHLogged" UBYTE Bool_ON_OFF 1 2 0 1 BIT_MASK 0x04 ECU_ADDRESS 0x36 /end MEASUREMENT
/begin MEASUREMENT FaultTCUCAP0_CAPSlipAut "FaultTCUCAP0_CAPSlipAut" UBYTE Bool_ON_OFF 1 2 0 1 BIT_MASK 0x08 ECU_ADDRESS 0x36 /end MEASUREMENT
/begin MEASUREMENT FaultTCUCAP0_CAPSlipCounter "FaultTCUCAP0_CAPSlipCount" UBYTE I_1 1 2 0 255 ECU_ADDRESS 0x47 /end MEASUREMENT
/begin MEASUREMENT FaultTCUCAP0_CAPSlipDetected "FaultTCUCAP0_CAPSlipDetected" UBYTE Bool_ON_OFF 1 2 0 1 BIT_MASK 0x08 ECU_ADDRESS 0x36 /end MEASUREMENT
/begin MEASUREMENT FaultTCUCAP0_CAPSlipLogged "FaultTCUCAP0_CAPSlipLogged" UBYTE Bool_ON_OFF 1 2 0 1 BIT_MASK 0x08 ECU_ADDRESS 0x36 /end MEASUREMENT
/begin MEASUREMENT FaultTCUCAP0_Detected "FaultTCUCAP0_Detected" UWORD I_1 1 2 0 65535 ECU_ADDRESS 0x36 /end MEASUREMENT
/begin MEASUREMENT FaultTCUCAP0_DragMomentHAut "FaultTCUCAP0_DragMomentHAut" UBYTE Bool_ON_OFF 1 2 0 1 BIT_MASK 0x10 ECU_ADDRESS 0x36 /end MEASUREMENT
/begin MEASUREMENT FaultTCUCAP0_DragMomentHCounter "FaultTCUCAP0_DragMomentHCount" UBYTE I_1 1 2 0 255 ECU_ADDRESS 0x48 /end MEASUREMENT
/begin MEASUREMENT FaultTCUCAP0_DragMomentHDetected "FaultTCUCAP0_DragMomentHDetected" UBYTE Bool_ON_OFF 1 2 0 1 BIT_MASK 0x10 ECU_ADDRESS 0x36 /end MEASUREMENT
/begin MEASUREMENT FaultTCUCAP0_DragMomentHLogged "FaultTCUCAP0_DragMomentHLogged" UBYTE Bool_ON_OFF 1 2 0 1 BIT_MASK 0x10 ECU_ADDRESS 0x36 /end MEASUREMENT
/begin MEASUREMENT FaultTCUCAP0_HLSinInvalidAut "FaultTCUCAP0_HLSinInvalidAut" UBYTE Bool_ON_OFF 1 2 0 1 BIT_MASK 0x20 ECU_ADDRESS 0x36 /end MEASUREMENT
/begin MEASUREMENT FaultTCUCAP0_HLSinInvalidCounter "FaultTCUCAP0_HLSinInvalidCount" UBYTE I_1 1 2 0 255 ECU_ADDRESS 0x49 /end MEASUREMENT
/begin MEASUREMENT FaultTCUCAP0_HLSinInvalidDetected "FaultTCUCAP0_HLSinInvalidDetected" UBYTE Bool_ON_OFF 1 2 0 1 BIT_MASK 0x20 ECU_ADDRESS 0x36 /end MEASUREMENT
/begin MEASUREMENT FaultTCUCAP0_HLSinInvalidLogged "FaultTCUCAP0_HLSinInvalidLogged" UBYTE Bool_ON_OFF 1 2 0 1 BIT_MASK 0x20 ECU_ADDRESS 0x36 /end MEASUREMENT
/begin MEASUREMENT FaultTCUCAP0_HLSinUndefineAut "FaultTCUCAP0_HLSinUndefineAut" UBYTE Bool_ON_OFF 1 2 0 1 BIT_MASK 0x40 ECU_ADDRESS 0x36 /end MEASUREMENT
/begin MEASUREMENT FaultTCUCAP0_HLSinUndefineCounter "FaultTCUCAP0_HLSinUndefineCount" UBYTE I_1 1 2 0 255 ECU_ADDRESS 0x4A /end MEASUREMENT
/begin MEASUREMENT FaultTCUCAP0_HLSinUndefineDetected "FaultTCUCAP0_HLSinUndefineDetected" UBYTE Bool_ON_OFF 1 2 0 1 BIT_MASK 0x40 ECU_ADDRESS 0x36 /end MEASUREMENT
/begin MEASUREMENT FaultTCUCAP0_HLSinUndefineLogged "FaultTCUCAP0_HLSinUndefineLogged" UBYTE Bool_ON_OFF 1 2 0 1 BIT_MASK 0x40 ECU_ADDRESS 0x36 /end MEASUREMENT
/begin MEASUREMENT FaultTCUCAP0_HLSupplyHAut "FaultTCUCAP0_HLSupplyHAut" UBYTE Bool_ON_OFF 1 2 0 1 BIT_MASK 0x80 ECU_ADDRESS 0x36 /end MEASUREMENT
/begin MEASUREMENT FaultTCUCAP0_HLSupplyHCounter "FaultTCUCAP0_HLSupplyHCount" UBYTE I_1 1 2 0 255 ECU_ADDRESS 0x4B /end MEASUREMENT
/begin MEASUREMENT FaultTCUCAP0_HLSupplyHDetected "FaultTCUCAP0_HLSupplyHDetected" UBYTE Bool_ON_OFF 1 2 0 1 BIT_MASK 0x80 ECU_ADDRESS 0x36 /end MEASUREMENT
/begin MEASUREMENT FaultTCUCAP0_HLSupplyHLogged "FaultTCUCAP0_HLSupplyHLogged" UBYTE Bool_ON_OFF 1 2 0 1 BIT_MASK 0x80 ECU_ADDRESS 0x36 /end MEASUREMENT
/begin MEASUREMENT FaultTCUCAP0_HLSupplyLAut "FaultTCUCAP0_HLSupplyLAut" UBYTE Bool_ON_OFF 1 2 0 1 BIT_MASK 0x01 ECU_ADDRESS 0x37 /end MEASUREMENT
/begin MEASUREMENT FaultTCUCAP0_HLSupplyLCounter "FaultTCUCAP0_HLSupplyLCount" UBYTE I_1 1 2 0 255 ECU_ADDRESS 0x4C /end MEASUREMENT
/begin MEASUREMENT FaultTCUCAP0_HLSupplyLDetected "FaultTCUCAP0_HLSupplyLDetected" UBYTE Bool_ON_OFF 1 2 0 1 BIT_MASK 0x01 ECU_ADDRESS 0x37 /end MEASUREMENT
/begin MEASUREMENT FaultTCUCAP0_HLSupplyLLogged "FaultTCUCAP0_HLSupplyLLogged" UBYTE Bool_ON_OFF 1 2 0 1 BIT_MASK 0x01 ECU_ADDRESS 0x37 /end MEASUREMENT
/begin MEASUREMENT FaultTCUCAP0_Logged "FaultTCUCAP0_Logged" UWORD I_1 1 2 0 65535 ECU_ADDRESS 0x36 /end MEASUREMENT
/begin MEASUREMENT FaultTCUCAP0_MotorPhaseVolHAut "FaultTCUCAP0_MotorPhaseVolHAut" UBYTE Bool_ON_OFF 1 2 0 1 BIT_MASK 0x02 ECU_ADDRESS 0x37 /end MEASUREMENT
/begin MEASUREMENT FaultTCUCAP0_MotorPhaseVolHCounter "FaultTCUCAP0_MotorPhaseVolHCount" UBYTE I_1 1 2 0 255 ECU_ADDRESS 0x4D /end MEASUREMENT
/begin MEASUREMENT FaultTCUCAP0_MotorPhaseVolHDetected "FaultTCUCAP0_MotorPhaseVolHDetected" UBYTE Bool_ON_OFF 1 2 0 1 BIT_MASK 0x02 ECU_ADDRESS 0x37 /end MEASUREMENT
/begin MEASUREMENT FaultTCUCAP0_MotorPhaseVolHLogged "FaultTCUCAP0_MotorPhaseVolHLogged" UBYTE Bool_ON_OFF 1 2 0 1 BIT_MASK 0x02 ECU_ADDRESS 0x37 /end MEASUREMENT
/begin MEASUREMENT FaultTCUCAP0_PressureRationalAut "FaultTCUCAP0_PressureRationalAut" UBYTE Bool_ON_OFF 1 2 0 1 BIT_MASK 0x04 ECU_ADDRESS 0x37 /end MEASUREMENT
/begin MEASUREMENT FaultTCUCAP0_PressureRationalCounter "FaultTCUCAP0_PressureRationalCount" UBYTE I_1 1 2 0 255 ECU_ADDRESS 0x4E /end MEASUREMENT
/begin MEASUREMENT FaultTCUCAP0_PressureRationalDetected "FaultTCUCAP0_PressureRationalDetected" UBYTE Bool_ON_OFF 1 2 0 1 BIT_MASK 0x04 ECU_ADDRESS 0x37 /end MEASUREMENT
/begin MEASUREMENT FaultTCUCAP0_PressureRationalLogged "FaultTCUCAP0_PressureRationalLogged" UBYTE Bool_ON_OFF 1 2 0 1 BIT_MASK 0x04 ECU_ADDRESS 0x37 /end MEASUREMENT
/begin MEASUREMENT FaultTCUCAP0_SenSigOpenOrGNDAut "FaultTCUCAP0_SenSigOpenOrGNDAut" UBYTE Bool_ON_OFF 1 2 0 1 BIT_MASK 0x08 ECU_ADDRESS 0x37 /end MEASUREMENT
/begin MEASUREMENT FaultTCUCAP0_SenSigOpenOrGNDCounter "FaultTCUCAP0_SenSigOpenOrGNDCount" UBYTE I_1 1 2 0 255 ECU_ADDRESS 0x4F /end MEASUREMENT
/begin MEASUREMENT FaultTCUCAP0_SenSigOpenOrGNDDetected "FaultTCUCAP0_SenSigOpenOrGNDDetected" UBYTE Bool_ON_OFF 1 2 0 1 BIT_MASK 0x08 ECU_ADDRESS 0x37 /end MEASUREMENT
/begin MEASUREMENT FaultTCUCAP0_SenSigOpenOrGNDLogged "FaultTCUCAP0_SenSigOpenOrGNDLogged" UBYTE Bool_ON_OFF 1 2 0 1 BIT_MASK 0x08 ECU_ADDRESS 0x37 /end MEASUREMENT
/begin MEASUREMENT FaultTCUCAP0_SenSigVCCAut "FaultTCUCAP0_SenSigVCCAut" UBYTE Bool_ON_OFF 1 2 0 1 BIT_MASK 0x10 ECU_ADDRESS 0x37 /end MEASUREMENT
/begin MEASUREMENT FaultTCUCAP0_SenSigVCCCounter "FaultTCUCAP0_SenSigVCCCount" UBYTE I_1 1 2 0 255 ECU_ADDRESS 0x50 /end MEASUREMENT
/begin MEASUREMENT FaultTCUCAP0_SenSigVCCDetected "FaultTCUCAP0_SenSigVCCDetected" UBYTE Bool_ON_OFF 1 2 0 1 BIT_MASK 0x10 ECU_ADDRESS 0x37 /end MEASUREMENT
/begin MEASUREMENT FaultTCUCAP0_SenSigVCCLogged "FaultTCUCAP0_SenSigVCCLogged" UBYTE Bool_ON_OFF 1 2 0 1 BIT_MASK 0x10 ECU_ADDRESS 0x37 /end MEASUREMENT
/begin MEASUREMENT FaultTCUCAP0_SensorPerforErrAut "FaultTCUCAP0_SensorPerforErrAut" UBYTE Bool_ON_OFF 1 2 0 1 BIT_MASK 0x20 ECU_ADDRESS 0x37 /end MEASUREMENT
/begin MEASUREMENT FaultTCUCAP0_SensorPerforErrCounter "FaultTCUCAP0_SensorPerforErrCount" UBYTE I_1 1 2 0 255 ECU_ADDRESS 0x51 /end MEASUREMENT
/begin MEASUREMENT FaultTCUCAP0_SensorPerforErrDetected "FaultTCUCAP0_SensorPerforErrDetected" UBYTE Bool_ON_OFF 1 2 0 1 BIT_MASK 0x20 ECU_ADDRESS 0x37 /end MEASUREMENT
/begin MEASUREMENT FaultTCUCAP0_SensorPerforErrLogged "FaultTCUCAP0_SensorPerforErrLogged" UBYTE Bool_ON_OFF 1 2 0 1 BIT_MASK 0x20 ECU_ADDRESS 0x37 /end MEASUREMENT
/begin MEASUREMENT FaultTCUCAP1_COM_GCUAut "FaultTCUCAP1_COM_GCUAut" UBYTE Bool_ON_OFF 1 2 0 1 BIT_MASK 0x01 ECU_ADDRESS 0x38 /end MEASUREMENT
/begin MEASUREMENT FaultTCUCAP1_COM_GCUCounter "FaultTCUCAP1_COM_GCUCount" UBYTE I_1 1 2 0 255 ECU_ADDRESS 0x52 /end MEASUREMENT
/begin MEASUREMENT FaultTCUCAP1_COM_GCUDetected "FaultTCUCAP1_COM_GCUDetected" UBYTE Bool_ON_OFF 1 2 0 1 BIT_MASK 0x01 ECU_ADDRESS 0x38 /end MEASUREMENT
/begin MEASUREMENT FaultTCUCAP1_COM_GCULogged "FaultTCUCAP1_COM_GCULogged" UBYTE Bool_ON_OFF 1 2 0 1 BIT_MASK 0x01 ECU_ADDRESS 0x38 /end MEASUREMENT
/begin MEASUREMENT FaultTCUCAP1_Detected "FaultTCUCAP1_Detected" UWORD I_1 1 2 0 65535 ECU_ADDRESS 0x38 /end MEASUREMENT
/begin MEASUREMENT FaultTCUCAP1_DriverTempHAut "FaultTCUCAP1_DriverTempHAut" UBYTE Bool_ON_OFF 1 2 0 1 BIT_MASK 0x02 ECU_ADDRESS 0x38 /end MEASUREMENT
/begin MEASUREMENT FaultTCUCAP1_DriverTempHCounter "FaultTCUCAP1_DriverTempHCount" UBYTE I_1 1 2 0 255 ECU_ADDRESS 0x53 /end MEASUREMENT
/begin MEASUREMENT FaultTCUCAP1_DriverTempHDetected "FaultTCUCAP1_DriverTempHDetected" UBYTE Bool_ON_OFF 1 2 0 1 BIT_MASK 0x02 ECU_ADDRESS 0x38 /end MEASUREMENT
/begin MEASUREMENT FaultTCUCAP1_DriverTempHLogged "FaultTCUCAP1_DriverTempHLogged" UBYTE Bool_ON_OFF 1 2 0 1 BIT_MASK 0x02 ECU_ADDRESS 0x38 /end MEASUREMENT
/begin MEASUREMENT FaultTCUCAP1_FETShortAut "FaultTCUCAP1_FETShortAut" UBYTE Bool_ON_OFF 1 2 0 1 BIT_MASK 0x04 ECU_ADDRESS 0x38 /end MEASUREMENT
/begin MEASUREMENT FaultTCUCAP1_FETShortCounter "FaultTCUCAP1_FETShortCount" UBYTE I_1 1 2 0 255 ECU_ADDRESS 0x54 /end MEASUREMENT
/begin MEASUREMENT FaultTCUCAP1_FETShortDetected "FaultTCUCAP1_FETShortDetected" UBYTE Bool_ON_OFF 1 2 0 1 BIT_MASK 0x04 ECU_ADDRESS 0x38 /end MEASUREMENT
/begin MEASUREMENT FaultTCUCAP1_FETShortLogged "FaultTCUCAP1_FETShortLogged" UBYTE Bool_ON_OFF 1 2 0 1 BIT_MASK 0x04 ECU_ADDRESS 0x38 /end MEASUREMENT
/begin MEASUREMENT FaultTCUCAP1_HWOverCurAut "FaultTCUCAP1_HWOverCurAut" UBYTE Bool_ON_OFF 1 2 0 1 BIT_MASK 0x08 ECU_ADDRESS 0x38 /end MEASUREMENT
/begin MEASUREMENT FaultTCUCAP1_HWOverCurCounter "FaultTCUCAP1_HWOverCurCount" UBYTE I_1 1 2 0 255 ECU_ADDRESS 0x55 /end MEASUREMENT
/begin MEASUREMENT FaultTCUCAP1_HWOverCurDetected "FaultTCUCAP1_HWOverCurDetected" UBYTE Bool_ON_OFF 1 2 0 1 BIT_MASK 0x08 ECU_ADDRESS 0x38 /end MEASUREMENT
/begin MEASUREMENT FaultTCUCAP1_HWOverCurLogged "FaultTCUCAP1_HWOverCurLogged" UBYTE Bool_ON_OFF 1 2 0 1 BIT_MASK 0x08 ECU_ADDRESS 0x38 /end MEASUREMENT
/begin MEASUREMENT FaultTCUCAP1_Logged "FaultTCUCAP1_Logged" UWORD I_1 1 2 0 65535 ECU_ADDRESS 0x38 /end MEASUREMENT
/begin MEASUREMENT FaultTCUCAP1_MotorPhaseDriveErrAut "FaultTCUCAP1_MotorPhaseDriveErrAut" UBYTE Bool_ON_OFF 1 2 0 1 BIT_MASK 0x10 ECU_ADDRESS 0x38 /end MEASUREMENT
/begin MEASUREMENT FaultTCUCAP1_MotorPhaseDriveErrCounter "FaultTCUCAP1_MotorPhaseDriveErrCount" UBYTE I_1 1 2 0 255 ECU_ADDRESS 0x56 /end MEASUREMENT
/begin MEASUREMENT FaultTCUCAP1_MotorPhaseDriveErrDetected "FaultTCUCAP1_MotorPhaseDriveErrDetected" UBYTE Bool_ON_OFF 1 2 0 1 BIT_MASK 0x10 ECU_ADDRESS 0x38 /end MEASUREMENT
/begin MEASUREMENT FaultTCUCAP1_MotorPhaseDriveErrLogged "FaultTCUCAP1_MotorPhaseDriveErrLogged" UBYTE Bool_ON_OFF 1 2 0 1 BIT_MASK 0x10 ECU_ADDRESS 0x38 /end MEASUREMENT
/begin MEASUREMENT FaultTCUCAP1_MotorStallAut "FaultTCUCAP1_MotorStallAut" UBYTE Bool_ON_OFF 1 2 0 1 BIT_MASK 0x20 ECU_ADDRESS 0x38 /end MEASUREMENT
/begin MEASUREMENT FaultTCUCAP1_MotorStallCounter "FaultTCUCAP1_MotorStallCount" UBYTE I_1 1 2 0 255 ECU_ADDRESS 0x57 /end MEASUREMENT
/begin MEASUREMENT FaultTCUCAP1_MotorStallDetected "FaultTCUCAP1_MotorStallDetected" UBYTE Bool_ON_OFF 1 2 0 1 BIT_MASK 0x20 ECU_ADDRESS 0x38 /end MEASUREMENT
/begin MEASUREMENT FaultTCUCAP1_MotorStallLogged "FaultTCUCAP1_MotorStallLogged" UBYTE Bool_ON_OFF 1 2 0 1 BIT_MASK 0x20 ECU_ADDRESS 0x38 /end MEASUREMENT
/begin MEASUREMENT FaultTCUCAP1_OverVoltageAut "FaultTCUCAP1_OverVoltageAut" UBYTE Bool_ON_OFF 1 2 0 1 BIT_MASK 0x40 ECU_ADDRESS 0x38 /end MEASUREMENT
/begin MEASUREMENT FaultTCUCAP1_OverVoltageCounter "FaultTCUCAP1_OverVoltageCount" UBYTE I_1 1 2 0 255 ECU_ADDRESS 0x58 /end MEASUREMENT
/begin MEASUREMENT FaultTCUCAP1_OverVoltageDetected "FaultTCUCAP1_OverVoltageDetected" UBYTE Bool_ON_OFF 1 2 0 1 BIT_MASK 0x40 ECU_ADDRESS 0x38 /end MEASUREMENT
/begin MEASUREMENT FaultTCUCAP1_OverVoltageLogged "FaultTCUCAP1_OverVoltageLogged" UBYTE Bool_ON_OFF 1 2 0 1 BIT_MASK 0x40 ECU_ADDRESS 0x38 /end MEASUREMENT
/begin MEASUREMENT FaultTCUCAP1_PhaseDetectGNDAut "FaultTCUCAP1_PhaseDetectGNDAut" UBYTE Bool_ON_OFF 1 2 0 1 BIT_MASK 0x80 ECU_ADDRESS 0x38 /end MEASUREMENT
/begin MEASUREMENT FaultTCUCAP1_PhaseDetectGNDCounter "FaultTCUCAP1_PhaseDetectGNDCount" UBYTE I_1 1 2 0 255 ECU_ADDRESS 0x59 /end MEASUREMENT
/begin MEASUREMENT FaultTCUCAP1_PhaseDetectGNDDetected "FaultTCUCAP1_PhaseDetectGNDDetected" UBYTE Bool_ON_OFF 1 2 0 1 BIT_MASK 0x80 ECU_ADDRESS 0x38 /end MEASUREMENT
/begin MEASUREMENT FaultTCUCAP1_PhaseDetectGNDLogged "FaultTCUCAP1_PhaseDetectGNDLogged" UBYTE Bool_ON_OFF 1 2 0 1 BIT_MASK 0x80 ECU_ADDRESS 0x38 /end MEASUREMENT
/begin MEASUREMENT FaultTCUCAP1_PhaseDetectVCCAut "FaultTCUCAP1_PhaseDetectVCCAut" UBYTE Bool_ON_OFF 1 2 0 1 BIT_MASK 0x01 ECU_ADDRESS 0x39 /end MEASUREMENT
/begin MEASUREMENT FaultTCUCAP1_PhaseDetectVCCCounter "FaultTCUCAP1_PhaseDetectVCCCount" UBYTE I_1 1 2 0 255 ECU_ADDRESS 0x5A /end MEASUREMENT
/begin MEASUREMENT FaultTCUCAP1_PhaseDetectVCCDetected "FaultTCUCAP1_PhaseDetectVCCDetected" UBYTE Bool_ON_OFF 1 2 0 1 BIT_MASK 0x01 ECU_ADDRESS 0x39 /end MEASUREMENT
/begin MEASUREMENT FaultTCUCAP1_PhaseDetectVCCLogged "FaultTCUCAP1_PhaseDetectVCCLogged" UBYTE Bool_ON_OFF 1 2 0 1 BIT_MASK 0x01 ECU_ADDRESS 0x39 /end MEASUREMENT
/begin MEASUREMENT FaultTCUCAP1_SWOverCurAut "FaultTCUCAP1_SWOverCurAut" UBYTE Bool_ON_OFF 1 2 0 1 BIT_MASK 0x02 ECU_ADDRESS 0x39 /end MEASUREMENT
/begin MEASUREMENT FaultTCUCAP1_SWOverCurCounter "FaultTCUCAP1_SWOverCurCount" UBYTE I_1 1 2 0 255 ECU_ADDRESS 0x5B /end MEASUREMENT
/begin MEASUREMENT FaultTCUCAP1_SWOverCurDetected "FaultTCUCAP1_SWOverCurDetected" UBYTE Bool_ON_OFF 1 2 0 1 BIT_MASK 0x02 ECU_ADDRESS 0x39 /end MEASUREMENT
/begin MEASUREMENT FaultTCUCAP1_SWOverCurLogged "FaultTCUCAP1_SWOverCurLogged" UBYTE Bool_ON_OFF 1 2 0 1 BIT_MASK 0x02 ECU_ADDRESS 0x39 /end MEASUREMENT
/begin MEASUREMENT FaultTCUCAP1_ThermalShutDownAut "FaultTCUCAP1_ThermalShutDownAut" UBYTE Bool_ON_OFF 1 2 0 1 BIT_MASK 0x04 ECU_ADDRESS 0x39 /end MEASUREMENT
/begin MEASUREMENT FaultTCUCAP1_ThermalShutDownCounter "FaultTCUCAP1_ThermalShutDownCount" UBYTE I_1 1 2 0 255 ECU_ADDRESS 0x5C /end MEASUREMENT
/begin MEASUREMENT FaultTCUCAP1_ThermalShutDownDetected "FaultTCUCAP1_ThermalShutDownDetected" UBYTE Bool_ON_OFF 1 2 0 1 BIT_MASK 0x04 ECU_ADDRESS 0x39 /end MEASUREMENT
/begin MEASUREMENT FaultTCUCAP1_ThermalShutDownLogged "FaultTCUCAP1_ThermalShutDownLogged" UBYTE Bool_ON_OFF 1 2 0 1 BIT_MASK 0x04 ECU_ADDRESS 0x39 /end MEASUREMENT
/begin MEASUREMENT FaultTCUCAP1_ThermalWarningAut "FaultTCUCAP1_ThermalWarningAut" UBYTE Bool_ON_OFF 1 2 0 1 BIT_MASK 0x08 ECU_ADDRESS 0x39 /end MEASUREMENT
/begin MEASUREMENT FaultTCUCAP1_ThermalWarningCounter "FaultTCUCAP1_ThermalWarningCount" UBYTE I_1 1 2 0 255 ECU_ADDRESS 0x5D /end MEASUREMENT
/begin MEASUREMENT FaultTCUCAP1_ThermalWarningDetected "FaultTCUCAP1_ThermalWarningDetected" UBYTE Bool_ON_OFF 1 2 0 1 BIT_MASK 0x08 ECU_ADDRESS 0x39 /end MEASUREMENT
/begin MEASUREMENT FaultTCUCAP1_ThermalWarningLogged "FaultTCUCAP1_ThermalWarningLogged" UBYTE Bool_ON_OFF 1 2 0 1 BIT_MASK 0x08 ECU_ADDRESS 0x39 /end MEASUREMENT
/begin MEASUREMENT FaultTCUCAP1_UnderVoltageAut "FaultTCUCAP1_UnderVoltageAut" UBYTE Bool_ON_OFF 1 2 0 1 BIT_MASK 0x10 ECU_ADDRESS 0x39 /end MEASUREMENT
/begin MEASUREMENT FaultTCUCAP1_UnderVoltageCounter "FaultTCUCAP1_UnderVoltageCount" UBYTE I_1 1 2 0 255 ECU_ADDRESS 0x5E /end MEASUREMENT
/begin MEASUREMENT FaultTCUCAP1_UnderVoltageDetected "FaultTCUCAP1_UnderVoltageDetected" UBYTE Bool_ON_OFF 1 2 0 1 BIT_MASK 0x10 ECU_ADDRESS 0x39 /end MEASUREMENT
/begin MEASUREMENT FaultTCUCAP1_UnderVoltageLogged "FaultTCUCAP1_UnderVoltageLogged" UBYTE Bool_ON_OFF 1 2 0 1 BIT_MASK 0x10 ECU_ADDRESS 0x39 /end MEASUREMENT
/begin MEASUREMENT FaultTCUCCP_Detected "FaultTCUCCP_Detected" UWORD I_1 1 2 0 65535 ECU_ADDRESS 0x3A /end MEASUREMENT
/begin MEASUREMENT FaultTCUCCP_Logged "FaultTCUCCP_Logged" UWORD I_1 1 2 0 65535 ECU_ADDRESS 0x3A /end MEASUREMENT
/begin MEASUREMENT FaultTCUCCP_OilMotorRationalAut "FaultTCUCCP_OilMotorRationalAut" UBYTE Bool_ON_OFF 1 2 0 1 BIT_MASK 0x01 ECU_ADDRESS 0x3A /end MEASUREMENT
/begin MEASUREMENT FaultTCUCCP_OilMotorRationalCounter "FaultTCUCCP_OilMotorRationalCount" UBYTE I_1 1 2 0 255 ECU_ADDRESS 0x5F /end MEASUREMENT
/begin MEASUREMENT FaultTCUCCP_OilMotorRationalDetected "FaultTCUCCP_OilMotorRationalDetected" UBYTE Bool_ON_OFF 1 2 0 1 BIT_MASK 0x01 ECU_ADDRESS 0x3A /end MEASUREMENT
/begin MEASUREMENT FaultTCUCCP_OilMotorRationalLogged "FaultTCUCCP_OilMotorRationalLogged" UBYTE Bool_ON_OFF 1 2 0 1 BIT_MASK 0x01 ECU_ADDRESS 0x3A /end MEASUREMENT
/begin MEASUREMENT FaultTCUCCP_OilMotorStallAut "FaultTCUCCP_OilMotorStallAut" UBYTE Bool_ON_OFF 1 2 0 1 BIT_MASK 0x02 ECU_ADDRESS 0x3A /end MEASUREMENT
/begin MEASUREMENT FaultTCUCCP_OilMotorStallCounter "FaultTCUCCP_OilMotorStallCount" UBYTE I_1 1 2 0 255 ECU_ADDRESS 0x60 /end MEASUREMENT
/begin MEASUREMENT FaultTCUCCP_OilMotorStallDetected "FaultTCUCCP_OilMotorStallDetected" UBYTE Bool_ON_OFF 1 2 0 1 BIT_MASK 0x02 ECU_ADDRESS 0x3A /end MEASUREMENT
/begin MEASUREMENT FaultTCUCCP_OilMotorStallLogged "FaultTCUCCP_OilMotorStallLogged" UBYTE Bool_ON_OFF 1 2 0 1 BIT_MASK 0x02 ECU_ADDRESS 0x3A /end MEASUREMENT
/begin MEASUREMENT FaultTCUCCP_OilSenRationalL1Aut "FaultTCUCCP_OilSenRationalL1Aut" UBYTE Bool_ON_OFF 1 2 0 1 BIT_MASK 0x04 ECU_ADDRESS 0x3A /end MEASUREMENT
/begin MEASUREMENT FaultTCUCCP_OilSenRationalL1Counter "FaultTCUCCP_OilSenRationalL1Count" UBYTE I_1 1 2 0 255 ECU_ADDRESS 0x61 /end MEASUREMENT
/begin MEASUREMENT FaultTCUCCP_OilSenRationalL1Detected "FaultTCUCCP_OilSenRationalL1Detected" UBYTE Bool_ON_OFF 1 2 0 1 BIT_MASK 0x04 ECU_ADDRESS 0x3A /end MEASUREMENT
/begin MEASUREMENT FaultTCUCCP_OilSenRationalL1Logged "FaultTCUCCP_OilSenRationalL1Logged" UBYTE Bool_ON_OFF 1 2 0 1 BIT_MASK 0x04 ECU_ADDRESS 0x3A /end MEASUREMENT
/begin MEASUREMENT FaultTCUCCP_OilSenRationalL2Aut "FaultTCUCCP_OilSenRationalL2Aut" UBYTE Bool_ON_OFF 1 2 0 1 BIT_MASK 0x08 ECU_ADDRESS 0x3A /end MEASUREMENT
/begin MEASUREMENT FaultTCUCCP_OilSenRationalL2Counter "FaultTCUCCP_OilSenRationalL2Count" UBYTE I_1 1 2 0 255 ECU_ADDRESS 0x62 /end MEASUREMENT
/begin MEASUREMENT FaultTCUCCP_OilSenRationalL2Detected "FaultTCUCCP_OilSenRationalL2Detected" UBYTE Bool_ON_OFF 1 2 0 1 BIT_MASK 0x08 ECU_ADDRESS 0x3A /end MEASUREMENT
/begin MEASUREMENT FaultTCUCCP_OilSenRationalL2Logged "FaultTCUCCP_OilSenRationalL2Logged" UBYTE Bool_ON_OFF 1 2 0 1 BIT_MASK 0x08 ECU_ADDRESS 0x3A /end MEASUREMENT
/begin MEASUREMENT FaultTCUCCP_OilTempRationalHAut "FaultTCUCCP_OilTempRationalHAut" UBYTE Bool_ON_OFF 1 2 0 1 BIT_MASK 0x10 ECU_ADDRESS 0x3A /end MEASUREMENT
/begin MEASUREMENT FaultTCUCCP_OilTempRationalHCounter "FaultTCUCCP_OilTempRationalHCount" UBYTE I_1 1 2 0 255 ECU_ADDRESS 0x63 /end MEASUREMENT
/begin MEASUREMENT FaultTCUCCP_OilTempRationalHDetected "FaultTCUCCP_OilTempRationalHDetected" UBYTE Bool_ON_OFF 1 2 0 1 BIT_MASK 0x10 ECU_ADDRESS 0x3A /end MEASUREMENT
/begin MEASUREMENT FaultTCUCCP_OilTempRationalHLogged "FaultTCUCCP_OilTempRationalHLogged" UBYTE Bool_ON_OFF 1 2 0 1 BIT_MASK 0x10 ECU_ADDRESS 0x3A /end MEASUREMENT
/begin MEASUREMENT FaultTCUCCP_OilTempRationalLAut "FaultTCUCCP_OilTempRationalLAut" UBYTE Bool_ON_OFF 1 2 0 1 BIT_MASK 0x20 ECU_ADDRESS 0x3A /end MEASUREMENT
/begin MEASUREMENT FaultTCUCCP_OilTempRationalLCounter "FaultTCUCCP_OilTempRationalLCount" UBYTE I_1 1 2 0 255 ECU_ADDRESS 0x64 /end MEASUREMENT
/begin MEASUREMENT FaultTCUCCP_OilTempRationalLDetected "FaultTCUCCP_OilTempRationalLDetected" UBYTE Bool_ON_OFF 1 2 0 1 BIT_MASK 0x20 ECU_ADDRESS 0x3A /end MEASUREMENT
/begin MEASUREMENT FaultTCUCCP_OilTempRationalLLogged "FaultTCUCCP_OilTempRationalLLogged" UBYTE Bool_ON_OFF 1 2 0 1 BIT_MASK 0x20 ECU_ADDRESS 0x3A /end MEASUREMENT
/begin MEASUREMENT FaultTableFuncTypeCounter1[1] "FaultTableFuncTypeCounter1[1]" UBYTE I_1 1 2 0 255 ECU_ADDRESS 0x0 /end MEASUREMENT
/begin MEASUREMENT FaultTableFuncTypeCounter1[20] "FaultTableFuncTypeCounter1[20]" UBYTE I_1 1 2 0 255 ECU_ADDRESS 0x0 /end MEASUREMENT
/begin MEASUREMENT FaultTableFuncTypeCounter1[21] "FaultTableFuncTypeCounter1[21]" UBYTE I_1 1 2 0 255 ECU_ADDRESS 0x0 /end MEASUREMENT
/begin MEASUREMENT FaultTableFuncTypeCounter1[22] "FaultTableFuncTypeCounter1[22]" UBYTE I_1 1 2 0 255 ECU_ADDRESS 0x0 /end MEASUREMENT
/begin MEASUREMENT FaultTableFuncTypeCounter1[23] "FaultTableFuncTypeCounter1[23]" UBYTE I_1 1 2 0 255 ECU_ADDRESS 0x0 /end MEASUREMENT
/begin MEASUREMENT FaultTableFuncTypeCounter1[24] "FaultTableFuncTypeCounter1[24]" UBYTE I_1 1 2 0 255 ECU_ADDRESS 0x0 /end MEASUREMENT
/begin MEASUREMENT FaultTableFuncTypeCounter1[25] "FaultTableFuncTypeCounter1[25]" UBYTE I_1 1 2 0 255 ECU_ADDRESS 0x0 /end MEASUREMENT
/begin MEASUREMENT FaultTableFuncTypeCounter1[26] "FaultTableFuncTypeCounter1[26]" UBYTE I_1 1 2 0 255 ECU_ADDRESS 0x0 /end MEASUREMENT
/begin MEASUREMENT FaultTableFuncTypeCounter1[27] "FaultTableFuncTypeCounter1[27]" UBYTE I_1 1 2 0 255 ECU_ADDRESS 0x0 /end MEASUREMENT
/begin MEASUREMENT FaultTableFuncTypeCounter1[28] "FaultTableFuncTypeCounter1[28]" UBYTE I_1 1 2 0 255 ECU_ADDRESS 0x0 /end MEASUREMENT
/begin MEASUREMENT FaultTableFuncTypeCounter1[29] "FaultTableFuncTypeCounter1[29]" UBYTE I_1 1 2 0 255 ECU_ADDRESS 0x0 /end MEASUREMENT
/begin MEASUREMENT FaultTableFuncTypeCounter1[2] "FaultTableFuncTypeCounter1[2]" UBYTE I_1 1 2 0 255 ECU_ADDRESS 0x0 /end MEASUREMENT
/begin MEASUREMENT FaultTableFuncTypeCounter1[30] "FaultTableFuncTypeCounter1[30]" UBYTE I_1 1 2 0 255 ECU_ADDRESS 0x0 /end MEASUREMENT
/begin MEASUREMENT FaultTableFuncTypeCounter1[31] "FaultTableFuncTypeCounter1[31]" UBYTE I_1 1 2 0 255 ECU_ADDRESS 0x0 /end MEASUREMENT
/begin MEASUREMENT FaultTableFuncTypeCounter1[32] "FaultTableFuncTypeCounter1[32]" UBYTE I_1 1 2 0 255 ECU_ADDRESS 0x0 /end MEASUREMENT
/begin MEASUREMENT FaultTableFuncTypeCounter1[33] "FaultTableFuncTypeCounter1[33]" UBYTE I_1 1 2 0 255 ECU_ADDRESS 0x0 /end MEASUREMENT
/begin MEASUREMENT FaultTableFuncTypeCounter1[34] "FaultTableFuncTypeCounter1[34]" UBYTE I_1 1 2 0 255 ECU_ADDRESS 0x0 /end MEASUREMENT
/begin MEASUREMENT FaultTableFuncTypeCounter1[35] "FaultTableFuncTypeCounter1[35]" UBYTE I_1 1 2 0 255 ECU_ADDRESS 0x0 /end MEASUREMENT
/begin MEASUREMENT FaultTableFuncTypeCounter1[36] "FaultTableFuncTypeCounter1[36]" UBYTE I_1 1 2 0 255 ECU_ADDRESS 0x0 /end MEASUREMENT
/begin MEASUREMENT FaultTableFuncTypeCounter1[37] "FaultTableFuncTypeCounter1[37]" UBYTE I_1 1 2 0 255 ECU_ADDRESS 0x0 /end MEASUREMENT
/begin MEASUREMENT FaultTableFuncTypeCounter1[38] "FaultTableFuncTypeCounter1[38]" UBYTE I_1 1 2 0 255 ECU_ADDRESS 0x0 /end MEASUREMENT
/begin MEASUREMENT FaultTableFuncTypeCounter1[39] "FaultTableFuncTypeCounter1[39]" UBYTE I_1 1 2 0 255 ECU_ADDRESS 0x0 /end MEASUREMENT
/begin MEASUREMENT FaultTableFuncTypeCounter1[3] "FaultTableFuncTypeCounter1[3]" UBYTE I_1 1 2 0 255 ECU_ADDRESS 0x0 /end MEASUREMENT
/begin MEASUREMENT FaultTableFuncTypeCounter1[40] "FaultTableFuncTypeCounter1[40]" UBYTE I_1 1 2 0 255 ECU_ADDRESS 0x0 /end MEASUREMENT
/begin MEASUREMENT FaultTableFuncTypeCounter1[41] "FaultTableFuncTypeCounter1[41]" UBYTE I_1 1 2 0 255 ECU_ADDRESS 0x0 /end MEASUREMENT
/begin MEASUREMENT FaultTableFuncTypeCounter1[42] "FaultTableFuncTypeCounter1[42]" UBYTE I_1 1 2 0 255 ECU_ADDRESS 0x0 /end MEASUREMENT
/begin MEASUREMENT FaultTableFuncTypeCounter1[43] "FaultTableFuncTypeCounter1[43]" UBYTE I_1 1 2 0 255 ECU_ADDRESS 0x0 /end MEASUREMENT
/begin MEASUREMENT FaultTableFuncTypeCounter1[44] "FaultTableFuncTypeCounter1[44]" UBYTE I_1 1 2 0 255 ECU_ADDRESS 0x0 /end MEASUREMENT
/begin MEASUREMENT FaultTableFuncTypeCounter1[45] "FaultTableFuncTypeCounter1[45]" UBYTE I_1 1 2 0 255 ECU_ADDRESS 0x0 /end MEASUREMENT
/begin MEASUREMENT FaultTableFuncTypeCounter1[46] "FaultTableFuncTypeCounter1[46]" UBYTE I_1 1 2 0 255 ECU_ADDRESS 0x0 /end MEASUREMENT
/begin MEASUREMENT FaultTableFuncTypeCounter1[47] "FaultTableFuncTypeCounter1[47]" UBYTE I_1 1 2 0 255 ECU_ADDRESS 0x0 /end MEASUREMENT
/begin MEASUREMENT FaultTableFuncTypeCounter1[48] "FaultTableFuncTypeCounter1[48]" UBYTE I_1 1 2 0 255 ECU_ADDRESS 0x0 /end MEASUREMENT
/begin MEASUREMENT FaultTableFuncTypeCounter1[49] "FaultTableFuncTypeCounter1[49]" UBYTE I_1 1 2 0 255 ECU_ADDRESS 0x0 /end MEASUREMENT
/begin MEASUREMENT FaultTableFuncTypeCounter1[4] "FaultTableFuncTypeCounter1[4]" UBYTE I_1 1 2 0 255 ECU_ADDRESS 0x0 /end MEASUREMENT
/begin MEASUREMENT FaultTableFuncTypeCounter1[50] "FaultTableFuncTypeCounter1[50]" UBYTE I_1 1 2 0 255 ECU_ADDRESS 0x0 /end MEASUREMENT
/begin MEASUREMENT FaultTableFuncTypeCounter1[51] "FaultTableFuncTypeCounter1[51]" UBYTE I_1 1 2 0 255 ECU_ADDRESS 0x0 /end MEASUREMENT
/begin MEASUREMENT FaultTableFuncTypeCounter1[52] "FaultTableFuncTypeCounter1[52]" UBYTE I_1 1 2 0 255 ECU_ADDRESS 0x0 /end MEASUREMENT
/begin MEASUREMENT FaultTableFuncTypeCounter1[53] "FaultTableFuncTypeCounter1[53]" UBYTE I_1 1 2 0 255 ECU_ADDRESS 0x0 /end MEASUREMENT
/begin MEASUREMENT FaultTableFuncTypeCounter1[54] "FaultTableFuncTypeCounter1[54]" UBYTE I_1 1 2 0 255 ECU_ADDRESS 0x0 /end MEASUREMENT
/begin MEASUREMENT FaultTableFuncTypeCounter1[55] "FaultTableFuncTypeCounter1[55]" UBYTE I_1 1 2 0 255 ECU_ADDRESS 0x0 /end MEASUREMENT
/begin MEASUREMENT FaultTableFuncTypeCounter1[56] "FaultTableFuncTypeCounter1[56]" UBYTE I_1 1 2 0 255 ECU_ADDRESS 0x0 /end MEASUREMENT
/begin MEASUREMENT FaultTableFuncTypeCounter1[57] "FaultTableFuncTypeCounter1[57]" UBYTE I_1 1 2 0 255 ECU_ADDRESS 0x0 /end MEASUREMENT
/begin MEASUREMENT FaultTableFuncTypeCounter1[58] "FaultTableFuncTypeCounter1[58]" UBYTE I_1 1 2 0 255 ECU_ADDRESS 0x0 /end MEASUREMENT
/begin MEASUREMENT FaultTableFuncTypeCounter1[59] "FaultTableFuncTypeCounter1[59]" UBYTE I_1 1 2 0 255 ECU_ADDRESS 0x0 /end MEASUREMENT
/begin MEASUREMENT FaultTableFuncTypeCounter1[5] "FaultTableFuncTypeCounter1[5]" UBYTE I_1 1 2 0 255 ECU_ADDRESS 0x0 /end MEASUREMENT
/begin MEASUREMENT FaultTableFuncTypeCounter1[60] "FaultTableFuncTypeCounter1[60]" UBYTE I_1 1 2 0 255 ECU_ADDRESS 0x0 /end MEASUREMENT
/begin MEASUREMENT FaultTableFuncTypeCounter1[61] "FaultTableFuncTypeCounter1[61]" UBYTE I_1 1 2 0 255 ECU_ADDRESS 0x0 /end MEASUREMENT
/begin MEASUREMENT FaultTableFuncTypeCounter1[62] "FaultTableFuncTypeCounter1[62]" UBYTE I_1 1 2 0 255 ECU_ADDRESS 0x0 /end MEASUREMENT
/begin MEASUREMENT FaultTableFuncTypeCounter1[63] "FaultTableFuncTypeCounter1[63]" UBYTE I_1 1 2 0 255 ECU_ADDRESS 0x0 /end MEASUREMENT
/begin MEASUREMENT FaultTableFuncTypeCounter1[64] "FaultTableFuncTypeCounter1[64]" UBYTE I_1 1 2 0 255 ECU_ADDRESS 0x0 /end MEASUREMENT
/begin MEASUREMENT FaultTableFuncTypeCounter1[65] "FaultTableFuncTypeCounter1[65]" UBYTE I_1 1 2 0 255 ECU_ADDRESS 0x0 /end MEASUREMENT
/begin MEASUREMENT FaultTableFuncTypeCounter1[66] "FaultTableFuncTypeCounter1[66]" UBYTE I_1 1 2 0 255 ECU_ADDRESS 0x0 /end MEASUREMENT
/begin MEASUREMENT FaultTableFuncTypeCounter1[67] "FaultTableFuncTypeCounter1[67]" UBYTE I_1 1 2 0 255 ECU_ADDRESS 0x0 /end MEASUREMENT
/begin MEASUREMENT FaultTableFuncTypeCounter1[68] "FaultTableFuncTypeCounter1[68]" UBYTE I_1 1 2 0 255 ECU_ADDRESS 0x0 /end MEASUREMENT
/begin MEASUREMENT FaultTableFuncTypeCounter1[69] "FaultTableFuncTypeCounter1[69]" UBYTE I_1 1 2 0 255 ECU_ADDRESS 0x0 /end MEASUREMENT
/begin MEASUREMENT FaultTableFuncTypeCounter1[6] "FaultTableFuncTypeCounter1[6]" UBYTE I_1 1 2 0 255 ECU_ADDRESS 0x0 /end MEASUREMENT
/begin MEASUREMENT FaultTableFuncTypeCounter1[70] "FaultTableFuncTypeCounter1[70]" UBYTE I_1 1 2 0 255 ECU_ADDRESS 0x0 /end MEASUREMENT
/begin MEASUREMENT FaultTableFuncTypeCounter1[71] "FaultTableFuncTypeCounter1[71]" UBYTE I_1 1 2 0 255 ECU_ADDRESS 0x0 /end MEASUREMENT
/begin MEASUREMENT FaultTableFuncTypeCounter1[72] "FaultTableFuncTypeCounter1[72]" UBYTE I_1 1 2 0 255 ECU_ADDRESS 0x0 /end MEASUREMENT
/begin MEASUREMENT FaultTableFuncTypeCounter1[73] "FaultTableFuncTypeCounter1[73]" UBYTE I_1 1 2 0 255 ECU_ADDRESS 0x0 /end MEASUREMENT
/begin MEASUREMENT FaultTableFuncTypeCounter1[74] "FaultTableFuncTypeCounter1[74]" UBYTE I_1 1 2 0 255 ECU_ADDRESS 0x0 /end MEASUREMENT
/begin MEASUREMENT FaultTableFuncTypeCounter1[75] "FaultTableFuncTypeCounter1[75]" UBYTE I_1 1 2 0 255 ECU_ADDRESS 0x0 /end MEASUREMENT
/begin MEASUREMENT FaultTableFuncTypeCounter1[76] "FaultTableFuncTypeCounter1[76]" UBYTE I_1 1 2 0 255 ECU_ADDRESS 0x0 /end MEASUREMENT
/begin MEASUREMENT FaultTableFuncTypeCounter1[77] "FaultTableFuncTypeCounter1[77]" UBYTE I_1 1 2 0 255 ECU_ADDRESS 0x0 /end MEASUREMENT
/begin MEASUREMENT FaultTableFuncTypeCounter1[78] "FaultTableFuncTypeCounter1[78]" UBYTE I_1 1 2 0 255 ECU_ADDRESS 0x0 /end MEASUREMENT
/begin MEASUREMENT FaultTableFuncTypeCounter1[79] "FaultTableFuncTypeCounter1[79]" UBYTE I_1 1 2 0 255 ECU_ADDRESS 0x0 /end MEASUREMENT
/begin MEASUREMENT FaultTableFuncTypeCounter1[7] "FaultTableFuncTypeCounter1[7]" UBYTE I_1 1 2 0 255 ECU_ADDRESS 0x0 /end MEASUREMENT
/begin MEASUREMENT FaultTableFuncTypeCounter1[80] "FaultTableFuncTypeCounter1[80]" UBYTE I_1 1 2 0 255 ECU_ADDRESS 0x0 /end MEASUREMENT
/begin MEASUREMENT FaultTableFuncTypeCounter1[81] "FaultTableFuncTypeCounter1[81]" UBYTE I_1 1 2 0 255 ECU_ADDRESS 0x0 /end MEASUREMENT
/begin MEASUREMENT FaultTableFuncTypeCounter1[82] "FaultTableFuncTypeCounter1[82]" UBYTE I_1 1 2 0 255 ECU_ADDRESS 0x0 /end MEASUREMENT
/begin MEASUREMENT FaultTableFuncTypeCounter1[83] "FaultTableFuncTypeCounter1[83]" UBYTE I_1 1 2 0 255 ECU_ADDRESS 0x0 /end MEASUREMENT
/begin MEASUREMENT FaultTableFuncTypeCounter1[84] "FaultTableFuncTypeCounter1[84]" UBYTE I_1 1 2 0 255 ECU_ADDRESS 0x0 /end MEASUREMENT
/begin MEASUREMENT FaultTableFuncTypeCounter1[85] "FaultTableFuncTypeCounter1[85]" UBYTE I_1 1 2 0 255 ECU_ADDRESS 0x0 /end MEASUREMENT
/begin MEASUREMENT FaultTableFuncTypeCounter1[86] "FaultTableFuncTypeCounter1[86]" UBYTE I_1 1 2 0 255 ECU_ADDRESS 0x0 /end MEASUREMENT
/begin MEASUREMENT FaultTableFuncTypeCounter1[87] "FaultTableFuncTypeCounter1[87]" UBYTE I_1 1 2 0 255 ECU_ADDRESS 0x0 /end MEASUREMENT
/begin MEASUREMENT FaultTableFuncTypeCounter1[88] "FaultTableFuncTypeCounter1[88]" UBYTE I_1 1 2 0 255 ECU_ADDRESS 0x0 /end MEASUREMENT
/begin MEASUREMENT FaultTableFuncTypeCounter1[89] "FaultTableFuncTypeCounter1[89]" UBYTE I_1 1 2 0 255 ECU_ADDRESS 0x0 /end MEASUREMENT
/begin MEASUREMENT FaultTableFuncTypeCounter1[8] "FaultTableFuncTypeCounter1[8]" UBYTE I_1 1 2 0 255 ECU_ADDRESS 0x0 /end MEASUREMENT
/begin MEASUREMENT FaultTableFuncTypeCounter1[90] "FaultTableFuncTypeCounter1[90]" UBYTE I_1 1 2 0 255 ECU_ADDRESS 0x0 /end MEASUREMENT
/begin MEASUREMENT FaultTableFuncTypeCounter1[91] "FaultTableFuncTypeCounter1[91]" UBYTE I_1 1 2 0 255 ECU_ADDRESS 0x0 /end MEASUREMENT
/begin MEASUREMENT FaultTableFuncTypeCounter1[92] "FaultTableFuncTypeCounter1[92]" UBYTE I_1 1 2 0 255 ECU_ADDRESS 0x0 /end MEASUREMENT
/begin MEASUREMENT FaultTableFuncTypeCounter1[93] "FaultTableFuncTypeCounter1[93]" UBYTE I_1 1 2 0 255 ECU_ADDRESS 0x0 /end MEASUREMENT
/begin MEASUREMENT FaultTableFuncTypeCounter1[94] "FaultTableFuncTypeCounter1[94]" UBYTE I_1 1 2 0 255 ECU_ADDRESS 0x0 /end MEASUREMENT
/begin MEASUREMENT FaultTableFuncTypeCounter1[95] "FaultTableFuncTypeCounter1[95]" UBYTE I_1 1 2 0 255 ECU_ADDRESS 0x0 /end MEASUREMENT
/begin MEASUREMENT FaultTableFuncTypeCounter1[96] "FaultTableFuncTypeCounter1[96]" UBYTE I_1 1 2 0 255 ECU_ADDRESS 0x0 /end MEASUREMENT
/begin MEASUREMENT FaultTableFuncTypeCounter1[97] "FaultTableFuncTypeCounter1[97]" UBYTE I_1 1 2 0 255 ECU_ADDRESS 0x0 /end MEASUREMENT
/begin MEASUREMENT FaultTableFuncTypeCounter1[98] "FaultTableFuncTypeCounter1[98]" UBYTE I_1 1 2 0 255 ECU_ADDRESS 0x0 /end MEASUREMENT
/begin MEASUREMENT FaultTableFuncTypeCounter1[99] "FaultTableFuncTypeCounter1[99]" UBYTE I_1 1 2 0 255 ECU_ADDRESS 0x0 /end MEASUREMENT
/begin MEASUREMENT FaultTableFuncTypeCounter1[9] "FaultTableFuncTypeCounter1[9]" UBYTE I_1 1 2 0 255 ECU_ADDRESS 0x0 /end MEASUREMENT
/begin MEASUREMENT Frecord_bFaultRecoverPermission "..." UBYTE Bool_ON_OFF 1 2 0 1 BIT_MASK 0x01 ECU_ADDRESS 0x0 /end MEASUREMENT
/begin MEASUREMENT GADCTotalTime "GADCTotalTime" ULONG I_1 1 2 0 4294967295 ECU_ADDRESS 0x0 /end MEASUREMENT
/begin MEASUREMENT GASWNM_bFullComSts "..." UBYTE Bool_ON_OFF 1 2 0 1 BIT_MASK 0x01 ECU_ADDRESS 0x0 /end MEASUREMENT
/begin MEASUREMENT GASWNM_bStayAwake "..." UBYTE Bool_ON_OFF 1 2 0 1 BIT_MASK 0x01 ECU_ADDRESS 0x0 /end MEASUREMENT
/begin MEASUREMENT GASWNM_u8CurrentState "..." UBYTE Id_0x00 1 2 0 255 MATRIX_DIM 21 1 1 ECU_ADDRESS 0x0 /end MEASUREMENT
/begin MEASUREMENT GASWNM_u8CurrentState[0] "GASWNM_u8CurrentState[0]" UBYTE Id_0x00 1 2 0 255 ECU_ADDRESS 0x0 /end MEASUREMENT
/begin MEASUREMENT GASWNM_u8CurrentState[10] "GASWNM_u8CurrentState[10]" UBYTE Id_0x00 1 2 0 255 ECU_ADDRESS 0x0 /end MEASUREMENT
/begin MEASUREMENT GASWNM_u8CurrentState[11] "GASWNM_u8CurrentState[11]" UBYTE Id_0x00 1 2 0 255 ECU_ADDRESS 0x0 /end MEASUREMENT
/begin MEASUREMENT GASWNM_u8CurrentState[12] "GASWNM_u8CurrentState[12]" UBYTE Id_0x00 1 2 0 255 ECU_ADDRESS 0x0 /end MEASUREMENT
/begin MEASUREMENT GASWNM_u8CurrentState[13] "GASWNM_u8CurrentState[13]" UBYTE Id_0x00 1 2 0 255 ECU_ADDRESS 0x0 /end MEASUREMENT
/begin MEASUREMENT GASWNM_u8CurrentState[14] "GASWNM_u8CurrentState[14]" UBYTE Id_0x00 1 2 0 255 ECU_ADDRESS 0x0 /end MEASUREMENT
/begin MEASUREMENT GASWNM_u8CurrentState[15] "GASWNM_u8CurrentState[15]" UBYTE Id_0x00 1 2 0 255 ECU_ADDRESS 0x0 /end MEASUREMENT
/begin MEASUREMENT GASWNM_u8CurrentState[16] "GASWNM_u8CurrentState[16]" UBYTE Id_0x00 1 2 0 255 ECU_ADDRESS 0x0 /end MEASUREMENT
/begin MEASUREMENT GASWNM_u8CurrentState[17] "GASWNM_u8CurrentState[17]" UBYTE Id_0x00 1 2 0 255 ECU_ADDRESS 0x0 /end MEASUREMENT
/begin MEASUREMENT GASWNM_u8CurrentState[18] "GASWNM_u8CurrentState[18]" UBYTE Id_0x00 1 2 0 255 ECU_ADDRESS 0x0 /end MEASUREMENT
/begin MEASUREMENT GASWNM_u8CurrentState[19] "GASWNM_u8CurrentState[19]" UBYTE Id_0x00 1 2 0 255 ECU_ADDRESS 0x0 /end MEASUREMENT
/begin MEASUREMENT GASWNM_u8CurrentState[1] "GASWNM_u8CurrentState[1]" UBYTE Id_0x00 1 2 0 255 ECU_ADDRESS 0x0 /end MEASUREMENT
/begin MEASUREMENT GASWNM_u8CurrentState[20] "GASWNM_u8CurrentState[20]" UBYTE Id_0x00 1 2 0 255 ECU_ADDRESS 0x0 /end MEASUREMENT
/begin MEASUREMENT GASWNM_u8CurrentState[2] "GASWNM_u8CurrentState[2]" UBYTE Id_0x00 1 2 0 255 ECU_ADDRESS 0x0 /end MEASUREMENT
/begin MEASUREMENT GASWNM_u8CurrentState[3] "GASWNM_u8CurrentState[3]" UBYTE Id_0x00 1 2 0 255 ECU_ADDRESS 0x0 /end MEASUREMENT
/begin MEASUREMENT GASWNM_u8CurrentState[4] "GASWNM_u8CurrentState[4]" UBYTE Id_0x00 1 2 0 255 ECU_ADDRESS 0x0 /end MEASUREMENT
/begin MEASUREMENT GASWNM_u8CurrentState[5] "GASWNM_u8CurrentState[5]" UBYTE Id_0x00 1 2 0 255 ECU_ADDRESS 0x0 /end MEASUREMENT
/begin MEASUREMENT GASWNM_u8CurrentState[6] "GASWNM_u8CurrentState[6]" UBYTE Id_0x00 1 2 0 255 ECU_ADDRESS 0x0 /end MEASUREMENT
/begin MEASUREMENT GASWNM_u8CurrentState[7] "GASWNM_u8CurrentState[7]" UBYTE Id_0x00 1 2 0 255 ECU_ADDRESS 0x0 /end MEASUREMENT
/begin MEASUREMENT GASWNM_u8CurrentState[8] "GASWNM_u8CurrentState[8]" UBYTE Id_0x00 1 2 0 255 ECU_ADDRESS 0x0 /end MEASUREMENT
/begin MEASUREMENT GASWNM_u8CurrentState[9] "GASWNM_u8CurrentState[9]" UBYTE Id_0x00 1 2 0 255 ECU_ADDRESS 0x0 /end MEASUREMENT
/begin MEASUREMENT GCCU6_au32PWMOnTime "." ULONG F_1_p0_4 1 2 0 4294967295 MATRIX_DIM 3 1 1 ECU_ADDRESS 0x0 /end MEASUREMENT
/begin MEASUREMENT GCCU6_au32PWMOnTime[0] "GCCU6_au32PWMOnTime[0]" ULONG F_1_p0_4 1 2 0 4294967295 ECU_ADDRESS 0x0 /end MEASUREMENT
/begin MEASUREMENT GCCU6_au32PWMOnTime[1] "GCCU6_au32PWMOnTime[1]" ULONG F_1_p0_4 1 2 0 4294967295 ECU_ADDRESS 0x0 /end MEASUREMENT
/begin MEASUREMENT GCCU6_au32PWMOnTime[2] "GCCU6_au32PWMOnTime[2]" ULONG F_1_p0_4 1 2 0 4294967295 ECU_ADDRESS 0x0 /end MEASUREMENT
/begin MEASUREMENT GCCU6_bAkdAfterAscReq "..." UBYTE Bool_ON_OFF 1 2 0 1 BIT_MASK 0x01 ECU_ADDRESS 0x0 /end MEASUREMENT
/begin MEASUREMENT GCCU6_bClrTrapReq "..." UBYTE Bool_ON_OFF 1 2 0 1 BIT_MASK 0x01 ECU_ADDRESS 0x0 /end MEASUREMENT
/begin MEASUREMENT GCCU6_bHighVoltStdbyFlg "..." UBYTE Bool_ON_OFF 1 2 0 1 BIT_MASK 0x01 ECU_ADDRESS 0x0 /end MEASUREMENT
/begin MEASUREMENT GCCU6_bHwFaultDcOvVolt "..." UBYTE Bool_ON_OFF 1 2 0 1 BIT_MASK 0x01 ECU_ADDRESS 0x0 /end MEASUREMENT
/begin MEASUREMENT GCCU6_bHwFaultIgbtH "..." UBYTE Bool_ON_OFF 1 2 0 1 BIT_MASK 0x01 ECU_ADDRESS 0x0 /end MEASUREMENT
/begin MEASUREMENT GCCU6_bHwFaultIgbtL "..." UBYTE Bool_ON_OFF 1 2 0 1 BIT_MASK 0x01 ECU_ADDRESS 0x0 /end MEASUREMENT
/begin MEASUREMENT GCCU6_bHwFaultOvcU "..." UBYTE Bool_ON_OFF 1 2 0 1 BIT_MASK 0x01 ECU_ADDRESS 0x0 /end MEASUREMENT
/begin MEASUREMENT GCCU6_bHwFaultOvcV "..." UBYTE Bool_ON_OFF 1 2 0 1 BIT_MASK 0x01 ECU_ADDRESS 0x0 /end MEASUREMENT
/begin MEASUREMENT GCCU6_bHwFaultOvcW "..." UBYTE Bool_ON_OFF 1 2 0 1 BIT_MASK 0x01 ECU_ADDRESS 0x0 /end MEASUREMENT
/begin MEASUREMENT GCCU6_bIgbtHighSideShort "..." UBYTE Bool_ON_OFF 1 2 0 1 BIT_MASK 0x01 ECU_ADDRESS 0x0 /end MEASUREMENT
/begin MEASUREMENT GCCU6_bIgbtLowSideShort "..." UBYTE Bool_ON_OFF 1 2 0 1 BIT_MASK 0x01 ECU_ADDRESS 0x0 /end MEASUREMENT
/begin MEASUREMENT GCCU6_bIsCCU6Start "..." UBYTE Bool_ON_OFF 1 2 0 1 BIT_MASK 0x01 ECU_ADDRESS 0x0 /end MEASUREMENT
/begin MEASUREMENT GCCU6_bIuvwCompReq "..." UBYTE Bool_ON_OFF 1 2 0 1 BIT_MASK 0x01 ECU_ADDRESS 0x0 /end MEASUREMENT
/begin MEASUREMENT GCCU6_bMotorSpdRdy "..." UBYTE Bool_ON_OFF 1 2 0 1 BIT_MASK 0x01 ECU_ADDRESS 0x0 /end MEASUREMENT
/begin MEASUREMENT GCCU6_bP5VDiagReinitCmd "..." UBYTE Bool_ON_OFF 1 2 0 1 BIT_MASK 0x01 ECU_ADDRESS 0x0 /end MEASUREMENT
/begin MEASUREMENT GCCU6_bP5VHSFltFlg "..." UBYTE Bool_ON_OFF 1 2 0 1 BIT_MASK 0x01 ECU_ADDRESS 0x0 /end MEASUREMENT
/begin MEASUREMENT GCCU6_bP5VLSFltFlg "..." UBYTE Bool_ON_OFF 1 2 0 1 BIT_MASK 0x01 ECU_ADDRESS 0x0 /end MEASUREMENT
/begin MEASUREMENT GCCU6_bPwmMidPointU "..." UBYTE Bool_ON_OFF 1 2 0 1 BIT_MASK 0x01 ECU_ADDRESS 0x0 /end MEASUREMENT
/begin MEASUREMENT GCCU6_bPwmMidPointV "..." UBYTE Bool_ON_OFF 1 2 0 1 BIT_MASK 0x01 ECU_ADDRESS 0x0 /end MEASUREMENT
/begin MEASUREMENT GCCU6_bPwmMidPointW "..." UBYTE Bool_ON_OFF 1 2 0 1 BIT_MASK 0x01 ECU_ADDRESS 0x0 /end MEASUREMENT
/begin MEASUREMENT GCCU6_bPwmOnGoingFlg "..." UBYTE Bool_ON_OFF 1 2 0 1 BIT_MASK 0x01 ECU_ADDRESS 0x0 /end MEASUREMENT
/begin MEASUREMENT GCCU6_bT12ZeroMatchFlg "..." UBYTE Bool_ON_OFF 1 2 0 1 BIT_MASK 0x01 ECU_ADDRESS 0x0 /end MEASUREMENT
/begin MEASUREMENT GCCU6_bTrapTrigger "..." UBYTE Bool_ON_OFF 1 2 0 1 BIT_MASK 0x01 ECU_ADDRESS 0x0 /end MEASUREMENT
/begin MEASUREMENT GCCU6_f32DrvClkHsDuty "..." FLOAT32_IEEE I_1 1 2 -3.402823466E+038 3.402823466E+038 ECU_ADDRESS 0x0 /end MEASUREMENT
/begin MEASUREMENT GCCU6_f32DrvClkLsDuty "..." FLOAT32_IEEE I_1 1 2 -3.402823466E+038 3.402823466E+038 ECU_ADDRESS 0x0 /end MEASUREMENT
/begin MEASUREMENT GCCU6_f32HighVolPhys "..." FLOAT32_IEEE I_1 1 2 -3.402823466E+038 3.402823466E+038 ECU_ADDRESS 0x0 /end MEASUREMENT
/begin MEASUREMENT GCCU6_f32PwmDutyPhysUZ "..." FLOAT32_IEEE I_1 1 2 -3.402823466E+038 3.402823466E+038 ECU_ADDRESS 0x0 /end MEASUREMENT
/begin MEASUREMENT GCCU6_f32PwmDutyPhysVZ "..." FLOAT32_IEEE I_1 1 2 -3.402823466E+038 3.402823466E+038 ECU_ADDRESS 0x0 /end MEASUREMENT
/begin MEASUREMENT GCCU6_f32PwmDutyPhysWZ "..." FLOAT32_IEEE I_1 1 2 -3.402823466E+038 3.402823466E+038 ECU_ADDRESS 0x0 /end MEASUREMENT
/begin MEASUREMENT GCCU6_u16AlimPowerOnDelay "..." UWORD I_1 1 2 0 65535 ECU_ADDRESS 0x0 /end MEASUREMENT
/begin MEASUREMENT GCCU6_u16CCU6T13CmpVal "PWM duty of GCCU6" UWORD I_1 1 2 0 65535 ECU_ADDRESS 0x0 /end MEASUREMENT
/begin MEASUREMENT GCCU6_u16HighVolAdc "..." UWORD I_1 1 2 0 65535 ECU_ADDRESS 0x0 /end MEASUREMENT
/begin MEASUREMENT GCCU6_u16McuAscSttDelay "..." UWORD I_1 1 2 0 65535 ECU_ADDRESS 0x0 /end MEASUREMENT
/begin MEASUREMENT GCCU6_u16P5VHSAdc "..." UWORD I_15 1 2 0 65535 ECU_ADDRESS 0x0 /end MEASUREMENT
/begin MEASUREMENT GCCU6_u16PowerOnDelay "..." UWORD I_1 1 2 0 65535 ECU_ADDRESS 0x0 /end MEASUREMENT
/begin MEASUREMENT GCCU6_u16PwmMaxDutyCyc "..." UWORD I_1 1 2 0 65535 ECU_ADDRESS 0x0 /end MEASUREMENT
/begin MEASUREMENT GCCU6_u16PwmMidPointErrCnt "..." UWORD I_1 1 2 0 65535 ECU_ADDRESS 0x0 /end MEASUREMENT
/begin MEASUREMENT GCCU6_u16PwmMinDutyCyc "..." UWORD I_1 1 2 0 65535 ECU_ADDRESS 0x0 /end MEASUREMENT
/begin MEASUREMENT GCCU6_u16PwmModReq "..." UWORD I_1 1 2 0 65535 ECU_ADDRESS 0x0 /end MEASUREMENT
/begin MEASUREMENT GCCU6_u16T12CntVal "..." UWORD I_1 1 2 0 65535 ECU_ADDRESS 0x0 /end MEASUREMENT
/begin MEASUREMENT GCCU6_u16T12PeriodVal "..." UWORD I_1 1 2 0 65535 ECU_ADDRESS 0x0 /end MEASUREMENT
/begin MEASUREMENT GCCU6_u16T13PeriodVal "..." UWORD I_1 1 2 0 65535 ECU_ADDRESS 0x0 /end MEASUREMENT
/begin MEASUREMENT GCCU6_u32DrvClkHsDutyRaw "..." ULONG I_1 1 2 0 4294967295 ECU_ADDRESS 0x0 /end MEASUREMENT
/begin MEASUREMENT GCCU6_u32DrvClkHsPerdRaw "..." ULONG I_1 1 2 0 4294967295 ECU_ADDRESS 0x0 /end MEASUREMENT
/begin MEASUREMENT GCCU6_u32DrvClkLsDutyRaw "..." ULONG I_1 1 2 0 4294967295 ECU_ADDRESS 0x0 /end MEASUREMENT
/begin MEASUREMENT GCCU6_u32DrvClkLsPerdRaw "..." ULONG I_1 1 2 0 4294967295 ECU_ADDRESS 0x0 /end MEASUREMENT
/begin MEASUREMENT GCCU6_u32TrapCreq "..." ULONG I_1 1 2 0 4294967295 ECU_ADDRESS 0x0 /end MEASUREMENT
/begin MEASUREMENT GCCU6_u8AscRecoverCnt "GCCU6 State" UBYTE I_1 1 2 0 255 ECU_ADDRESS 0x0 /end MEASUREMENT
/begin MEASUREMENT GCCU6_u8McuAscSttStep "GCCU6 State" UBYTE I_1 1 2 0 255 ECU_ADDRESS 0x0 /end MEASUREMENT
/begin MEASUREMENT GCCU6_u8McuAscType "GCCU6 ASC Type" UBYTE I_1 1 2 0 255 ECU_ADDRESS 0x0 /end MEASUREMENT
/begin MEASUREMENT GCCU6_u8P5VHSFltCnt "..." UBYTE I_1 1 2 0 255 ECU_ADDRESS 0x0 /end MEASUREMENT
/begin MEASUREMENT GCCU6_u8P5VLSFltCnt "..." UBYTE I_1 1 2 0 255 ECU_ADDRESS 0x0 /end MEASUREMENT
/begin MEASUREMENT GCCU6_u8P5VPowerMngStt "..." UBYTE I_1 1 2 0 255 ECU_ADDRESS 0x0 /end MEASUREMENT
/begin MEASUREMENT GCCU6_u8P5VSelfTstStt "..." UBYTE I_1 1 2 0 255 ECU_ADDRESS 0x0 /end MEASUREMENT
/begin MEASUREMENT GCCU6_u8P5VSelfTstTimCnt "..." UBYTE I_1 1 2 0 255 ECU_ADDRESS 0x0 /end MEASUREMENT
/begin MEASUREMENT GCCU6_u8PreTestStep "..." UBYTE I_1 1 2 0 255 ECU_ADDRESS 0x0 /end MEASUREMENT
/begin MEASUREMENT GCCU6_u8PwmState "GCCU6 State" UBYTE I_1 1 2 0 255 ECU_ADDRESS 0x0 /end MEASUREMENT
/begin MEASUREMENT GCalibration_debut "GCalibration_debut" UWORD I_1 1 2 0 65535 ECU_ADDRESS 0x0 /end MEASUREMENT
/begin MEASUREMENT GCore0_f32Asw100msLoad "..." FLOAT32_IEEE F_1_p0_21 1 2 -3.402823466E+038 3.402823466E+038 ECU_ADDRESS 0x0 /end MEASUREMENT
/begin MEASUREMENT GCore0_f32Asw10msLoad "..." FLOAT32_IEEE F_1_p0_21 1 2 -3.402823466E+038 3.402823466E+038 ECU_ADDRESS 0x0 /end MEASUREMENT
/begin MEASUREMENT GCore0_f32Bsw100msLoad "..." FLOAT32_IEEE F_1_p0_21 1 2 -3.402823466E+038 3.402823466E+038 ECU_ADDRESS 0x0 /end MEASUREMENT
/begin MEASUREMENT GCore0_f32Bsw10msLoad "..." FLOAT32_IEEE F_1_p0_21 1 2 -3.402823466E+038 3.402823466E+038 ECU_ADDRESS 0x0 /end MEASUREMENT
/begin MEASUREMENT GCore0_f32Bsw1msLoad "..." FLOAT32_IEEE F_1_p0_21 1 2 -3.402823466E+038 3.402823466E+038 ECU_ADDRESS 0x0 /end MEASUREMENT
/begin MEASUREMENT GCore0_f32Bsw50msLoad "..." FLOAT32_IEEE F_1_p0_21 1 2 -3.402823466E+038 3.402823466E+038 ECU_ADDRESS 0x0 /end MEASUREMENT
/begin MEASUREMENT GCore0_f32ModReqLoad "..." FLOAT32_IEEE F_1_p0_21 1 2 -3.402823466E+038 3.402823466E+038 ECU_ADDRESS 0x0 /end MEASUREMENT
/begin MEASUREMENT GCore0_f32VsiTreatmentLoad "..." FLOAT32_IEEE F_1_p0_21 1 2 -3.402823466E+038 3.402823466E+038 ECU_ADDRESS 0x0 /end MEASUREMENT
/begin MEASUREMENT GCore1_f32Asw10msLoad "..." FLOAT32_IEEE F_1_p0_21 1 2 -3.402823466E+038 3.402823466E+038 ECU_ADDRESS 0x0 /end MEASUREMENT
/begin MEASUREMENT GCore1_f32Asw1msLoad "..." FLOAT32_IEEE F_1_p0_21 1 2 -3.402823466E+038 3.402823466E+038 ECU_ADDRESS 0x0 /end MEASUREMENT
/begin MEASUREMENT GCore1_f32Bsw10msLoad "..." FLOAT32_IEEE F_1_p0_21 1 2 -3.402823466E+038 3.402823466E+038 ECU_ADDRESS 0x0 /end MEASUREMENT
/begin MEASUREMENT GCore1_f32PosTreatmentLoad "..." FLOAT32_IEEE F_1_p0_21 1 2 -3.402823466E+038 3.402823466E+038 ECU_ADDRESS 0x0 /end MEASUREMENT
/begin MEASUREMENT GCore2_f32Asw10msLoad "..." FLOAT32_IEEE F_1_p0_21 1 2 -3.402823466E+038 3.402823466E+038 ECU_ADDRESS 0x0 /end MEASUREMENT
/begin MEASUREMENT GCore2_f32Asw1msLoad "..." FLOAT32_IEEE F_1_p0_21 1 2 -3.402823466E+038 3.402823466E+038 ECU_ADDRESS 0x0 /end MEASUREMENT
/begin MEASUREMENT GCore2_f32BldcTreatmentLoad "..." FLOAT32_IEEE F_1_p0_21 1 2 -3.402823466E+038 3.402823466E+038 ECU_ADDRESS 0x0 /end MEASUREMENT
/begin MEASUREMENT GCore2_f32Bsw10msLoad "..." FLOAT32_IEEE F_1_p0_21 1 2 -3.402823466E+038 3.402823466E+038 ECU_ADDRESS 0x0 /end MEASUREMENT
/begin MEASUREMENT GDSM_DtcNumber "GDSM_DtcNumber" ULONG I_1 1 2 0 4294967295 MATRIX_DIM 10 1 1 ECU_ADDRESS 0x0 /end MEASUREMENT
/begin MEASUREMENT GDSM_DtcNumber[0] "GDSM_DtcNumber[0]" ULONG I_1 1 2 0 4294967295 ECU_ADDRESS 0x0 /end MEASUREMENT
/begin MEASUREMENT GDSM_DtcNumber[1] "GDSM_DtcNumber[1]" ULONG I_1 1 2 0 4294967295 ECU_ADDRESS 0x0 /end MEASUREMENT
/begin MEASUREMENT GDSM_DtcNumber[2] "GDSM_DtcNumber[2]" ULONG I_1 1 2 0 4294967295 ECU_ADDRESS 0x0 /end MEASUREMENT
/begin MEASUREMENT GDSM_DtcNumber[3] "GDSM_DtcNumber[3]" ULONG I_1 1 2 0 4294967295 ECU_ADDRESS 0x0 /end MEASUREMENT
/begin MEASUREMENT GDSM_DtcNumber[4] "GDSM_DtcNumber[4]" ULONG I_1 1 2 0 4294967295 ECU_ADDRESS 0x0 /end MEASUREMENT
/begin MEASUREMENT GDSM_DtcNumber[5] "GDSM_DtcNumber[5]" ULONG I_1 1 2 0 4294967295 ECU_ADDRESS 0x0 /end MEASUREMENT
/begin MEASUREMENT GDSM_DtcNumber[6] "GDSM_DtcNumber[6]" ULONG I_1 1 2 0 4294967295 ECU_ADDRESS 0x0 /end MEASUREMENT
/begin MEASUREMENT GDSM_DtcNumber[7] "GDSM_DtcNumber[7]" ULONG I_1 1 2 0 4294967295 ECU_ADDRESS 0x0 /end MEASUREMENT
/begin MEASUREMENT GDSM_DtcNumber[8] "GDSM_DtcNumber[8]" ULONG I_1 1 2 0 4294967295 ECU_ADDRESS 0x0 /end MEASUREMENT
/begin MEASUREMENT GDSM_DtcNumber[9] "GDSM_DtcNumber[9]" ULONG I_1 1 2 0 4294967295 ECU_ADDRESS 0x0 /end MEASUREMENT
/begin MEASUREMENT GDSM_DtcStatusNvm "DID 120 -> DTC Setting Control" UBYTE F_1_p0_4 1 2 0 255 MATRIX_DIM 10 1 1 ECU_ADDRESS 0x0 /end MEASUREMENT
/begin MEASUREMENT GDSM_DtcStatusNvm[0] "GDSM_DtcStatusNvm[0]" UBYTE F_1_p0_4 1 2 0 255 ECU_ADDRESS 0x0 /end MEASUREMENT
/begin MEASUREMENT GDSM_DtcStatusNvm[1] "GDSM_DtcStatusNvm[1]" UBYTE F_1_p0_4 1 2 0 255 ECU_ADDRESS 0x0 /end MEASUREMENT
/begin MEASUREMENT GDSM_DtcStatusNvm[2] "GDSM_DtcStatusNvm[2]" UBYTE F_1_p0_4 1 2 0 255 ECU_ADDRESS 0x0 /end MEASUREMENT
/begin MEASUREMENT GDSM_DtcStatusNvm[3] "GDSM_DtcStatusNvm[3]" UBYTE F_1_p0_4 1 2 0 255 ECU_ADDRESS 0x0 /end MEASUREMENT
/begin MEASUREMENT GDSM_DtcStatusNvm[4] "GDSM_DtcStatusNvm[4]" UBYTE F_1_p0_4 1 2 0 255 ECU_ADDRESS 0x0 /end MEASUREMENT
/begin MEASUREMENT GDSM_DtcStatusNvm[5] "GDSM_DtcStatusNvm[5]" UBYTE F_1_p0_4 1 2 0 255 ECU_ADDRESS 0x0 /end MEASUREMENT
/begin MEASUREMENT GDSM_DtcStatusNvm[6] "GDSM_DtcStatusNvm[6]" UBYTE F_1_p0_4 1 2 0 255 ECU_ADDRESS 0x0 /end MEASUREMENT
/begin MEASUREMENT GDSM_DtcStatusNvm[7] "GDSM_DtcStatusNvm[7]" UBYTE F_1_p0_4 1 2 0 255 ECU_ADDRESS 0x0 /end MEASUREMENT
/begin MEASUREMENT GDSM_DtcStatusNvm[8] "GDSM_DtcStatusNvm[8]" UBYTE F_1_p0_4 1 2 0 255 ECU_ADDRESS 0x0 /end MEASUREMENT
/begin MEASUREMENT GDSM_DtcStatusNvm[9] "GDSM_DtcStatusNvm[9]" UBYTE F_1_p0_4 1 2 0 255 ECU_ADDRESS 0x0 /end MEASUREMENT
/begin MEASUREMENT GFaultEraseRequest "GFaultEraseRequest" UWORD I_1 1 2 0 65535 ECU_ADDRESS 0x0 /end MEASUREMENT
/begin MEASUREMENT GFaultFailureLevel "GFaultFailureLevel" UBYTE I_1 1 2 0 255 ECU_ADDRESS 0x0 /end MEASUREMENT
/begin MEASUREMENT GMAIN_as32OCTrimNvm "-" SLONG Id_0x00 1 2 -2147483648 2147483647 MATRIX_DIM 5 1 1 ECU_ADDRESS 0x0 /end MEASUREMENT
/begin MEASUREMENT GMAIN_as32OCTrimNvm[0] "GMAIN_as32OCTrimNvm[0]" SLONG Id_0x00 1 2 -2147483648 2147483647 ECU_ADDRESS 0x0 /end MEASUREMENT
/begin MEASUREMENT GMAIN_as32OCTrimNvm[1] "GMAIN_as32OCTrimNvm[1]" SLONG Id_0x00 1 2 -2147483648 2147483647 ECU_ADDRESS 0x0 /end MEASUREMENT
/begin MEASUREMENT GMAIN_as32OCTrimNvm[2] "GMAIN_as32OCTrimNvm[2]" SLONG Id_0x00 1 2 -2147483648 2147483647 ECU_ADDRESS 0x0 /end MEASUREMENT
/begin MEASUREMENT GMAIN_as32OCTrimNvm[3] "GMAIN_as32OCTrimNvm[3]" SLONG Id_0x00 1 2 -2147483648 2147483647 ECU_ADDRESS 0x0 /end MEASUREMENT
/begin MEASUREMENT GMAIN_as32OCTrimNvm[4] "GMAIN_as32OCTrimNvm[4]" SLONG Id_0x00 1 2 -2147483648 2147483647 ECU_ADDRESS 0x0 /end MEASUREMENT
/begin MEASUREMENT GMAIN_au8ErrCode "-" UBYTE F_1_p0_4 1 2 0 255 MATRIX_DIM 20 1 1 ECU_ADDRESS 0x0 /end MEASUREMENT
/begin MEASUREMENT GMAIN_au8ErrCode[0] "GMAIN_au8ErrCode[0]" UBYTE F_1_p0_4 1 2 0 255 ECU_ADDRESS 0x0 /end MEASUREMENT
/begin MEASUREMENT GMAIN_au8ErrCode[10] "GMAIN_au8ErrCode[10]" UBYTE F_1_p0_4 1 2 0 255 ECU_ADDRESS 0x0 /end MEASUREMENT
/begin MEASUREMENT GMAIN_au8ErrCode[11] "GMAIN_au8ErrCode[11]" UBYTE F_1_p0_4 1 2 0 255 ECU_ADDRESS 0x0 /end MEASUREMENT
/begin MEASUREMENT GMAIN_au8ErrCode[12] "GMAIN_au8ErrCode[12]" UBYTE F_1_p0_4 1 2 0 255 ECU_ADDRESS 0x0 /end MEASUREMENT
/begin MEASUREMENT GMAIN_au8ErrCode[13] "GMAIN_au8ErrCode[13]" UBYTE F_1_p0_4 1 2 0 255 ECU_ADDRESS 0x0 /end MEASUREMENT
/begin MEASUREMENT GMAIN_au8ErrCode[14] "GMAIN_au8ErrCode[14]" UBYTE F_1_p0_4 1 2 0 255 ECU_ADDRESS 0x0 /end MEASUREMENT
/begin MEASUREMENT GMAIN_au8ErrCode[15] "GMAIN_au8ErrCode[15]" UBYTE F_1_p0_4 1 2 0 255 ECU_ADDRESS 0x0 /end MEASUREMENT
/begin MEASUREMENT GMAIN_au8ErrCode[16] "GMAIN_au8ErrCode[16]" UBYTE F_1_p0_4 1 2 0 255 ECU_ADDRESS 0x0 /end MEASUREMENT
/begin MEASUREMENT GMAIN_au8ErrCode[17] "GMAIN_au8ErrCode[17]" UBYTE F_1_p0_4 1 2 0 255 ECU_ADDRESS 0x0 /end MEASUREMENT
/begin MEASUREMENT GMAIN_au8ErrCode[18] "GMAIN_au8ErrCode[18]" UBYTE F_1_p0_4 1 2 0 255 ECU_ADDRESS 0x0 /end MEASUREMENT
/begin MEASUREMENT GMAIN_au8ErrCode[19] "GMAIN_au8ErrCode[19]" UBYTE F_1_p0_4 1 2 0 255 ECU_ADDRESS 0x0 /end MEASUREMENT
/begin MEASUREMENT GMAIN_au8ErrCode[1] "GMAIN_au8ErrCode[1]" UBYTE F_1_p0_4 1 2 0 255 ECU_ADDRESS 0x0 /end MEASUREMENT
/begin MEASUREMENT GMAIN_au8ErrCode[2] "GMAIN_au8ErrCode[2]" UBYTE F_1_p0_4 1 2 0 255 ECU_ADDRESS 0x0 /end MEASUREMENT
/begin MEASUREMENT GMAIN_au8ErrCode[3] "GMAIN_au8ErrCode[3]" UBYTE F_1_p0_4 1 2 0 255 ECU_ADDRESS 0x0 /end MEASUREMENT
/begin MEASUREMENT GMAIN_au8ErrCode[4] "GMAIN_au8ErrCode[4]" UBYTE F_1_p0_4 1 2 0 255 ECU_ADDRESS 0x0 /end MEASUREMENT
/begin MEASUREMENT GMAIN_au8ErrCode[5] "GMAIN_au8ErrCode[5]" UBYTE F_1_p0_4 1 2 0 255 ECU_ADDRESS 0x0 /end MEASUREMENT
/begin MEASUREMENT GMAIN_au8ErrCode[6] "GMAIN_au8ErrCode[6]" UBYTE F_1_p0_4 1 2 0 255 ECU_ADDRESS 0x0 /end MEASUREMENT
/begin MEASUREMENT GMAIN_au8ErrCode[7] "GMAIN_au8ErrCode[7]" UBYTE F_1_p0_4 1 2 0 255 ECU_ADDRESS 0x0 /end MEASUREMENT
/begin MEASUREMENT GMAIN_au8ErrCode[8] "GMAIN_au8ErrCode[8]" UBYTE F_1_p0_4 1 2 0 255 ECU_ADDRESS 0x0 /end MEASUREMENT
/begin MEASUREMENT HARD_ESM_FT_STATE_FT_SHUTDOWN "HARD_ESM_FT_STATE_FT_SHUTDOWN" UBYTE Bool_ON_OFF 1 2 0 1 BIT_MASK 0x08 ECU_ADDRESS 0x0 /end MEASUREMENT
/begin MEASUREMENT HARD_ESM_FT_STATE_IDLE "HARD_ESM_FT_STATE_IDLE" UBYTE Bool_ON_OFF 1 2 0 1 BIT_MASK 0x40 ECU_ADDRESS 0x0 /end MEASUREMENT
/begin MEASUREMENT HARD_ESM_FT_STATE_PWM_DIRECT "HARD_ESM_FT_STATE_PWM_DIRECT" UBYTE Bool_ON_OFF 1 2 0 1 BIT_MASK 0x01 ECU_ADDRESS 0x0 /end MEASUREMENT
/begin MEASUREMENT HARD_ESM_FT_STATE_PWM_HARD "HARD_ESM_FT_STATE_PWM_HARD" UBYTE Bool_ON_OFF 1 2 0 1 BIT_MASK 0x02 ECU_ADDRESS 0x0 /end MEASUREMENT
/begin MEASUREMENT HARD_ESM_FT_STATE_PWM_OFF "HARD_ESM_FT_STATE_PWM_OFF" UBYTE Bool_ON_OFF 1 2 0 1 BIT_MASK 0x04 ECU_ADDRESS 0x0 /end MEASUREMENT
/begin MEASUREMENT HARD_ESM_NF_STATE_FT_START "HARD_ESM_NF_STATE_FT_START" UBYTE Bool_ON_OFF 1 2 0 1 BIT_MASK 0x01 ECU_ADDRESS 0x0 /end MEASUREMENT
/begin MEASUREMENT HARD_ESM_NF_STATE_IDLE "HARD_ESM_NF_STATE_IDLE" UBYTE Bool_ON_OFF 1 2 0 1 BIT_MASK 0x40 ECU_ADDRESS 0x0 /end MEASUREMENT
/begin MEASUREMENT HARD_ESM_NF_STATE_PWM_HARD "HARD_ESM_NF_STATE_PWM_HARD" UBYTE Bool_ON_OFF 1 2 0 1 BIT_MASK 0x08 ECU_ADDRESS 0x0 /end MEASUREMENT
/begin MEASUREMENT HARD_ESM_NF_STATE_PWM_OFF "HARD_ESM_NF_STATE_PWM_OFF" UBYTE Bool_ON_OFF 1 2 0 1 BIT_MASK 0x10 ECU_ADDRESS 0x0 /end MEASUREMENT
/begin MEASUREMENT HARD_ESM_NF_STATE_SW_SHUTDOWN "HARD_ESM_NF_STATE_SW_SHUTDOWN" UBYTE Bool_ON_OFF 1 2 0 1 BIT_MASK 0x04 ECU_ADDRESS 0x0 /end MEASUREMENT
/begin MEASUREMENT HARD_EsmFtState "HARD_EsmFtState" UWORD HARD_EsmFtState_conv 1 2 1 64 ECU_ADDRESS 0x0 /end MEASUREMENT
/begin MEASUREMENT HARD_EsmFtStateAut "HARD_EsmFtStateAut" UBYTE Bool_ON_OFF 1 2 0 1 BIT_MASK 0x01 ECU_ADDRESS 0x0 /end MEASUREMENT
/begin MEASUREMENT HARD_EsmNfState "HARD_EsmNfState" UWORD HARD_EsmNfState_conv 1 2 1 64 ECU_ADDRESS 0x0 /end MEASUREMENT
/begin MEASUREMENT HARD_EsmNfStateAut "HARD_EsmNfStateAut" UBYTE Bool_ON_OFF 1 2 0 1 BIT_MASK 0x01 ECU_ADDRESS 0x0 /end MEASUREMENT
/begin MEASUREMENT HARD_PTG_CONTINUOUS_MODE "HARD_PTG_CONTINUOUS_MODE" UBYTE Bool_ON_OFF 1 2 0 1 BIT_MASK 0x10 ECU_ADDRESS 0x0 /end MEASUREMENT
/begin MEASUREMENT HARD_PTG_DISJUNCTION_MODE "HARD_PTG_DISJUNCTION_MODE" UBYTE Bool_ON_OFF 1 2 0 1 BIT_MASK 0x40 ECU_ADDRESS 0x0 /end MEASUREMENT
/begin MEASUREMENT HARD_PTG_LOOP_NB_MODE "HARD_PTG_LOOP_NB_MODE" UBYTE Bool_ON_OFF 1 2 0 1 BIT_MASK 0x80 ECU_ADDRESS 0x0 /end MEASUREMENT
/begin MEASUREMENT HARD_PTG_PROFIL_MODE "HARD_PTG_PROFIL_MODE" UBYTE Bool_ON_OFF 1 2 0 1 BIT_MASK 0x20 ECU_ADDRESS 0x0 /end MEASUREMENT
/begin MEASUREMENT HARD_PTG_PULSE_MODE "HARD_PTG_PULSE_MODE" UBYTE Bool_ON_OFF 1 2 0 1 BIT_MASK 0x01 ECU_ADDRESS 0x0 /end MEASUREMENT
/begin MEASUREMENT HARD_PTG_SINUS_MODE "HARD_PTG_SINUS_MODE" UBYTE Bool_ON_OFF 1 2 0 1 BIT_MASK 0x02 ECU_ADDRESS 0x0 /end MEASUREMENT
/begin MEASUREMENT HARD_PTG_SQUARE_MODE "HARD_PTG_SQUARE_MODE" UBYTE Bool_ON_OFF 1 2 0 1 BIT_MASK 0x08 ECU_ADDRESS 0x0 /end MEASUREMENT
/begin MEASUREMENT HARD_PTG_TRIANGLE_MODE "HARD_PTG_TRIANGLE_MODE" UBYTE Bool_ON_OFF 1 2 0 1 BIT_MASK 0x04 ECU_ADDRESS 0x0 /end MEASUREMENT
/begin MEASUREMENT HARD_PtgModeTest "HARD_PtgModeTest" UWORD HARD_PtgModeTest_conv 1 2 1 128 ECU_ADDRESS 0x0 /end MEASUREMENT
/begin MEASUREMENT HARD_bDio_DCLINK_OV_FAULT "HARD_bDio_DCLINK_OV_FAULT" UBYTE Bool_ON_OFF 1 2 0 1 BIT_MASK 0x01 ECU_ADDRESS 0x0 /end MEASUREMENT
/begin MEASUREMENT HARD_bDio_MCU_STATE_LED "HARD_bDio_MCU_STATE_LED" UBYTE Bool_ON_OFF 1 2 0 1 BIT_MASK 0x01 ECU_ADDRESS 0x0 /end MEASUREMENT
/begin MEASUREMENT HARD_bDio_M_CLU_ENA "HARD_bDio_M_CLU_ENA" UBYTE Bool_ON_OFF 1 2 0 1 BIT_MASK 0x01 ECU_ADDRESS 0x0 /end MEASUREMENT
/begin MEASUREMENT HARD_bDio_M_EXCI_TRIGGER_GCU "HARD_bDio_M_EXCI_TRIGGER_GCU" UBYTE Bool_ON_OFF 1 2 0 1 BIT_MASK 0x01 ECU_ADDRESS 0x0 /end MEASUREMENT
/begin MEASUREMENT HARD_bDio_M_EXCI_TRIGGER_MCU "HARD_bDio_M_EXCI_TRIGGER_MCU" UBYTE Bool_ON_OFF 1 2 0 1 BIT_MASK 0x01 ECU_ADDRESS 0x0 /end MEASUREMENT
/begin MEASUREMENT HARD_bDio_M_FAULT_DRV_GCU_H "HARD_bDio_M_FAULT_DRV_GCU_H" UBYTE Bool_ON_OFF 1 2 0 1 BIT_MASK 0x01 ECU_ADDRESS 0x0 /end MEASUREMENT
/begin MEASUREMENT HARD_bDio_M_FAULT_DRV_GCU_L "HARD_bDio_M_FAULT_DRV_GCU_L" UBYTE Bool_ON_OFF 1 2 0 1 BIT_MASK 0x01 ECU_ADDRESS 0x0 /end MEASUREMENT
/begin MEASUREMENT HARD_bDio_M_FAULT_DRV_MCU_H "HARD_bDio_M_FAULT_DRV_MCU_H" UBYTE Bool_ON_OFF 1 2 0 1 BIT_MASK 0x01 ECU_ADDRESS 0x0 /end MEASUREMENT
/begin MEASUREMENT HARD_bDio_M_FAULT_DRV_MCU_L "HARD_bDio_M_FAULT_DRV_MCU_L" UBYTE Bool_ON_OFF 1 2 0 1 BIT_MASK 0x01 ECU_ADDRESS 0x0 /end MEASUREMENT
/begin MEASUREMENT HARD_bDio_M_FAULT_HS "HARD_bDio_M_FAULT_HS" UBYTE Bool_ON_OFF 1 2 0 1 BIT_MASK 0x01 ECU_ADDRESS 0x0 /end MEASUREMENT
/begin MEASUREMENT HARD_bDio_M_FAULT_LS "HARD_bDio_M_FAULT_LS" UBYTE Bool_ON_OFF 1 2 0 1 BIT_MASK 0x01 ECU_ADDRESS 0x0 /end MEASUREMENT
/begin MEASUREMENT HARD_bDio_M_FLT_EXCITATION_IN_GCU "HARD_bDio_M_FLT_EXCITATION_IN_GCU" UBYTE Bool_ON_OFF 1 2 0 1 BIT_MASK 0x01 ECU_ADDRESS 0x0 /end MEASUREMENT
/begin MEASUREMENT HARD_bDio_M_FLT_EXCITATION_IN_MCU "HARD_bDio_M_FLT_EXCITATION_IN_MCU" UBYTE Bool_ON_OFF 1 2 0 1 BIT_MASK 0x01 ECU_ADDRESS 0x0 /end MEASUREMENT
/begin MEASUREMENT HARD_bDio_M_HWCFG1 "HARD_bDio_M_HWCFG1" UBYTE Bool_ON_OFF 1 2 0 1 BIT_MASK 0x01 ECU_ADDRESS 0x0 /end MEASUREMENT
/begin MEASUREMENT HARD_bDio_M_HWCFG2 "HARD_bDio_M_HWCFG2" UBYTE Bool_ON_OFF 1 2 0 1 BIT_MASK 0x01 ECU_ADDRESS 0x0 /end MEASUREMENT
/begin MEASUREMENT HARD_bDio_M_HWCFG3 "HARD_bDio_M_HWCFG3" UBYTE Bool_ON_OFF 1 2 0 1 BIT_MASK 0x01 ECU_ADDRESS 0x0 /end MEASUREMENT
/begin MEASUREMENT HARD_bDio_M_HWCFG4 "HARD_bDio_M_HWCFG4" UBYTE Bool_ON_OFF 1 2 0 1 BIT_MASK 0x01 ECU_ADDRESS 0x0 /end MEASUREMENT
/begin MEASUREMENT HARD_bDio_M_HWCFG5 "HARD_bDio_M_HWCFG5" UBYTE Bool_ON_OFF 1 2 0 1 BIT_MASK 0x01 ECU_ADDRESS 0x0 /end MEASUREMENT
/begin MEASUREMENT HARD_bDio_M_HWCFG6 "HARD_bDio_M_HWCFG6" UBYTE Bool_ON_OFF 1 2 0 1 BIT_MASK 0x01 ECU_ADDRESS 0x0 /end MEASUREMENT
/begin MEASUREMENT HARD_bDio_M_HWNUM_0 "HARD_bDio_M_HWNUM_0" UBYTE Bool_ON_OFF 1 2 0 1 BIT_MASK 0x01 ECU_ADDRESS 0x0 /end MEASUREMENT
/begin MEASUREMENT HARD_bDio_M_HWNUM_1 "HARD_bDio_M_HWNUM_1" UBYTE Bool_ON_OFF 1 2 0 1 BIT_MASK 0x01 ECU_ADDRESS 0x0 /end MEASUREMENT
/begin MEASUREMENT HARD_bDio_M_HWNUM_2 "HARD_bDio_M_HWNUM_2" UBYTE Bool_ON_OFF 1 2 0 1 BIT_MASK 0x01 ECU_ADDRESS 0x0 /end MEASUREMENT
/begin MEASUREMENT HARD_bDio_M_KEY_ON "HARD_bDio_M_KEY_ON" UBYTE Bool_ON_OFF 1 2 0 1 BIT_MASK 0x01 ECU_ADDRESS 0x0 /end MEASUREMENT
/begin MEASUREMENT HARD_bDio_M_MCU_ASC_STATE_MCU "HARD_bDio_M_MCU_ASC_STATE_MCU" UBYTE Bool_ON_OFF 1 2 0 1 BIT_MASK 0x01 ECU_ADDRESS 0x0 /end MEASUREMENT
/begin MEASUREMENT HARD_bDio_M_OIL_ENA "HARD_bDio_M_OIL_ENA" UBYTE Bool_ON_OFF 1 2 0 1 BIT_MASK 0x01 ECU_ADDRESS 0x0 /end MEASUREMENT
/begin MEASUREMENT HARD_bDio_M_PW_DOWN "HARD_bDio_M_PW_DOWN" UBYTE Bool_ON_OFF 1 2 0 1 BIT_MASK 0x01 ECU_ADDRESS 0x0 /end MEASUREMENT
/begin MEASUREMENT HARD_bDio_M_SUPPLY_WDI "HARD_bDio_M_SUPPLY_WDI" UBYTE Bool_ON_OFF 1 2 0 1 BIT_MASK 0x01 ECU_ADDRESS 0x0 /end MEASUREMENT
/begin MEASUREMENT HARD_bDio_OIL_ERR "HARD_bDio_OIL_ERR" UBYTE Bool_ON_OFF 1 2 0 1 BIT_MASK 0x01 ECU_ADDRESS 0x0 /end MEASUREMENT
/begin MEASUREMENT HARD_bESMCmdFtShutdownReq "HARD_bESMCmdFtShutdownReq" UBYTE Bool_ON_OFF 1 2 0 1 BIT_MASK 0x01 ECU_ADDRESS 0x0 /end MEASUREMENT
/begin MEASUREMENT HARD_bESMCmdFtShutdownRes "HARD_bESMCmdFtShutdownRes" UBYTE Bool_ON_OFF 1 2 0 1 BIT_MASK 0x01 ECU_ADDRESS 0x0 /end MEASUREMENT
/begin MEASUREMENT HARD_bESMCmdFtStartReq "HARD_bESMCmdFtStartReq" UBYTE Bool_ON_OFF 1 2 0 1 BIT_MASK 0x01 ECU_ADDRESS 0x0 /end MEASUREMENT
/begin MEASUREMENT HARD_bESMCmdFtStartRes "HARD_bESMCmdFtStartRes" UBYTE Bool_ON_OFF 1 2 0 1 BIT_MASK 0x01 ECU_ADDRESS 0x0 /end MEASUREMENT
/begin MEASUREMENT HARD_bESMCmdPwmDirectReq "HARD_bESMCmdPwmDirectReq" UBYTE Bool_ON_OFF 1 2 0 1 BIT_MASK 0x01 ECU_ADDRESS 0x0 /end MEASUREMENT
/begin MEASUREMENT HARD_bESMCmdPwmDirectRes "HARD_bESMCmdPwmDirectRes" UBYTE Bool_ON_OFF 1 2 0 1 BIT_MASK 0x01 ECU_ADDRESS 0x0 /end MEASUREMENT
/begin MEASUREMENT HARD_bESMCmdPwmHardReq "HARD_bESMCmdPwmHardReq" UBYTE Bool_ON_OFF 1 2 0 1 BIT_MASK 0x01 ECU_ADDRESS 0x0 /end MEASUREMENT
/begin MEASUREMENT HARD_bESMCmdPwmHardRes "HARD_bESMCmdPwmHardRes" UBYTE Bool_ON_OFF 1 2 0 1 BIT_MASK 0x01 ECU_ADDRESS 0x0 /end MEASUREMENT
/begin MEASUREMENT HARD_bESMCmdPwmOffReq "HARD_bESMCmdPwmOffReq" UBYTE Bool_ON_OFF 1 2 0 1 BIT_MASK 0x01 ECU_ADDRESS 0x0 /end MEASUREMENT
/begin MEASUREMENT HARD_bESMCmdPwmOffRes "HARD_bESMCmdPwmOffRes" UBYTE Bool_ON_OFF 1 2 0 1 BIT_MASK 0x01 ECU_ADDRESS 0x0 /end MEASUREMENT
/begin MEASUREMENT HARD_bESMCmdSwShutdownReq "HARD_bESMCmdSwShutdownReq" UBYTE Bool_ON_OFF 1 2 0 1 BIT_MASK 0x01 ECU_ADDRESS 0x0 /end MEASUREMENT
/begin MEASUREMENT HARD_bESMCmdSwShutdownRes "HARD_bESMCmdSwShutdownRes" UBYTE Bool_ON_OFF 1 2 0 1 BIT_MASK 0x01 ECU_ADDRESS 0x0 /end MEASUREMENT
/begin MEASUREMENT HARD_bESMCmdSwStartReq "HARD_bESMCmdSwStartReq" UBYTE Bool_ON_OFF 1 2 0 1 BIT_MASK 0x01 ECU_ADDRESS 0x0 /end MEASUREMENT
/begin MEASUREMENT HARD_bESMCmdSwStartRes "HARD_bESMCmdSwStartRes" UBYTE Bool_ON_OFF 1 2 0 1 BIT_MASK 0x01 ECU_ADDRESS 0x0 /end MEASUREMENT
/begin MEASUREMENT HARD_bModSeq1FuncOn "Mode fonctionnel Hard mode #1: Functional stage: Test CEM traction (20/10/2015)" UBYTE Bool_ON_OFF 1 2 0 1 BIT_MASK 0x01 ECU_ADDRESS 0x0 /end MEASUREMENT
/begin MEASUREMENT HARD_bModSeq1InitOn "Mode fonctionnel Hard mode #1: Initialization stage : Test CEM traction (20/10/2015)" UBYTE Bool_ON_OFF 1 2 0 1 BIT_MASK 0x01 ECU_ADDRESS 0x0 /end MEASUREMENT
/begin MEASUREMENT HARD_bModSeq2FuncOn "Mode fonctionnel Hard mode #2: Functional stage: Test xx (xx/xx/xxxx)" UBYTE Bool_ON_OFF 1 2 0 1 BIT_MASK 0x01 ECU_ADDRESS 0x0 /end MEASUREMENT
/begin MEASUREMENT HARD_bModSeq2InitOn "Mode fonctionnel Hard mode #2: Initialization stage : Test xx (xx/xx/xxxx)" UBYTE Bool_ON_OFF 1 2 0 1 BIT_MASK 0x01 ECU_ADDRESS 0x0 /end MEASUREMENT
/begin MEASUREMENT HARD_bNMTestOn "Nm Test on" UBYTE Bool_ON_OFF 1 2 0 1 BIT_MASK 0x01 ECU_ADDRESS 0x0 /end MEASUREMENT
/begin MEASUREMENT HARD_bNmRxRepeatMsgReq "Nm Test on" UBYTE Bool_ON_OFF 1 2 0 1 BIT_MASK 0x01 ECU_ADDRESS 0x0 /end MEASUREMENT
/begin MEASUREMENT HARD_bNmTxRepeatMsgReq "Nm Test on" UBYTE Bool_ON_OFF 1 2 0 1 BIT_MASK 0x01 ECU_ADDRESS 0x0 /end MEASUREMENT
/begin MEASUREMENT HARD_bPtgEnable "HARD_bPtgEnable" UBYTE Bool_ON_OFF 1 2 0 1 BIT_MASK 0x01 ECU_ADDRESS 0x0 /end MEASUREMENT
/begin MEASUREMENT HARD_bPtgSignalsShiftControl "HARD_bPtgSignalsShiftControl" UBYTE Bool_ON_OFF 1 2 0 1 BIT_MASK 0x01 ECU_ADDRESS 0x0 /end MEASUREMENT
/begin MEASUREMENT HARD_bPtgUSignalEnable "HARD_bPtgUSignalEnable" UBYTE Bool_ON_OFF 1 2 0 1 BIT_MASK 0x01 ECU_ADDRESS 0x0 /end MEASUREMENT
/begin MEASUREMENT HARD_bPtgVSignalEnable "HARD_bPtgVSignalEnable" UBYTE Bool_ON_OFF 1 2 0 1 BIT_MASK 0x01 ECU_ADDRESS 0x0 /end MEASUREMENT
/begin MEASUREMENT HARD_bPtgWSignalEnable "HARD_bPtgWSignalEnable" UBYTE Bool_ON_OFF 1 2 0 1 BIT_MASK 0x01 ECU_ADDRESS 0x0 /end MEASUREMENT
/begin MEASUREMENT HARD_s16PtgRefSignalValue "HARD_s16PtgRefSignalValue" SWORD I_1 1 2 -32768 32767 ECU_ADDRESS 0x0 /end MEASUREMENT
/begin MEASUREMENT HARD_s16PtgUSignalValue "HARD_s16PtgUSignalValue" SWORD I_1 1 2 -32768 32767 ECU_ADDRESS 0x0 /end MEASUREMENT
/begin MEASUREMENT HARD_s16PtgVSignalValue "HARD_s16PtgVSignalValue" SWORD I_1 1 2 -32768 32767 ECU_ADDRESS 0x0 /end MEASUREMENT
/begin MEASUREMENT HARD_s16PtgWSignalValue "HARD_s16PtgWSignalValue" SWORD I_1 1 2 -32768 32767 ECU_ADDRESS 0x0 /end MEASUREMENT
/begin MEASUREMENT HARD_u16Adc0An00_MOT_COS "HARD_u16Adc0An00_MOT_COS" UWORD F_0v0012210012_p0_10 1 2 0 80.01831502 ECU_ADDRESS 0x0 /end MEASUREMENT
/begin MEASUREMENT HARD_u16Adc0An01_P5VHS_REF "HARD_u16Adc0An01_P5VHS_REF" UWORD F_0v0012210012_p0_10 1 2 0 80.01831502 ECU_ADDRESS 0x0 /end MEASUREMENT
/begin MEASUREMENT HARD_u16Adc0An02_P16VMult "HARD_u16Adc0An02_P16VMult" UWORD F_0v0012210012_p0_10 1 2 0 80.01831502 ECU_ADDRESS 0x0 /end MEASUREMENT
/begin MEASUREMENT HARD_u16Adc0An03_CTP_MOT1_F "HARD_u16Adc0An03_CTP_MOT1_F" UWORD F_0v0012210012_p0_10 1 2 0 80.01831502 ECU_ADDRESS 0x0 /end MEASUREMENT
/begin MEASUREMENT HARD_u16Adc0An03_CTP_MOT1_FPhys "HARD_u16Adc0An03_CTP_MOT1_Fphys" UWORD F_1_m40_58 1 2 -40 65495 ECU_ADDRESS 0x0 /end MEASUREMENT
/begin MEASUREMENT HARD_u16Adc0An04_CTP_MOT2_F "HARD_u16Adc0An04_CTP_MOT2_F" UWORD F_0v0012210012_p0_10 1 2 0 80.01831502 ECU_ADDRESS 0x0 /end MEASUREMENT
/begin MEASUREMENT HARD_u16Adc0An04_CTP_MOT2_FPhys "HARD_u16Adc0An04_CTP_MOT2_Fphys" UWORD F_1_m40_58 1 2 -40 65495 ECU_ADDRESS 0x0 /end MEASUREMENT
/begin MEASUREMENT HARD_u16Adc0An05_MonP5VRef "HARD_u16Adc0An05_MonP5VRef" UWORD F_0v0012210012_p0_10 1 2 0 80.01831502 ECU_ADDRESS 0x0 /end MEASUREMENT
/begin MEASUREMENT HARD_u16Adc0An06_P5vLsRef "HARD_u16Adc0An06_P5vLsRef" UWORD F_0v0012210012_p0_10 1 2 0 80.01831502 ECU_ADDRESS 0x0 /end MEASUREMENT
/begin MEASUREMENT HARD_u16Adc0An07_DIAG_CONS_EXC "HARD_u16Adc0An07_DIAG_CONS_EXC" UWORD F_0v0012210012_p0_10 1 2 0 80.01831502 ECU_ADDRESS 0x0 /end MEASUREMENT
/begin MEASUREMENT HARD_u16Adc0An08_CTP_COOLING "HARD_u16Adc0An08_CTP_COOLING" UWORD F_0v0012210012_p0_10 1 2 0 80.01831502 ECU_ADDRESS 0x0 /end MEASUREMENT
/begin MEASUREMENT HARD_u16Adc0An08_CTP_COOLINGPhys "HARD_u16Adc0An08_CTP_COOLINGPhys" UWORD F_1_m40_58 1 2 -40 65495 ECU_ADDRESS 0x0 /end MEASUREMENT
/begin MEASUREMENT HARD_u16Adc0An10_CTN_BOARD2 "HARD_u16Adc0An10_CTN_BOARD2" UWORD F_0v0012210012_p0_10 1 2 0 80.01831502 ECU_ADDRESS 0x0 /end MEASUREMENT
/begin MEASUREMENT HARD_u16Adc0An10_CTN_BOARD2Phys "HARD_u16Adc0An10_CTN_BOARD2Phys" UBYTE F_1_m40_58 1 2 -40 215 ECU_ADDRESS 0x0 /end MEASUREMENT
/begin MEASUREMENT HARD_u16Adc0An11_IgbtTemp_3 "HARD_u16Adc0An11_IgbtTemp_3" UWORD F_0v0012210012_p0_10 1 2 0 80.01831502 ECU_ADDRESS 0x0 /end MEASUREMENT
/begin MEASUREMENT HARD_u16Adc0An12_IgbtTemp_2 "HARD_u16Adc0An12_IgbtTemp_2" UWORD F_0v0012210012_p0_10 1 2 0 80.01831502 ECU_ADDRESS 0x0 /end MEASUREMENT
/begin MEASUREMENT HARD_u16Adc0An13_MOT_COS_SAFE "HARD_u16Adc0An13_MOT_COS_SAFE" UWORD F_0v0012210012_p0_10 1 2 0 80.01831502 ECU_ADDRESS 0x0 /end MEASUREMENT
/begin MEASUREMENT HARD_u16Adc1An16_MOT_SIN "HARD_u16Adc1An16_MOT_SIN" UWORD F_0v0012210012_p0_10 1 2 0 80.01831502 ECU_ADDRESS 0x0 /end MEASUREMENT
/begin MEASUREMENT HARD_u16Adc1An18_VolDcLinkDrv "HARD_u16Adc1An18_VolDcLinkDrv" UWORD F_0v0012210012_p0_10 1 2 0 80.01831502 ECU_ADDRESS 0x0 /end MEASUREMENT
/begin MEASUREMENT HARD_u16Adc1An19_P12V_BATT_F "HARD_u16Adc1An19_P12V_BATT_F" UWORD F_0v0012210012_p0_10 1 2 0 80.01831502 ECU_ADDRESS 0x0 /end MEASUREMENT
/begin MEASUREMENT HARD_u16Adc1An19_P12V_BATT_Fphys "HARD_u16Adc1An19_P12V_BATT_Fphys" UWORD F_0v0126197802_p0_59 1 2 0 827.0372967 ECU_ADDRESS 0x0 /end MEASUREMENT
/begin MEASUREMENT HARD_u16Adc1An20_DELTA_COS_POS "HARD_u16Adc1An20_DELTA_COS_POS" UWORD F_0v0012210012_p0_10 1 2 0 80.01831502 ECU_ADDRESS 0x0 /end MEASUREMENT
/begin MEASUREMENT HARD_u16Adc1An21_DELTA_COS_NEG "HARD_u16Adc1An21_DELTA_COS_NEG" UWORD F_0v0012210012_p0_10 1 2 0 80.01831502 ECU_ADDRESS 0x0 /end MEASUREMENT
/begin MEASUREMENT HARD_u16Adc1An24_PSU_P5V_LS "HARD_u16Adc1An24_PSU_P5V_LS" UWORD F_0v0012210012_p0_10 1 2 0 80.01831502 ECU_ADDRESS 0x0 /end MEASUREMENT
/begin MEASUREMENT HARD_u16Adc1An25_CURR_DC "HARD_u16Adc1An25_CURR_DC" UWORD F_0v0012210012_p0_10 1 2 0 80.01831502 ECU_ADDRESS 0x0 /end MEASUREMENT
/begin MEASUREMENT HARD_u16Adc1An26_PSU_P5V_HS "HARD_u16Adc1An26_PSU_P5V_HS" UWORD F_0v0012210012_p0_10 1 2 0 80.01831502 ECU_ADDRESS 0x0 /end MEASUREMENT
/begin MEASUREMENT HARD_u16Adc1An27_SPARE_4 "HARD_u16Adc1An27_SPARE_4" UWORD F_0v0012210012_p0_10 1 2 0 80.01831502 ECU_ADDRESS 0x0 /end MEASUREMENT
/begin MEASUREMENT HARD_u16Adc1An28_MonCurrOcpL "HARD_u16Adc1An28_MonCurrOcpL" UWORD F_0v0012210012_p0_10 1 2 0 80.01831502 ECU_ADDRESS 0x0 /end MEASUREMENT
/begin MEASUREMENT HARD_u16Adc1An29_MOT_SIN_SAFE "HARD_u16Adc1An29_MOT_SIN_SAFE" UWORD F_0v0012210012_p0_10 1 2 0 80.01831502 ECU_ADDRESS 0x0 /end MEASUREMENT
/begin MEASUREMENT HARD_u16Adc1An57_TempDrv "HARD_u16Adc1An57_TempDrv" UWORD I_1 1 2 0 65535 ECU_ADDRESS 0x0 /end MEASUREMENT
/begin MEASUREMENT HARD_u16Adc2An32_DIAG_COS_H "HARD_u16Adc2An32_DIAG_COS_H" UWORD F_0v0012210012_p0_10 1 2 0 80.01831502 ECU_ADDRESS 0x0 /end MEASUREMENT
/begin MEASUREMENT HARD_u16Adc2An33_DIAG_COS_L "HARD_u16Adc2An33_DIAG_COS_L" UWORD F_0v0012210012_p0_10 1 2 0 80.01831502 ECU_ADDRESS 0x0 /end MEASUREMENT
/begin MEASUREMENT HARD_u16Adc2An35_DIAG_SIN_H "HARD_u16Adc2An35_DIAG_SIN_H" UWORD F_0v0012210012_p0_10 1 2 0 80.01831502 ECU_ADDRESS 0x0 /end MEASUREMENT
/begin MEASUREMENT HARD_u16Adc2An38_DIAG_SIN_L "HARD_u16Adc2An38_DIAG_SIN_L" UWORD F_0v0012210012_p0_10 1 2 0 80.01831502 ECU_ADDRESS 0x0 /end MEASUREMENT
/begin MEASUREMENT HARD_u16Adc2An44_CTN_BOARD1 "HARD_u16Adc2An44_CTN_BOARD1" UWORD F_0v0012210012_p0_10 1 2 0 80.01831502 ECU_ADDRESS 0x0 /end MEASUREMENT
/begin MEASUREMENT HARD_u16Adc2An44_CTN_BOARD1Phys "HARD_u16Adc2An44_CTN_BOARD1Phys" UWORD F_0v0024420024_p0_60 1 2 0 160.03663 ECU_ADDRESS 0x0 /end MEASUREMENT
/begin MEASUREMENT HARD_u16Adc2An46_VolDcLinkFil "HARD_u16Adc2An46_VolDcLinkFil" UWORD F_0v0012210012_p0_10 1 2 0 80.01831502 ECU_ADDRESS 0x0 /end MEASUREMENT
/begin MEASUREMENT HARD_u16Adc2An47_15V_RDC "HARD_u16Adc2An47_15V_RDC" UWORD F_0v0012210012_p0_10 1 2 0 80.01831502 ECU_ADDRESS 0x0 /end MEASUREMENT
/begin MEASUREMENT HARD_u16Adc2An48_MonDcOvpSele "HARD_u16Adc2An48_MonDcOvpSele" UWORD F_1_p0_48 1 2 0 65535 ECU_ADDRESS 0x0 /end MEASUREMENT
/begin MEASUREMENT HARD_u16Adc2An49_TempIgbt "HARD_u16Adc2An49_TempIgbt" UWORD I_1 1 2 0 65535 ECU_ADDRESS 0x0 /end MEASUREMENT
/begin MEASUREMENT HARD_u16Adc_15V_RDC "HARD_u16Adc_15V_RDC" UWORD I_1 1 2 0 65535 ECU_ADDRESS 0x0 /end MEASUREMENT
/begin MEASUREMENT HARD_u16Adc_CTN_BOARD "HARD_u16Adc_CTN_BOARD" UWORD I_1 1 2 0 65535 ECU_ADDRESS 0x0 /end MEASUREMENT
/begin MEASUREMENT HARD_u16Adc_CTP_MOT_N_GCU "HARD_u16Adc_CTP_MOT_N_GCU" UWORD I_1 1 2 0 65535 ECU_ADDRESS 0x0 /end MEASUREMENT
/begin MEASUREMENT HARD_u16Adc_CTP_MOT_N_MCU "HARD_u16Adc_CTP_MOT_N_MCU" UWORD I_1 1 2 0 65535 ECU_ADDRESS 0x0 /end MEASUREMENT
/begin MEASUREMENT HARD_u16Adc_CTP_MOT_P_GCU "HARD_u16Adc_CTP_MOT_P_GCU" UWORD I_1 1 2 0 65535 ECU_ADDRESS 0x0 /end MEASUREMENT
/begin MEASUREMENT HARD_u16Adc_CTP_MOT_P_MCU "HARD_u16Adc_CTP_MOT_P_MCU" UWORD I_1 1 2 0 65535 ECU_ADDRESS 0x0 /end MEASUREMENT
/begin MEASUREMENT HARD_u16Adc_CURRENT_U_GCU "HARD_u16Adc_CURRENT_U_GCU" UWORD I_1 1 2 0 65535 ECU_ADDRESS 0x0 /end MEASUREMENT
/begin MEASUREMENT HARD_u16Adc_CURRENT_U_MCU "HARD_u16Adc_CURRENT_U_MCU" UWORD I_1 1 2 0 65535 ECU_ADDRESS 0x0 /end MEASUREMENT
/begin MEASUREMENT HARD_u16Adc_CURRENT_V_GCU "HARD_u16Adc_CURRENT_V_GCU" UWORD I_1 1 2 0 65535 ECU_ADDRESS 0x0 /end MEASUREMENT
/begin MEASUREMENT HARD_u16Adc_CURRENT_V_MCU "HARD_u16Adc_CURRENT_V_MCU" UWORD I_1 1 2 0 65535 ECU_ADDRESS 0x0 /end MEASUREMENT
/begin MEASUREMENT HARD_u16Adc_CURRENT_W_GCU "HARD_u16Adc_CURRENT_W_GCU" UWORD I_1 1 2 0 65535 ECU_ADDRESS 0x0 /end MEASUREMENT
/begin MEASUREMENT HARD_u16Adc_CURRENT_W_MCU "HARD_u16Adc_CURRENT_W_MCU" UWORD I_1 1 2 0 65535 ECU_ADDRESS 0x0 /end MEASUREMENT
/begin MEASUREMENT HARD_u16Adc_DIAG_COS_H_GCU "HARD_u16Adc_DIAG_COS_H_GCU" UWORD I_1 1 2 0 65535 ECU_ADDRESS 0x0 /end MEASUREMENT
/begin MEASUREMENT HARD_u16Adc_DIAG_COS_H_MCU "HARD_u16Adc_DIAG_COS_H_MCU" UWORD I_1 1 2 0 65535 ECU_ADDRESS 0x0 /end MEASUREMENT
/begin MEASUREMENT HARD_u16Adc_DIAG_COS_L_GCU "HARD_u16Adc_DIAG_COS_L_GCU" UWORD I_1 1 2 0 65535 ECU_ADDRESS 0x0 /end MEASUREMENT
/begin MEASUREMENT HARD_u16Adc_DIAG_COS_L_MCU "HARD_u16Adc_DIAG_COS_L_MCU" UWORD I_1 1 2 0 65535 ECU_ADDRESS 0x0 /end MEASUREMENT
/begin MEASUREMENT HARD_u16Adc_DIAG_SIN_H_GCU "HARD_u16Adc_DIAG_SIN_H_GCU" UWORD I_1 1 2 0 65535 ECU_ADDRESS 0x0 /end MEASUREMENT
/begin MEASUREMENT HARD_u16Adc_DIAG_SIN_H_MCU "HARD_u16Adc_DIAG_SIN_H_MCU" UWORD I_1 1 2 0 65535 ECU_ADDRESS 0x0 /end MEASUREMENT
/begin MEASUREMENT HARD_u16Adc_DIAG_SIN_L_GCU "HARD_u16Adc_DIAG_SIN_L_GCU" UWORD I_1 1 2 0 65535 ECU_ADDRESS 0x0 /end MEASUREMENT
/begin MEASUREMENT HARD_u16Adc_DIAG_SIN_L_MCU "HARD_u16Adc_DIAG_SIN_L_MCU" UWORD I_1 1 2 0 65535 ECU_ADDRESS 0x0 /end MEASUREMENT
/begin MEASUREMENT HARD_u16Adc_EXCI_HI_FB_GCU "HARD_u16Adc_EXCI_HI_FB_GCU" UWORD I_1 1 2 0 65535 ECU_ADDRESS 0x0 /end MEASUREMENT
/begin MEASUREMENT HARD_u16Adc_EXCI_HI_FB_MCU "HARD_u16Adc_EXCI_HI_FB_MCU" UWORD I_1 1 2 0 65535 ECU_ADDRESS 0x0 /end MEASUREMENT
/begin MEASUREMENT HARD_u16Adc_EXCI_LO_FB_GCU "HARD_u16Adc_EXCI_LO_FB_GCU" UWORD I_1 1 2 0 65535 ECU_ADDRESS 0x0 /end MEASUREMENT
/begin MEASUREMENT HARD_u16Adc_EXCI_LO_FB_MCU "HARD_u16Adc_EXCI_LO_FB_MCU" UWORD I_1 1 2 0 65535 ECU_ADDRESS 0x0 /end MEASUREMENT
/begin MEASUREMENT HARD_u16Adc_ISN_CLU_BLDC "HARD_u16Adc_ISN_CLU_BLDC" UWORD I_1 1 2 0 65535 ECU_ADDRESS 0x0 /end MEASUREMENT
/begin MEASUREMENT HARD_u16Adc_ISN_OIL_BLDC "HARD_u16Adc_ISN_OIL_BLDC" UWORD I_1 1 2 0 65535 ECU_ADDRESS 0x0 /end MEASUREMENT
/begin MEASUREMENT HARD_u16Adc_MOT_COS "HARD_u16Adc_MOT_COS" UWORD I_1 1 2 0 65535 ECU_ADDRESS 0x0 /end MEASUREMENT
/begin MEASUREMENT HARD_u16Adc_MOT_COS_GCU "HARD_u16Adc_MOT_COS_GCU" UWORD I_1 1 2 0 65535 ECU_ADDRESS 0x0 /end MEASUREMENT
/begin MEASUREMENT HARD_u16Adc_MOT_COS_MCU "HARD_u16Adc_MOT_COS_MCU" UWORD I_1 1 2 0 65535 ECU_ADDRESS 0x0 /end MEASUREMENT
/begin MEASUREMENT HARD_u16Adc_MOT_SIN "HARD_u16Adc_MOT_SIN" UWORD I_1 1 2 0 65535 ECU_ADDRESS 0x0 /end MEASUREMENT
/begin MEASUREMENT HARD_u16Adc_MOT_SIN_GCU "HARD_u16Adc_MOT_SIN_GCU" UWORD I_1 1 2 0 65535 ECU_ADDRESS 0x0 /end MEASUREMENT
/begin MEASUREMENT HARD_u16Adc_MOT_SIN_MCU "HARD_u16Adc_MOT_SIN_MCU" UWORD I_1 1 2 0 65535 ECU_ADDRESS 0x0 /end MEASUREMENT
/begin MEASUREMENT HARD_u16Adc_Oil_Pressure "HARD_u16Adc_Oil_Pressure" UWORD I_1 1 2 0 65535 ECU_ADDRESS 0x0 /end MEASUREMENT
/begin MEASUREMENT HARD_u16Adc_Oil_Temp_N "HARD_u16Adc_Oil_Temp_N" UWORD I_1 1 2 0 65535 ECU_ADDRESS 0x0 /end MEASUREMENT
/begin MEASUREMENT HARD_u16Adc_Oil_Temp_P "HARD_u16Adc_Oil_Temp_P" UWORD I_1 1 2 0 65535 ECU_ADDRESS 0x0 /end MEASUREMENT
/begin MEASUREMENT HARD_u16Adc_P12V_BATT_1 "HARD_u16Adc_P12V_BATT_1" UWORD I_1 1 2 0 65535 ECU_ADDRESS 0x0 /end MEASUREMENT
/begin MEASUREMENT HARD_u16Adc_P12V_BATT_2 "HARD_u16Adc_P12V_BATT_2" UWORD I_1 1 2 0 65535 ECU_ADDRESS 0x0 /end MEASUREMENT
/begin MEASUREMENT HARD_u16Adc_P5V_BT "HARD_u16Adc_P5V_BT" UWORD I_1 1 2 0 65535 ECU_ADDRESS 0x0 /end MEASUREMENT
/begin MEASUREMENT HARD_u16Adc_P5V_BT_AD2S "HARD_u16Adc_P5V_BT_AD2S" UWORD I_1 1 2 0 65535 ECU_ADDRESS 0x0 /end MEASUREMENT
/begin MEASUREMENT HARD_u16Adc_P5V_COM "HARD_u16Adc_P5V_COM" UWORD I_1 1 2 0 65535 ECU_ADDRESS 0x0 /end MEASUREMENT
/begin MEASUREMENT HARD_u16Adc_P5V_GATEWAY "HARD_u16Adc_P5V_GATEWAY" UWORD I_1 1 2 0 65535 ECU_ADDRESS 0x0 /end MEASUREMENT
/begin MEASUREMENT HARD_u16Adc_P5V_REF "HARD_u16Adc_P5V_REF" UWORD I_1 1 2 0 65535 ECU_ADDRESS 0x0 /end MEASUREMENT
/begin MEASUREMENT HARD_u16Adc_PSUP_P9V_MULTI "HARD_u16Adc_PSUP_P9V_MULTI" UWORD I_1 1 2 0 65535 ECU_ADDRESS 0x0 /end MEASUREMENT
/begin MEASUREMENT HARD_u16Adc_PSU_P5V_HS "HARD_u16Adc_PSU_P5V_HS" UWORD I_1 1 2 0 65535 ECU_ADDRESS 0x0 /end MEASUREMENT
/begin MEASUREMENT HARD_u16Adc_PSU_P5V_LS "HARD_u16Adc_PSU_P5V_LS" UWORD I_1 1 2 0 65535 ECU_ADDRESS 0x0 /end MEASUREMENT
/begin MEASUREMENT HARD_u16Adc_RESCOSHI_ADC_GCU "HARD_u16Adc_RESCOSHI_ADC_GCU" UWORD I_1 1 2 0 65535 ECU_ADDRESS 0x0 /end MEASUREMENT
/begin MEASUREMENT HARD_u16Adc_RESCOSHO_ADC_MCU "HARD_u16Adc_RESCOSHO_ADC_MCU" UWORD I_1 1 2 0 65535 ECU_ADDRESS 0x0 /end MEASUREMENT
/begin MEASUREMENT HARD_u16Adc_RESCOSLO_ADC_GCU "HARD_u16Adc_RESCOSLO_ADC_GCU" UWORD I_1 1 2 0 65535 ECU_ADDRESS 0x0 /end MEASUREMENT
/begin MEASUREMENT HARD_u16Adc_RESCOSLO_ADC_MCU "HARD_u16Adc_RESCOSLO_ADC_MCU" UWORD I_1 1 2 0 65535 ECU_ADDRESS 0x0 /end MEASUREMENT
/begin MEASUREMENT HARD_u16Adc_RESSINHI_ADC_GCU "HARD_u16Adc_RESSINHI_ADC_GCU" UWORD I_1 1 2 0 65535 ECU_ADDRESS 0x0 /end MEASUREMENT
/begin MEASUREMENT HARD_u16Adc_RESSINHI_ADC_MCU "HARD_u16Adc_RESSINHI_ADC_MCU" UWORD I_1 1 2 0 65535 ECU_ADDRESS 0x0 /end MEASUREMENT
/begin MEASUREMENT HARD_u16Adc_RESSINLO_ADC_GCU "HARD_u16Adc_RESSINLO_ADC_GCU" UWORD I_1 1 2 0 65535 ECU_ADDRESS 0x0 /end MEASUREMENT
/begin MEASUREMENT HARD_u16Adc_RESSINLO_ADC_MCU "HARD_u16Adc_RESSINLO_ADC_MCU" UWORD I_1 1 2 0 65535 ECU_ADDRESS 0x0 /end MEASUREMENT
/begin MEASUREMENT HARD_u16Adc_TEMP_MEAS_MOD1 "HARD_u16Adc_TEMP_MEAS_MOD1" UWORD I_1 1 2 0 65535 ECU_ADDRESS 0x0 /end MEASUREMENT
/begin MEASUREMENT HARD_u16Adc_TEMP_MEAS_MOD2 "HARD_u16Adc_TEMP_MEAS_MOD2" UWORD I_1 1 2 0 65535 ECU_ADDRESS 0x0 /end MEASUREMENT
/begin MEASUREMENT HARD_u16Adc_TEMP_MEAS_MOD3 "HARD_u16Adc_TEMP_MEAS_MOD3" UWORD I_1 1 2 0 65535 ECU_ADDRESS 0x0 /end MEASUREMENT
/begin MEASUREMENT HARD_u16Adc_TEMP_MEAS_MOD_GCU "HARD_u16Adc_TEMP_MEAS_MOD_GCU" UWORD I_1 1 2 0 65535 ECU_ADDRESS 0x0 /end MEASUREMENT
/begin MEASUREMENT HARD_u16Adc_VOL_DCLINK_DRV "HARD_u16Adc_VOL_DCLINK_DRV" UWORD I_1 1 2 0 65535 ECU_ADDRESS 0x0 /end MEASUREMENT
/begin MEASUREMENT HARD_u16PtgRefSignalNbPeriode "HARD_u16PtgRefSignalNbPeriode" UWORD I_1 1 2 0 65535 ECU_ADDRESS 0x0 /end MEASUREMENT
/begin MEASUREMENT HARD_u16PtgRefSignalTime "HARD_u16PtgRefSignalTime" UWORD I_1 1 2 0 65535 ECU_ADDRESS 0x0 /end MEASUREMENT
/begin MEASUREMENT HARD_u16PtgUSignalNbPeriode "HARD_u16PtgUSignalNbPeriode" UWORD I_1 1 2 0 65535 ECU_ADDRESS 0x0 /end MEASUREMENT
/begin MEASUREMENT HARD_u16PtgUSignalTime "HARD_u16PtgUSignalTime" UWORD I_1 1 2 0 65535 ECU_ADDRESS 0x0 /end MEASUREMENT
/begin MEASUREMENT HARD_u16PtgVSignalNbPeriode "HARD_u16PtgVSignalNbPeriode" UWORD I_1 1 2 0 65535 ECU_ADDRESS 0x0 /end MEASUREMENT
/begin MEASUREMENT HARD_u16PtgVSignalTime "HARD_u16PtgVSignalTime" UWORD I_1 1 2 0 65535 ECU_ADDRESS 0x0 /end MEASUREMENT
/begin MEASUREMENT HARD_u16PtgWSignalNbPeriode "HARD_u16PtgWSignalNbPeriode" UWORD I_1 1 2 0 65535 ECU_ADDRESS 0x0 /end MEASUREMENT
/begin MEASUREMENT HARD_u16PtgWSignalTime "HARD_u16PtgWSignalTime" UWORD I_1 1 2 0 65535 ECU_ADDRESS 0x0 /end MEASUREMENT
/begin MEASUREMENT HARD_u8CanIfCtrlMode "Test Number of Nm Test" UBYTE I_1 1 2 0 255 ECU_ADDRESS 0x0 /end MEASUREMENT
/begin MEASUREMENT HARD_u8CanIfCtrlModeReq "Test Number of Nm Test" UBYTE I_1 1 2 0 255 ECU_ADDRESS 0x0 /end MEASUREMENT
/begin MEASUREMENT HARD_u8CanIfPduMode "Test Number of Nm Test" UBYTE I_1 1 2 0 255 ECU_ADDRESS 0x0 /end MEASUREMENT
/begin MEASUREMENT HARD_u8CanIfPduModeReq "Test Number of Nm Test" UBYTE I_1 1 2 0 255 ECU_ADDRESS 0x0 /end MEASUREMENT
/begin MEASUREMENT HARD_u8CanNmLocalNodeId "Test Number of Nm Test" UBYTE I_1 1 2 0 255 ECU_ADDRESS 0x0 /end MEASUREMENT
/begin MEASUREMENT HARD_u8CanNmMode "Test Number of Nm Test" UBYTE I_1 1 2 0 255 ECU_ADDRESS 0x0 /end MEASUREMENT
/begin MEASUREMENT HARD_u8CanNmNodeId "Test Number of Nm Test" UBYTE I_1 1 2 0 255 ECU_ADDRESS 0x0 /end MEASUREMENT
/begin MEASUREMENT HARD_u8CanNmState "Test Number of Nm Test" UBYTE I_1 1 2 0 255 ECU_ADDRESS 0x0 /end MEASUREMENT
/begin MEASUREMENT HARD_u8CanSmMode "Test Number of Nm Test" UBYTE Id_0x00 1 2 0 255 ECU_ADDRESS 0x0 /end MEASUREMENT
/begin MEASUREMENT HARD_u8CanSmModeReq "Test Number of Nm Test" UBYTE I_1 1 2 0 255 ECU_ADDRESS 0x0 /end MEASUREMENT
/begin MEASUREMENT HARD_u8ComMMode "Test Number of Nm Test" UBYTE I_1 1 2 0 255 ECU_ADDRESS 0x0 /end MEASUREMENT
/begin MEASUREMENT HARD_u8ComMState "Test Number of Nm Test" UBYTE I_1 1 2 0 255 ECU_ADDRESS 0x0 /end MEASUREMENT
/begin MEASUREMENT HARD_u8ComMStatus "Test Number of Nm Test" UBYTE I_1 1 2 0 255 ECU_ADDRESS 0x0 /end MEASUREMENT
/begin MEASUREMENT HARD_u8NmMode "Test Number of Nm Test" UBYTE I_1 1 2 0 255 ECU_ADDRESS 0x0 /end MEASUREMENT
/begin MEASUREMENT HARD_u8NmState "Test Number of Nm Test" UBYTE I_1 1 2 0 255 ECU_ADDRESS 0x0 /end MEASUREMENT
/begin MEASUREMENT HARD_u8NmTestNum "Test Number of Nm Test" UBYTE I_1 1 2 0 255 ECU_ADDRESS 0x0 /end MEASUREMENT
/begin MEASUREMENT HARD_u8NmUserDataRx "Test Number of Nm Test" UBYTE I_1 1 2 0 255 MATRIX_DIM 6 1 1 ECU_ADDRESS 0x0 /end MEASUREMENT
/begin MEASUREMENT HARD_u8NmUserDataRx[0] "HARD_u8NmUserDataRx[0]" UBYTE I_1 1 2 0 255 ECU_ADDRESS 0x0 /end MEASUREMENT
/begin MEASUREMENT HARD_u8NmUserDataRx[1] "HARD_u8NmUserDataRx[1]" UBYTE I_1 1 2 0 255 ECU_ADDRESS 0x0 /end MEASUREMENT
/begin MEASUREMENT HARD_u8NmUserDataRx[2] "HARD_u8NmUserDataRx[2]" UBYTE I_1 1 2 0 255 ECU_ADDRESS 0x0 /end MEASUREMENT
/begin MEASUREMENT HARD_u8NmUserDataRx[3] "HARD_u8NmUserDataRx[3]" UBYTE I_1 1 2 0 255 ECU_ADDRESS 0x0 /end MEASUREMENT
/begin MEASUREMENT HARD_u8NmUserDataRx[4] "HARD_u8NmUserDataRx[4]" UBYTE I_1 1 2 0 255 ECU_ADDRESS 0x0 /end MEASUREMENT
/begin MEASUREMENT HARD_u8NmUserDataRx[5] "HARD_u8NmUserDataRx[5]" UBYTE I_1 1 2 0 255 ECU_ADDRESS 0x0 /end MEASUREMENT
/begin MEASUREMENT HARD_u8NmUserDataTx "Test Number of Nm Test" UBYTE I_1 1 2 0 255 MATRIX_DIM 6 1 1 ECU_ADDRESS 0x0 /end MEASUREMENT
/begin MEASUREMENT HARD_u8NmUserDataTx[0] "HARD_u8NmUserDataTx[0]" UBYTE I_1 1 2 0 255 ECU_ADDRESS 0x0 /end MEASUREMENT
/begin MEASUREMENT HARD_u8NmUserDataTx[1] "HARD_u8NmUserDataTx[1]" UBYTE I_1 1 2 0 255 ECU_ADDRESS 0x0 /end MEASUREMENT
/begin MEASUREMENT HARD_u8NmUserDataTx[2] "HARD_u8NmUserDataTx[2]" UBYTE I_1 1 2 0 255 ECU_ADDRESS 0x0 /end MEASUREMENT
/begin MEASUREMENT HARD_u8NmUserDataTx[3] "HARD_u8NmUserDataTx[3]" UBYTE I_1 1 2 0 255 ECU_ADDRESS 0x0 /end MEASUREMENT
/begin MEASUREMENT HARD_u8NmUserDataTx[4] "HARD_u8NmUserDataTx[4]" UBYTE I_1 1 2 0 255 ECU_ADDRESS 0x0 /end MEASUREMENT
/begin MEASUREMENT HARD_u8NmUserDataTx[5] "HARD_u8NmUserDataTx[5]" UBYTE I_1 1 2 0 255 ECU_ADDRESS 0x0 /end MEASUREMENT
/begin MEASUREMENT HARD_u8NmWakeupReason "Test Number of Nm Test" UBYTE I_1 1 2 0 255 ECU_ADDRESS 0x0 /end MEASUREMENT
/begin MEASUREMENT HARD_u8VSIRxaTempCtrlBdPhys "Physical value of MAIN_VSIRxaTempCtrlBd" UBYTE F_1_m40_58 1 2 -40 215 ECU_ADDRESS 0x0 /end MEASUREMENT
/begin MEASUREMENT HARD_u8VSIRxaTempDrvBdPhys "Physical value of MAIN_VSIRxaTempDrvBd (MAJ OC140)" UBYTE F_1_m40_58 1 2 -40 215 ECU_ADDRESS 0x0 /end MEASUREMENT
/begin MEASUREMENT HARD_u8VSIRxaTempIgbtPhys "Physical value of MAIN_VSIRxaTempIgbt (MAJ OC140)" UBYTE F_1_m40_58 1 2 -40 215 ECU_ADDRESS 0x0 /end MEASUREMENT
/begin COMPU_METHOD I_1 "" RAT_FUNC "%9.2" "-" COEFFS 0 1 0 0 0 1 /end COMPU_METHOD
/begin COMPU_METHOD F_1_p0_4 "" RAT_FUNC "%9.2" "-" COEFFS 0 1 0 0 0 1 /end COMPU_METHOD
/begin COMPU_METHOD F_0v0012210012_p0_10 "" RAT_FUNC "%9.3" "V" COEFFS 0 1 0 0 0 0.001221 /end COMPU_METHOD
/begin COMPU_METHOD I_15 "" RAT_FUNC "%9.2" "V" COEFFS 0 1 0 0 0 1 /end COMPU_METHOD
/begin COMPU_METHOD F_1_p0_21 "" RAT_FUNC "%9.2" "RPM" COEFFS 0 1 0 0 0 1 /end COMPU_METHOD
/begin COMPU_METHOD F_1_m20000_35 "" RAT_FUNC "%9.2" "-" COEFFS 0 1 20000 0 0 1 /end COMPU_METHOD
/begin COMPU_METHOD F_1_p0_48 "" RAT_FUNC "%9.2" "A" COEFFS 0 1 0 0 0 1 /end COMPU_METHOD
/begin COMPU_METHOD F_0v0030518044_p0_55 "" RAT_FUNC "%9.3" "%" COEFFS 0 1 0 0 0 0.0030518 /end COMPU_METHOD
/begin COMPU_METHOD F_0v0015259022_p0_56 "" RAT_FUNC "%9.3" "%" COEFFS 0 1 0 0 0 0.0015259 /end COMPU_METHOD
/begin COMPU_METHOD D_2_0v01_p0_57 "" RAT_FUNC "%9.2" "%" COEFFS 0 0 1 0 0.01 0 /end COMPU_METHOD
/begin COMPU_METHOD F_1_m40_58 "" RAT_FUNC "%9.2" "°C" COEFFS 0 1 40 0 0 1 /end COMPU_METHOD
/begin COMPU_METHOD F_0v0126197802_p0_59 "" RAT_FUNC "%9.2" "V" COEFFS 0 1 0 0 0 0.0126198 /end COMPU_METHOD
/begin COMPU_METHOD F_0v0024420024_p0_60 "" RAT_FUNC "%9.3" "V" COEFFS 0 1 0 0 0 0.002442 /end COMPU_METHOD
/begin COMPU_METHOD F_0v0000305176_p0_61 "" RAT_FUNC "%9.5" "PI/RAD" COEFFS 0 1 0 0 0 3.05176e-005 /end COMPU_METHOD
/begin COMPU_METHOD Id_0x00 "" RAT_FUNC "%9.2" "." COEFFS 0 1 0 0 0 1 /end COMPU_METHOD
/begin COMPU_METHOD Bool_ON_OFF "" TAB_VERB "%8.4" "." COMPU_TAB_REF Bool_ON_OFF_table /end COMPU_METHOD
/begin COMPU_VTAB Bool_ON_OFF_table "" TAB_VERB 2 0 "OFF" 1 "ON" /end COMPU_VTAB
/begin FUNCTION FAULT ""
 /begin DEF_CHARACTERISTIC FaultBSW_COM_BusOff_CAN1Dec FaultBSW_COM_BusOff_CAN1FailMod FaultBSW_COM_BusOff_CAN1Inc FaultBSW_COM_ChecksumErrVCUDec FaultBSW_COM_ChecksumErrVCUFailMod FaultBSW_COM_ChecksumErrVCUInc FaultBSW_COM_InterFaultVCUDec FaultBSW_COM_InterFaultVCUFailMod FaultBSW_COM_InterFaultVCUInc FaultBSW_COM_RollCntErrVCUDec FaultBSW_COM_RollCntErrVCUFailMod FaultBSW_COM_RollCntErrVCUInc FaultBSW_COM_TimoutRxBCMDec FaultBSW_COM_TimoutRxBCMFailMod FaultBSW_COM_TimoutRxBCMInc FaultBSW_COM_TimoutRxBMSHDec FaultBSW_COM_TimoutRxBMSHFailMod FaultBSW_COM_TimoutRxBMSHInc FaultBSW_COM_TimoutRxEMSDec FaultBSW_COM_TimoutRxEMSFailMod FaultBSW_COM_TimoutRxEMSInc FaultBSW_COM_TimoutRxGCUDec FaultBSW_COM_TimoutRxGCUFailMod FaultBSW_COM_TimoutRxGCUInc FaultBSW_COM_TimoutRxIPCDec FaultBSW_COM_TimoutRxIPCFailMod FaultBSW_COM_TimoutRxIPCInc FaultBSW_COM_TimoutRxTBOXDec FaultBSW_COM_TimoutRxTBOXFailMod FaultBSW_COM_TimoutRxTBOXInc FaultBSW_COM_TimoutRxVCUDec FaultBSW_COM_TimoutRxVCUFailMod FaultBSW_COM_TimoutRxVCUInc FaultBSW_HW2_FPGA_OverVoltVBatDec FaultBSW_HW2_FPGA_OverVoltVBatFailMod FaultBSW_HW2_FPGA_OverVoltVBatInc FaultBSW_HW2_SafeTlib_PreRunDec FaultBSW_HW2_SafeTlib_PreRunFailMod FaultBSW_HW2_SafeTlib_PreRunInc FaultBSW_HW_EasAckFailDec FaultBSW_HW_EasAckFailFailMod FaultBSW_HW_EasAckFailInc FaultBSW_HW_FPGA_IGBT_HDec FaultBSW_HW_FPGA_IGBT_HFailMod FaultBSW_HW_FPGA_IGBT_HInc FaultBSW_HW_FPGA_IGBT_LDec FaultBSW_HW_FPGA_IGBT_LFailMod FaultBSW_HW_FPGA_IGBT_LInc FaultBSW_HW_FPGA_OverUnderCurUIDec FaultBSW_HW_FPGA_OverUnderCurUIFailMod FaultBSW_HW_FPGA_OverUnderCurUIInc FaultBSW_HW_FPGA_OverUnderCurVIDec FaultBSW_HW_FPGA_OverUnderCurVIFailMod FaultBSW_HW_FPGA_OverUnderCurVIInc FaultBSW_HW_FPGA_OverUnderCurWIDec FaultBSW_HW_FPGA_OverUnderCurWIFailMod FaultBSW_HW_FPGA_OverUnderCurWIInc FaultBSW_HW_OCDataNotRationalDec FaultBSW_HW_OCDataNotRationalFailMod FaultBSW_HW_OCDataNotRationalInc FaultBSW_SYS_RstHotDec FaultBSW_SYS_RstHotFailMod FaultBSW_SYS_RstHotInc FaultBSW_SYS_StackOverflowDec FaultBSW_SYS_StackOverflowFailMod FaultBSW_SYS_StackOverflowInc FaultBSW_VSI_TimeoutTCalcDec FaultBSW_VSI_TimeoutTCalcFailMod FaultBSW_VSI_TimeoutTCalcInc FaultFSEVBHV_OverVoltageDec FaultFSEVBHV_OverVoltageFailMod FaultFSEVBHV_OverVoltageInc FaultFSEVBHV_SampleVolOutRngHDec FaultFSEVBHV_SampleVolOutRngHFailMod FaultFSEVBHV_SampleVolOutRngHInc FaultFSEVBHV_SampleVolOutRngLDec FaultFSEVBHV_SampleVolOutRngLFailMod FaultFSEVBHV_SampleVolOutRngLInc FaultFSEVBHV_UnderVoltageDec FaultFSEVBHV_UnderVoltageFailMod FaultFSEVBHV_UnderVoltageInc FaultFSEVBHV_UnderVoltageWarnDec FaultFSEVBHV_UnderVoltageWarnFailMod FaultFSEVBHV_UnderVoltageWarnInc FaultFSEVBHV_VolNotRationalDec FaultFSEVBHV_VolNotRationalFailMod FaultFSEVBHV_VolNotRationalInc FaultFSEVBHV_VoltageGndDec FaultFSEVBHV_VoltageGndFailMod FaultFSEVBHV_VoltageGndInc FaultFSEVBHV_VoltageVccDec FaultFSEVBHV_VoltageVccFailMod FaultFSEVBHV_VoltageVccInc FaultFSEVBLV_OverVoltageDec FaultFSEVBLV_OverVoltageFailMod FaultFSEVBLV_OverVoltageInc FaultFSEVBLV_P5VRefADCFltDec FaultFSEVBLV_P5VRefADCFltFailMod FaultFSEVBLV_P5VRefADCFltInc FaultFSEVBLV_UnderVoltageDec FaultFSEVBLV_UnderVoltageFailMod FaultFSEVBLV_UnderVoltageInc FaultFSEVBLV_UnderVoltageWarnDec FaultFSEVBLV_UnderVoltageWarnFailMod FaultFSEVBLV_UnderVoltageWarnInc FaultFSEVBLV_VoltageGndDec FaultFSEVBLV_VoltageGndFailMod FaultFSEVBLV_VoltageGndInc FaultFSEVBLV_VoltageVccDec FaultFSEVBLV_VoltageVccFailMod FaultFSEVBLV_VoltageVccInc FaultFSEVETA_DrvTempRationDec FaultFSEVETA_DrvTempRationFailMod FaultFSEVETA_DrvTempRationInc FaultFSEVETA_IgbtTempRationalDec FaultFSEVETA_IgbtTempRationalFailMod FaultFSEVETA_IgbtTempRationalInc FaultFSEVETA_OverTempDrvLeftDec FaultFSEVETA_OverTempDrvLeftFailMod FaultFSEVETA_OverTempDrvLeftInc FaultFSEVETA_OverTempIgbtLeftDec FaultFSEVETA_OverTempIgbtLeftFailMod FaultFSEVETA_OverTempIgbtLeftInc FaultFSEVETA_OverTempNTC1CmdBoardDec FaultFSEVETA_OverTempNTC1CmdBoardFailMod FaultFSEVETA_OverTempNTC1CmdBoardInc FaultFSEVETA_SampleIgbtTempOutRngHDec FaultFSEVETA_SampleIgbtTempOutRngHFailMod FaultFSEVETA_SampleIgbtTempOutRngHInc FaultFSEVETA_SampleIgbtTempOutRngLDec FaultFSEVETA_SampleIgbtTempOutRngLFailMod FaultFSEVETA_SampleIgbtTempOutRngLInc FaultFSEVETA_TempDrvBoardLeftGndDec FaultFSEVETA_TempDrvBoardLeftGndFailMod FaultFSEVETA_TempDrvBoardLeftGndInc FaultFSEVETA_TempDrvBoardLeftVccDec FaultFSEVETA_TempDrvBoardLeftVccFailMod FaultFSEVETA_TempDrvBoardLeftVccInc FaultFSEVETA_TempIgbtLeftGndDec FaultFSEVETA_TempIgbtLeftGndFailMod FaultFSEVETA_TempIgbtLeftGndInc FaultFSEVETA_TempIgbtLeftVccDec FaultFSEVETA_TempIgbtLeftVccFailMod FaultFSEVETA_TempIgbtLeftVccInc FaultFSEVETA_TempNTC1CmdBoardGndDec FaultFSEVETA_TempNTC1CmdBoardGndFailMod FaultFSEVETA_TempNTC1CmdBoardGndInc FaultFSEVETA_TempNTC1CmdBoardVccDec FaultFSEVETA_TempNTC1CmdBoardVccFailMod FaultFSEVETA_TempNTC1CmdBoardVccInc FaultFSEVETA_UnderTempDrvLeftDec FaultFSEVETA_UnderTempDrvLeftFailMod FaultFSEVETA_UnderTempDrvLeftInc FaultFSEVETA_UnderTempIgbtLeftDec FaultFSEVETA_UnderTempIgbtLeftFailMod FaultFSEVETA_UnderTempIgbtLeftInc FaultFSEVETA_UnderTempNTC1CmdBoardDec FaultFSEVETA_UnderTempNTC1CmdBoardFailMod FaultFSEVETA_UnderTempNTC1CmdBoardInc FaultFSMTMTA_OverTempWdgHead1Dec FaultFSMTMTA_OverTempWdgHead1FailMod FaultFSMTMTA_OverTempWdgHead1Inc FaultFSMTMTA_TempWindHead1OutRngHDec FaultFSMTMTA_TempWindHead1OutRngHFailMod FaultFSMTMTA_TempWindHead1OutRngHInc FaultFSMTMTA_TempWindHead1OutRngLDec FaultFSMTMTA_TempWindHead1OutRngLFailMod FaultFSMTMTA_TempWindHead1OutRngLInc FaultFSMTMTA_TempWindingHead1GndDec FaultFSMTMTA_TempWindingHead1GndFailMod FaultFSMTMTA_TempWindingHead1GndInc FaultFSMTMTA_TempWindingHead1VccDec FaultFSMTMTA_TempWindingHead1VccFailMod FaultFSMTMTA_TempWindingHead1VccInc FaultFSMTMTA_UnderTempWdgHead1Dec FaultFSMTMTA_UnderTempWdgHead1FailMod FaultFSMTMTA_UnderTempWdgHead1Inc FaultFSMTRDG_ExcGenerationDec FaultFSMTRDG_ExcGenerationFailMod FaultFSMTRDG_ExcGenerationInc FaultFSMTRDG_ExcSignalGNDDec FaultFSMTRDG_ExcSignalGNDFailMod FaultFSMTRDG_ExcSignalGNDInc FaultFSMTRDG_ExcSignalVCCDec FaultFSMTRDG_ExcSignalVCCFailMod FaultFSMTRDG_ExcSignalVCCInc FaultFSMTRDG_SinCosHLGndDec FaultFSMTRDG_SinCosHLGndFailMod FaultFSMTRDG_SinCosHLGndInc FaultFSMTRDG_SinCosHLOpenDec FaultFSMTRDG_SinCosHLOpenFailMod FaultFSMTRDG_SinCosHLOpenInc FaultFSMTRDG_SinCosHLVccDec FaultFSMTRDG_SinCosHLVccFailMod FaultFSMTRDG_SinCosHLVccInc FaultFSSMACS_AkdFailFlagDec FaultFSSMACS_AkdFailFlagFailMod FaultFSSMACS_AkdFailFlagInc FaultFTASBDS_BattVoltDeratingActDec FaultFTASBDS_BattVoltDeratingActFailMod FaultFTASBDS_BattVoltDeratingActInc FaultFTASETP_EstPmDeratingActDec FaultFTASETP_EstPmDeratingActFailMod FaultFTASETP_EstPmDeratingActInc FaultFTASETP_PmDeratingActDec FaultFTASETP_PmDeratingActFailMod FaultFTASETP_PmDeratingActInc FaultFTASMTP_Wndg1DeratingActDec FaultFTASMTP_Wndg1DeratingActFailMod FaultFTASMTP_Wndg1DeratingActInc FaultFTASOSP_MotorSpdDeratingActDec FaultFTASOSP_MotorSpdDeratingActFailMod FaultFTASOSP_MotorSpdDeratingActInc FaultFTCMSCS_CtrlSatTimoutDec FaultFTCMSCS_CtrlSatTimoutFailMod FaultFTCMSCS_CtrlSatTimoutInc FaultFTCMSCS_SpdOvershootDec FaultFTCMSCS_SpdOvershootFailMod FaultFTCMSCS_SpdOvershootInc FaultFTCMSCS_ZeroSpeedTimoutDec FaultFTCMSCS_ZeroSpeedTimoutFailMod FaultFTCMSCS_ZeroSpeedTimoutInc FaultFTCMTCS_VoltageMarginLowDec FaultFTCMTCS_VoltageMarginLowFailMod FaultFTCMTCS_VoltageMarginLowInc FaultFTEVEIT_EstOverTempDec FaultFTEVEIT_EstOverTempFailMod FaultFTEVEIT_EstOverTempInc FaultFTMTLCS_CurrentSumErrorDec FaultFTMTLCS_CurrentSumErrorFailMod FaultFTMTLCS_CurrentSumErrorInc FaultFTMTLCS_CurSenrPhaU_GNDDec FaultFTMTLCS_CurSenrPhaU_GNDFailMod FaultFTMTLCS_CurSenrPhaU_GNDInc FaultFTMTLCS_CurSenrPhaU_OutRngHDec FaultFTMTLCS_CurSenrPhaU_OutRngHFailMod FaultFTMTLCS_CurSenrPhaU_OutRngHInc FaultFTMTLCS_CurSenrPhaU_OutRngLDec FaultFTMTLCS_CurSenrPhaU_OutRngLFailMod FaultFTMTLCS_CurSenrPhaU_OutRngLInc FaultFTMTLCS_CurSenrPhaU_VCCDec FaultFTMTLCS_CurSenrPhaU_VCCFailMod FaultFTMTLCS_CurSenrPhaU_VCCInc FaultFTMTLCS_CurSenrPhaV_GNDDec FaultFTMTLCS_CurSenrPhaV_GNDFailMod FaultFTMTLCS_CurSenrPhaV_GNDInc FaultFTMTLCS_CurSenrPhaV_OutRngHDec FaultFTMTLCS_CurSenrPhaV_OutRngHFailMod FaultFTMTLCS_CurSenrPhaV_OutRngHInc FaultFTMTLCS_CurSenrPhaV_OutRngLDec FaultFTMTLCS_CurSenrPhaV_OutRngLFailMod FaultFTMTLCS_CurSenrPhaV_OutRngLInc FaultFTMTLCS_CurSenrPhaV_VCCDec FaultFTMTLCS_CurSenrPhaV_VCCFailMod FaultFTMTLCS_CurSenrPhaV_VCCInc FaultFTMTLCS_CurSenrPhaW_GNDDec FaultFTMTLCS_CurSenrPhaW_GNDFailMod FaultFTMTLCS_CurSenrPhaW_GNDInc FaultFTMTLCS_CurSenrPhaW_OutRngHDec FaultFTMTLCS_CurSenrPhaW_OutRngHFailMod FaultFTMTLCS_CurSenrPhaW_OutRngHInc FaultFTMTLCS_CurSenrPhaW_OutRngLDec FaultFTMTLCS_CurSenrPhaW_OutRngLFailMod FaultFTMTLCS_CurSenrPhaW_OutRngLInc FaultFTMTLCS_CurSenrPhaW_VCCDec FaultFTMTLCS_CurSenrPhaW_VCCFailMod FaultFTMTLCS_CurSenrPhaW_VCCInc FaultSDMTMEP_CosGndDec FaultSDMTMEP_CosGndFailMod FaultSDMTMEP_CosGndInc FaultSDMTMEP_CosOutRangeHighDec FaultSDMTMEP_CosOutRangeHighFailMod FaultSDMTMEP_CosOutRangeHighInc FaultSDMTMEP_CosOutRangeLowDec FaultSDMTMEP_CosOutRangeLowFailMod FaultSDMTMEP_CosOutRangeLowInc FaultSDMTMEP_CosVccDec FaultSDMTMEP_CosVccFailMod FaultSDMTMEP_CosVccInc FaultSDMTMEP_OverSpeedDec FaultSDMTMEP_OverSpeedFailMod FaultSDMTMEP_OverSpeedInc FaultSDMTMEP_ResSquaSumErrByFTDec FaultSDMTMEP_ResSquaSumErrByFTFailMod FaultSDMTMEP_ResSquaSumErrByFTInc FaultSDMTMEP_SinGndDec FaultSDMTMEP_SinGndFailMod FaultSDMTMEP_SinGndInc FaultSDMTMEP_SinOutRangeHighDec FaultSDMTMEP_SinOutRangeHighFailMod FaultSDMTMEP_SinOutRangeHighInc FaultSDMTMEP_SinOutRangeLowDec FaultSDMTMEP_SinOutRangeLowFailMod FaultSDMTMEP_SinOutRangeLowInc FaultSDMTMEP_SinVccDec FaultSDMTMEP_SinVccFailMod FaultSDMTMEP_SinVccInc FaultSDMTMEP_UnderSpeedDec FaultSDMTMEP_UnderSpeedFailMod FaultSDMTMEP_UnderSpeedInc FaultTCUCAP0_CAPPressureHDec FaultTCUCAP0_CAPPressureHFailMod FaultTCUCAP0_CAPPressureHInc FaultTCUCAP0_CAPPressureLDec FaultTCUCAP0_CAPPressureLFailMod FaultTCUCAP0_CAPPressureLInc FaultTCUCAP0_CAPPressureOverHDec FaultTCUCAP0_CAPPressureOverHFailMod FaultTCUCAP0_CAPPressureOverHInc FaultTCUCAP0_CAPSlipDec FaultTCUCAP0_CAPSlipFailMod FaultTCUCAP0_CAPSlipInc FaultTCUCAP0_DragMomentHDec FaultTCUCAP0_DragMomentHFailMod FaultTCUCAP0_DragMomentHInc FaultTCUCAP0_HLSinInvalidDec FaultTCUCAP0_HLSinInvalidFailMod FaultTCUCAP0_HLSinInvalidInc FaultTCUCAP0_HLSinUndefineDec FaultTCUCAP0_HLSinUndefineFailMod FaultTCUCAP0_HLSinUndefineInc FaultTCUCAP0_HLSupplyHDec FaultTCUCAP0_HLSupplyHFailMod FaultTCUCAP0_HLSupplyHInc FaultTCUCAP0_HLSupplyLDec FaultTCUCAP0_HLSupplyLFailMod FaultTCUCAP0_HLSupplyLInc FaultTCUCAP0_MotorPhaseVolHDec FaultTCUCAP0_MotorPhaseVolHFailMod FaultTCUCAP0_MotorPhaseVolHInc FaultTCUCAP0_PressureRationalDec FaultTCUCAP0_PressureRationalFailMod FaultTCUCAP0_PressureRationalInc FaultTCUCAP0_SenSigOpenOrGNDDec FaultTCUCAP0_SenSigOpenOrGNDFailMod FaultTCUCAP0_SenSigOpenOrGNDInc FaultTCUCAP0_SenSigVCCDec FaultTCUCAP0_SenSigVCCFailMod FaultTCUCAP0_SenSigVCCInc FaultTCUCAP0_SensorPerforErrDec FaultTCUCAP0_SensorPerforErrFailMod FaultTCUCAP0_SensorPerforErrInc FaultTCUCAP1_COM_GCUDec FaultTCUCAP1_COM_GCUFailMod FaultTCUCAP1_COM_GCUInc FaultTCUCAP1_DriverTempHDec FaultTCUCAP1_DriverTempHFailMod FaultTCUCAP1_DriverTempHInc FaultTCUCAP1_FETShortDec FaultTCUCAP1_FETShortFailMod FaultTCUCAP1_FETShortInc FaultTCUCAP1_HWOverCurDec FaultTCUCAP1_HWOverCurFailMod FaultTCUCAP1_HWOverCurInc FaultTCUCAP1_MotorPhaseDriveErrDec FaultTCUCAP1_MotorPhaseDriveErrFailMod FaultTCUCAP1_MotorPhaseDriveErrInc FaultTCUCAP1_MotorStallDec FaultTCUCAP1_MotorStallFailMod FaultTCUCAP1_MotorStallInc FaultTCUCAP1_OverVoltageDec FaultTCUCAP1_OverVoltageFailMod FaultTCUCAP1_OverVoltageInc FaultTCUCAP1_PhaseDetectGNDDec FaultTCUCAP1_PhaseDetectGNDFailMod FaultTCUCAP1_PhaseDetectGNDInc FaultTCUCAP1_PhaseDetectVCCDec FaultTCUCAP1_PhaseDetectVCCFailMod FaultTCUCAP1_PhaseDetectVCCInc FaultTCUCAP1_SWOverCurDec FaultTCUCAP1_SWOverCurFailMod FaultTCUCAP1_SWOverCurInc FaultTCUCAP1_ThermalShutDownDec FaultTCUCAP1_ThermalShutDownFailMod FaultTCUCAP1_ThermalShutDownInc FaultTCUCAP1_ThermalWarningDec FaultTCUCAP1_ThermalWarningFailMod FaultTCUCAP1_ThermalWarningInc FaultTCUCAP1_UnderVoltageDec FaultTCUCAP1_UnderVoltageFailMod FaultTCUCAP1_UnderVoltageInc FaultTCUCCP_OilMotorRationalDec FaultTCUCCP_OilMotorRationalFailMod FaultTCUCCP_OilMotorRationalInc FaultTCUCCP_OilMotorStallDec FaultTCUCCP_OilMotorStallFailMod FaultTCUCCP_OilMotorStallInc FaultTCUCCP_OilSenRationalL1Dec FaultTCUCCP_OilSenRationalL1FailMod FaultTCUCCP_OilSenRationalL1Inc FaultTCUCCP_OilSenRationalL2Dec FaultTCUCCP_OilSenRationalL2FailMod FaultTCUCCP_OilSenRationalL2Inc FaultTCUCCP_OilTempRationalHDec FaultTCUCCP_OilTempRationalHFailMod FaultTCUCCP_OilTempRationalHInc FaultTCUCCP_OilTempRationalLDec FaultTCUCCP_OilTempRationalLFailMod FaultTCUCCP_OilTempRationalLInc /end DEF_CHARACTERISTIC
 /begin OUT_MEASUREMENT FaultTableFuncTypeCounter1[1] FaultTableFuncTypeCounter1[20] FaultTableFuncTypeCounter1[21] FaultTableFuncTypeCounter1[22] FaultTableFuncTypeCounter1[23] FaultTableFuncTypeCounter1[24] FaultTableFuncTypeCounter1[25] FaultTableFuncTypeCounter1[26] FaultTableFuncTypeCounter1[27] FaultTableFuncTypeCounter1[28] FaultTableFuncTypeCounter1[29] FaultTableFuncTypeCounter1[2] FaultTableFuncTypeCounter1[30] FaultTableFuncTypeCounter1[31] FaultTableFuncTypeCounter1[32] FaultTableFuncTypeCounter1[33] FaultTableFuncTypeCounter1[34] FaultTableFuncTypeCounter1[35] FaultTableFuncTypeCounter1[36] FaultTableFuncTypeCounter1[37] FaultTableFuncTypeCounter1[38] FaultTableFuncTypeCounter1[39] FaultTableFuncTypeCounter1[3] FaultTableFuncTypeCounter1[40] FaultTableFuncTypeCounter1[41] FaultTableFuncTypeCounter1[42] FaultTableFuncTypeCounter1[43] FaultTableFuncTypeCounter1[44] FaultTableFuncTypeCounter1[45] FaultTableFuncTypeCounter1[46] FaultTableFuncTypeCounter1[47] FaultTableFuncTypeCounter1[48] FaultTableFuncTypeCounter1[49] FaultTableFuncTypeCounter1[4] FaultTableFuncTypeCounter1[50] FaultTableFuncTypeCounter1[51] FaultTableFuncTypeCounter1[52] FaultTableFuncTypeCounter1[53] FaultTableFuncTypeCounter1[54] FaultTableFuncTypeCounter1[55] FaultTableFuncTypeCounter1[56] FaultTableFuncTypeCounter1[57] FaultTableFuncTypeCounter1[58] FaultTableFuncTypeCounter1[59] FaultTableFuncTypeCounter1[5] FaultTableFuncTypeCounter1[60] FaultTableFuncTypeCounter1[61] FaultTableFuncTypeCounter1[62] FaultTableFuncTypeCounter1[63] FaultTableFuncTypeCounter1[64] FaultTableFuncTypeCounter1[65] FaultTableFuncTypeCounter1[66] FaultTableFuncTypeCounter1[67] FaultTableFuncTypeCounter1[68] FaultTableFuncTypeCounter1[69] FaultTableFuncTypeCounter1[6] FaultTableFuncTypeCounter1[70] FaultTableFuncTypeCounter1[71] FaultTableFuncTypeCounter1[72] FaultTableFuncTypeCounter1[73] FaultTableFuncTypeCounter1[74] FaultTableFuncTypeCounter1[75] FaultTableFuncTypeCounter1[76] FaultTableFuncTypeCounter1[77] FaultTableFuncTypeCounter1[78] FaultTableFuncTypeCounter1[79] FaultTableFuncTypeCounter1[7] FaultTableFuncTypeCounter1[80] FaultTableFuncTypeCounter1[81] FaultTableFuncTypeCounter1[82] FaultTableFuncTypeCounter1[83] FaultTableFuncTypeCounter1[84] FaultTableFuncTypeCounter1[85] FaultTableFuncTypeCounter1[86] FaultTableFuncTypeCounter1[87] FaultTableFuncTypeCounter1[88] FaultTableFuncTypeCounter1[89] FaultTableFuncTypeCounter1[8] FaultTableFuncTypeCounter1[90] FaultTableFuncTypeCounter1[91] FaultTableFuncTypeCounter1[92] FaultTableFuncTypeCounter1[93] FaultTableFuncTypeCounter1[94] FaultTableFuncTypeCounter1[95] FaultTableFuncTypeCounter1[96] FaultTableFuncTypeCounter1[97] FaultTableFuncTypeCounter1[98] FaultTableFuncTypeCounter1[99] FaultTableFuncTypeCounter1[9] FaultTCUCAP0_CAPPressureHAut FaultTCUCAP0_CAPPressureHCounter FaultTCUCAP0_CAPPressureHDetected FaultTCUCAP0_CAPPressureHLogged FaultTCUCAP0_CAPPressureLAut FaultTCUCAP0_CAPPressureLCounter FaultTCUCAP0_CAPPressureLDetected FaultTCUCAP0_CAPPressureLLogged FaultTCUCAP0_CAPPressureOverHAut FaultTCUCAP0_CAPPressureOverHCounter FaultTCUCAP0_CAPPressureOverHDetected FaultTCUCAP0_CAPPressureOverHLogged FaultTCUCAP0_CAPSlipAut FaultTCUCAP0_CAPSlipCounter FaultTCUCAP0_CAPSlipDetected FaultTCUCAP0_CAPSlipLogged FaultTCUCAP0_Detected FaultTCUCAP0_DragMomentHAut FaultTCUCAP0_DragMomentHCounter FaultTCUCAP0_DragMomentHDetected FaultTCUCAP0_DragMomentHLogged FaultTCUCAP0_HLSinInvalidAut FaultTCUCAP0_HLSinInvalidCounter FaultTCUCAP0_HLSinInvalidDetected FaultTCUCAP0_HLSinInvalidLogged FaultTCUCAP0_HLSinUndefineAut FaultTCUCAP0_HLSinUndefineCounter FaultTCUCAP0_HLSinUndefineDetected FaultTCUCAP0_HLSinUndefineLogged FaultTCUCAP0_HLSupplyHAut FaultTCUCAP0_HLSupplyHCounter FaultTCUCAP0_HLSupplyHDetected FaultTCUCAP0_HLSupplyHLogged FaultTCUCAP0_HLSupplyLAut FaultTCUCAP0_HLSupplyLCounter FaultTCUCAP0_HLSupplyLDetected FaultTCUCAP0_HLSupplyLLogged FaultTCUCAP0_Logged FaultTCUCAP0_MotorPhaseVolHAut FaultTCUCAP0_MotorPhaseVolHCounter FaultTCUCAP0_MotorPhaseVolHDetected FaultTCUCAP0_MotorPhaseVolHLogged FaultTCUCAP0_PressureRationalAut FaultTCUCAP0_PressureRationalCounter FaultTCUCAP0_PressureRationalDetected FaultTCUCAP0_PressureRationalLogged FaultTCUCAP0_SenSigOpenOrGNDAut FaultTCUCAP0_SenSigOpenOrGNDCounter FaultTCUCAP0_SenSigOpenOrGNDDetected FaultTCUCAP0_SenSigOpenOrGNDLogged FaultTCUCAP0_SenSigVCCAut FaultTCUCAP0_SenSigVCCCounter FaultTCUCAP0_SenSigVCCDetected FaultTCUCAP0_SenSigVCCLogged FaultTCUCAP0_SensorPerforErrAut FaultTCUCAP0_SensorPerforErrCounter FaultTCUCAP0_SensorPerforErrDetected FaultTCUCAP0_SensorPerforErrLogged FaultTCUCAP1_COM_GCUAut FaultTCUCAP1_COM_GCUCounter FaultTCUCAP1_COM_GCUDetected FaultTCUCAP1_COM_GCULogged FaultTCUCAP1_Detected FaultTCUCAP1_DriverTempHAut FaultTCUCAP1_DriverTempHCounter FaultTCUCAP1_DriverTempHDetected FaultTCUCAP1_DriverTempHLogged FaultTCUCAP1_FETShortAut FaultTCUCAP1_FETShortCounter FaultTCUCAP1_FETShortDetected FaultTCUCAP1_FETShortLogged FaultTCUCAP1_HWOverCurAut FaultTCUCAP1_HWOverCurCounter FaultTCUCAP1_HWOverCurDetected FaultTCUCAP1_HWOverCurLogged FaultTCUCAP1_Logged FaultTCUCAP1_MotorPhaseDriveErrAut FaultTCUCAP1_MotorPhaseDriveErrCounter FaultTCUCAP1_MotorPhaseDriveErrDetected FaultTCUCAP1_MotorPhaseDriveErrLogged FaultTCUCAP1_MotorStallAut FaultTCUCAP1_MotorStallCounter FaultTCUCAP1_MotorStallDetected FaultTCUCAP1_MotorStallLogged FaultTCUCAP1_OverVoltageAut FaultTCUCAP1_OverVoltageCounter FaultTCUCAP1_OverVoltageDetected FaultTCUCAP1_OverVoltageLogged FaultTCUCAP1_PhaseDetectGNDAut FaultTCUCAP1_PhaseDetectGNDCounter FaultTCUCAP1_PhaseDetectGNDDetected FaultTCUCAP1_PhaseDetectGNDLogged FaultTCUCAP1_PhaseDetectVCCAut FaultTCUCAP1_PhaseDetectVCCCounter FaultTCUCAP1_PhaseDetectVCCDetected FaultTCUCAP1_PhaseDetectVCCLogged FaultTCUCAP1_SWOverCurAut FaultTCUCAP1_SWOverCurCounter FaultTCUCAP1_SWOverCurDetected FaultTCUCAP1_SWOverCurLogged FaultTCUCAP1_ThermalShutDownAut FaultTCUCAP1_ThermalShutDownCounter FaultTCUCAP1_ThermalShutDownDetected FaultTCUCAP1_ThermalShutDownLogged FaultTCUCAP1_ThermalWarningAut FaultTCUCAP1_ThermalWarningCounter FaultTCUCAP1_ThermalWarningDetected FaultTCUCAP1_ThermalWarningLogged FaultTCUCAP1_UnderVoltageAut FaultTCUCAP1_UnderVoltageCounter FaultTCUCAP1_UnderVoltageDetected FaultTCUCAP1_UnderVoltageLogged FaultTCUCCP_Detected FaultTCUCCP_Logged FaultTCUCCP_OilMotorRationalAut FaultTCUCCP_OilMotorRationalCounter FaultTCUCCP_OilMotorRationalDetected FaultTCUCCP_OilMotorRationalLogged FaultTCUCCP_OilMotorStallAut FaultTCUCCP_OilMotorStallCounter FaultTCUCCP_OilMotorStallDetected FaultTCUCCP_OilMotorStallLogged FaultTCUCCP_OilSenRationalL1Aut FaultTCUCCP_OilSenRationalL1Counter FaultTCUCCP_OilSenRationalL1Detected FaultTCUCCP_OilSenRationalL1Logged FaultTCUCCP_OilSenRationalL2Aut FaultTCUCCP_OilSenRationalL2Counter FaultTCUCCP_OilSenRationalL2Detected FaultTCUCCP_OilSenRationalL2Logged FaultTCUCCP_OilTempRationalHAut FaultTCUCCP_OilTempRationalHCounter FaultTCUCCP_OilTempRationalHDetected FaultTCUCCP_OilTempRationalHLogged FaultTCUCCP_OilTempRationalLAut FaultTCUCCP_OilTempRationalLCounter FaultTCUCCP_OilTempRationalLDetected FaultTCUCCP_OilTempRationalLLogged /end OUT_MEASUREMENT
/end FUNCTION
/begin FUNCTION FAULT_FF ""
 /begin OUT_MEASUREMENT FAULT_FF_bFrameLock_FF1 FF_FF1_BatteryVoltage FF_FF1_BMS_HVBusVolt FF_FF1_CosScaled FF_FF1_DC_Current FF_FF1_DrivingPermission FF_FF1_EngineSpeed FF_FF1_EstimTempSecFild FF_FF1_ExcitationDiag FF_FF1_ExcVoltageFild FF_FF1_FPGA_FaultA FF_FF1_FPGA_FaultB FF_FF1_FT_AclState FF_FF1_FTModeReq FF_FF1_GlbRealTimeDay FF_FF1_GlbRealTimeHour FF_FF1_GlbRealTimeMinute FF_FF1_GlbRealTimeMonth FF_FF1_GlbRealTimeSec FF_FF1_GlbRealTimeYear FF_FF1_HV_VoltageFild FF_FF1_I0dq3_1 FF_FF1_I0dq3_2 FF_FF1_i0dqTgt3_1 FF_FF1_i0dqTgt3_2 FF_FF1_idCorTgt FF_FF1_idLutTgt FF_FF1_IGBTStatus FF_FF1_IgnitionSwSig FF_FF1_IPUMode FF_FF1_iqLutTgt FF_FF1_ISGCurrentTorq FF_FF1_Iu FF_FF1_Iv FF_FF1_Iw FF_FF1_MaxMinTorqueDrtVect FF_FF1_MCU_HVBusVolt FF_FF1_MecaSpeedRpm FF_FF1_MecaTorqueMaxMin FF_FF1_MotTemp FF_FF1_ParkVoltageTgt FF_FF1_ResolNext2ThetaRdByPi FF_FF1_RMS_Cur_U FF_FF1_RMS_Cur_V FF_FF1_RMS_Cur_W FF_FF1_RstStartUpCnt FF_FF1_SinScaled FF_FF1_SOC FF_FF1_TempCmdBoard FF_FF1_TempCoolingFild FF_FF1_TempDrvBoard FF_FF1_TempIgbt FF_FF1_TimestampIgn FF_FF1_TimestampLife_H FF_FF1_TimestampLife_L FF_FF1_TotalMiles_H FF_FF1_TotalMiles_L FF_FF1_UM1dTgt FF_FF1_UM1qTgt FF_FF1_VCU_AllowTorq FF_FF1_VCU_DCU_ModeReq FF_FF1_VCU_DCU_TorqSet FF_FF1_VehicleSpd /end OUT_MEASUREMENT
/end FUNCTION
/begin FUNCTION FRecord "" /begin DEF_CHARACTERISTIC FRecord_ku32TimeBeforeFaultOccurC /end DEF_CHARACTERISTIC
 /begin OUT_MEASUREMENT Frecord_bFaultRecoverPermission FRecord_u8ClearReq FRecord_u8EventWriteState FRecord_u8FRLockedStatus FRecord_u8FRStoreState FRecord_u8HeadWriteState /end OUT_MEASUREMENT
/end FUNCTION
/begin FUNCTION GCCU6 ""
 /begin DEF_CHARACTERISTIC GCCU6_bAlimFreqChgEnaC GCCU6_bDualSmpEnaC GCCU6_bHwOvcFltDetEnaC GCCU6_bHwPinAscEnaC GCCU6_f32DrvClkDutyThdHighC GCCU6_f32DrvClkDutyThdLowC GCCU6_kbDrvBdClkEnaC GCCU6_kf32MidPointDutyHC GCCU6_kf32MidPointDutyLC GCCU6_ku16AlimDutyCycRawC GCCU6_ku32AlimFreqRawC GCCU6_ku8AscRecoverCntMaxC GCCU6_ku8PwmMidPointFaultC /end DEF_CHARACTERISTIC
 /begin OUT_MEASUREMENT GCCU6_au32PWMOnTime GCCU6_au32PWMOnTime[0] GCCU6_au32PWMOnTime[1] GCCU6_au32PWMOnTime[2] GCCU6_bAkdAfterAscReq GCCU6_bClrTrapReq GCCU6_bHighVoltStdbyFlg GCCU6_bHwFaultDcOvVolt GCCU6_bHwFaultIgbtH GCCU6_bHwFaultIgbtL GCCU6_bHwFaultOvcU GCCU6_bHwFaultOvcV GCCU6_bHwFaultOvcW GCCU6_bIgbtHighSideShort GCCU6_bIgbtLowSideShort GCCU6_bIsCCU6Start GCCU6_bIuvwCompReq GCCU6_bMotorSpdRdy GCCU6_bP5VDiagReinitCmd GCCU6_bP5VHSFltFlg GCCU6_bP5VLSFltFlg GCCU6_bPwmMidPointU GCCU6_bPwmMidPointV GCCU6_bPwmMidPointW GCCU6_bPwmOnGoingFlg GCCU6_bT12ZeroMatchFlg GCCU6_bTrapTrigger GCCU6_f32DrvClkHsDuty GCCU6_f32DrvClkLsDuty GCCU6_f32HighVolPhys GCCU6_f32PwmDutyPhysUZ GCCU6_f32PwmDutyPhysVZ GCCU6_f32PwmDutyPhysWZ GCCU6_u16AlimPowerOnDelay GCCU6_u16CCU6T13CmpVal GCCU6_u16HighVolAdc GCCU6_u16McuAscSttDelay GCCU6_u16P5VHSAdc GCCU6_u16PowerOnDelay GCCU6_u16PwmMaxDutyCyc GCCU6_u16PwmMidPointErrCnt GCCU6_u16PwmMinDutyCyc GCCU6_u16PwmModReq GCCU6_u16T12CntVal GCCU6_u16T12PeriodVal GCCU6_u16T13PeriodVal GCCU6_u32DrvClkHsDutyRaw GCCU6_u32DrvClkHsPerdRaw GCCU6_u32DrvClkLsDutyRaw GCCU6_u32DrvClkLsPerdRaw GCCU6_u32TrapCreq GCCU6_u8AscRecoverCnt GCCU6_u8McuAscSttStep GCCU6_u8McuAscType GCCU6_u8P5VHSFltCnt GCCU6_u8P5VLSFltCnt GCCU6_u8P5VPowerMngStt GCCU6_u8P5VSelfTstStt GCCU6_u8P5VSelfTstTimCnt GCCU6_u8PreTestStep GCCU6_u8PwmState /end OUT_MEASUREMENT
/end FUNCTION
/begin FUNCTION GDSM "" /begin DEF_CHARACTERISTIC GFaultEraseRequestC /end DEF_CHARACTERISTIC
 /begin OUT_MEASUREMENT GDSM_DtcNumber GDSM_DtcNumber[0] GDSM_DtcNumber[1] GDSM_DtcNumber[2] GDSM_DtcNumber[3] GDSM_DtcNumber[4] GDSM_DtcNumber[5] GDSM_DtcNumber[6] GDSM_DtcNumber[7] GDSM_DtcNumber[8] GDSM_DtcNumber[9] GDSM_DtcStatusNvm GDSM_DtcStatusNvm[0] GDSM_DtcStatusNvm[1] GDSM_DtcStatusNvm[2] GDSM_DtcStatusNvm[3] GDSM_DtcStatusNvm[4] GDSM_DtcStatusNvm[5] GDSM_DtcStatusNvm[6] GDSM_DtcStatusNvm[7] GDSM_DtcStatusNvm[8] GDSM_DtcStatusNvm[9] GFaultEraseRequest GFaultFailureLevel /end OUT_MEASUREMENT
/end FUNCTION
/begin FUNCTION HARD ""
 /begin DEF_CHARACTERISTIC HARD_bPtgEnablePhaseShiftingC HARD_u16PtgUSignalShiftC HARD_u16PtgVSignalShiftC HARD_u16PtgWSignalShiftC HARDPTG_s16AmplitudeC HARDPTG_s16ContinuousRequestC HARDPTG_s16OffsetC HARDPTG_s16SlewRateC HARDPTG_u16PulseDutyCycleC HARDPTG_u32FrequenceC /end DEF_CHARACTERISTIC
 /begin OUT_MEASUREMENT HARD_bDio_DCLINK_OV_FAULT HARD_bDio_M_CLU_ENA HARD_bDio_M_EXCI_TRIGGER_GCU HARD_bDio_M_EXCI_TRIGGER_MCU HARD_bDio_M_FAULT_DRV_GCU_H HARD_bDio_M_FAULT_DRV_GCU_L HARD_bDio_M_FAULT_DRV_MCU_H HARD_bDio_M_FAULT_DRV_MCU_L HARD_bDio_M_FAULT_HS HARD_bDio_M_FAULT_LS HARD_bDio_M_FLT_EXCITATION_IN_GCU HARD_bDio_M_FLT_EXCITATION_IN_MCU HARD_bDio_M_HWCFG1 HARD_bDio_M_HWCFG2 HARD_bDio_M_HWCFG3 HARD_bDio_M_HWCFG4 HARD_bDio_M_HWCFG5 HARD_bDio_M_HWCFG6 HARD_bDio_M_HWNUM_0 HARD_bDio_M_HWNUM_1 HARD_bDio_M_HWNUM_2 HARD_bDio_M_KEY_ON HARD_bDio_M_MCU_ASC_STATE_MCU HARD_bDio_M_OIL_ENA HARD_bDio_M_PW_DOWN HARD_bDio_M_SUPPLY_WDI HARD_bDio_MCU_STATE_LED HARD_bDio_OIL_ERR HARD_bESMCmdFtShutdownReq HARD_bESMCmdFtShutdownRes HARD_bESMCmdFtStartReq HARD_bESMCmdFtStartRes HARD_bESMCmdPwmDirectReq HARD_bESMCmdPwmDirectRes HARD_bESMCmdPwmHardReq HARD_bESMCmdPwmHardRes HARD_bESMCmdPwmOffReq HARD_bESMCmdPwmOffRes HARD_bESMCmdSwShutdownReq HARD_bESMCmdSwShutdownRes HARD_bESMCmdSwStartReq HARD_bESMCmdSwStartRes HARD_bModSeq1FuncOn HARD_bModSeq1InitOn HARD_bModSeq2FuncOn HARD_bModSeq2InitOn HARD_bNmRxRepeatMsgReq HARD_bNMTestOn HARD_bNmTxRepeatMsgReq HARD_bPtgEnable HARD_bPtgSignalsShiftControl HARD_bPtgUSignalEnable HARD_bPtgVSignalEnable HARD_bPtgWSignalEnable HARD_ESM_FT_STATE_FT_SHUTDOWN HARD_ESM_FT_STATE_IDLE HARD_ESM_FT_STATE_PWM_DIRECT HARD_ESM_FT_STATE_PWM_HARD HARD_ESM_FT_STATE_PWM_OFF HARD_ESM_NF_STATE_FT_START HARD_ESM_NF_STATE_IDLE HARD_ESM_NF_STATE_PWM_HARD HARD_ESM_NF_STATE_PWM_OFF HARD_ESM_NF_STATE_SW_SHUTDOWN HARD_EsmFtState HARD_EsmFtStateAut HARD_EsmNfState HARD_EsmNfStateAut HARD_PTG_CONTINUOUS_MODE HARD_PTG_DISJUNCTION_MODE HARD_PTG_LOOP_NB_MODE HARD_PTG_PROFIL_MODE HARD_PTG_PULSE_MODE HARD_PTG_SINUS_MODE HARD_PTG_SQUARE_MODE HARD_PTG_TRIANGLE_MODE HARD_PtgModeTest HARD_s16PtgRefSignalValue HARD_s16PtgUSignalValue HARD_s16PtgVSignalValue HARD_s16PtgWSignalValue HARD_u16Adc0An00_MOT_COS HARD_u16Adc0An01_P5VHS_REF HARD_u16Adc0An02_P16VMult HARD_u16Adc0An03_CTP_MOT1_F HARD_u16Adc0An03_CTP_MOT1_FPhys HARD_u16Adc0An04_CTP_MOT2_F HARD_u16Adc0An04_CTP_MOT2_FPhys HARD_u16Adc0An05_MonP5VRef HARD_u16Adc0An06_P5vLsRef HARD_u16Adc0An07_DIAG_CONS_EXC HARD_u16Adc0An08_CTP_COOLING HARD_u16Adc0An08_CTP_COOLINGPhys HARD_u16Adc0An10_CTN_BOARD2 HARD_u16Adc0An10_CTN_BOARD2Phys HARD_u16Adc0An11_IgbtTemp_3 HARD_u16Adc0An12_IgbtTemp_2 HARD_u16Adc0An13_MOT_COS_SAFE HARD_u16Adc1An16_MOT_SIN HARD_u16Adc1An18_VolDcLinkDrv HARD_u16Adc1An19_P12V_BATT_F HARD_u16Adc1An19_P12V_BATT_Fphys HARD_u16Adc1An20_DELTA_COS_POS HARD_u16Adc1An21_DELTA_COS_NEG HARD_u16Adc1An24_PSU_P5V_LS HARD_u16Adc1An25_CURR_DC HARD_u16Adc1An26_PSU_P5V_HS HARD_u16Adc1An27_SPARE_4 HARD_u16Adc1An28_MonCurrOcpL HARD_u16Adc1An29_MOT_SIN_SAFE HARD_u16Adc1An57_TempDrv HARD_u16Adc2An32_DIAG_COS_H HARD_u16Adc2An33_DIAG_COS_L HARD_u16Adc2An35_DIAG_SIN_H HARD_u16Adc2An38_DIAG_SIN_L HARD_u16Adc2An44_CTN_BOARD1 HARD_u16Adc2An44_CTN_BOARD1Phys HARD_u16Adc2An46_VolDcLinkFil HARD_u16Adc2An47_15V_RDC HARD_u16Adc2An48_MonDcOvpSele HARD_u16Adc2An49_TempIgbt HARD_u16Adc_15V_RDC HARD_u16Adc_CTN_BOARD HARD_u16Adc_CTP_MOT_N_GCU HARD_u16Adc_CTP_MOT_N_MCU HARD_u16Adc_CTP_MOT_P_GCU HARD_u16Adc_CTP_MOT_P_MCU HARD_u16Adc_CURRENT_U_GCU HARD_u16Adc_CURRENT_U_MCU HARD_u16Adc_CURRENT_V_GCU HARD_u16Adc_CURRENT_V_MCU HARD_u16Adc_CURRENT_W_GCU HARD_u16Adc_CURRENT_W_MCU HARD_u16Adc_DIAG_COS_H_GCU HARD_u16Adc_DIAG_COS_H_MCU HARD_u16Adc_DIAG_COS_L_GCU HARD_u16Adc_DIAG_COS_L_MCU HARD_u16Adc_DIAG_SIN_H_GCU HARD_u16Adc_DIAG_SIN_H_MCU HARD_u16Adc_DIAG_SIN_L_GCU HARD_u16Adc_DIAG_SIN_L_MCU HARD_u16Adc_EXCI_HI_FB_GCU HARD_u16Adc_EXCI_HI_FB_MCU HARD_u16Adc_EXCI_LO_FB_GCU HARD_u16Adc_EXCI_LO_FB_MCU HARD_u16Adc_ISN_CLU_BLDC HARD_u16Adc_ISN_OIL_BLDC HARD_u16Adc_MOT_COS HARD_u16Adc_MOT_COS_GCU HARD_u16Adc_MOT_COS_MCU HARD_u16Adc_MOT_SIN HARD_u16Adc_MOT_SIN_GCU HARD_u16Adc_MOT_SIN_MCU HARD_u16Adc_Oil_Pressure HARD_u16Adc_Oil_Temp_N HARD_u16Adc_Oil_Temp_P HARD_u16Adc_P12V_BATT_1 HARD_u16Adc_P12V_BATT_2 HARD_u16Adc_P5V_BT HARD_u16Adc_P5V_BT_AD2S HARD_u16Adc_P5V_COM HARD_u16Adc_P5V_GATEWAY HARD_u16Adc_P5V_REF HARD_u16Adc_PSU_P5V_HS HARD_u16Adc_PSU_P5V_LS HARD_u16Adc_PSUP_P9V_MULTI HARD_u16Adc_RESCOSHI_ADC_GCU HARD_u16Adc_RESCOSHO_ADC_MCU HARD_u16Adc_RESCOSLO_ADC_GCU HARD_u16Adc_RESCOSLO_ADC_MCU HARD_u16Adc_RESSINHI_ADC_GCU HARD_u16Adc_RESSINHI_ADC_MCU HARD_u16Adc_RESSINLO_ADC_GCU HARD_u16Adc_RESSINLO_ADC_MCU HARD_u16Adc_TEMP_MEAS_MOD1 HARD_u16Adc_TEMP_MEAS_MOD2 HARD_u16Adc_TEMP_MEAS_MOD3 HARD_u16Adc_TEMP_MEAS_MOD_GCU HARD_u16Adc_VOL_DCLINK_DRV HARD_u16PtgRefSignalNbPeriode HARD_u16PtgRefSignalTime HARD_u16PtgUSignalNbPeriode HARD_u16PtgUSignalTime HARD_u16PtgVSignalNbPeriode HARD_u16PtgVSignalTime HARD_u16PtgWSignalNbPeriode HARD_u16PtgWSignalTime HARD_u8CanIfCtrlMode HARD_u8CanIfCtrlModeReq HARD_u8CanIfPduMode HARD_u8CanIfPduModeReq HARD_u8CanNmLocalNodeId HARD_u8CanNmMode HARD_u8CanNmNodeId HARD_u8CanNmState HARD_u8CanSmMode HARD_u8CanSmModeReq HARD_u8ComMMode HARD_u8ComMState HARD_u8ComMStatus HARD_u8NmMode HARD_u8NmState HARD_u8NmTestNum HARD_u8NmUserDataRx HARD_u8NmUserDataRx[0] HARD_u8NmUserDataRx[1] HARD_u8NmUserDataRx[2] HARD_u8NmUserDataRx[3] HARD_u8NmUserDataRx[4] HARD_u8NmUserDataRx[5] HARD_u8NmUserDataTx HARD_u8NmUserDataTx[0] HARD_u8NmUserDataTx[1] HARD_u8NmUserDataTx[2] HARD_u8NmUserDataTx[3] HARD_u8NmUserDataTx[4] HARD_u8NmUserDataTx[5] HARD_u8NmWakeupReason HARD_u8VSIRxaTempCtrlBdPhys HARD_u8VSIRxaTempDrvBdPhys HARD_u8VSIRxaTempIgbtPhys /end OUT_MEASUREMENT
/end FUNCTION
/begin FUNCTION MAIN ""
 /begin OUT_MEASUREMENT ADCTotalTime ASWNM_bFullComSts ASWNM_u8CurrentState ASWNM_u8CurrentState[0] ASWNM_u8CurrentState[10] ASWNM_u8CurrentState[11] ASWNM_u8CurrentState[12] ASWNM_u8CurrentState[13] ASWNM_u8CurrentState[14] ASWNM_u8CurrentState[15] ASWNM_u8CurrentState[16] ASWNM_u8CurrentState[17] ASWNM_u8CurrentState[18] ASWNM_u8CurrentState[19] ASWNM_u8CurrentState[1] ASWNM_u8CurrentState[20] ASWNM_u8CurrentState[2] ASWNM_u8CurrentState[3] ASWNM_u8CurrentState[4] ASWNM_u8CurrentState[5] ASWNM_u8CurrentState[6] ASWNM_u8CurrentState[7] ASWNM_u8CurrentState[8] ASWNM_u8CurrentState[9] Calibration_debut Core0_f32Asw100msLoad Core0_f32Asw10msLoad Core0_f32Bsw100msLoad Core0_f32Bsw10msLoad Core0_f32Bsw1msLoad Core0_f32Bsw50msLoad Core0_f32ModReqLoad Core0_f32VsiTreatmentLoad Core1_f32Asw10msLoad Core1_f32Asw1msLoad Core1_f32Bsw10msLoad Core1_f32PosTreatmentLoad Core2_f32Asw10msLoad Core2_f32Asw1msLoad Core2_f32BldcTreatmentLoad Core2_f32Bsw10msLoad GADCTotalTime GASWNM_bFullComSts GASWNM_bStayAwake GASWNM_u8CurrentState GASWNM_u8CurrentState[0] GASWNM_u8CurrentState[10] GASWNM_u8CurrentState[11] GASWNM_u8CurrentState[12] GASWNM_u8CurrentState[13] GASWNM_u8CurrentState[14] GASWNM_u8CurrentState[15] GASWNM_u8CurrentState[16] GASWNM_u8CurrentState[17] GASWNM_u8CurrentState[18] GASWNM_u8CurrentState[19] GASWNM_u8CurrentState[1] GASWNM_u8CurrentState[20] GASWNM_u8CurrentState[2] GASWNM_u8CurrentState[3] GASWNM_u8CurrentState[4] GASWNM_u8CurrentState[5] GASWNM_u8CurrentState[6] GASWNM_u8CurrentState[7] GASWNM_u8CurrentState[8] GASWNM_u8CurrentState[9] GCalibration_debut GCore0_f32Asw100msLoad GCore0_f32Asw10msLoad GCore0_f32Bsw100msLoad GCore0_f32Bsw10msLoad GCore0_f32Bsw1msLoad GCore0_f32Bsw50msLoad GCore0_f32ModReqLoad GCore0_f32VsiTreatmentLoad GCore1_f32Asw10msLoad GCore1_f32Asw1msLoad GCore1_f32Bsw10msLoad GCore1_f32PosTreatmentLoad GCore2_f32Asw10msLoad GCore2_f32Asw1msLoad GCore2_f32BldcTreatmentLoad GCore2_f32Bsw10msLoad GMAIN_as32OCTrimNvm GMAIN_as32OCTrimNvm[0] GMAIN_as32OCTrimNvm[1] GMAIN_as32OCTrimNvm[2] GMAIN_as32OCTrimNvm[3] GMAIN_as32OCTrimNvm[4] GMAIN_au8ErrCode GMAIN_au8ErrCode[0] GMAIN_au8ErrCode[10] GMAIN_au8ErrCode[11] GMAIN_au8ErrCode[12] GMAIN_au8ErrCode[13] GMAIN_au8ErrCode[14] GMAIN_au8ErrCode[15] GMAIN_au8ErrCode[16] GMAIN_au8ErrCode[17] GMAIN_au8ErrCode[18] GMAIN_au8ErrCode[19] GMAIN_au8ErrCode[1] GMAIN_au8ErrCode[2] GMAIN_au8ErrCode[3] GMAIN_au8ErrCode[4] GMAIN_au8ErrCode[5] GMAIN_au8ErrCode[6] GMAIN_au8ErrCode[7] GMAIN_au8ErrCode[8] /end OUT_MEASUREMENT
/end FUNCTION
/begin COMPU_METHOD HARD_EsmFtState_conv "" TAB_VERB "%8.4" "." COMPU_TAB_REF HARD_EsmFtState_table /end COMPU_METHOD
/begin COMPU_VTAB HARD_EsmFtState_table "" TAB_VERB 5 1 "HARD_ESM_FT_STATE_PWM_DIRECT" 2 "HARD_ESM_FT_STATE_PWM_HARD" 4 "HARD_ESM_FT_STATE_PWM_OFF" 8 "HARD_ESM_FT_STATE_FT_SHUTDOWN" 64 "HARD_ESM_FT_STATE_IDLE" /end COMPU_VTAB
/begin COMPU_METHOD HARD_EsmNfState_conv "" TAB_VERB "%8.4" "." COMPU_TAB_REF HARD_EsmNfState_table /end COMPU_METHOD
/begin COMPU_VTAB HARD_EsmNfState_table "" TAB_VERB 5 1 "HARD_ESM_NF_STATE_FT_START" 4 "HARD_ESM_NF_STATE_SW_SHUTDOWN" 8 "HARD_ESM_NF_STATE_PWM_HARD" 16 "HARD_ESM_NF_STATE_PWM_OFF" 64 "HARD_ESM_NF_STATE_IDLE" /end COMPU_VTAB
/begin COMPU_METHOD HARD_PtgModeTest_conv "" TAB_VERB "%8.4" "." COMPU_TAB_REF HARD_PtgModeTest_table /end COMPU_METHOD
/begin COMPU_VTAB HARD_PtgModeTest_table "" TAB_VERB 8 1 "HARD_PTG_PULSE_MODE" 2 "HARD_PTG_SINUS_MODE" 4 "HARD_PTG_TRIANGLE_MODE" 8 "HARD_PTG_SQUARE_MODE" 16 "HARD_PTG_CONTINUOUS_MODE" 32 "HARD_PTG_PROFIL_MODE" 64 "HARD_PTG_DISJUNCTION_MODE" 128 "HARD_PTG_LOOP_NB_MODE" /end COMPU_VTAB
/end MODULE
/end PROJECT
