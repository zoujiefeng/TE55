/* Genebase version 6.5.0.0 */
ASAP2_VERSION 1 3
/begin PROJECT D_TC387_PLATFORM_0_0 "D_TC387_PLATFORM_0_0"
/begin HEADER "" VERSION "5210.00" PROJECT_NO D0 /end HEADER
/begin MODULE D_TC387_PLATFORM_0_0 "Invt"
/begin MOD_PAR "CCP" USER "D_TC387_PLATFORM_0_0" ECU "D_TC387_PLATFORM_0_0"
 /begin MEMORY_SEGMENT CODE1 "FillMemory1" CODE FLASH INTERN 0x80050000 0x8000 -1 -1 -1 -1 -1 /end MEMORY_SEGMENT
 /begin MEMORY_SEGMENT DATA1 "CalibrationMemoryArea" DATA FLASH INTERN 0x80058000 0x10000 -1 -1 -1 -1 -1 /begin IF_DATA ASAP1B_CCP ADDRESS_MAPPING 0x80058000 0x80058000 0x10000 /end IF_DATA /end MEMORY_SEGMENT
 /begin MEMORY_SEGMENT CODE2 "FillMemory2" CODE FLASH INTERN 0x80068000 0x98000 -1 -1 -1 -1 -1 /end MEMORY_SEGMENT
 /begin MEMORY_SEGMENT CODE3 "CodeMemoryArea" CODE FLASH INTERN 0x80100000 0x180000 -1 -1 -1 -1 -1 /end MEMORY_SEGMENT
 /begin MEMORY_SEGMENT VARIABLES1 "DataMemory" VARIABLES RAM INTERN 0x60000000 0x18000 -1 -1 -1 -1 -1 /end MEMORY_SEGMENT
/end MOD_PAR
/begin MOD_COMMON "" DEPOSIT ABSOLUTE ALIGNMENT_BYTE 1 ALIGNMENT_WORD 2 ALIGNMENT_LONG 4 ALIGNMENT_FLOAT32_IEEE 4 ALIGNMENT_FLOAT64_IEEE 8 BYTE_ORDER MSB_LAST /end MOD_COMMON
/begin IF_DATA ASAP1B_CCP
 /begin SOURCE "1 ms" 3 1 DISPLAY_IDENTIFIER "1 ms" /begin QP_BLOB 0 LENGTH 6 CAN_ID_FIXED 0x200 RASTER 0 FIRST_PID 0x00 /end QP_BLOB /end SOURCE
 /begin SOURCE "10 ms" 4 1 DISPLAY_IDENTIFIER "10 ms" /begin QP_BLOB 1 LENGTH 28 CAN_ID_FIXED 0x201 RASTER 1 FIRST_PID 0x12 /end QP_BLOB /end SOURCE
 /begin SOURCE "5 ms" 3 5 DISPLAY_IDENTIFIER "5 ms" /begin QP_BLOB 2 LENGTH 12 CAN_ID_FIXED 0x1FF RASTER 2 FIRST_PID 0x06 /end QP_BLOB /end SOURCE
 /begin RASTER "Timer 1 ms" "1 ms" 0 3 1 /end RASTER
 /begin RASTER "Timer 10 ms" "10 ms" 1 4 1 /end RASTER
 /begin RASTER "Timer 5 ms" "5 ms" 2 3 5 /end RASTER
 /begin TP_BLOB 0x0201 0x0202 0x301 0x302 0x0209 2 STORE_SUPPORTED BAUDRATE 1000000 SAMPLE_POINT 80 SAMPLE_RATE 1 BTL_CYCLES 20 SJW 3 SYNC_EDGE 0 /begin CHECKSUM_PARAM 0x8001 0x00000200 CHECKSUM_CALCULATION ACTIVE_PAGE /end CHECKSUM_PARAM /begin DEFINED_PAGES 0 "ReferencePage" 0x0000 0x80058000 0x00010000 ROM /end DEFINED_PAGES
  /begin DEFINED_PAGES 1 "WorkingPage" 0x0000 0x60018000 0x00004000 RAM FLASH_BACK RAM_INIT_BY_ECU /end DEFINED_PAGES
  OPTIONAL_CMD 0x0C OPTIONAL_CMD 0x0D OPTIONAL_CMD 0x0E OPTIONAL_CMD 0x23 OPTIONAL_CMD 0x11 OPTIONAL_CMD 0x09 /end TP_BLOB
/end IF_DATA
/begin RECORD_LAYOUT DATA_RECORD_UBYTE FNC_VALUES 1 UBYTE ROW_DIR DIRECT /end RECORD_LAYOUT
/begin RECORD_LAYOUT DATA_RECORD_SBYTE FNC_VALUES 1 SBYTE ROW_DIR DIRECT /end RECORD_LAYOUT
/begin RECORD_LAYOUT DATA_RECORD_UWORD FNC_VALUES 1 UWORD ROW_DIR DIRECT /end RECORD_LAYOUT
/begin RECORD_LAYOUT DATA_RECORD_ULONG FNC_VALUES 1 ULONG ROW_DIR DIRECT /end RECORD_LAYOUT
/begin RECORD_LAYOUT DATA_RECORD_FLOAT32_IEEE FNC_VALUES 1 FLOAT32_IEEE ROW_DIR DIRECT /end RECORD_LAYOUT
/begin CHARACTERISTIC BLDC_bHallInvalidFltTestOnC "..." VALUE 0x0000 DATA_RECORD_UBYTE 1 Bool_ON_OFF 0 1 BIT_MASK 0x01 /end CHARACTERISTIC
/begin CHARACTERISTIC BLDC_bHallUndefFltTestOnC "..." VALUE 0x0000 DATA_RECORD_UBYTE 1 Bool_ON_OFF 0 1 BIT_MASK 0x01 /end CHARACTERISTIC
/begin CHARACTERISTIC BLDC_bHwPinAscEnaC "..." VALUE 0x0000 DATA_RECORD_UBYTE 1 Bool_ON_OFF 0 1 BIT_MASK 0x01 /end CHARACTERISTIC
/begin CHARACTERISTIC BLDC_bOilPressShortGndFltTestOnC "..." VALUE 0x0000 DATA_RECORD_UBYTE 1 Bool_ON_OFF 0 1 BIT_MASK 0x01 /end CHARACTERISTIC
/begin CHARACTERISTIC BLDC_bOilPressShortVccFltTestOnC "..." VALUE 0x0000 DATA_RECORD_UBYTE 1 Bool_ON_OFF 0 1 BIT_MASK 0x01 /end CHARACTERISTIC
/begin CHARACTERISTIC BLDC_bP5vAD2SOverVolFltTestOnC "..." VALUE 0x0000 DATA_RECORD_UBYTE 1 Bool_ON_OFF 0 1 BIT_MASK 0x01 /end CHARACTERISTIC
/begin CHARACTERISTIC BLDC_bP5vAD2SUnderVolFltTestOnC "..." VALUE 0x0000 DATA_RECORD_UBYTE 1 Bool_ON_OFF 0 1 BIT_MASK 0x01 /end CHARACTERISTIC
/begin CHARACTERISTIC BLDC_bTestPinEnaC "..." VALUE 0x0000 DATA_RECORD_UBYTE 1 Bool_ON_OFF 0 1 BIT_MASK 0x01 /end CHARACTERISTIC
/begin CHARACTERISTIC BLDC_kf32LVThdHighC "..." VALUE 0x0000 DATA_RECORD_FLOAT32_IEEE 3.402823466E+038 F_1_p0_4 -3.402823466E+038 3.402823466E+038 /end CHARACTERISTIC
/begin CHARACTERISTIC BLDC_kf32LVThdLowC "..." VALUE 0x0000 DATA_RECORD_FLOAT32_IEEE 3.402823466E+038 F_1_p0_4 -3.402823466E+038 3.402823466E+038 /end CHARACTERISTIC
/begin CHARACTERISTIC BLDC_kf32MidPotMaxMonitorDutyC "Spare" VALUE 0x0000 DATA_RECORD_FLOAT32_IEEE 3.402823466E+038 F_1_p0_4 -3.402823466E+038 3.402823466E+038 /end CHARACTERISTIC
/begin CHARACTERISTIC BLDC_kf32MidPotMinMonitorDutyC "Spare" VALUE 0x0000 DATA_RECORD_FLOAT32_IEEE 3.402823466E+038 F_1_p0_4 -3.402823466E+038 3.402823466E+038 /end CHARACTERISTIC
/begin CHARACTERISTIC BLDC_kf32MidPotShrtGndDutyC "Spare" VALUE 0x0000 DATA_RECORD_FLOAT32_IEEE 3.402823466E+038 F_100_p0_5 -3.402823466E+038 3.402823466E+038 /end CHARACTERISTIC
/begin CHARACTERISTIC BLDC_kf32MidPotShrtVccDutyC "Spare" VALUE 0x0000 DATA_RECORD_FLOAT32_IEEE 3.402823466E+038 F_100_p0_5 -3.402823466E+038 3.402823466E+038 /end CHARACTERISTIC
/begin CHARACTERISTIC BLDC_kf32MidPotTgtHighC "Spare" VALUE 0x0000 DATA_RECORD_FLOAT32_IEEE 3.402823466E+038 F_100_p0_5 -3.402823466E+038 3.402823466E+038 /end CHARACTERISTIC
/begin CHARACTERISTIC BLDC_kf32MidPotTgtLowC "Spare" VALUE 0x0000 DATA_RECORD_FLOAT32_IEEE 3.402823466E+038 F_100_p0_5 -3.402823466E+038 3.402823466E+038 /end CHARACTERISTIC
/begin CHARACTERISTIC BLDC_kf32MotorSpeedC "..." VALUE 0x0000 DATA_RECORD_FLOAT32_IEEE 3.402823466E+038 F_1_p0_4 -3.402823466E+038 3.402823466E+038 /end CHARACTERISTIC
/begin CHARACTERISTIC BLDC_kf32P5vAD2SOverVolC "Spare" VALUE 0x0000 DATA_RECORD_FLOAT32_IEEE 3.402823466E+038 F_1_p0_4 -3.402823466E+038 3.402823466E+038 /end CHARACTERISTIC
/begin CHARACTERISTIC BLDC_kf32P5vAD2SUnderVolC "Spare" VALUE 0x0000 DATA_RECORD_FLOAT32_IEEE 3.402823466E+038 F_1_p0_4 -3.402823466E+038 3.402823466E+038 /end CHARACTERISTIC
/begin CHARACTERISTIC BLDC_kf32TgtDutyDeltMaxC "Spare" VALUE 0x0000 DATA_RECORD_FLOAT32_IEEE 3.402823466E+038 F_1_p0_4 -3.402823466E+038 3.402823466E+038 /end CHARACTERISTIC
/begin CHARACTERISTIC BLDC_ku16MidPotFltConfirmC "BLDC_ku16MidPotFltConfirmC" VALUE 0x0000 DATA_RECORD_UWORD 65535 I_1 0 65535 /end CHARACTERISTIC
/begin CHARACTERISTIC BLDC_ku16MidPotFltIncStepC "BLDC_ku16MidPotFltIncStepC" VALUE 0x0000 DATA_RECORD_UWORD 65535 I_1 0 65535 /end CHARACTERISTIC
/begin CHARACTERISTIC BLDC_ku16MidPotRcvTimC "Spare" VALUE 0x0000 DATA_RECORD_UWORD 655350 F_10_p0_6 0 655350 /end CHARACTERISTIC
/begin CHARACTERISTIC BLDC_ku16RvsDutyDelayC "Spare" VALUE 0x0000 DATA_RECORD_UWORD 3276.75 F_0v05_p0_7 0 3276.75 /end CHARACTERISTIC
/begin CHARACTERISTIC BLDC_ku16TgtDutyRisingTimC "BLDC_ku16TgtDutyRisingTimC" VALUE 0x0000 DATA_RECORD_UWORD 65535 I_1 0 65535 /end CHARACTERISTIC
/begin CHARACTERISTIC BSW_bGCUTOutTestOnC "..." VALUE 0x0000 DATA_RECORD_UBYTE 1 Bool_ON_OFF 0 1 BIT_MASK 0x01 /end CHARACTERISTIC
/begin CHARACTERISTIC BSW_bIntLockDetEnaC "..." VALUE 0x0000 DATA_RECORD_UBYTE 1 Bool_ON_OFF 0 1 BIT_MASK 0x01 /end CHARACTERISTIC
/begin CHARACTERISTIC BSW_bOBDEnaC "..." VALUE 0x0000 DATA_RECORD_UBYTE 1 Bool_ON_OFF 0 1 BIT_MASK 0x01 /end CHARACTERISTIC
/begin CHARACTERISTIC BSW_bSPYBenchOnC "SPY activation" VALUE 0x0000 DATA_RECORD_UBYTE 1 Bool_ON_OFF 0 1 BIT_MASK 0x01 /end CHARACTERISTIC
/begin CHARACTERISTIC BSW_ku16VSIRdyChkTimoutC "BSW_ku16VSIRdyChkTimoutC" VALUE 0x0000 DATA_RECORD_UWORD 65535 I_1 0 65535 /end CHARACTERISTIC
/begin CHARACTERISTIC CCU6_bAlimFreqChgEnaC "..." VALUE 0x0000 DATA_RECORD_UBYTE 1 Bool_ON_OFF 0 1 BIT_MASK 0x01 /end CHARACTERISTIC
/begin CHARACTERISTIC CCU6_bDualSmpEnaC "..." VALUE 0x0000 DATA_RECORD_UBYTE 1 Bool_ON_OFF 0 1 BIT_MASK 0x01 /end CHARACTERISTIC
/begin CHARACTERISTIC CCU6_bHwOvcFltDetEnaC "..." VALUE 0x0000 DATA_RECORD_UBYTE 1 Bool_ON_OFF 0 1 BIT_MASK 0x01 /end CHARACTERISTIC
/begin CHARACTERISTIC CCU6_bHwPinAscEnaC "..." VALUE 0x0000 DATA_RECORD_UBYTE 1 Bool_ON_OFF 0 1 BIT_MASK 0x01 /end CHARACTERISTIC
/begin CHARACTERISTIC CCU6_f32DrvClkDutyThdHighC "..." VALUE 0x0000 DATA_RECORD_FLOAT32_IEEE 3.402823466E+038 F_1_p0_4 -3.402823466E+038 3.402823466E+038 /end CHARACTERISTIC
/begin CHARACTERISTIC CCU6_f32DrvClkDutyThdLowC "..." VALUE 0x0000 DATA_RECORD_FLOAT32_IEEE 3.402823466E+038 F_1_p0_4 -3.402823466E+038 3.402823466E+038 /end CHARACTERISTIC
/begin CHARACTERISTIC CCU6_kbDrvBdClkEnaC "..." VALUE 0x0000 DATA_RECORD_UBYTE 1 Bool_ON_OFF 0 1 BIT_MASK 0x01 /end CHARACTERISTIC
/begin CHARACTERISTIC CCU6_kf32MidPointDutyHC "..." VALUE 0x0000 DATA_RECORD_FLOAT32_IEEE 3.402823466E+038 F_1_p0_4 -3.402823466E+038 3.402823466E+038 /end CHARACTERISTIC
/begin CHARACTERISTIC CCU6_kf32MidPointDutyLC "..." VALUE 0x0000 DATA_RECORD_FLOAT32_IEEE 3.402823466E+038 F_1_p0_4 -3.402823466E+038 3.402823466E+038 /end CHARACTERISTIC
/begin CHARACTERISTIC CCU6_ku16AlimDutyCycRawC "..." VALUE 0x0000 DATA_RECORD_UWORD 65535 F_1_p0_4 0 65535 /end CHARACTERISTIC
/begin CHARACTERISTIC CCU6_ku32AlimFreqRawC "..." VALUE 0x0000 DATA_RECORD_ULONG 4294967295 F_1_p0_4 0 4294967295 /end CHARACTERISTIC
/begin CHARACTERISTIC CCU6_ku8AscRecoverCntMaxC "..." VALUE 0x0000 DATA_RECORD_UBYTE 255 F_1_p0_4 0 255 /end CHARACTERISTIC
/begin CHARACTERISTIC CCU6_ku8PwmMidPointFaultC "..." VALUE 0x0000 DATA_RECORD_UBYTE 255 F_1_p0_4 0 255 /end CHARACTERISTIC
/begin CHARACTERISTIC CalUsr_ku32CalibUpdEnaMskA "..." VALUE 0x0000 DATA_RECORD_ULONG 4294967295 I_1 0 4294967295 /end CHARACTERISTIC
/begin CHARACTERISTIC CalUsr_ku32CalibUpdEnaMskB "..." VALUE 0x0000 DATA_RECORD_ULONG 4294967295 I_1 0 4294967295 /end CHARACTERISTIC
/begin CHARACTERISTIC EAS_bDefaultEskPassC "..." VALUE 0x0000 DATA_RECORD_UBYTE 1 Bool_ON_OFF 0 1 BIT_MASK 0x01 /end CHARACTERISTIC
/begin CHARACTERISTIC EAS_bRN32EnaOnC "Enable random number flag" VALUE 0x0000 DATA_RECORD_UBYTE 1 Bool_ON_OFF 0 1 BIT_MASK 0x01 /end CHARACTERISTIC
/begin CHARACTERISTIC EAS_u8Chg1DelayTimoutC "..." VALUE 0x0000 DATA_RECORD_UBYTE 255 I_1 0 255 /end CHARACTERISTIC
/begin CHARACTERISTIC ESM_u16PowerLatchTempoC "ESM_u16PowerLatchTempoC" VALUE 0x0000 DATA_RECORD_UWORD 327675 F_5_p0_30 0 327675 /end CHARACTERISTIC
/begin CHARACTERISTIC ESM_u8RestartDelayCntC "ESM_u8RestartDelayCntC" VALUE 0x0000 DATA_RECORD_UBYTE 1275 F_5_p0_30 0 1275 /end CHARACTERISTIC
/begin CHARACTERISTIC FAIL_bCanErrCheckonC "Check Can Error" VALUE 0x0000 DATA_RECORD_UBYTE 1 Bool_ON_OFF 0 1 BIT_MASK 0x01 /end CHARACTERISTIC
/begin CHARACTERISTIC FaultEraseRequestC "FaultEraseRequestC" VALUE 0x0000 DATA_RECORD_UWORD 65535 I_1 0 65535 /end CHARACTERISTIC
/begin MEASUREMENT ASWNM_bBusSleep "Shutdown request" UBYTE Bool_ON_OFF 1 2 0 1 BIT_MASK 0x01 ECU_ADDRESS 0x0 /end MEASUREMENT
/begin MEASUREMENT ASWNM_bStayAwake "Shutdown request" UBYTE Bool_ON_OFF 1 2 0 1 BIT_MASK 0x01 ECU_ADDRESS 0x0 /end MEASUREMENT
/begin MEASUREMENT ASWNM_u16AfterRunDelayTimes "ASWNM_u16AfterRunDelayTimes" UWORD I_1 1 2 0 65535 ECU_ADDRESS 0x0 /end MEASUREMENT
/begin MEASUREMENT ASWNM_u16Kl15Sts "ASWNM_u16Kl15Sts" UWORD I_1 1 2 0 65535 ECU_ADDRESS 0x0 /end MEASUREMENT
/begin MEASUREMENT BLDC_bClrTrapReq "..." UBYTE Bool_ON_OFF 1 2 0 1 BIT_MASK 0x01 ECU_ADDRESS 0x0 /end MEASUREMENT
/begin MEASUREMENT BLDC_bEnterSleepMod "..." UBYTE Bool_ON_OFF 1 2 0 1 BIT_MASK 0x01 ECU_ADDRESS 0x0 /end MEASUREMENT
/begin MEASUREMENT BLDC_bHallInvalidFlt "..." UBYTE Bool_ON_OFF 1 2 0 1 BIT_MASK 0x01 ECU_ADDRESS 0x0 /end MEASUREMENT
/begin MEASUREMENT BLDC_bHallUndefFlt "..." UBYTE Bool_ON_OFF 1 2 0 1 BIT_MASK 0x01 ECU_ADDRESS 0x0 /end MEASUREMENT
/begin MEASUREMENT BLDC_bHwFaultDcOvVolt "..." UBYTE Bool_ON_OFF 1 2 0 1 BIT_MASK 0x01 ECU_ADDRESS 0x0 /end MEASUREMENT
/begin MEASUREMENT BLDC_bHwFaultIgbtH "..." UBYTE Bool_ON_OFF 1 2 0 1 BIT_MASK 0x01 ECU_ADDRESS 0x0 /end MEASUREMENT
/begin MEASUREMENT BLDC_bHwFaultIgbtL "..." UBYTE Bool_ON_OFF 1 2 0 1 BIT_MASK 0x01 ECU_ADDRESS 0x0 /end MEASUREMENT
/begin MEASUREMENT BLDC_bHwFaultOvcU "..." UBYTE Bool_ON_OFF 1 2 0 1 BIT_MASK 0x01 ECU_ADDRESS 0x0 /end MEASUREMENT
/begin MEASUREMENT BLDC_bHwFaultOvcV "..." UBYTE Bool_ON_OFF 1 2 0 1 BIT_MASK 0x01 ECU_ADDRESS 0x0 /end MEASUREMENT
/begin MEASUREMENT BLDC_bHwFaultOvcW "..." UBYTE Bool_ON_OFF 1 2 0 1 BIT_MASK 0x01 ECU_ADDRESS 0x0 /end MEASUREMENT
/begin MEASUREMENT BLDC_bIsBldcStart "..." UBYTE Bool_ON_OFF 1 2 0 1 BIT_MASK 0x01 ECU_ADDRESS 0x0 /end MEASUREMENT
/begin MEASUREMENT BLDC_bMotorSpdRdy "..." UBYTE Bool_ON_OFF 1 2 0 1 BIT_MASK 0x01 ECU_ADDRESS 0x0 /end MEASUREMENT
/begin MEASUREMENT BLDC_bOilPressShortGndFlt "..." UBYTE Bool_ON_OFF 1 2 0 1 BIT_MASK 0x01 ECU_ADDRESS 0x0 /end MEASUREMENT
/begin MEASUREMENT BLDC_bOilPressShortVccFlt "..." UBYTE Bool_ON_OFF 1 2 0 1 BIT_MASK 0x01 ECU_ADDRESS 0x0 /end MEASUREMENT
/begin MEASUREMENT BLDC_bP5vAD2SOverVolFlt "..." UBYTE Bool_ON_OFF 1 2 0 1 BIT_MASK 0x01 ECU_ADDRESS 0x0 /end MEASUREMENT
/begin MEASUREMENT BLDC_bP5vAD2SUnderVolFlt "..." UBYTE Bool_ON_OFF 1 2 0 1 BIT_MASK 0x01 ECU_ADDRESS 0x0 /end MEASUREMENT
/begin MEASUREMENT BLDC_bTrapTrigger "..." UBYTE Bool_ON_OFF 1 2 0 1 BIT_MASK 0x01 ECU_ADDRESS 0x0 /end MEASUREMENT
/begin MEASUREMENT BLDC_bUShortGnd "..." UBYTE Bool_ON_OFF 1 2 0 1 BIT_MASK 0x01 ECU_ADDRESS 0x0 /end MEASUREMENT
/begin MEASUREMENT BLDC_bUShortVs "..." UBYTE Bool_ON_OFF 1 2 0 1 BIT_MASK 0x01 ECU_ADDRESS 0x0 /end MEASUREMENT
/begin MEASUREMENT BLDC_bUvwShortGnd "..." UBYTE Bool_ON_OFF 1 2 0 1 BIT_MASK 0x01 ECU_ADDRESS 0x0 /end MEASUREMENT
/begin MEASUREMENT BLDC_bUvwShortVs "..." UBYTE Bool_ON_OFF 1 2 0 1 BIT_MASK 0x01 ECU_ADDRESS 0x0 /end MEASUREMENT
/begin MEASUREMENT BLDC_bVShortGnd "..." UBYTE Bool_ON_OFF 1 2 0 1 BIT_MASK 0x01 ECU_ADDRESS 0x0 /end MEASUREMENT
/begin MEASUREMENT BLDC_bVShortVs "..." UBYTE Bool_ON_OFF 1 2 0 1 BIT_MASK 0x01 ECU_ADDRESS 0x0 /end MEASUREMENT
/begin MEASUREMENT BLDC_bWShortGnd "..." UBYTE Bool_ON_OFF 1 2 0 1 BIT_MASK 0x01 ECU_ADDRESS 0x0 /end MEASUREMENT
/begin MEASUREMENT BLDC_bWShortVs "..." UBYTE Bool_ON_OFF 1 2 0 1 BIT_MASK 0x01 ECU_ADDRESS 0x0 /end MEASUREMENT
/begin MEASUREMENT BLDC_f32BatteryVoltage "BLDC_f32BatteryVoltage" FLOAT32_IEEE I_3 1 2 -3.402823466E+038 3.402823466E+038 ECU_ADDRESS 0x0 /end MEASUREMENT
/begin MEASUREMENT BLDC_f32BkpVoltage "BLDC_f32BkpVoltage" FLOAT32_IEEE I_3 1 2 -3.402823466E+038 3.402823466E+038 ECU_ADDRESS 0x0 /end MEASUREMENT
/begin MEASUREMENT BLDC_f32BldcPosDuty "..." FLOAT32_IEEE I_1 1 2 -3.402823466E+038 3.402823466E+038 ECU_ADDRESS 0x0 /end MEASUREMENT
/begin MEASUREMENT BLDC_f32MotorSpeed "BLDC_f32MotorSpeed" FLOAT32_IEEE I_3 1 2 -3.402823466E+038 3.402823466E+038 ECU_ADDRESS 0x0 /end MEASUREMENT
/begin MEASUREMENT BLDC_f32P5vAD2SPhys "..." FLOAT32_IEEE I_1 1 2 -3.402823466E+038 3.402823466E+038 ECU_ADDRESS 0x0 /end MEASUREMENT
/begin MEASUREMENT BLDC_f32Pfb1DutyPhys "BLDC_f32Pfb1DutyPhys" FLOAT32_IEEE I_1 1 2 -3.402823466E+038 3.402823466E+038 MATRIX_DIM 8 1 1 ECU_ADDRESS 0x0 /end MEASUREMENT
/begin MEASUREMENT BLDC_f32Pfb1DutyPhysSum "..." FLOAT32_IEEE I_1 1 2 -3.402823466E+038 3.402823466E+038 ECU_ADDRESS 0x0 /end MEASUREMENT
/begin MEASUREMENT BLDC_f32Pfb1DutyPhys[0] "BLDC_f32Pfb1DutyPhys[0]" FLOAT32_IEEE I_1 1 2 -3.402823466E+038 3.402823466E+038 ECU_ADDRESS 0x0 /end MEASUREMENT
/begin MEASUREMENT BLDC_f32Pfb1DutyPhys[1] "BLDC_f32Pfb1DutyPhys[1]" FLOAT32_IEEE I_1 1 2 -3.402823466E+038 3.402823466E+038 ECU_ADDRESS 0x0 /end MEASUREMENT
/begin MEASUREMENT BLDC_f32Pfb1DutyPhys[2] "BLDC_f32Pfb1DutyPhys[2]" FLOAT32_IEEE I_1 1 2 -3.402823466E+038 3.402823466E+038 ECU_ADDRESS 0x0 /end MEASUREMENT
/begin MEASUREMENT BLDC_f32Pfb1DutyPhys[3] "BLDC_f32Pfb1DutyPhys[3]" FLOAT32_IEEE I_1 1 2 -3.402823466E+038 3.402823466E+038 ECU_ADDRESS 0x0 /end MEASUREMENT
/begin MEASUREMENT BLDC_f32Pfb1DutyPhys[4] "BLDC_f32Pfb1DutyPhys[4]" FLOAT32_IEEE I_1 1 2 -3.402823466E+038 3.402823466E+038 ECU_ADDRESS 0x0 /end MEASUREMENT
/begin MEASUREMENT BLDC_f32Pfb1DutyPhys[5] "BLDC_f32Pfb1DutyPhys[5]" FLOAT32_IEEE I_1 1 2 -3.402823466E+038 3.402823466E+038 ECU_ADDRESS 0x0 /end MEASUREMENT
/begin MEASUREMENT BLDC_f32Pfb1DutyPhys[6] "BLDC_f32Pfb1DutyPhys[6]" FLOAT32_IEEE I_1 1 2 -3.402823466E+038 3.402823466E+038 ECU_ADDRESS 0x0 /end MEASUREMENT
/begin MEASUREMENT BLDC_f32Pfb1DutyPhys[7] "BLDC_f32Pfb1DutyPhys[7]" FLOAT32_IEEE I_1 1 2 -3.402823466E+038 3.402823466E+038 ECU_ADDRESS 0x0 /end MEASUREMENT
/begin MEASUREMENT BLDC_f32Pfb2DutyPhys "BLDC_f32Pfb2DutyPhys" FLOAT32_IEEE I_1 1 2 -3.402823466E+038 3.402823466E+038 MATRIX_DIM 8 1 1 ECU_ADDRESS 0x0 /end MEASUREMENT
/begin MEASUREMENT BLDC_f32Pfb2DutyPhysSum "..." FLOAT32_IEEE I_1 1 2 -3.402823466E+038 3.402823466E+038 ECU_ADDRESS 0x0 /end MEASUREMENT
/begin MEASUREMENT BLDC_f32Pfb2DutyPhys[0] "BLDC_f32Pfb2DutyPhys[0]" FLOAT32_IEEE I_1 1 2 -3.402823466E+038 3.402823466E+038 ECU_ADDRESS 0x0 /end MEASUREMENT
/begin MEASUREMENT BLDC_f32Pfb2DutyPhys[1] "BLDC_f32Pfb2DutyPhys[1]" FLOAT32_IEEE I_1 1 2 -3.402823466E+038 3.402823466E+038 ECU_ADDRESS 0x0 /end MEASUREMENT
/begin MEASUREMENT BLDC_f32Pfb2DutyPhys[2] "BLDC_f32Pfb2DutyPhys[2]" FLOAT32_IEEE I_1 1 2 -3.402823466E+038 3.402823466E+038 ECU_ADDRESS 0x0 /end MEASUREMENT
/begin MEASUREMENT BLDC_f32Pfb2DutyPhys[3] "BLDC_f32Pfb2DutyPhys[3]" FLOAT32_IEEE I_1 1 2 -3.402823466E+038 3.402823466E+038 ECU_ADDRESS 0x0 /end MEASUREMENT
/begin MEASUREMENT BLDC_f32Pfb2DutyPhys[4] "BLDC_f32Pfb2DutyPhys[4]" FLOAT32_IEEE I_1 1 2 -3.402823466E+038 3.402823466E+038 ECU_ADDRESS 0x0 /end MEASUREMENT
/begin MEASUREMENT BLDC_f32Pfb2DutyPhys[5] "BLDC_f32Pfb2DutyPhys[5]" FLOAT32_IEEE I_1 1 2 -3.402823466E+038 3.402823466E+038 ECU_ADDRESS 0x0 /end MEASUREMENT
/begin MEASUREMENT BLDC_f32Pfb2DutyPhys[6] "BLDC_f32Pfb2DutyPhys[6]" FLOAT32_IEEE I_1 1 2 -3.402823466E+038 3.402823466E+038 ECU_ADDRESS 0x0 /end MEASUREMENT
/begin MEASUREMENT BLDC_f32Pfb2DutyPhys[7] "BLDC_f32Pfb2DutyPhys[7]" FLOAT32_IEEE I_1 1 2 -3.402823466E+038 3.402823466E+038 ECU_ADDRESS 0x0 /end MEASUREMENT
/begin MEASUREMENT BLDC_f32Pfb3DutyPhys "BLDC_f32Pfb3DutyPhys" FLOAT32_IEEE I_1 1 2 -3.402823466E+038 3.402823466E+038 MATRIX_DIM 8 1 1 ECU_ADDRESS 0x0 /end MEASUREMENT
/begin MEASUREMENT BLDC_f32Pfb3DutyPhysSum "..." FLOAT32_IEEE I_1 1 2 -3.402823466E+038 3.402823466E+038 ECU_ADDRESS 0x0 /end MEASUREMENT
/begin MEASUREMENT BLDC_f32Pfb3DutyPhys[0] "BLDC_f32Pfb3DutyPhys[0]" FLOAT32_IEEE I_1 1 2 -3.402823466E+038 3.402823466E+038 ECU_ADDRESS 0x0 /end MEASUREMENT
/begin MEASUREMENT BLDC_f32Pfb3DutyPhys[1] "BLDC_f32Pfb3DutyPhys[1]" FLOAT32_IEEE I_1 1 2 -3.402823466E+038 3.402823466E+038 ECU_ADDRESS 0x0 /end MEASUREMENT
/begin MEASUREMENT BLDC_f32Pfb3DutyPhys[2] "BLDC_f32Pfb3DutyPhys[2]" FLOAT32_IEEE I_1 1 2 -3.402823466E+038 3.402823466E+038 ECU_ADDRESS 0x0 /end MEASUREMENT
/begin MEASUREMENT BLDC_f32Pfb3DutyPhys[3] "BLDC_f32Pfb3DutyPhys[3]" FLOAT32_IEEE I_1 1 2 -3.402823466E+038 3.402823466E+038 ECU_ADDRESS 0x0 /end MEASUREMENT
/begin MEASUREMENT BLDC_f32Pfb3DutyPhys[4] "BLDC_f32Pfb3DutyPhys[4]" FLOAT32_IEEE I_1 1 2 -3.402823466E+038 3.402823466E+038 ECU_ADDRESS 0x0 /end MEASUREMENT
/begin MEASUREMENT BLDC_f32Pfb3DutyPhys[5] "BLDC_f32Pfb3DutyPhys[5]" FLOAT32_IEEE I_1 1 2 -3.402823466E+038 3.402823466E+038 ECU_ADDRESS 0x0 /end MEASUREMENT
/begin MEASUREMENT BLDC_f32Pfb3DutyPhys[6] "BLDC_f32Pfb3DutyPhys[6]" FLOAT32_IEEE I_1 1 2 -3.402823466E+038 3.402823466E+038 ECU_ADDRESS 0x0 /end MEASUREMENT
/begin MEASUREMENT BLDC_f32Pfb3DutyPhys[7] "BLDC_f32Pfb3DutyPhys[7]" FLOAT32_IEEE I_1 1 2 -3.402823466E+038 3.402823466E+038 ECU_ADDRESS 0x0 /end MEASUREMENT
/begin MEASUREMENT BLDC_f32PrevTgtDuty "..." FLOAT32_IEEE I_1 1 2 -3.402823466E+038 3.402823466E+038 ECU_ADDRESS 0x0 /end MEASUREMENT
/begin MEASUREMENT BLDC_f32TgtDutyDeltVal "..." FLOAT32_IEEE I_1 1 2 -3.402823466E+038 3.402823466E+038 ECU_ADDRESS 0x0 /end MEASUREMENT
/begin MEASUREMENT BLDC_f32TgtDutyPhys "BLDC_f32TgtDutyPhys" FLOAT32_IEEE I_1 1 2 -3.402823466E+038 3.402823466E+038 MATRIX_DIM 8 1 1 ECU_ADDRESS 0x0 /end MEASUREMENT
/begin MEASUREMENT BLDC_f32TgtDutyPhysSum "..." FLOAT32_IEEE I_1 1 2 -3.402823466E+038 3.402823466E+038 ECU_ADDRESS 0x0 /end MEASUREMENT
/begin MEASUREMENT BLDC_f32TgtDutyPhys[0] "BLDC_f32TgtDutyPhys[0]" FLOAT32_IEEE I_1 1 2 -3.402823466E+038 3.402823466E+038 ECU_ADDRESS 0x0 /end MEASUREMENT
/begin MEASUREMENT BLDC_f32TgtDutyPhys[1] "BLDC_f32TgtDutyPhys[1]" FLOAT32_IEEE I_1 1 2 -3.402823466E+038 3.402823466E+038 ECU_ADDRESS 0x0 /end MEASUREMENT
/begin MEASUREMENT BLDC_f32TgtDutyPhys[2] "BLDC_f32TgtDutyPhys[2]" FLOAT32_IEEE I_1 1 2 -3.402823466E+038 3.402823466E+038 ECU_ADDRESS 0x0 /end MEASUREMENT
/begin MEASUREMENT BLDC_f32TgtDutyPhys[3] "BLDC_f32TgtDutyPhys[3]" FLOAT32_IEEE I_1 1 2 -3.402823466E+038 3.402823466E+038 ECU_ADDRESS 0x0 /end MEASUREMENT
/begin MEASUREMENT BLDC_f32TgtDutyPhys[4] "BLDC_f32TgtDutyPhys[4]" FLOAT32_IEEE I_1 1 2 -3.402823466E+038 3.402823466E+038 ECU_ADDRESS 0x0 /end MEASUREMENT
/begin MEASUREMENT BLDC_f32TgtDutyPhys[5] "BLDC_f32TgtDutyPhys[5]" FLOAT32_IEEE I_1 1 2 -3.402823466E+038 3.402823466E+038 ECU_ADDRESS 0x0 /end MEASUREMENT
/begin MEASUREMENT BLDC_f32TgtDutyPhys[6] "BLDC_f32TgtDutyPhys[6]" FLOAT32_IEEE I_1 1 2 -3.402823466E+038 3.402823466E+038 ECU_ADDRESS 0x0 /end MEASUREMENT
/begin MEASUREMENT BLDC_f32TgtDutyPhys[7] "BLDC_f32TgtDutyPhys[7]" FLOAT32_IEEE I_1 1 2 -3.402823466E+038 3.402823466E+038 ECU_ADDRESS 0x0 /end MEASUREMENT
/begin MEASUREMENT BLDC_u16DutyDelayCnt "..." UWORD I_1 1 2 0 65535 ECU_ADDRESS 0x0 /end MEASUREMENT
/begin MEASUREMENT BLDC_u16McuAscSttDelay "..." UWORD I_1 1 2 0 65535 ECU_ADDRESS 0x0 /end MEASUREMENT
/begin MEASUREMENT BLDC_u16OilPressureRaw "..." UWORD I_1 1 2 0 65535 ECU_ADDRESS 0x0 /end MEASUREMENT
/begin MEASUREMENT BLDC_u16P5vAD2SRaw "..." UWORD I_1 1 2 0 65535 ECU_ADDRESS 0x0 /end MEASUREMENT
/begin MEASUREMENT BLDC_u16PowerOnDelay "..." UWORD I_1 1 2 0 65535 ECU_ADDRESS 0x0 /end MEASUREMENT
/begin MEASUREMENT BLDC_u16PwmMaxDutyCyc "..." UWORD I_1 1 2 0 65535 ECU_ADDRESS 0x0 /end MEASUREMENT
/begin MEASUREMENT BLDC_u16PwmMinDutyCyc "..." UWORD I_1 1 2 0 65535 ECU_ADDRESS 0x0 /end MEASUREMENT
/begin MEASUREMENT BLDC_u16ShortConfirmCnt "..." UWORD I_1 1 2 0 65535 ECU_ADDRESS 0x0 /end MEASUREMENT
/begin MEASUREMENT BLDC_u16ShortRecoveryCnt "BLDC_u16ShortRecoveryCnt" UWORD I_1 1 2 0 65535 ECU_ADDRESS 0x0 /end MEASUREMENT
/begin MEASUREMENT BLDC_u16T12PeriodVal "..." UWORD I_1 1 2 0 65535 ECU_ADDRESS 0x0 /end MEASUREMENT
/begin MEASUREMENT BLDC_u16T13CmpVal "." UWORD F_1_p0_4 1 2 0 65535 ECU_ADDRESS 0x0 /end MEASUREMENT
/begin MEASUREMENT BLDC_u16T13PeriodVal "..." UWORD I_1 1 2 0 65535 ECU_ADDRESS 0x0 /end MEASUREMENT
/begin MEASUREMENT BLDC_u16TgtDutyRisingDelay "..." UWORD I_1 1 2 0 65535 ECU_ADDRESS 0x0 /end MEASUREMENT
/begin MEASUREMENT BLDC_u32MotPosSigDuty "..." ULONG I_1 1 2 0 4294967295 ECU_ADDRESS 0x0 /end MEASUREMENT
/begin MEASUREMENT BLDC_u32MotPosSigPerd "..." ULONG I_1 1 2 0 4294967295 ECU_ADDRESS 0x0 /end MEASUREMENT
/begin MEASUREMENT BLDC_u32T12IsrCounter "..." ULONG I_1 1 2 0 4294967295 ECU_ADDRESS 0x0 /end MEASUREMENT
/begin MEASUREMENT BLDC_u32TrapCreq "..." ULONG I_1 1 2 0 4294967295 ECU_ADDRESS 0x0 /end MEASUREMENT
/begin MEASUREMENT BLDC_u8ConfirmDirSts "..." UBYTE I_1 1 2 0 255 ECU_ADDRESS 0x0 /end MEASUREMENT
/begin MEASUREMENT BLDC_u8CurDirSts "..." UBYTE I_1 1 2 0 255 ECU_ADDRESS 0x0 /end MEASUREMENT
/begin MEASUREMENT BLDC_u8CurHallStt "..." UBYTE I_1 1 2 0 255 ECU_ADDRESS 0x0 /end MEASUREMENT
/begin MEASUREMENT BLDC_u8DiagHallStt "..." UBYTE I_1 1 2 0 255 ECU_ADDRESS 0x0 /end MEASUREMENT
/begin MEASUREMENT BLDC_u8DiagHallSttPre "..." UBYTE I_1 1 2 0 255 ECU_ADDRESS 0x0 /end MEASUREMENT
/begin MEASUREMENT BLDC_u8DutyModeStt "..." UBYTE I_1 1 2 0 255 ECU_ADDRESS 0x0 /end MEASUREMENT
/begin MEASUREMENT BLDC_u8HallStt "..." UBYTE I_1 1 2 0 255 ECU_ADDRESS 0x0 /end MEASUREMENT
/begin MEASUREMENT BLDC_u8McuAscSttStep "BLDC State" UBYTE I_1 1 2 0 255 ECU_ADDRESS 0x0 /end MEASUREMENT
/begin MEASUREMENT BLDC_u8PfbDutyCnt "BLDC_u8PfbDutyCnt" UBYTE I_1 1 2 0 255 ECU_ADDRESS 0x0 /end MEASUREMENT
/begin MEASUREMENT BLDC_u8PrevDirSts "..." UBYTE I_1 1 2 0 255 ECU_ADDRESS 0x0 /end MEASUREMENT
/begin MEASUREMENT BLDC_u8PwmState "BLDC State" UBYTE I_1 1 2 0 255 ECU_ADDRESS 0x0 /end MEASUREMENT
/begin MEASUREMENT BLDC_u8WrCurHallStt "..." UBYTE I_1 1 2 0 255 ECU_ADDRESS 0x0 /end MEASUREMENT
/begin MEASUREMENT BLDC_u8WrExpHallStt "..." UBYTE I_1 1 2 0 255 ECU_ADDRESS 0x0 /end MEASUREMENT
/begin MEASUREMENT BLDC_u8WrExpOutput "..." UBYTE I_1 1 2 0 255 ECU_ADDRESS 0x0 /end MEASUREMENT
/begin MEASUREMENT BLDC_u8WrExpOutputLast "BLDC_u8WrExpOutputLast" UBYTE I_1 1 2 0 255 ECU_ADDRESS 0x0 /end MEASUREMENT
/begin MEASUREMENT BSW_bAppMsgTxEna "Flag to enable App message transmission" UBYTE Bool_ON_OFF 1 2 0 1 BIT_MASK 0x01 ECU_ADDRESS 0x0 /end MEASUREMENT
/begin MEASUREMENT BSW_bCAN0BusOff "BSW_bCAN0BusOff" UBYTE Bool_ON_OFF 1 2 0 1 BIT_MASK 0x01 ECU_ADDRESS 0x0 /end MEASUREMENT
/begin MEASUREMENT BSW_bCAN1BusOff "BSW_bCAN1BusOff" UBYTE Bool_ON_OFF 1 2 0 1 BIT_MASK 0x01 ECU_ADDRESS 0x0 /end MEASUREMENT
/begin MEASUREMENT BSW_bCbkRxTOutFlag_SGBCM_pepsReq "..." UBYTE Bool_ON_OFF 1 2 0 1 BIT_MASK 0x01 ECU_ADDRESS 0x0 /end MEASUREMENT
/begin MEASUREMENT BSW_bCbkRxTOutFlag_SGRx10Req "..." UBYTE Bool_ON_OFF 1 2 0 1 BIT_MASK 0x01 ECU_ADDRESS 0x0 /end MEASUREMENT
/begin MEASUREMENT BSW_bCbkRxTOutFlag_SGRx11Req "..." UBYTE Bool_ON_OFF 1 2 0 1 BIT_MASK 0x01 ECU_ADDRESS 0x0 /end MEASUREMENT
/begin MEASUREMENT BSW_bCbkRxTOutFlag_SGRx12Req "..." UBYTE Bool_ON_OFF 1 2 0 1 BIT_MASK 0x01 ECU_ADDRESS 0x0 /end MEASUREMENT
/begin MEASUREMENT BSW_bCbkRxTOutFlag_SGRx13Req "..." UBYTE Bool_ON_OFF 1 2 0 1 BIT_MASK 0x01 ECU_ADDRESS 0x0 /end MEASUREMENT
/begin MEASUREMENT BSW_bCbkRxTOutFlag_SGRx14Req "..." UBYTE Bool_ON_OFF 1 2 0 1 BIT_MASK 0x01 ECU_ADDRESS 0x0 /end MEASUREMENT
/begin MEASUREMENT BSW_bCbkRxTOutFlag_SGRx15Req "..." UBYTE Bool_ON_OFF 1 2 0 1 BIT_MASK 0x01 ECU_ADDRESS 0x0 /end MEASUREMENT
/begin MEASUREMENT BSW_bCbkRxTOutFlag_SGRx16Req "..." UBYTE Bool_ON_OFF 1 2 0 1 BIT_MASK 0x01 ECU_ADDRESS 0x0 /end MEASUREMENT
/begin MEASUREMENT BSW_bCbkRxTOutFlag_SGRx17Req "..." UBYTE Bool_ON_OFF 1 2 0 1 BIT_MASK 0x01 ECU_ADDRESS 0x0 /end MEASUREMENT
/begin MEASUREMENT BSW_bCbkRxTOutFlag_SGRx18Req "..." UBYTE Bool_ON_OFF 1 2 0 1 BIT_MASK 0x01 ECU_ADDRESS 0x0 /end MEASUREMENT
/begin MEASUREMENT BSW_bCbkRxTOutFlag_SGRx19Req "..." UBYTE Bool_ON_OFF 1 2 0 1 BIT_MASK 0x01 ECU_ADDRESS 0x0 /end MEASUREMENT
/begin MEASUREMENT BSW_bCbkRxTOutFlag_SGRx1Req "..." UBYTE Bool_ON_OFF 1 2 0 1 BIT_MASK 0x01 ECU_ADDRESS 0x0 /end MEASUREMENT
/begin MEASUREMENT BSW_bCbkRxTOutFlag_SGRx20Req "..." UBYTE Bool_ON_OFF 1 2 0 1 BIT_MASK 0x01 ECU_ADDRESS 0x0 /end MEASUREMENT
/begin MEASUREMENT BSW_bCbkRxTOutFlag_SGRx21Req "..." UBYTE Bool_ON_OFF 1 2 0 1 BIT_MASK 0x01 ECU_ADDRESS 0x0 /end MEASUREMENT
/begin MEASUREMENT BSW_bCbkRxTOutFlag_SGRx22Req "..." UBYTE Bool_ON_OFF 1 2 0 1 BIT_MASK 0x01 ECU_ADDRESS 0x0 /end MEASUREMENT
/begin MEASUREMENT BSW_bCbkRxTOutFlag_SGRx23Req "..." UBYTE Bool_ON_OFF 1 2 0 1 BIT_MASK 0x01 ECU_ADDRESS 0x0 /end MEASUREMENT
/begin MEASUREMENT BSW_bCbkRxTOutFlag_SGRx24Req "..." UBYTE Bool_ON_OFF 1 2 0 1 BIT_MASK 0x01 ECU_ADDRESS 0x0 /end MEASUREMENT
/begin MEASUREMENT BSW_bCbkRxTOutFlag_SGRx25Req "..." UBYTE Bool_ON_OFF 1 2 0 1 BIT_MASK 0x01 ECU_ADDRESS 0x0 /end MEASUREMENT
/begin MEASUREMENT BSW_bCbkRxTOutFlag_SGRx26Req "..." UBYTE Bool_ON_OFF 1 2 0 1 BIT_MASK 0x01 ECU_ADDRESS 0x0 /end MEASUREMENT
/begin MEASUREMENT BSW_bCbkRxTOutFlag_SGRx27Req "..." UBYTE Bool_ON_OFF 1 2 0 1 BIT_MASK 0x01 ECU_ADDRESS 0x0 /end MEASUREMENT
/begin MEASUREMENT BSW_bCbkRxTOutFlag_SGRx2Req "..." UBYTE Bool_ON_OFF 1 2 0 1 BIT_MASK 0x01 ECU_ADDRESS 0x0 /end MEASUREMENT
/begin MEASUREMENT BSW_bCbkRxTOutFlag_SGRx3Req "..." UBYTE Bool_ON_OFF 1 2 0 1 BIT_MASK 0x01 ECU_ADDRESS 0x0 /end MEASUREMENT
/begin MEASUREMENT BSW_bCbkRxTOutFlag_SGRx4Req "..." UBYTE Bool_ON_OFF 1 2 0 1 BIT_MASK 0x01 ECU_ADDRESS 0x0 /end MEASUREMENT
/begin MEASUREMENT BSW_bCbkRxTOutFlag_SGRx5Req "..." UBYTE Bool_ON_OFF 1 2 0 1 BIT_MASK 0x01 ECU_ADDRESS 0x0 /end MEASUREMENT
/begin MEASUREMENT BSW_bCbkRxTOutFlag_SGRx6Req "..." UBYTE Bool_ON_OFF 1 2 0 1 BIT_MASK 0x01 ECU_ADDRESS 0x0 /end MEASUREMENT
/begin MEASUREMENT BSW_bCbkRxTOutFlag_SGRx7Req "..." UBYTE Bool_ON_OFF 1 2 0 1 BIT_MASK 0x01 ECU_ADDRESS 0x0 /end MEASUREMENT
/begin MEASUREMENT BSW_bCbkRxTOutFlag_SGRx8Req "..." UBYTE Bool_ON_OFF 1 2 0 1 BIT_MASK 0x01 ECU_ADDRESS 0x0 /end MEASUREMENT
/begin MEASUREMENT BSW_bCbkRxTOutFlag_SGRx9Req "..." UBYTE Bool_ON_OFF 1 2 0 1 BIT_MASK 0x01 ECU_ADDRESS 0x0 /end MEASUREMENT
/begin MEASUREMENT BSW_bCsumErrFlag_SGGcu2Req "..." UBYTE Bool_ON_OFF 1 2 0 1 BIT_MASK 0x01 ECU_ADDRESS 0x0 /end MEASUREMENT
/begin MEASUREMENT BSW_bCsumErrFlag_SGGcu4Req "..." UBYTE Bool_ON_OFF 1 2 0 1 BIT_MASK 0x01 ECU_ADDRESS 0x0 /end MEASUREMENT
/begin MEASUREMENT BSW_bCsumErrFlag_SGPdcm_acu_epsReq "..." UBYTE Bool_ON_OFF 1 2 0 1 BIT_MASK 0x01 ECU_ADDRESS 0x0 /end MEASUREMENT
/begin MEASUREMENT BSW_bCsumErrFlag_SGPdcm_gcuReq "..." UBYTE Bool_ON_OFF 1 2 0 1 BIT_MASK 0x01 ECU_ADDRESS 0x0 /end MEASUREMENT
/begin MEASUREMENT BSW_bCsumErrFlag_SGPdcm_ic_acuReq "..." UBYTE Bool_ON_OFF 1 2 0 1 BIT_MASK 0x01 ECU_ADDRESS 0x0 /end MEASUREMENT
/begin MEASUREMENT BSW_bCsumErrFlag_SGRx1Req "..." UBYTE Bool_ON_OFF 1 2 0 1 BIT_MASK 0x01 ECU_ADDRESS 0x0 /end MEASUREMENT
/begin MEASUREMENT BSW_bCsumErrFlag_SGRx2Req "..." UBYTE Bool_ON_OFF 1 2 0 1 BIT_MASK 0x01 ECU_ADDRESS 0x0 /end MEASUREMENT
/begin MEASUREMENT BSW_bEnableCalcWriteNvMMaxTime "Enable Calc Write NvM Max Time" UBYTE Bool_ON_OFF 1 2 0 1 BIT_MASK 0x01 ECU_ADDRESS 0x0 /end MEASUREMENT
/begin MEASUREMENT BSW_bIntLockDetEna "..." UBYTE Bool_ON_OFF 1 2 0 1 BIT_MASK 0x01 ECU_ADDRESS 0x0 /end MEASUREMENT
/begin MEASUREMENT BSW_bIntLockOccurFlg "..." UBYTE Bool_ON_OFF 1 2 0 1 BIT_MASK 0x01 ECU_ADDRESS 0x0 /end MEASUREMENT
/begin MEASUREMENT BSW_bMKeyOnStatus "..." UBYTE Bool_ON_OFF 1 2 0 1 BIT_MASK 0x01 ECU_ADDRESS 0x0 /end MEASUREMENT
/begin MEASUREMENT BSW_bMSGTrigTxFlag_Mcu7Req "..." UBYTE Bool_ON_OFF 1 2 0 1 BIT_MASK 0x01 ECU_ADDRESS 0x0 /end MEASUREMENT
/begin MEASUREMENT BSW_bNvmWrTrig "..." UBYTE Bool_ON_OFF 1 2 0 1 BIT_MASK 0x01 ECU_ADDRESS 0x0 /end MEASUREMENT
/begin MEASUREMENT BSW_bOCDataNotRation "..." UBYTE Bool_ON_OFF 1 2 0 1 BIT_MASK 0x01 ECU_ADDRESS 0x0 /end MEASUREMENT
/begin MEASUREMENT BSW_bRcErrFlag_SGGcu2Req "..." UBYTE Bool_ON_OFF 1 2 0 1 BIT_MASK 0x01 ECU_ADDRESS 0x0 /end MEASUREMENT
/begin MEASUREMENT BSW_bRcErrFlag_SGGcu4Req "..." UBYTE Bool_ON_OFF 1 2 0 1 BIT_MASK 0x01 ECU_ADDRESS 0x0 /end MEASUREMENT
/begin MEASUREMENT BSW_bRcErrFlag_SGPdcm_acu_epsReq "..." UBYTE Bool_ON_OFF 1 2 0 1 BIT_MASK 0x01 ECU_ADDRESS 0x0 /end MEASUREMENT
/begin MEASUREMENT BSW_bRcErrFlag_SGPdcm_gcuReq "..." UBYTE Bool_ON_OFF 1 2 0 1 BIT_MASK 0x01 ECU_ADDRESS 0x0 /end MEASUREMENT
/begin MEASUREMENT BSW_bRcErrFlag_SGPdcm_ic_acuReq "..." UBYTE Bool_ON_OFF 1 2 0 1 BIT_MASK 0x01 ECU_ADDRESS 0x0 /end MEASUREMENT
/begin MEASUREMENT BSW_bRcErrFlag_SGRx1Req "..." UBYTE Bool_ON_OFF 1 2 0 1 BIT_MASK 0x01 ECU_ADDRESS 0x0 /end MEASUREMENT
/begin MEASUREMENT BSW_bRcErrFlag_SGRx2Req "..." UBYTE Bool_ON_OFF 1 2 0 1 BIT_MASK 0x01 ECU_ADDRESS 0x0 /end MEASUREMENT
/begin MEASUREMENT BSW_bStackOverflowWarning "Stack overflow warning" UBYTE Bool_ON_OFF 1 2 0 1 BIT_MASK 0x01 ECU_ADDRESS 0x0 /end MEASUREMENT
/begin MEASUREMENT BSW_bUdsFunctionReqFlg "..." UBYTE Bool_ON_OFF 1 2 0 1 BIT_MASK 0x01 ECU_ADDRESS 0x0 /end MEASUREMENT
/begin MEASUREMENT BSW_bVsiReadySts "...." UBYTE Bool_ON_OFF 1 2 0 1 BIT_MASK 0x01 ECU_ADDRESS 0x0 /end MEASUREMENT
/begin MEASUREMENT BSW_u16CurWriteNvMTime "Current Write NvM Time" UWORD F_0v001_p0_9 1 2 0 65.535 ECU_ADDRESS 0x0 /end MEASUREMENT
/begin MEASUREMENT BSW_u16IntLockDelayTim "..." UWORD I_1 1 2 0 65535 ECU_ADDRESS 0x0 /end MEASUREMENT
/begin MEASUREMENT BSW_u16NvMWriteCmd "BSW_u16NvMWriteCmd" UWORD I_1 1 2 0 65535 ECU_ADDRESS 0x0 /end MEASUREMENT
/begin MEASUREMENT BSW_u16NvmStoreDelay "...." UWORD I_1 1 2 0 65535 ECU_ADDRESS 0x0 /end MEASUREMENT
/begin MEASUREMENT BSW_u16RawVolMonCurOcpH "BSW_u16RawVolMonCurOcpH" UWORD F_0v0012210012_p0_10 1 2 0 80.01831502 ECU_ADDRESS 0x0 /end MEASUREMENT
/begin MEASUREMENT BSW_u16RawVolMonCurOcpL "BSW_u16RawVolMonCurOcpL" UWORD F_0v0012210012_p0_10 1 2 0 80.01831502 ECU_ADDRESS 0x0 /end MEASUREMENT
/begin MEASUREMENT BSW_u16RawVolMonDcOvpSele "BSW_u16RawVolMonDcOvpSele" UWORD F_0v0012210012_p0_10 1 2 0 80.01831502 ECU_ADDRESS 0x0 /end MEASUREMENT
/begin MEASUREMENT BSW_u16RawVolP16VMulti "BSW_u16RawVolP16VMulti" UWORD F_0v0012210012_p0_10 1 2 0 80.01831502 ECU_ADDRESS 0x0 /end MEASUREMENT
/begin MEASUREMENT BSW_u16RawVolP5VHS "BSW_u16RawVolP5VHS" UWORD F_0v0012210012_p0_10 1 2 0 80.01831502 ECU_ADDRESS 0x0 /end MEASUREMENT
/begin MEASUREMENT BSW_u16RawVolP5VHsREF "BSW_u16RawVolP5VHsREF" UWORD F_0v0012210012_p0_10 1 2 0 80.01831502 ECU_ADDRESS 0x0 /end MEASUREMENT
/begin MEASUREMENT BSW_u16RawVolP5VLS "BSW_u16RawVolP5VLS" UWORD F_0v0012210012_p0_10 1 2 0 80.01831502 ECU_ADDRESS 0x0 /end MEASUREMENT
/begin MEASUREMENT BSW_u16RawVolP5VLsREF "BSW_u16RawVolP5VLsREF" UWORD F_0v0012210012_p0_10 1 2 0 80.01831502 ECU_ADDRESS 0x0 /end MEASUREMENT
/begin MEASUREMENT BSW_u16RawVolP5VREF "BSW_u16RawVolP5VREF" UWORD F_0v0012210012_p0_10 1 2 0 80.01831502 ECU_ADDRESS 0x0 /end MEASUREMENT
/begin MEASUREMENT BSW_u16RawVolt15VRdc "BSW_u16RawVolt15VRdc" UWORD F_0v0012210012_p0_10 1 2 0 80.01831502 ECU_ADDRESS 0x0 /end MEASUREMENT
/begin MEASUREMENT BSW_u16RawVoltDclinkFIL "BSW_u16RawVoltDclinkFIL" UWORD F_0v0012210012_p0_10 1 2 0 80.01831502 ECU_ADDRESS 0x0 /end MEASUREMENT
/begin MEASUREMENT BSW_u16SelfChkDelay "...." UWORD I_1 1 2 0 65535 ECU_ADDRESS 0x0 /end MEASUREMENT
/begin MEASUREMENT BSW_u16Var1 "BSW_u16Var1" UWORD I_1 1 2 0 65535 ECU_ADDRESS 0x0 /end MEASUREMENT
/begin MEASUREMENT BSW_u16VsiReadyDelay "...." UWORD I_1 1 2 0 65535 ECU_ADDRESS 0x0 /end MEASUREMENT
/begin MEASUREMENT BSW_u16WriteNvMMaxTime "Write NvM Max Time" UWORD F_0v001_p0_9 1 2 0 65.535 ECU_ADDRESS 0x0 /end MEASUREMENT
/begin MEASUREMENT BSW_u32CbkRxAckCntSGPepsMsgSts "..." ULONG I_1 1 2 0 4294967295 ECU_ADDRESS 0x0 /end MEASUREMENT
/begin MEASUREMENT BSW_u32FeeNextFreePageAddr "Fee Next Free Page Addr" ULONG I_1 1 2 0 4294967295 ECU_ADDRESS 0x0 /end MEASUREMENT
/begin MEASUREMENT BSW_u32RcvUdsCanId "..." ULONG I_1 1 2 0 4294967295 ECU_ADDRESS 0x0 /end MEASUREMENT
/begin MEASUREMENT BSW_u32StackUsed "Stack used (bytes)" ULONG F_4_p0_11 1 2 0 1.717986918E+010 ECU_ADDRESS 0x0 /end MEASUREMENT
/begin MEASUREMENT BSW_u32VSICounterCkreq "..." ULONG I_1 1 2 0 4294967295 ECU_ADDRESS 0x0 /end MEASUREMENT
/begin MEASUREMENT BSW_u32VSICounterSafeCkreq "..." ULONG I_1 1 2 0 4294967295 ECU_ADDRESS 0x0 /end MEASUREMENT
/begin MEASUREMENT BSW_u32VSICounterTimeoutCs "..." ULONG I_1 1 2 0 4294967295 ECU_ADDRESS 0x0 /end MEASUREMENT
/begin MEASUREMENT BSW_u32VSICounterTimeoutFrame "..." ULONG I_1 1 2 0 4294967295 ECU_ADDRESS 0x0 /end MEASUREMENT
/begin MEASUREMENT BSW_u32VSICounterTimeoutSafeTCalc "..." ULONG I_1 1 2 0 4294967295 ECU_ADDRESS 0x0 /end MEASUREMENT
/begin MEASUREMENT BSW_u32VSICounterTimeoutSyncPos "..." ULONG I_1 1 2 0 4294967295 ECU_ADDRESS 0x0 /end MEASUREMENT
/begin MEASUREMENT BSW_u32VSICounterTimeoutTCalc "..." ULONG I_1 1 2 0 4294967295 ECU_ADDRESS 0x0 /end MEASUREMENT
/begin MEASUREMENT BSW_u32VSISafeTimeDuration "..." ULONG F_0v01_p0_12 1 2 0 42949672.95 ECU_ADDRESS 0x0 /end MEASUREMENT
/begin MEASUREMENT BSW_u32VSISafeTimeDurationMax "..." ULONG F_0v01_p0_12 1 2 0 42949672.95 ECU_ADDRESS 0x0 /end MEASUREMENT
/begin MEASUREMENT BSW_u32VSISafeTimeDurationMin "..." ULONG F_0v01_p0_12 1 2 0 42949672.95 ECU_ADDRESS 0x0 /end MEASUREMENT
/begin MEASUREMENT BSW_u32VSITimeDuration "..." ULONG F_0v01_p0_12 1 2 0 42949672.95 ECU_ADDRESS 0x0 /end MEASUREMENT
/begin MEASUREMENT BSW_u32VSITimeDurationMax "..." ULONG F_0v01_p0_12 1 2 0 42949672.95 ECU_ADDRESS 0x0 /end MEASUREMENT
/begin MEASUREMENT BSW_u32VSITimeDurationMin "..." ULONG F_0v01_p0_12 1 2 0 42949672.95 ECU_ADDRESS 0x0 /end MEASUREMENT
/begin MEASUREMENT BSW_u8CAN0BusOffCounter "..." ULONG I_1 1 2 0 4294967295 ECU_ADDRESS 0x0 /end MEASUREMENT
/begin MEASUREMENT BSW_u8CAN1BusOffCounter "..." ULONG I_1 1 2 0 4294967295 ECU_ADDRESS 0x0 /end MEASUREMENT
/begin MEASUREMENT BSW_u8FeeCurSector "Fee Current Sector" UBYTE I_1 1 2 0 255 ECU_ADDRESS 0x0 /end MEASUREMENT
/begin MEASUREMENT BSW_u8FeeSectorChangeCnt "Fee Sector change count" UBYTE I_1 1 2 0 255 ECU_ADDRESS 0x0 /end MEASUREMENT
/begin MEASUREMENT BSW_u8Gcu2CsumErrCnt "..." UBYTE I_1 1 2 0 255 ECU_ADDRESS 0x0 /end MEASUREMENT
/begin MEASUREMENT BSW_u8Gcu2RcErrCnt "..." UBYTE I_1 1 2 0 255 ECU_ADDRESS 0x0 /end MEASUREMENT
/begin MEASUREMENT BSW_u8Gcu2RcLast "..." UBYTE I_1 1 2 0 255 ECU_ADDRESS 0x0 /end MEASUREMENT
/begin MEASUREMENT BSW_u8Gcu2RcNow "..." UBYTE I_1 1 2 0 255 ECU_ADDRESS 0x0 /end MEASUREMENT
/begin MEASUREMENT BSW_u8Gcu4CsumErrCnt "..." UBYTE I_1 1 2 0 255 ECU_ADDRESS 0x0 /end MEASUREMENT
/begin MEASUREMENT BSW_u8Gcu4RcErrCnt "..." UBYTE I_1 1 2 0 255 ECU_ADDRESS 0x0 /end MEASUREMENT
/begin MEASUREMENT BSW_u8Gcu4RcLast "..." UBYTE I_1 1 2 0 255 ECU_ADDRESS 0x0 /end MEASUREMENT
/begin MEASUREMENT BSW_u8Gcu4RcNow "..." UBYTE I_1 1 2 0 255 ECU_ADDRESS 0x0 /end MEASUREMENT
/begin MEASUREMENT BSW_u8IntLockErrCnt "..." UBYTE I_1 1 2 0 255 ECU_ADDRESS 0x0 /end MEASUREMENT
/begin MEASUREMENT BSW_u8McuMotTrqRollCnt "..." UBYTE I_1 1 2 0 255 ECU_ADDRESS 0x0 /end MEASUREMENT
/begin MEASUREMENT BSW_u8McuStsRollCnt "..." UBYTE I_1 1 2 0 255 ECU_ADDRESS 0x0 /end MEASUREMENT
/begin MEASUREMENT BSW_u8NvMReturnResult "NvM Return Result" UBYTE I_1 1 2 0 255 ECU_ADDRESS 0x0 /end MEASUREMENT
/begin MEASUREMENT BSW_u8NvmMngStt "..." UBYTE I_1 1 2 0 255 ECU_ADDRESS 0x0 /end MEASUREMENT
/begin MEASUREMENT BSW_u8Pdcm_acu_epsCsumErrCnt "..." UBYTE I_1 1 2 0 255 ECU_ADDRESS 0x0 /end MEASUREMENT
/begin MEASUREMENT BSW_u8Pdcm_acu_epsRcErrCnt "..." UBYTE I_1 1 2 0 255 ECU_ADDRESS 0x0 /end MEASUREMENT
/begin MEASUREMENT BSW_u8Pdcm_acu_epsRcLast "..." UBYTE I_1 1 2 0 255 ECU_ADDRESS 0x0 /end MEASUREMENT
/begin MEASUREMENT BSW_u8Pdcm_acu_epsRcNow "..." UBYTE I_1 1 2 0 255 ECU_ADDRESS 0x0 /end MEASUREMENT
/begin MEASUREMENT BSW_u8Pdcm_gcuCsumErrCnt "..." UBYTE I_1 1 2 0 255 ECU_ADDRESS 0x0 /end MEASUREMENT
/begin MEASUREMENT BSW_u8Pdcm_gcuRcErrCnt "..." UBYTE I_1 1 2 0 255 ECU_ADDRESS 0x0 /end MEASUREMENT
/begin MEASUREMENT BSW_u8Pdcm_gcuRcLast "..." UBYTE I_1 1 2 0 255 ECU_ADDRESS 0x0 /end MEASUREMENT
/begin MEASUREMENT BSW_u8Pdcm_gcuRcNow "..." UBYTE I_1 1 2 0 255 ECU_ADDRESS 0x0 /end MEASUREMENT
/begin MEASUREMENT BSW_u8Pdcm_ic_acuCsumErrCnt "..." UBYTE I_1 1 2 0 255 ECU_ADDRESS 0x0 /end MEASUREMENT
/begin MEASUREMENT BSW_u8Pdcm_ic_acuRcErrCnt "..." UBYTE I_1 1 2 0 255 ECU_ADDRESS 0x0 /end MEASUREMENT
/begin MEASUREMENT BSW_u8Pdcm_ic_acuRcLast "..." UBYTE I_1 1 2 0 255 ECU_ADDRESS 0x0 /end MEASUREMENT
/begin MEASUREMENT BSW_u8Pdcm_ic_acuRcNow "..." UBYTE I_1 1 2 0 255 ECU_ADDRESS 0x0 /end MEASUREMENT
/begin MEASUREMENT BSW_u8Rx1CsumErrCnt "..." UBYTE I_1 1 2 0 255 ECU_ADDRESS 0x0 /end MEASUREMENT
/begin MEASUREMENT BSW_u8Rx1RcErrCnt "..." UBYTE I_1 1 2 0 255 ECU_ADDRESS 0x0 /end MEASUREMENT
/begin MEASUREMENT BSW_u8Rx1RcLast "..." UBYTE I_1 1 2 0 255 ECU_ADDRESS 0x0 /end MEASUREMENT
/begin MEASUREMENT BSW_u8Rx1RcUnchangedErrCnt "..." UBYTE I_1 1 2 0 255 ECU_ADDRESS 0x0 /end MEASUREMENT
/begin MEASUREMENT BSW_u8Rx2CsumErrCnt "..." UBYTE I_1 1 2 0 255 ECU_ADDRESS 0x0 /end MEASUREMENT
/begin MEASUREMENT BSW_u8Rx2RcErrCnt "..." UBYTE I_1 1 2 0 255 ECU_ADDRESS 0x0 /end MEASUREMENT
/begin MEASUREMENT BSW_u8Rx2RcLast "..." UBYTE I_1 1 2 0 255 ECU_ADDRESS 0x0 /end MEASUREMENT
/begin MEASUREMENT BSW_u8Rx2RcUnchangedErrCnt "..." UBYTE I_1 1 2 0 255 ECU_ADDRESS 0x0 /end MEASUREMENT
/begin MEASUREMENT BSW_u8SelfChkErr "..." UBYTE I_1 1 2 0 255 ECU_ADDRESS 0x0 /end MEASUREMENT
/begin MEASUREMENT CCU6_au32PWMOnTime "." ULONG F_1_p0_4 1 2 0 4294967295 MATRIX_DIM 3 1 1 ECU_ADDRESS 0x0 /end MEASUREMENT
/begin MEASUREMENT CCU6_au32PWMOnTime[0] "CCU6_au32PWMOnTime[0]" ULONG F_1_p0_4 1 2 0 4294967295 ECU_ADDRESS 0x0 /end MEASUREMENT
/begin MEASUREMENT CCU6_au32PWMOnTime[1] "CCU6_au32PWMOnTime[1]" ULONG F_1_p0_4 1 2 0 4294967295 ECU_ADDRESS 0x0 /end MEASUREMENT
/begin MEASUREMENT CCU6_au32PWMOnTime[2] "CCU6_au32PWMOnTime[2]" ULONG F_1_p0_4 1 2 0 4294967295 ECU_ADDRESS 0x0 /end MEASUREMENT
/begin MEASUREMENT CCU6_bAkdAfterAscReq "..." UBYTE Bool_ON_OFF 1 2 0 1 BIT_MASK 0x01 ECU_ADDRESS 0x0 /end MEASUREMENT
/begin MEASUREMENT CCU6_bClrTrapReq "..." UBYTE Bool_ON_OFF 1 2 0 1 BIT_MASK 0x01 ECU_ADDRESS 0x0 /end MEASUREMENT
/begin MEASUREMENT CCU6_bHighVoltStdbyFlg "..." UBYTE Bool_ON_OFF 1 2 0 1 BIT_MASK 0x01 ECU_ADDRESS 0x0 /end MEASUREMENT
/begin MEASUREMENT CCU6_bHwFaultDcOvVolt "..." UBYTE Bool_ON_OFF 1 2 0 1 BIT_MASK 0x01 ECU_ADDRESS 0x0 /end MEASUREMENT
/begin MEASUREMENT CCU6_bHwFaultIgbtH "..." UBYTE Bool_ON_OFF 1 2 0 1 BIT_MASK 0x01 ECU_ADDRESS 0x0 /end MEASUREMENT
/begin MEASUREMENT CCU6_bHwFaultIgbtL "..." UBYTE Bool_ON_OFF 1 2 0 1 BIT_MASK 0x01 ECU_ADDRESS 0x0 /end MEASUREMENT
/begin MEASUREMENT CCU6_bHwFaultOvcU "..." UBYTE Bool_ON_OFF 1 2 0 1 BIT_MASK 0x01 ECU_ADDRESS 0x0 /end MEASUREMENT
/begin MEASUREMENT CCU6_bHwFaultOvcV "..." UBYTE Bool_ON_OFF 1 2 0 1 BIT_MASK 0x01 ECU_ADDRESS 0x0 /end MEASUREMENT
/begin MEASUREMENT CCU6_bHwFaultOvcW "..." UBYTE Bool_ON_OFF 1 2 0 1 BIT_MASK 0x01 ECU_ADDRESS 0x0 /end MEASUREMENT
/begin MEASUREMENT CCU6_bIgbtHighSideShort "..." UBYTE Bool_ON_OFF 1 2 0 1 BIT_MASK 0x01 ECU_ADDRESS 0x0 /end MEASUREMENT
/begin MEASUREMENT CCU6_bIgbtLowSideShort "..." UBYTE Bool_ON_OFF 1 2 0 1 BIT_MASK 0x01 ECU_ADDRESS 0x0 /end MEASUREMENT
/begin MEASUREMENT CCU6_bIsCCU6Start "..." UBYTE Bool_ON_OFF 1 2 0 1 BIT_MASK 0x01 ECU_ADDRESS 0x0 /end MEASUREMENT
/begin MEASUREMENT CCU6_bIuvwCompReq "..." UBYTE Bool_ON_OFF 1 2 0 1 BIT_MASK 0x01 ECU_ADDRESS 0x0 /end MEASUREMENT
/begin MEASUREMENT CCU6_bMotorSpdRdy "..." UBYTE Bool_ON_OFF 1 2 0 1 BIT_MASK 0x01 ECU_ADDRESS 0x0 /end MEASUREMENT
/begin MEASUREMENT CCU6_bP5VDiagReinitCmd "..." UBYTE Bool_ON_OFF 1 2 0 1 BIT_MASK 0x01 ECU_ADDRESS 0x0 /end MEASUREMENT
/begin MEASUREMENT CCU6_bP5VHSFltFlg "..." UBYTE Bool_ON_OFF 1 2 0 1 BIT_MASK 0x01 ECU_ADDRESS 0x0 /end MEASUREMENT
/begin MEASUREMENT CCU6_bP5VLSFltFlg "..." UBYTE Bool_ON_OFF 1 2 0 1 BIT_MASK 0x01 ECU_ADDRESS 0x0 /end MEASUREMENT
/begin MEASUREMENT CCU6_bPwmMidPointU "..." UBYTE Bool_ON_OFF 1 2 0 1 BIT_MASK 0x01 ECU_ADDRESS 0x0 /end MEASUREMENT
/begin MEASUREMENT CCU6_bPwmMidPointV "..." UBYTE Bool_ON_OFF 1 2 0 1 BIT_MASK 0x01 ECU_ADDRESS 0x0 /end MEASUREMENT
/begin MEASUREMENT CCU6_bPwmMidPointW "..." UBYTE Bool_ON_OFF 1 2 0 1 BIT_MASK 0x01 ECU_ADDRESS 0x0 /end MEASUREMENT
/begin MEASUREMENT CCU6_bPwmOnGoingFlg "..." UBYTE Bool_ON_OFF 1 2 0 1 BIT_MASK 0x01 ECU_ADDRESS 0x0 /end MEASUREMENT
/begin MEASUREMENT CCU6_bT12ZeroMatchFlg "..." UBYTE Bool_ON_OFF 1 2 0 1 BIT_MASK 0x01 ECU_ADDRESS 0x0 /end MEASUREMENT
/begin MEASUREMENT CCU6_bTrapTrigger "..." UBYTE Bool_ON_OFF 1 2 0 1 BIT_MASK 0x01 ECU_ADDRESS 0x0 /end MEASUREMENT
/begin MEASUREMENT CCU6_f32DrvClkHsDuty "..." FLOAT32_IEEE I_1 1 2 -3.402823466E+038 3.402823466E+038 ECU_ADDRESS 0x0 /end MEASUREMENT
/begin MEASUREMENT CCU6_f32DrvClkLsDuty "..." FLOAT32_IEEE I_1 1 2 -3.402823466E+038 3.402823466E+038 ECU_ADDRESS 0x0 /end MEASUREMENT
/begin MEASUREMENT CCU6_f32HighVolPhys "..." FLOAT32_IEEE I_1 1 2 -3.402823466E+038 3.402823466E+038 ECU_ADDRESS 0x0 /end MEASUREMENT
/begin MEASUREMENT CCU6_f32PwmDutyPhysUZ "..." FLOAT32_IEEE I_1 1 2 -3.402823466E+038 3.402823466E+038 ECU_ADDRESS 0x0 /end MEASUREMENT
/begin MEASUREMENT CCU6_f32PwmDutyPhysVZ "..." FLOAT32_IEEE I_1 1 2 -3.402823466E+038 3.402823466E+038 ECU_ADDRESS 0x0 /end MEASUREMENT
/begin MEASUREMENT CCU6_f32PwmDutyPhysWZ "..." FLOAT32_IEEE I_1 1 2 -3.402823466E+038 3.402823466E+038 ECU_ADDRESS 0x0 /end MEASUREMENT
/begin MEASUREMENT CCU6_u16AlimPowerOnDelay "..." UWORD I_1 1 2 0 65535 ECU_ADDRESS 0x0 /end MEASUREMENT
/begin MEASUREMENT CCU6_u16CCU6T13CmpVal "PWM duty of CCU6" UWORD I_1 1 2 0 65535 ECU_ADDRESS 0x0 /end MEASUREMENT
/begin MEASUREMENT CCU6_u16HighVolAdc "..." UWORD I_1 1 2 0 65535 ECU_ADDRESS 0x0 /end MEASUREMENT
/begin MEASUREMENT CCU6_u16McuAscSttDelay "..." UWORD I_1 1 2 0 65535 ECU_ADDRESS 0x0 /end MEASUREMENT
/begin MEASUREMENT CCU6_u16P5VHSAdc "..." UWORD I_15 1 2 0 65535 ECU_ADDRESS 0x0 /end MEASUREMENT
/begin MEASUREMENT CCU6_u16PowerOnDelay "..." UWORD I_1 1 2 0 65535 ECU_ADDRESS 0x0 /end MEASUREMENT
/begin MEASUREMENT CCU6_u16PwmMaxDutyCyc "..." UWORD I_1 1 2 0 65535 ECU_ADDRESS 0x0 /end MEASUREMENT
/begin MEASUREMENT CCU6_u16PwmMidPointErrCnt "..." UWORD I_1 1 2 0 65535 ECU_ADDRESS 0x0 /end MEASUREMENT
/begin MEASUREMENT CCU6_u16PwmMinDutyCyc "..." UWORD I_1 1 2 0 65535 ECU_ADDRESS 0x0 /end MEASUREMENT
/begin MEASUREMENT CCU6_u16PwmModReq "..." UWORD I_1 1 2 0 65535 ECU_ADDRESS 0x0 /end MEASUREMENT
/begin MEASUREMENT CCU6_u16T12CntVal "..." UWORD I_1 1 2 0 65535 ECU_ADDRESS 0x0 /end MEASUREMENT
/begin MEASUREMENT CCU6_u16T12PeriodVal "..." UWORD I_1 1 2 0 65535 ECU_ADDRESS 0x0 /end MEASUREMENT
/begin MEASUREMENT CCU6_u16T13PeriodVal "..." UWORD I_1 1 2 0 65535 ECU_ADDRESS 0x0 /end MEASUREMENT
/begin MEASUREMENT CCU6_u32DrvClkHsDutyRaw "..." ULONG I_1 1 2 0 4294967295 ECU_ADDRESS 0x0 /end MEASUREMENT
/begin MEASUREMENT CCU6_u32DrvClkHsPerdRaw "..." ULONG I_1 1 2 0 4294967295 ECU_ADDRESS 0x0 /end MEASUREMENT
/begin MEASUREMENT CCU6_u32DrvClkLsDutyRaw "..." ULONG I_1 1 2 0 4294967295 ECU_ADDRESS 0x0 /end MEASUREMENT
/begin MEASUREMENT CCU6_u32DrvClkLsPerdRaw "..." ULONG I_1 1 2 0 4294967295 ECU_ADDRESS 0x0 /end MEASUREMENT
/begin MEASUREMENT CCU6_u32TrapCreq "..." ULONG I_1 1 2 0 4294967295 ECU_ADDRESS 0x0 /end MEASUREMENT
/begin MEASUREMENT CCU6_u8AscRecoverCnt "CCU6 State" UBYTE I_1 1 2 0 255 ECU_ADDRESS 0x0 /end MEASUREMENT
/begin MEASUREMENT CCU6_u8McuAscSttStep "CCU6 State" UBYTE I_1 1 2 0 255 ECU_ADDRESS 0x0 /end MEASUREMENT
/begin MEASUREMENT CCU6_u8McuAscType "CCU6 ASC Type" UBYTE I_1 1 2 0 255 ECU_ADDRESS 0x0 /end MEASUREMENT
/begin MEASUREMENT CCU6_u8P5VHSFltCnt "..." UBYTE I_1 1 2 0 255 ECU_ADDRESS 0x0 /end MEASUREMENT
/begin MEASUREMENT CCU6_u8P5VLSFltCnt "..." UBYTE I_1 1 2 0 255 ECU_ADDRESS 0x0 /end MEASUREMENT
/begin MEASUREMENT CCU6_u8P5VPowerMngStt "..." UBYTE I_1 1 2 0 255 ECU_ADDRESS 0x0 /end MEASUREMENT
/begin MEASUREMENT CCU6_u8P5VSelfTstStt "..." UBYTE I_1 1 2 0 255 ECU_ADDRESS 0x0 /end MEASUREMENT
/begin MEASUREMENT CCU6_u8P5VSelfTstTimCnt "..." UBYTE I_1 1 2 0 255 ECU_ADDRESS 0x0 /end MEASUREMENT
/begin MEASUREMENT CCU6_u8PreTestStep "..." UBYTE I_1 1 2 0 255 ECU_ADDRESS 0x0 /end MEASUREMENT
/begin MEASUREMENT CCU6_u8PwmState "CCU6 State" UBYTE I_1 1 2 0 255 ECU_ADDRESS 0x0 /end MEASUREMENT
/begin MEASUREMENT COMMUSR_bComNoComModeReqed "Stay awake request" UBYTE Bool_ON_OFF 1 2 0 1 BIT_MASK 0x01 ECU_ADDRESS 0x0 /end MEASUREMENT
/begin MEASUREMENT COMMUSR_bPwrDnRunFlg "..." UBYTE Bool_ON_OFF 1 2 0 1 BIT_MASK 0x01 ECU_ADDRESS 0x0 /end MEASUREMENT
/begin MEASUREMENT COMMUSR_bShutdownReq "Shutdown request" UBYTE Bool_ON_OFF 1 2 0 1 BIT_MASK 0x01 ECU_ADDRESS 0x0 /end MEASUREMENT
/begin MEASUREMENT COMMUSR_bStayAwakeReq "Stay awake request" UBYTE Bool_ON_OFF 1 2 0 1 BIT_MASK 0x01 ECU_ADDRESS 0x0 /end MEASUREMENT
/begin MEASUREMENT COMMUSR_bStayAwakeReqDiag "Stay awake request" UBYTE Bool_ON_OFF 1 2 0 1 BIT_MASK 0x01 ECU_ADDRESS 0x0 /end MEASUREMENT
/begin MEASUREMENT COMMUSR_bTrigPwrDownFlg "..." UBYTE Bool_ON_OFF 1 2 0 1 BIT_MASK 0x01 ECU_ADDRESS 0x0 /end MEASUREMENT
/begin MEASUREMENT COMMUSR_bWkpByCAN "PBM to RMS cause by NM msg" UBYTE Bool_ON_OFF 1 2 0 1 BIT_MASK 0x01 ECU_ADDRESS 0x0 /end MEASUREMENT
/begin MEASUREMENT COMMUSR_u16DiagToutCtr "COMMUSR_u16DiagToutCtr" UWORD I_1 1 2 0 65535 ECU_ADDRESS 0x0 /end MEASUREMENT
/begin MEASUREMENT COMMUSR_u8NmState "COMMUSR_u8NmState" UBYTE I_1 1 2 0 255 ECU_ADDRESS 0x0 /end MEASUREMENT
/begin MEASUREMENT COMMUSR_u8NvmJobRes "COMMUSR_u8NvmJobRes" UBYTE I_1 1 2 0 255 ECU_ADDRESS 0x0 /end MEASUREMENT
/begin MEASUREMENT COMMUSR_u8PrevNmState "COMMUSR_u8PrevNmState" UBYTE I_1 1 2 0 255 ECU_ADDRESS 0x0 /end MEASUREMENT
/begin MEASUREMENT COMMUSR_u8State "ComMUsr_u8State" UBYTE I_1 1 2 0 255 ECU_ADDRESS 0x0 /end MEASUREMENT
/begin MEASUREMENT COMMUSR_u8StayAwakeReason "COMMUSR_u8StayAwakeReason" UBYTE I_1 1 2 0 255 ECU_ADDRESS 0x0 /end MEASUREMENT
/begin MEASUREMENT COMMUSR_u8WakeReason "ComMUsr_u8WakeReason" UBYTE I_1 1 2 0 255 ECU_ADDRESS 0x0 /end MEASUREMENT
/begin MEASUREMENT CalUsr_bIsCalibUpdEna "Check whether OC enabled" UBYTE Bool_ON_OFF 1 2 0 1 BIT_MASK 0x01 ECU_ADDRESS 0x0 /end MEASUREMENT
/begin MEASUREMENT CalUsr_u32ChkDataCrc "." ULONG I_1 1 2 0 4294967295 ECU_ADDRESS 0x0 /end MEASUREMENT
/begin MEASUREMENT CalUsr_u32POCalibDnEnaMskA "." ULONG I_1 1 2 0 4294967295 ECU_ADDRESS 0x0 /end MEASUREMENT
/begin MEASUREMENT CalUsr_u32POCalibDnEnaMskB "." ULONG I_1 1 2 0 4294967295 ECU_ADDRESS 0x0 /end MEASUREMENT
/begin MEASUREMENT CalUsr_u32PODataCRC "." ULONG I_1 1 2 0 4294967295 ECU_ADDRESS 0x0 /end MEASUREMENT
/begin MEASUREMENT DEVHAL_bIsInitialized "DEVHAL_bIsInitialized" UBYTE Bool_ON_OFF 1 2 0 1 BIT_MASK 0x01 ECU_ADDRESS 0x0 /end MEASUREMENT
/begin MEASUREMENT DEVHAL_u8CheckEngineState "DEVHAL_u8CheckEngineState" UBYTE I_1 1 2 0 255 ECU_ADDRESS 0x0 /end MEASUREMENT
/begin MEASUREMENT DFApp_u8DflashMainState "..." UBYTE I_1 1 2 0 255 ECU_ADDRESS 0x0 /end MEASUREMENT
/begin MEASUREMENT DSM_DtcNumber "DSM_DtcNumber" ULONG I_1 1 2 0 4294967295 MATRIX_DIM 10 1 1 ECU_ADDRESS 0x0 /end MEASUREMENT
/begin MEASUREMENT DSM_DtcNumber[0] "DSM_DtcNumber[0]" ULONG I_1 1 2 0 4294967295 ECU_ADDRESS 0x0 /end MEASUREMENT
/begin MEASUREMENT DSM_DtcNumber[1] "DSM_DtcNumber[1]" ULONG I_1 1 2 0 4294967295 ECU_ADDRESS 0x0 /end MEASUREMENT
/begin MEASUREMENT DSM_DtcNumber[2] "DSM_DtcNumber[2]" ULONG I_1 1 2 0 4294967295 ECU_ADDRESS 0x0 /end MEASUREMENT
/begin MEASUREMENT DSM_DtcNumber[3] "DSM_DtcNumber[3]" ULONG I_1 1 2 0 4294967295 ECU_ADDRESS 0x0 /end MEASUREMENT
/begin MEASUREMENT DSM_DtcNumber[4] "DSM_DtcNumber[4]" ULONG I_1 1 2 0 4294967295 ECU_ADDRESS 0x0 /end MEASUREMENT
/begin MEASUREMENT DSM_DtcNumber[5] "DSM_DtcNumber[5]" ULONG I_1 1 2 0 4294967295 ECU_ADDRESS 0x0 /end MEASUREMENT
/begin MEASUREMENT DSM_DtcNumber[6] "DSM_DtcNumber[6]" ULONG I_1 1 2 0 4294967295 ECU_ADDRESS 0x0 /end MEASUREMENT
/begin MEASUREMENT DSM_DtcNumber[7] "DSM_DtcNumber[7]" ULONG I_1 1 2 0 4294967295 ECU_ADDRESS 0x0 /end MEASUREMENT
/begin MEASUREMENT DSM_DtcNumber[8] "DSM_DtcNumber[8]" ULONG I_1 1 2 0 4294967295 ECU_ADDRESS 0x0 /end MEASUREMENT
/begin MEASUREMENT DSM_DtcNumber[9] "DSM_DtcNumber[9]" ULONG I_1 1 2 0 4294967295 ECU_ADDRESS 0x0 /end MEASUREMENT
/begin MEASUREMENT DSM_DtcStatusNvm "DID 120 -> DTC Setting Control" UBYTE F_1_p0_4 1 2 0 255 MATRIX_DIM 10 1 1 ECU_ADDRESS 0x0 /end MEASUREMENT
/begin MEASUREMENT DSM_DtcStatusNvm[0] "DSM_DtcStatusNvm[0]" UBYTE F_1_p0_4 1 2 0 255 ECU_ADDRESS 0x0 /end MEASUREMENT
/begin MEASUREMENT DSM_DtcStatusNvm[1] "DSM_DtcStatusNvm[1]" UBYTE F_1_p0_4 1 2 0 255 ECU_ADDRESS 0x0 /end MEASUREMENT
/begin MEASUREMENT DSM_DtcStatusNvm[2] "DSM_DtcStatusNvm[2]" UBYTE F_1_p0_4 1 2 0 255 ECU_ADDRESS 0x0 /end MEASUREMENT
/begin MEASUREMENT DSM_DtcStatusNvm[3] "DSM_DtcStatusNvm[3]" UBYTE F_1_p0_4 1 2 0 255 ECU_ADDRESS 0x0 /end MEASUREMENT
/begin MEASUREMENT DSM_DtcStatusNvm[4] "DSM_DtcStatusNvm[4]" UBYTE F_1_p0_4 1 2 0 255 ECU_ADDRESS 0x0 /end MEASUREMENT
/begin MEASUREMENT DSM_DtcStatusNvm[5] "DSM_DtcStatusNvm[5]" UBYTE F_1_p0_4 1 2 0 255 ECU_ADDRESS 0x0 /end MEASUREMENT
/begin MEASUREMENT DSM_DtcStatusNvm[6] "DSM_DtcStatusNvm[6]" UBYTE F_1_p0_4 1 2 0 255 ECU_ADDRESS 0x0 /end MEASUREMENT
/begin MEASUREMENT DSM_DtcStatusNvm[7] "DSM_DtcStatusNvm[7]" UBYTE F_1_p0_4 1 2 0 255 ECU_ADDRESS 0x0 /end MEASUREMENT
/begin MEASUREMENT DSM_DtcStatusNvm[8] "DSM_DtcStatusNvm[8]" UBYTE F_1_p0_4 1 2 0 255 ECU_ADDRESS 0x0 /end MEASUREMENT
/begin MEASUREMENT DSM_DtcStatusNvm[9] "DSM_DtcStatusNvm[9]" UBYTE F_1_p0_4 1 2 0 255 ECU_ADDRESS 0x0 /end MEASUREMENT
/begin MEASUREMENT DSM_FaultFailureLevel "DSM_FaultFailureLevel" UBYTE I_23 1 2 0 255 MATRIX_DIM 2 1 1 ECU_ADDRESS 0x0 /end MEASUREMENT
/begin MEASUREMENT DSM_FaultFailureLevel[0] "DSM_FaultFailureLevel[0]" UBYTE I_23 1 2 0 255 ECU_ADDRESS 0x0 /end MEASUREMENT
/begin MEASUREMENT DSM_FaultFailureLevel[1] "DSM_FaultFailureLevel[1]" UBYTE I_23 1 2 0 255 ECU_ADDRESS 0x0 /end MEASUREMENT
/begin MEASUREMENT Det_astrRecordedErrors[0].u16ModuleId "Det_astrRecordedErrors[0].u16ModuleId" UWORD F_1_p0_4 1 2 0 65535 ECU_ADDRESS 0x0 /end MEASUREMENT
/begin MEASUREMENT Det_astrRecordedErrors[0].u8ApiId "Det_astrRecordedErrors[0].u8ApiId" UBYTE F_1_p0_4 1 2 0 255 ECU_ADDRESS 0x3 /end MEASUREMENT
/begin MEASUREMENT Det_astrRecordedErrors[0].u8ErrorId "Det_astrRecordedErrors[0].u8ErrorId" UBYTE F_1_p0_4 1 2 0 255 ECU_ADDRESS 0x4 /end MEASUREMENT
/begin MEASUREMENT Det_astrRecordedErrors[0].u8InstanceId "Det_astrRecordedErrors[0].u8InstanceId" UBYTE F_1_p0_4 1 2 0 255 ECU_ADDRESS 0x2 /end MEASUREMENT
/begin MEASUREMENT Det_astrRecordedErrors[1].u16ModuleId "Det_astrRecordedErrors[1].u16ModuleId" UWORD F_1_p0_4 1 2 0 65535 ECU_ADDRESS 0x6 /end MEASUREMENT
/begin MEASUREMENT Det_astrRecordedErrors[1].u8ApiId "Det_astrRecordedErrors[1].u8ApiId" UBYTE F_1_p0_4 1 2 0 255 ECU_ADDRESS 0x9 /end MEASUREMENT
/begin MEASUREMENT Det_astrRecordedErrors[1].u8ErrorId "Det_astrRecordedErrors[1].u8ErrorId" UBYTE F_1_p0_4 1 2 0 255 ECU_ADDRESS 0xA /end MEASUREMENT
/begin MEASUREMENT Det_astrRecordedErrors[1].u8InstanceId "Det_astrRecordedErrors[1].u8InstanceId" UBYTE F_1_p0_4 1 2 0 255 ECU_ADDRESS 0x8 /end MEASUREMENT
/begin MEASUREMENT Det_astrRecordedErrors[2].u16ModuleId "Det_astrRecordedErrors[2].u16ModuleId" UWORD F_1_p0_4 1 2 0 65535 ECU_ADDRESS 0xC /end MEASUREMENT
/begin MEASUREMENT Det_astrRecordedErrors[2].u8ApiId "Det_astrRecordedErrors[2].u8ApiId" UBYTE F_1_p0_4 1 2 0 255 ECU_ADDRESS 0xF /end MEASUREMENT
/begin MEASUREMENT Det_astrRecordedErrors[2].u8ErrorId "Det_astrRecordedErrors[2].u8ErrorId" UBYTE F_1_p0_4 1 2 0 255 ECU_ADDRESS 0x10 /end MEASUREMENT
/begin MEASUREMENT Det_astrRecordedErrors[2].u8InstanceId "Det_astrRecordedErrors[2].u8InstanceId" UBYTE F_1_p0_4 1 2 0 255 ECU_ADDRESS 0xE /end MEASUREMENT
/begin MEASUREMENT Det_astrRecordedErrors[3].u16ModuleId "Det_astrRecordedErrors[3].u16ModuleId" UWORD F_1_p0_4 1 2 0 65535 ECU_ADDRESS 0x12 /end MEASUREMENT
/begin MEASUREMENT Det_astrRecordedErrors[3].u8ApiId "Det_astrRecordedErrors[3].u8ApiId" UBYTE F_1_p0_4 1 2 0 255 ECU_ADDRESS 0x15 /end MEASUREMENT
/begin MEASUREMENT Det_astrRecordedErrors[3].u8ErrorId "Det_astrRecordedErrors[3].u8ErrorId" UBYTE F_1_p0_4 1 2 0 255 ECU_ADDRESS 0x16 /end MEASUREMENT
/begin MEASUREMENT Det_astrRecordedErrors[3].u8InstanceId "Det_astrRecordedErrors[3].u8InstanceId" UBYTE F_1_p0_4 1 2 0 255 ECU_ADDRESS 0x14 /end MEASUREMENT
/begin MEASUREMENT Det_astrRecordedErrors[4].u16ModuleId "Det_astrRecordedErrors[4].u16ModuleId" UWORD F_1_p0_4 1 2 0 65535 ECU_ADDRESS 0x18 /end MEASUREMENT
/begin MEASUREMENT Det_astrRecordedErrors[4].u8ApiId "Det_astrRecordedErrors[4].u8ApiId" UBYTE F_1_p0_4 1 2 0 255 ECU_ADDRESS 0x1B /end MEASUREMENT
/begin MEASUREMENT Det_astrRecordedErrors[4].u8ErrorId "Det_astrRecordedErrors[4].u8ErrorId" UBYTE F_1_p0_4 1 2 0 255 ECU_ADDRESS 0x1C /end MEASUREMENT
/begin MEASUREMENT Det_astrRecordedErrors[4].u8InstanceId "Det_astrRecordedErrors[4].u8InstanceId" UBYTE F_1_p0_4 1 2 0 255 ECU_ADDRESS 0x1A /end MEASUREMENT
/begin MEASUREMENT Det_bOverflowOccured "Det_bOverflowOccured" UBYTE Bool_ON_OFF 1 2 0 1 BIT_MASK 0x01 ECU_ADDRESS 0x0 /end MEASUREMENT
/begin MEASUREMENT Det_u8BufferHead "Det_u8BufferHead" UBYTE F_1_p0_4 1 2 0 255 ECU_ADDRESS 0x0 /end MEASUREMENT
/begin MEASUREMENT Det_u8NumberOfErrors "Det_u8NumberOfErrors" UBYTE F_1_p0_4 1 2 0 255 ECU_ADDRESS 0x0 /end MEASUREMENT
/begin MEASUREMENT EAS_au8ComChallengeVal "EAS_au8ComChallengeVal" UBYTE I_1 1 2 0 255 MATRIX_DIM 8 1 1 ECU_ADDRESS 0x0 /end MEASUREMENT
/begin MEASUREMENT EAS_au8ComChallengeVal[0] "EAS_au8ComChallengeVal[0]" UBYTE I_1 1 2 0 255 ECU_ADDRESS 0x0 /end MEASUREMENT
/begin MEASUREMENT EAS_au8ComChallengeVal[1] "EAS_au8ComChallengeVal[1]" UBYTE I_1 1 2 0 255 ECU_ADDRESS 0x0 /end MEASUREMENT
/begin MEASUREMENT EAS_au8ComChallengeVal[2] "EAS_au8ComChallengeVal[2]" UBYTE I_1 1 2 0 255 ECU_ADDRESS 0x0 /end MEASUREMENT
/begin MEASUREMENT EAS_au8ComChallengeVal[3] "EAS_au8ComChallengeVal[3]" UBYTE I_1 1 2 0 255 ECU_ADDRESS 0x0 /end MEASUREMENT
/begin MEASUREMENT EAS_au8ComChallengeVal[4] "EAS_au8ComChallengeVal[4]" UBYTE I_1 1 2 0 255 ECU_ADDRESS 0x0 /end MEASUREMENT
/begin MEASUREMENT EAS_au8ComChallengeVal[5] "EAS_au8ComChallengeVal[5]" UBYTE I_1 1 2 0 255 ECU_ADDRESS 0x0 /end MEASUREMENT
/begin MEASUREMENT EAS_au8ComChallengeVal[6] "EAS_au8ComChallengeVal[6]" UBYTE I_1 1 2 0 255 ECU_ADDRESS 0x0 /end MEASUREMENT
/begin MEASUREMENT EAS_au8ComChallengeVal[7] "EAS_au8ComChallengeVal[7]" UBYTE I_1 1 2 0 255 ECU_ADDRESS 0x0 /end MEASUREMENT
/begin MEASUREMENT EAS_au8ComImmoCode "EAS_au8ComImmoCode" UBYTE I_1 1 2 0 255 MATRIX_DIM 8 1 1 ECU_ADDRESS 0x0 /end MEASUREMENT
/begin MEASUREMENT EAS_au8ComImmoCode[0] "EAS_au8ComImmoCode[0]" UBYTE I_1 1 2 0 255 ECU_ADDRESS 0x0 /end MEASUREMENT
/begin MEASUREMENT EAS_au8ComImmoCode[1] "EAS_au8ComImmoCode[1]" UBYTE I_1 1 2 0 255 ECU_ADDRESS 0x0 /end MEASUREMENT
/begin MEASUREMENT EAS_au8ComImmoCode[2] "EAS_au8ComImmoCode[2]" UBYTE I_1 1 2 0 255 ECU_ADDRESS 0x0 /end MEASUREMENT
/begin MEASUREMENT EAS_au8ComImmoCode[3] "EAS_au8ComImmoCode[3]" UBYTE I_1 1 2 0 255 ECU_ADDRESS 0x0 /end MEASUREMENT
/begin MEASUREMENT EAS_au8ComImmoCode[4] "EAS_au8ComImmoCode[4]" UBYTE I_1 1 2 0 255 ECU_ADDRESS 0x0 /end MEASUREMENT
/begin MEASUREMENT EAS_au8ComImmoCode[5] "EAS_au8ComImmoCode[5]" UBYTE I_1 1 2 0 255 ECU_ADDRESS 0x0 /end MEASUREMENT
/begin MEASUREMENT EAS_au8ComImmoCode[6] "EAS_au8ComImmoCode[6]" UBYTE I_1 1 2 0 255 ECU_ADDRESS 0x0 /end MEASUREMENT
/begin MEASUREMENT EAS_au8ComImmoCode[7] "EAS_au8ComImmoCode[7]" UBYTE I_1 1 2 0 255 ECU_ADDRESS 0x0 /end MEASUREMENT
/begin MEASUREMENT EAS_au8ParmCC64Nvm "EAS_au8ParmCC64Nvm" UBYTE I_1 1 2 0 255 MATRIX_DIM 8 1 1 ECU_ADDRESS 0x0 /end MEASUREMENT
/begin MEASUREMENT EAS_au8ParmCC64Nvm[0] "EAS_au8ParmCC64Nvm[0]" UBYTE I_1 1 2 0 255 ECU_ADDRESS 0x0 /end MEASUREMENT
/begin MEASUREMENT EAS_au8ParmCC64Nvm[1] "EAS_au8ParmCC64Nvm[1]" UBYTE I_1 1 2 0 255 ECU_ADDRESS 0x0 /end MEASUREMENT
/begin MEASUREMENT EAS_au8ParmCC64Nvm[2] "EAS_au8ParmCC64Nvm[2]" UBYTE I_1 1 2 0 255 ECU_ADDRESS 0x0 /end MEASUREMENT
/begin MEASUREMENT EAS_au8ParmCC64Nvm[3] "EAS_au8ParmCC64Nvm[3]" UBYTE I_1 1 2 0 255 ECU_ADDRESS 0x0 /end MEASUREMENT
/begin MEASUREMENT EAS_au8ParmCC64Nvm[4] "EAS_au8ParmCC64Nvm[4]" UBYTE I_1 1 2 0 255 ECU_ADDRESS 0x0 /end MEASUREMENT
/begin MEASUREMENT EAS_au8ParmCC64Nvm[5] "EAS_au8ParmCC64Nvm[5]" UBYTE I_1 1 2 0 255 ECU_ADDRESS 0x0 /end MEASUREMENT
/begin MEASUREMENT EAS_au8ParmCC64Nvm[6] "EAS_au8ParmCC64Nvm[6]" UBYTE I_1 1 2 0 255 ECU_ADDRESS 0x0 /end MEASUREMENT
/begin MEASUREMENT EAS_au8ParmCC64Nvm[7] "EAS_au8ParmCC64Nvm[7]" UBYTE I_1 1 2 0 255 ECU_ADDRESS 0x0 /end MEASUREMENT
/begin MEASUREMENT EAS_au8ParmEacEncr "EAS_au8ParmEacEncr" UBYTE I_1 1 2 0 255 MATRIX_DIM 16 1 1 ECU_ADDRESS 0x0 /end MEASUREMENT
/begin MEASUREMENT EAS_au8ParmEacEncr[0] "EAS_au8ParmEacEncr[0]" UBYTE I_1 1 2 0 255 ECU_ADDRESS 0x0 /end MEASUREMENT
/begin MEASUREMENT EAS_au8ParmEacEncr[10] "EAS_au8ParmEacEncr[10]" UBYTE I_1 1 2 0 255 ECU_ADDRESS 0x0 /end MEASUREMENT
/begin MEASUREMENT EAS_au8ParmEacEncr[11] "EAS_au8ParmEacEncr[11]" UBYTE I_1 1 2 0 255 ECU_ADDRESS 0x0 /end MEASUREMENT
/begin MEASUREMENT EAS_au8ParmEacEncr[12] "EAS_au8ParmEacEncr[12]" UBYTE I_1 1 2 0 255 ECU_ADDRESS 0x0 /end MEASUREMENT
/begin MEASUREMENT EAS_au8ParmEacEncr[13] "EAS_au8ParmEacEncr[13]" UBYTE I_1 1 2 0 255 ECU_ADDRESS 0x0 /end MEASUREMENT
/begin MEASUREMENT EAS_au8ParmEacEncr[14] "EAS_au8ParmEacEncr[14]" UBYTE I_1 1 2 0 255 ECU_ADDRESS 0x0 /end MEASUREMENT
/begin MEASUREMENT EAS_au8ParmEacEncr[15] "EAS_au8ParmEacEncr[15]" UBYTE I_1 1 2 0 255 ECU_ADDRESS 0x0 /end MEASUREMENT
/begin MEASUREMENT EAS_au8ParmEacEncr[1] "EAS_au8ParmEacEncr[1]" UBYTE I_1 1 2 0 255 ECU_ADDRESS 0x0 /end MEASUREMENT
/begin MEASUREMENT EAS_au8ParmEacEncr[2] "EAS_au8ParmEacEncr[2]" UBYTE I_1 1 2 0 255 ECU_ADDRESS 0x0 /end MEASUREMENT
/begin MEASUREMENT EAS_au8ParmEacEncr[3] "EAS_au8ParmEacEncr[3]" UBYTE I_1 1 2 0 255 ECU_ADDRESS 0x0 /end MEASUREMENT
/begin MEASUREMENT EAS_au8ParmEacEncr[4] "EAS_au8ParmEacEncr[4]" UBYTE I_1 1 2 0 255 ECU_ADDRESS 0x0 /end MEASUREMENT
/begin MEASUREMENT EAS_au8ParmEacEncr[5] "EAS_au8ParmEacEncr[5]" UBYTE I_1 1 2 0 255 ECU_ADDRESS 0x0 /end MEASUREMENT
/begin MEASUREMENT EAS_au8ParmEacEncr[6] "EAS_au8ParmEacEncr[6]" UBYTE I_1 1 2 0 255 ECU_ADDRESS 0x0 /end MEASUREMENT
/begin MEASUREMENT EAS_au8ParmEacEncr[7] "EAS_au8ParmEacEncr[7]" UBYTE I_1 1 2 0 255 ECU_ADDRESS 0x0 /end MEASUREMENT
/begin MEASUREMENT EAS_au8ParmEacEncr[8] "EAS_au8ParmEacEncr[8]" UBYTE I_1 1 2 0 255 ECU_ADDRESS 0x0 /end MEASUREMENT
/begin MEASUREMENT EAS_au8ParmEacEncr[9] "EAS_au8ParmEacEncr[9]" UBYTE I_1 1 2 0 255 ECU_ADDRESS 0x0 /end MEASUREMENT
/begin MEASUREMENT EAS_au8ParmEacSeed "EAS_au8ParmEacSeed" UBYTE I_1 1 2 0 255 MATRIX_DIM 16 1 1 ECU_ADDRESS 0x0 /end MEASUREMENT
/begin MEASUREMENT EAS_au8ParmEacSeed[0] "EAS_au8ParmEacSeed[0]" UBYTE I_1 1 2 0 255 ECU_ADDRESS 0x0 /end MEASUREMENT
/begin MEASUREMENT EAS_au8ParmEacSeed[10] "EAS_au8ParmEacSeed[10]" UBYTE I_1 1 2 0 255 ECU_ADDRESS 0x0 /end MEASUREMENT
/begin MEASUREMENT EAS_au8ParmEacSeed[11] "EAS_au8ParmEacSeed[11]" UBYTE I_1 1 2 0 255 ECU_ADDRESS 0x0 /end MEASUREMENT
/begin MEASUREMENT EAS_au8ParmEacSeed[12] "EAS_au8ParmEacSeed[12]" UBYTE I_1 1 2 0 255 ECU_ADDRESS 0x0 /end MEASUREMENT
/begin MEASUREMENT EAS_au8ParmEacSeed[13] "EAS_au8ParmEacSeed[13]" UBYTE I_1 1 2 0 255 ECU_ADDRESS 0x0 /end MEASUREMENT
/begin MEASUREMENT EAS_au8ParmEacSeed[14] "EAS_au8ParmEacSeed[14]" UBYTE I_1 1 2 0 255 ECU_ADDRESS 0x0 /end MEASUREMENT
/begin MEASUREMENT EAS_au8ParmEacSeed[15] "EAS_au8ParmEacSeed[15]" UBYTE I_1 1 2 0 255 ECU_ADDRESS 0x0 /end MEASUREMENT
/begin MEASUREMENT EAS_au8ParmEacSeed[1] "EAS_au8ParmEacSeed[1]" UBYTE I_1 1 2 0 255 ECU_ADDRESS 0x0 /end MEASUREMENT
/begin MEASUREMENT EAS_au8ParmEacSeed[2] "EAS_au8ParmEacSeed[2]" UBYTE I_1 1 2 0 255 ECU_ADDRESS 0x0 /end MEASUREMENT
/begin MEASUREMENT EAS_au8ParmEacSeed[3] "EAS_au8ParmEacSeed[3]" UBYTE I_1 1 2 0 255 ECU_ADDRESS 0x0 /end MEASUREMENT
/begin MEASUREMENT EAS_au8ParmEacSeed[4] "EAS_au8ParmEacSeed[4]" UBYTE I_1 1 2 0 255 ECU_ADDRESS 0x0 /end MEASUREMENT
/begin MEASUREMENT EAS_au8ParmEacSeed[5] "EAS_au8ParmEacSeed[5]" UBYTE I_1 1 2 0 255 ECU_ADDRESS 0x0 /end MEASUREMENT
/begin MEASUREMENT EAS_au8ParmEacSeed[6] "EAS_au8ParmEacSeed[6]" UBYTE I_1 1 2 0 255 ECU_ADDRESS 0x0 /end MEASUREMENT
/begin MEASUREMENT EAS_au8ParmEacSeed[7] "EAS_au8ParmEacSeed[7]" UBYTE I_1 1 2 0 255 ECU_ADDRESS 0x0 /end MEASUREMENT
/begin MEASUREMENT EAS_au8ParmEacSeed[8] "EAS_au8ParmEacSeed[8]" UBYTE I_1 1 2 0 255 ECU_ADDRESS 0x0 /end MEASUREMENT
/begin MEASUREMENT EAS_au8ParmEacSeed[9] "EAS_au8ParmEacSeed[9]" UBYTE I_1 1 2 0 255 ECU_ADDRESS 0x0 /end MEASUREMENT
/begin MEASUREMENT EAS_au8ParmEarEncr1 "EAS_au8ParmEarEncr1" UBYTE I_1 1 2 0 255 MATRIX_DIM 16 1 1 ECU_ADDRESS 0x0 /end MEASUREMENT
/begin MEASUREMENT EAS_au8ParmEarEncr1[0] "EAS_au8ParmEarEncr1[0]" UBYTE I_1 1 2 0 255 ECU_ADDRESS 0x0 /end MEASUREMENT
/begin MEASUREMENT EAS_au8ParmEarEncr1[10] "EAS_au8ParmEarEncr1[10]" UBYTE I_1 1 2 0 255 ECU_ADDRESS 0x0 /end MEASUREMENT
/begin MEASUREMENT EAS_au8ParmEarEncr1[11] "EAS_au8ParmEarEncr1[11]" UBYTE I_1 1 2 0 255 ECU_ADDRESS 0x0 /end MEASUREMENT
/begin MEASUREMENT EAS_au8ParmEarEncr1[12] "EAS_au8ParmEarEncr1[12]" UBYTE I_1 1 2 0 255 ECU_ADDRESS 0x0 /end MEASUREMENT
/begin MEASUREMENT EAS_au8ParmEarEncr1[13] "EAS_au8ParmEarEncr1[13]" UBYTE I_1 1 2 0 255 ECU_ADDRESS 0x0 /end MEASUREMENT
/begin MEASUREMENT EAS_au8ParmEarEncr1[14] "EAS_au8ParmEarEncr1[14]" UBYTE I_1 1 2 0 255 ECU_ADDRESS 0x0 /end MEASUREMENT
/begin MEASUREMENT EAS_au8ParmEarEncr1[15] "EAS_au8ParmEarEncr1[15]" UBYTE I_1 1 2 0 255 ECU_ADDRESS 0x0 /end MEASUREMENT
/begin MEASUREMENT EAS_au8ParmEarEncr1[1] "EAS_au8ParmEarEncr1[1]" UBYTE I_1 1 2 0 255 ECU_ADDRESS 0x0 /end MEASUREMENT
/begin MEASUREMENT EAS_au8ParmEarEncr1[2] "EAS_au8ParmEarEncr1[2]" UBYTE I_1 1 2 0 255 ECU_ADDRESS 0x0 /end MEASUREMENT
/begin MEASUREMENT EAS_au8ParmEarEncr1[3] "EAS_au8ParmEarEncr1[3]" UBYTE I_1 1 2 0 255 ECU_ADDRESS 0x0 /end MEASUREMENT
/begin MEASUREMENT EAS_au8ParmEarEncr1[4] "EAS_au8ParmEarEncr1[4]" UBYTE I_1 1 2 0 255 ECU_ADDRESS 0x0 /end MEASUREMENT
/begin MEASUREMENT EAS_au8ParmEarEncr1[5] "EAS_au8ParmEarEncr1[5]" UBYTE I_1 1 2 0 255 ECU_ADDRESS 0x0 /end MEASUREMENT
/begin MEASUREMENT EAS_au8ParmEarEncr1[6] "EAS_au8ParmEarEncr1[6]" UBYTE I_1 1 2 0 255 ECU_ADDRESS 0x0 /end MEASUREMENT
/begin MEASUREMENT EAS_au8ParmEarEncr1[7] "EAS_au8ParmEarEncr1[7]" UBYTE I_1 1 2 0 255 ECU_ADDRESS 0x0 /end MEASUREMENT
/begin MEASUREMENT EAS_au8ParmEarEncr1[8] "EAS_au8ParmEarEncr1[8]" UBYTE I_1 1 2 0 255 ECU_ADDRESS 0x0 /end MEASUREMENT
/begin MEASUREMENT EAS_au8ParmEarEncr1[9] "EAS_au8ParmEarEncr1[9]" UBYTE I_1 1 2 0 255 ECU_ADDRESS 0x0 /end MEASUREMENT
/begin MEASUREMENT EAS_au8ParmEarEncr2 "EAS_au8ParmEarEncr2" UBYTE I_1 1 2 0 255 MATRIX_DIM 16 1 1 ECU_ADDRESS 0x0 /end MEASUREMENT
/begin MEASUREMENT EAS_au8ParmEarEncr2[0] "EAS_au8ParmEarEncr2[0]" UBYTE I_1 1 2 0 255 ECU_ADDRESS 0x0 /end MEASUREMENT
/begin MEASUREMENT EAS_au8ParmEarEncr2[10] "EAS_au8ParmEarEncr2[10]" UBYTE I_1 1 2 0 255 ECU_ADDRESS 0x0 /end MEASUREMENT
/begin MEASUREMENT EAS_au8ParmEarEncr2[11] "EAS_au8ParmEarEncr2[11]" UBYTE I_1 1 2 0 255 ECU_ADDRESS 0x0 /end MEASUREMENT
/begin MEASUREMENT EAS_au8ParmEarEncr2[12] "EAS_au8ParmEarEncr2[12]" UBYTE I_1 1 2 0 255 ECU_ADDRESS 0x0 /end MEASUREMENT
/begin MEASUREMENT EAS_au8ParmEarEncr2[13] "EAS_au8ParmEarEncr2[13]" UBYTE I_1 1 2 0 255 ECU_ADDRESS 0x0 /end MEASUREMENT
/begin MEASUREMENT EAS_au8ParmEarEncr2[14] "EAS_au8ParmEarEncr2[14]" UBYTE I_1 1 2 0 255 ECU_ADDRESS 0x0 /end MEASUREMENT
/begin MEASUREMENT EAS_au8ParmEarEncr2[15] "EAS_au8ParmEarEncr2[15]" UBYTE I_1 1 2 0 255 ECU_ADDRESS 0x0 /end MEASUREMENT
/begin MEASUREMENT EAS_au8ParmEarEncr2[1] "EAS_au8ParmEarEncr2[1]" UBYTE I_1 1 2 0 255 ECU_ADDRESS 0x0 /end MEASUREMENT
/begin MEASUREMENT EAS_au8ParmEarEncr2[2] "EAS_au8ParmEarEncr2[2]" UBYTE I_1 1 2 0 255 ECU_ADDRESS 0x0 /end MEASUREMENT
/begin MEASUREMENT EAS_au8ParmEarEncr2[3] "EAS_au8ParmEarEncr2[3]" UBYTE I_1 1 2 0 255 ECU_ADDRESS 0x0 /end MEASUREMENT
/begin MEASUREMENT EAS_au8ParmEarEncr2[4] "EAS_au8ParmEarEncr2[4]" UBYTE I_1 1 2 0 255 ECU_ADDRESS 0x0 /end MEASUREMENT
/begin MEASUREMENT EAS_au8ParmEarEncr2[5] "EAS_au8ParmEarEncr2[5]" UBYTE I_1 1 2 0 255 ECU_ADDRESS 0x0 /end MEASUREMENT
/begin MEASUREMENT EAS_au8ParmEarEncr2[6] "EAS_au8ParmEarEncr2[6]" UBYTE I_1 1 2 0 255 ECU_ADDRESS 0x0 /end MEASUREMENT
/begin MEASUREMENT EAS_au8ParmEarEncr2[7] "EAS_au8ParmEarEncr2[7]" UBYTE I_1 1 2 0 255 ECU_ADDRESS 0x0 /end MEASUREMENT
/begin MEASUREMENT EAS_au8ParmEarEncr2[8] "EAS_au8ParmEarEncr2[8]" UBYTE I_1 1 2 0 255 ECU_ADDRESS 0x0 /end MEASUREMENT
/begin MEASUREMENT EAS_au8ParmEarEncr2[9] "EAS_au8ParmEarEncr2[9]" UBYTE I_1 1 2 0 255 ECU_ADDRESS 0x0 /end MEASUREMENT
/begin MEASUREMENT EAS_au8ParmRN32 "EAS_au8ParmRN32" UBYTE I_1 1 2 0 255 MATRIX_DIM 4 1 1 ECU_ADDRESS 0x0 /end MEASUREMENT
/begin MEASUREMENT EAS_au8ParmRN32[0] "EAS_au8ParmRN32[0]" UBYTE I_1 1 2 0 255 ECU_ADDRESS 0x0 /end MEASUREMENT
/begin MEASUREMENT EAS_au8ParmRN32[1] "EAS_au8ParmRN32[1]" UBYTE I_1 1 2 0 255 ECU_ADDRESS 0x0 /end MEASUREMENT
/begin MEASUREMENT EAS_au8ParmRN32[2] "EAS_au8ParmRN32[2]" UBYTE I_1 1 2 0 255 ECU_ADDRESS 0x0 /end MEASUREMENT
/begin MEASUREMENT EAS_au8ParmRN32[3] "EAS_au8ParmRN32[3]" UBYTE I_1 1 2 0 255 ECU_ADDRESS 0x0 /end MEASUREMENT
/begin MEASUREMENT EAS_au8ParmSC32Nvm "EAS_au8ParmSC32Nvm" UBYTE I_1 1 2 0 255 MATRIX_DIM 4 1 1 ECU_ADDRESS 0x0 /end MEASUREMENT
/begin MEASUREMENT EAS_au8ParmSC32Nvm[0] "EAS_au8ParmSC32Nvm[0]" UBYTE I_1 1 2 0 255 ECU_ADDRESS 0x0 /end MEASUREMENT
/begin MEASUREMENT EAS_au8ParmSC32Nvm[1] "EAS_au8ParmSC32Nvm[1]" UBYTE I_1 1 2 0 255 ECU_ADDRESS 0x0 /end MEASUREMENT
/begin MEASUREMENT EAS_au8ParmSC32Nvm[2] "EAS_au8ParmSC32Nvm[2]" UBYTE I_1 1 2 0 255 ECU_ADDRESS 0x0 /end MEASUREMENT
/begin MEASUREMENT EAS_au8ParmSC32Nvm[3] "EAS_au8ParmSC32Nvm[3]" UBYTE I_1 1 2 0 255 ECU_ADDRESS 0x0 /end MEASUREMENT
/begin MEASUREMENT EAS_au8ParmSK128Nvm "EAS_au8ParmSK128Nvm" UBYTE I_1 1 2 0 255 MATRIX_DIM 16 1 1 ECU_ADDRESS 0x0 /end MEASUREMENT
/begin MEASUREMENT EAS_au8ParmSK128Nvm[0] "EAS_au8ParmSK128Nvm[0]" UBYTE I_1 1 2 0 255 ECU_ADDRESS 0x0 /end MEASUREMENT
/begin MEASUREMENT EAS_au8ParmSK128Nvm[10] "EAS_au8ParmSK128Nvm[10]" UBYTE I_1 1 2 0 255 ECU_ADDRESS 0x0 /end MEASUREMENT
/begin MEASUREMENT EAS_au8ParmSK128Nvm[11] "EAS_au8ParmSK128Nvm[11]" UBYTE I_1 1 2 0 255 ECU_ADDRESS 0x0 /end MEASUREMENT
/begin MEASUREMENT EAS_au8ParmSK128Nvm[12] "EAS_au8ParmSK128Nvm[12]" UBYTE I_1 1 2 0 255 ECU_ADDRESS 0x0 /end MEASUREMENT
/begin MEASUREMENT EAS_au8ParmSK128Nvm[13] "EAS_au8ParmSK128Nvm[13]" UBYTE I_1 1 2 0 255 ECU_ADDRESS 0x0 /end MEASUREMENT
/begin MEASUREMENT EAS_au8ParmSK128Nvm[14] "EAS_au8ParmSK128Nvm[14]" UBYTE I_1 1 2 0 255 ECU_ADDRESS 0x0 /end MEASUREMENT
/begin MEASUREMENT EAS_au8ParmSK128Nvm[15] "EAS_au8ParmSK128Nvm[15]" UBYTE I_1 1 2 0 255 ECU_ADDRESS 0x0 /end MEASUREMENT
/begin MEASUREMENT EAS_au8ParmSK128Nvm[1] "EAS_au8ParmSK128Nvm[1]" UBYTE I_1 1 2 0 255 ECU_ADDRESS 0x0 /end MEASUREMENT
/begin MEASUREMENT EAS_au8ParmSK128Nvm[2] "EAS_au8ParmSK128Nvm[2]" UBYTE I_1 1 2 0 255 ECU_ADDRESS 0x0 /end MEASUREMENT
/begin MEASUREMENT EAS_au8ParmSK128Nvm[3] "EAS_au8ParmSK128Nvm[3]" UBYTE I_1 1 2 0 255 ECU_ADDRESS 0x0 /end MEASUREMENT
/begin MEASUREMENT EAS_au8ParmSK128Nvm[4] "EAS_au8ParmSK128Nvm[4]" UBYTE I_1 1 2 0 255 ECU_ADDRESS 0x0 /end MEASUREMENT
/begin MEASUREMENT EAS_au8ParmSK128Nvm[5] "EAS_au8ParmSK128Nvm[5]" UBYTE I_1 1 2 0 255 ECU_ADDRESS 0x0 /end MEASUREMENT
/begin MEASUREMENT EAS_au8ParmSK128Nvm[6] "EAS_au8ParmSK128Nvm[6]" UBYTE I_1 1 2 0 255 ECU_ADDRESS 0x0 /end MEASUREMENT
/begin MEASUREMENT EAS_au8ParmSK128Nvm[7] "EAS_au8ParmSK128Nvm[7]" UBYTE I_1 1 2 0 255 ECU_ADDRESS 0x0 /end MEASUREMENT
/begin MEASUREMENT EAS_au8ParmSK128Nvm[8] "EAS_au8ParmSK128Nvm[8]" UBYTE I_1 1 2 0 255 ECU_ADDRESS 0x0 /end MEASUREMENT
/begin MEASUREMENT EAS_au8ParmSK128Nvm[9] "EAS_au8ParmSK128Nvm[9]" UBYTE I_1 1 2 0 255 ECU_ADDRESS 0x0 /end MEASUREMENT
/begin MEASUREMENT EAS_bAesVerifyRes "..." UBYTE Bool_ON_OFF 1 2 0 1 BIT_MASK 0x01 ECU_ADDRESS 0x0 /end MEASUREMENT
/begin MEASUREMENT EAS_bDefaultEskFlg "..." UBYTE Bool_ON_OFF 1 2 0 1 BIT_MASK 0x01 ECU_ADDRESS 0x0 /end MEASUREMENT
/begin MEASUREMENT EAS_bImmoCodRcvFlg "..." UBYTE Bool_ON_OFF 1 2 0 1 BIT_MASK 0x01 ECU_ADDRESS 0x0 /end MEASUREMENT
/begin MEASUREMENT EAS_bSendNewChalgFlg "..." UBYTE Bool_ON_OFF 1 2 0 1 BIT_MASK 0x01 ECU_ADDRESS 0x0 /end MEASUREMENT
/begin MEASUREMENT EAS_u8AuthFailedCnt "." UBYTE I_1 1 2 0 255 ECU_ADDRESS 0x0 /end MEASUREMENT
/begin MEASUREMENT EAS_u8AuthState "." UBYTE I_1 1 2 0 255 ECU_ADDRESS 0x0 /end MEASUREMENT
/begin MEASUREMENT EAS_u8AuthVerifyCnt "." UBYTE I_1 1 2 0 255 ECU_ADDRESS 0x0 /end MEASUREMENT
/begin MEASUREMENT EAS_u8Chg1DelayCnt "." UBYTE I_1 1 2 0 255 ECU_ADDRESS 0x0 /end MEASUREMENT
/begin MEASUREMENT EAS_u8ImmFailReason "." UBYTE I_1 1 2 0 255 ECU_ADDRESS 0x0 /end MEASUREMENT
/begin MEASUREMENT EAS_u8SttTimerCnt "." UBYTE I_1 1 2 0 255 ECU_ADDRESS 0x0 /end MEASUREMENT
/begin MEASUREMENT EAS_u8TMReleaseSig "..." UBYTE I_1 1 2 0 255 ECU_ADDRESS 0x0 /end MEASUREMENT
/begin MEASUREMENT ESM_EcuState "ESM_EcuState" UBYTE I_1 1 2 0 255 ECU_ADDRESS 0x0 /end MEASUREMENT
/begin MEASUREMENT ESM_OPERATIONAL_MODE "ESM_OPERATIONAL_MODE" UBYTE Bool_ON_OFF 1 2 0 1 BIT_MASK 0x04 ECU_ADDRESS 0x0 /end MEASUREMENT
/begin MEASUREMENT ESM_POWERLATCH_MODE "ESM_POWERLATCH_MODE" UBYTE Bool_ON_OFF 1 2 0 1 BIT_MASK 0x08 ECU_ADDRESS 0x0 /end MEASUREMENT
/begin MEASUREMENT ESM_POWER_OFF_MODE "ESM_POWER_OFF_MODE" UBYTE Bool_ON_OFF 1 2 0 1 BIT_MASK 0x10 ECU_ADDRESS 0x0 /end MEASUREMENT
/begin MEASUREMENT ESM_STARTUP_II_MODE "ESM_STARTUP_II_MODE" UBYTE Bool_ON_OFF 1 2 0 1 BIT_MASK 0x02 ECU_ADDRESS 0x0 /end MEASUREMENT
/begin MEASUREMENT ESM_STARTUP_I_MODE "ESM_STARTUP_I_MODE" UBYTE Bool_ON_OFF 1 2 0 1 BIT_MASK 0x01 ECU_ADDRESS 0x0 /end MEASUREMENT
/begin MEASUREMENT ESM_u16PowerLatchTempo "ESM_u16PowerLatchTempo" UWORD F_5_p0_30 1 2 0 327675 ECU_ADDRESS 0x0 /end MEASUREMENT
/begin MEASUREMENT FAIL_bCanErrChkDisabled "Indicates if CAN error check is disabled" UBYTE Bool_ON_OFF 1 2 0 1 BIT_MASK 0x01 ECU_ADDRESS 0x0 /end MEASUREMENT
/begin MEASUREMENT FAIL_bComLostDiagTEna "Indicates if external CAN communication started" UBYTE Bool_ON_OFF 1 2 0 1 BIT_MASK 0x01 ECU_ADDRESS 0x0 /end MEASUREMENT
/begin MEASUREMENT FAIL_bComLostDiagVEna "Indicates if external CAN communication started" UBYTE Bool_ON_OFF 1 2 0 1 BIT_MASK 0x01 ECU_ADDRESS 0x0 /end MEASUREMENT
/begin MEASUREMENT FAIL_bComLostDiagVHigh "Indicates if external CAN communication started" UBYTE Bool_ON_OFF 1 2 0 1 BIT_MASK 0x01 ECU_ADDRESS 0x0 /end MEASUREMENT
/begin MEASUREMENT FAIL_bComLostDiagVLow "Indicates if external CAN communication started" UBYTE Bool_ON_OFF 1 2 0 1 BIT_MASK 0x01 ECU_ADDRESS 0x0 /end MEASUREMENT
/begin MEASUREMENT FAIL_bDebug1 "FAIL_bDebug1" UBYTE Bool_ON_OFF 1 2 0 1 BIT_MASK 0x01 ECU_ADDRESS 0x0 /end MEASUREMENT
/begin MEASUREMENT FAIL_bRstHotFlag "Detection power off without OS TASK_POWER_DOWN activation" UBYTE Bool_ON_OFF 1 2 0 1 BIT_MASK 0x01 ECU_ADDRESS 0x0 /end MEASUREMENT
/begin MEASUREMENT FAIL_bRstHotFlagNvm "Flag to detect power off without OS TASK_POWER_DOWN activation (stored into NVM)" UBYTE Bool_ON_OFF 1 2 0 1 BIT_MASK 0x01 ECU_ADDRESS 0x0 /end MEASUREMENT
/begin MEASUREMENT FAIL_bRstHotFlagNvm_def "Flag to detect power off without OS TASK_POWER_DOWN activation (stored into NVM)" UBYTE Bool_ON_OFF 1 2 0 1 BIT_MASK 0x01 ECU_ADDRESS 0x0 /end MEASUREMENT
/begin MEASUREMENT FAIL_u16ComLostDiagEnaCnt "ECU communication lost detection delay count" UWORD F_10_p0_6 1 2 0 655350 ECU_ADDRESS 0x0 /end MEASUREMENT
/begin MEASUREMENT FAIL_u16ComLostDiagVRecCnt "ECU communication lost detection delay count" UWORD F_10_p0_6 1 2 0 655350 ECU_ADDRESS 0x0 /end MEASUREMENT
/begin MEASUREMENT FAIL_u16KeyOnDelay "..." UWORD Id_0x00 1 2 0 65535 ECU_ADDRESS 0x0 /end MEASUREMENT
/begin MEASUREMENT FAIL_u16KeyOnValue "ECU communication lost detection delay count" UWORD I_1 1 2 0 65535 ECU_ADDRESS 0x0 /end MEASUREMENT
/begin MEASUREMENT FAIL_u16LvBatVoltRaw "ECU communication lost detection delay count" UWORD F_0v0128205128_p0_31 1 2 0 840.1923077 ECU_ADDRESS 0x0 /end MEASUREMENT
/begin MEASUREMENT FAIL_u16RstHotCntNvm "Number of detection power off without OS TASK_POWER_DOWN activation (stored into NVM)" UWORD I_1 1 2 0 65535 ECU_ADDRESS 0x0 /end MEASUREMENT
/begin MEASUREMENT FAIL_u16RstHotCntNvm_def "Number of detection power off without OS TASK_POWER_DOWN activation (stored into NVM)" UWORD I_1 1 2 0 65535 ECU_ADDRESS 0x0 /end MEASUREMENT
/begin MEASUREMENT FAIL_u16RstStartUpCntNvm "Number of power off detected with OS TASK_POWER_DOWN activation (stored into NVM)" UWORD I_1 1 2 0 65535 ECU_ADDRESS 0x0 /end MEASUREMENT
/begin MEASUREMENT FAIL_u16RstStartUpCntNvm_def "Number of power off detected with OS TASK_POWER_DOWN activation (stored into NVM)" UWORD I_1 1 2 0 65535 ECU_ADDRESS 0x0 /end MEASUREMENT
/begin MEASUREMENT FAIL_u16TimestampIgnNvm "Inverter Ignition time stamp (s)" UWORD I_1 1 2 0 65535 ECU_ADDRESS 0x0 /end MEASUREMENT
/begin MEASUREMENT FAIL_u16TimestampIgnNvm_def "Inverter Ignition time stamp (s)" UWORD I_1 1 2 0 65535 ECU_ADDRESS 0x0 /end MEASUREMENT
/begin MEASUREMENT FAIL_u32TimestampLifeNvm "Inverter life time stamp (s)" ULONG I_1 1 2 0 4294967295 ECU_ADDRESS 0x0 /end MEASUREMENT
/begin MEASUREMENT FAIL_u32TimestampLifeNvm_def "Inverter life time stamp (s)" ULONG I_1 1 2 0 4294967295 ECU_ADDRESS 0x0 /end MEASUREMENT
/begin MEASUREMENT FAIL_u8CCP_FaultLevel "..." UBYTE I_1 1 2 0 255 ECU_ADDRESS 0x0 /end MEASUREMENT
/begin MEASUREMENT FAIL_u8Can1BusoffCnt "FAIL_u8Can1BusoffCnt" UBYTE Bool_ON_OFF 1 2 0 1 BIT_MASK 0x01 ECU_ADDRESS 0x0 /end MEASUREMENT
/begin MEASUREMENT FaultBSW_COM_BusOff_CAN1Aut "FaultBSW_COM_BusOff_CAN1Aut" UBYTE Bool_ON_OFF 1 2 0 1 BIT_MASK 0x01 ECU_ADDRESS 0x0 /end MEASUREMENT
/begin MEASUREMENT FaultBSW_COM_BusOff_CAN1Counter "FaultBSW_COM_BusOff_CAN1Count" UBYTE I_1 1 2 0 255 ECU_ADDRESS 0xFFFFFFE0 /end MEASUREMENT
/begin MEASUREMENT FaultBSW_COM_BusOff_CAN1Detected "FaultBSW_COM_BusOff_CAN1Detected" UBYTE Bool_ON_OFF 1 2 0 1 BIT_MASK 0x01 ECU_ADDRESS 0x0 /end MEASUREMENT
/begin MEASUREMENT FaultBSW_COM_BusOff_CAN1Logged "FaultBSW_COM_BusOff_CAN1Logged" UBYTE Bool_ON_OFF 1 2 0 1 BIT_MASK 0x01 ECU_ADDRESS 0x0 /end MEASUREMENT
/begin MEASUREMENT FaultBSW_COM_ChecksumErrVCUAut "FaultBSW_COM_ChecksumErrVCUAut" UBYTE Bool_ON_OFF 1 2 0 1 BIT_MASK 0x02 ECU_ADDRESS 0x0 /end MEASUREMENT
/begin MEASUREMENT FaultBSW_COM_ChecksumErrVCUCounter "FaultBSW_COM_ChecksumErrVCUCount" UBYTE I_1 1 2 0 255 ECU_ADDRESS 0xFFFFFFE1 /end MEASUREMENT
/begin MEASUREMENT FaultBSW_COM_ChecksumErrVCUDetected "FaultBSW_COM_ChecksumErrVCUDetected" UBYTE Bool_ON_OFF 1 2 0 1 BIT_MASK 0x02 ECU_ADDRESS 0x0 /end MEASUREMENT
/begin MEASUREMENT FaultBSW_COM_ChecksumErrVCULogged "FaultBSW_COM_ChecksumErrVCULogged" UBYTE Bool_ON_OFF 1 2 0 1 BIT_MASK 0x02 ECU_ADDRESS 0x0 /end MEASUREMENT
/begin MEASUREMENT FaultBSW_COM_Detected "FaultBSW_COM_Detected" UWORD I_1 1 2 0 65535 ECU_ADDRESS 0x0 /end MEASUREMENT
/begin MEASUREMENT FaultBSW_COM_InterFaultVCUAut "FaultBSW_COM_InterFaultVCUAut" UBYTE Bool_ON_OFF 1 2 0 1 BIT_MASK 0x04 ECU_ADDRESS 0x0 /end MEASUREMENT
/begin MEASUREMENT FaultBSW_COM_InterFaultVCUCounter "FaultBSW_COM_InterFaultVCUCount" UBYTE I_1 1 2 0 255 ECU_ADDRESS 0xFFFFFFE2 /end MEASUREMENT
/begin MEASUREMENT FaultBSW_COM_InterFaultVCUDetected "FaultBSW_COM_InterFaultVCUDetected" UBYTE Bool_ON_OFF 1 2 0 1 BIT_MASK 0x04 ECU_ADDRESS 0x0 /end MEASUREMENT
/begin MEASUREMENT FaultBSW_COM_InterFaultVCULogged "FaultBSW_COM_InterFaultVCULogged" UBYTE Bool_ON_OFF 1 2 0 1 BIT_MASK 0x04 ECU_ADDRESS 0x0 /end MEASUREMENT
/begin MEASUREMENT FaultBSW_COM_Logged "FaultBSW_COM_Logged" UWORD I_1 1 2 0 65535 ECU_ADDRESS 0x0 /end MEASUREMENT
/begin MEASUREMENT FaultBSW_COM_RollCntErrVCUAut "FaultBSW_COM_RollCntErrVCUAut" UBYTE Bool_ON_OFF 1 2 0 1 BIT_MASK 0x08 ECU_ADDRESS 0x0 /end MEASUREMENT
/begin MEASUREMENT FaultBSW_COM_RollCntErrVCUCounter "FaultBSW_COM_RollCntErrVCUCount" UBYTE I_1 1 2 0 255 ECU_ADDRESS 0xFFFFFFE3 /end MEASUREMENT
/begin MEASUREMENT FaultBSW_COM_RollCntErrVCUDetected "FaultBSW_COM_RollCntErrVCUDetected" UBYTE Bool_ON_OFF 1 2 0 1 BIT_MASK 0x08 ECU_ADDRESS 0x0 /end MEASUREMENT
/begin MEASUREMENT FaultBSW_COM_RollCntErrVCULogged "FaultBSW_COM_RollCntErrVCULogged" UBYTE Bool_ON_OFF 1 2 0 1 BIT_MASK 0x08 ECU_ADDRESS 0x0 /end MEASUREMENT
/begin MEASUREMENT FaultBSW_COM_TimoutRxBCMAut "FaultBSW_COM_TimoutRxBCMAut" UBYTE Bool_ON_OFF 1 2 0 1 BIT_MASK 0x10 ECU_ADDRESS 0x0 /end MEASUREMENT
/begin MEASUREMENT FaultBSW_COM_TimoutRxBCMCounter "FaultBSW_COM_TimoutRxBCMCount" UBYTE I_1 1 2 0 255 ECU_ADDRESS 0xFFFFFFE4 /end MEASUREMENT
/begin MEASUREMENT FaultBSW_COM_TimoutRxBCMDetected "FaultBSW_COM_TimoutRxBCMDetected" UBYTE Bool_ON_OFF 1 2 0 1 BIT_MASK 0x10 ECU_ADDRESS 0x0 /end MEASUREMENT
/begin MEASUREMENT FaultBSW_COM_TimoutRxBCMLogged "FaultBSW_COM_TimoutRxBCMLogged" UBYTE Bool_ON_OFF 1 2 0 1 BIT_MASK 0x10 ECU_ADDRESS 0x0 /end MEASUREMENT
/begin MEASUREMENT FaultBSW_COM_TimoutRxBMSHAut "FaultBSW_COM_TimoutRxBMSHAut" UBYTE Bool_ON_OFF 1 2 0 1 BIT_MASK 0x20 ECU_ADDRESS 0x0 /end MEASUREMENT
/begin MEASUREMENT FaultBSW_COM_TimoutRxBMSHCounter "FaultBSW_COM_TimoutRxBMSHCount" UBYTE I_1 1 2 0 255 ECU_ADDRESS 0xFFFFFFE5 /end MEASUREMENT
/begin MEASUREMENT FaultBSW_COM_TimoutRxBMSHDetected "FaultBSW_COM_TimoutRxBMSHDetected" UBYTE Bool_ON_OFF 1 2 0 1 BIT_MASK 0x20 ECU_ADDRESS 0x0 /end MEASUREMENT
/begin MEASUREMENT FaultBSW_COM_TimoutRxBMSHLogged "FaultBSW_COM_TimoutRxBMSHLogged" UBYTE Bool_ON_OFF 1 2 0 1 BIT_MASK 0x20 ECU_ADDRESS 0x0 /end MEASUREMENT
/begin MEASUREMENT FaultBSW_COM_TimoutRxEMSAut "FaultBSW_COM_TimoutRxEMSAut" UBYTE Bool_ON_OFF 1 2 0 1 BIT_MASK 0x40 ECU_ADDRESS 0x0 /end MEASUREMENT
/begin MEASUREMENT FaultBSW_COM_TimoutRxEMSCounter "FaultBSW_COM_TimoutRxEMSCount" UBYTE I_1 1 2 0 255 ECU_ADDRESS 0xFFFFFFE6 /end MEASUREMENT
/begin MEASUREMENT FaultBSW_COM_TimoutRxEMSDetected "FaultBSW_COM_TimoutRxEMSDetected" UBYTE Bool_ON_OFF 1 2 0 1 BIT_MASK 0x40 ECU_ADDRESS 0x0 /end MEASUREMENT
/begin MEASUREMENT FaultBSW_COM_TimoutRxEMSLogged "FaultBSW_COM_TimoutRxEMSLogged" UBYTE Bool_ON_OFF 1 2 0 1 BIT_MASK 0x40 ECU_ADDRESS 0x0 /end MEASUREMENT
/begin MEASUREMENT FaultBSW_COM_TimoutRxGCUAut "FaultBSW_COM_TimoutRxGCUAut" UBYTE Bool_ON_OFF 1 2 0 1 BIT_MASK 0x80 ECU_ADDRESS 0x0 /end MEASUREMENT
/begin MEASUREMENT FaultBSW_COM_TimoutRxGCUCounter "FaultBSW_COM_TimoutRxGCUCount" UBYTE I_1 1 2 0 255 ECU_ADDRESS 0xFFFFFFE7 /end MEASUREMENT
/begin MEASUREMENT FaultBSW_COM_TimoutRxGCUDetected "FaultBSW_COM_TimoutRxGCUDetected" UBYTE Bool_ON_OFF 1 2 0 1 BIT_MASK 0x80 ECU_ADDRESS 0x0 /end MEASUREMENT
/begin MEASUREMENT FaultBSW_COM_TimoutRxGCULogged "FaultBSW_COM_TimoutRxGCULogged" UBYTE Bool_ON_OFF 1 2 0 1 BIT_MASK 0x80 ECU_ADDRESS 0x0 /end MEASUREMENT
/begin MEASUREMENT FaultBSW_COM_TimoutRxIPCAut "FaultBSW_COM_TimoutRxIPCAut" UBYTE Bool_ON_OFF 1 2 0 1 BIT_MASK 0x01 ECU_ADDRESS 0x1 /end MEASUREMENT
/begin MEASUREMENT FaultBSW_COM_TimoutRxIPCCounter "FaultBSW_COM_TimoutRxIPCCount" UBYTE I_1 1 2 0 255 ECU_ADDRESS 0xFFFFFFE8 /end MEASUREMENT
/begin MEASUREMENT FaultBSW_COM_TimoutRxIPCDetected "FaultBSW_COM_TimoutRxIPCDetected" UBYTE Bool_ON_OFF 1 2 0 1 BIT_MASK 0x01 ECU_ADDRESS 0x1 /end MEASUREMENT
/begin MEASUREMENT FaultBSW_COM_TimoutRxIPCLogged "FaultBSW_COM_TimoutRxIPCLogged" UBYTE Bool_ON_OFF 1 2 0 1 BIT_MASK 0x01 ECU_ADDRESS 0x1 /end MEASUREMENT
/begin MEASUREMENT FaultBSW_COM_TimoutRxTBOXAut "FaultBSW_COM_TimoutRxTBOXAut" UBYTE Bool_ON_OFF 1 2 0 1 BIT_MASK 0x02 ECU_ADDRESS 0x1 /end MEASUREMENT
/begin MEASUREMENT FaultBSW_COM_TimoutRxTBOXCounter "FaultBSW_COM_TimoutRxTBOXCount" UBYTE I_1 1 2 0 255 ECU_ADDRESS 0xFFFFFFE9 /end MEASUREMENT
/begin MEASUREMENT FaultBSW_COM_TimoutRxTBOXDetected "FaultBSW_COM_TimoutRxTBOXDetected" UBYTE Bool_ON_OFF 1 2 0 1 BIT_MASK 0x02 ECU_ADDRESS 0x1 /end MEASUREMENT
/begin MEASUREMENT FaultBSW_COM_TimoutRxTBOXLogged "FaultBSW_COM_TimoutRxTBOXLogged" UBYTE Bool_ON_OFF 1 2 0 1 BIT_MASK 0x02 ECU_ADDRESS 0x1 /end MEASUREMENT
/begin MEASUREMENT FaultBSW_COM_TimoutRxVCUAut "FaultBSW_COM_TimoutRxVCUAut" UBYTE Bool_ON_OFF 1 2 0 1 BIT_MASK 0x04 ECU_ADDRESS 0x1 /end MEASUREMENT
/begin MEASUREMENT FaultBSW_COM_TimoutRxVCUCounter "FaultBSW_COM_TimoutRxVCUCount" UBYTE I_1 1 2 0 255 ECU_ADDRESS 0xFFFFFFEA /end MEASUREMENT
/begin MEASUREMENT FaultBSW_COM_TimoutRxVCUDetected "FaultBSW_COM_TimoutRxVCUDetected" UBYTE Bool_ON_OFF 1 2 0 1 BIT_MASK 0x04 ECU_ADDRESS 0x1 /end MEASUREMENT
/begin MEASUREMENT FaultBSW_COM_TimoutRxVCULogged "FaultBSW_COM_TimoutRxVCULogged" UBYTE Bool_ON_OFF 1 2 0 1 BIT_MASK 0x04 ECU_ADDRESS 0x1 /end MEASUREMENT
/begin MEASUREMENT FaultBSW_HW2_Detected "FaultBSW_HW2_Detected" UWORD I_1 1 2 0 65535 ECU_ADDRESS 0x2 /end MEASUREMENT
/begin MEASUREMENT FaultBSW_HW2_FPGA_OverVoltVBatAut "FaultBSW_HW2_FPGA_OverVoltVBatAut" UBYTE Bool_ON_OFF 1 2 0 1 BIT_MASK 0x01 ECU_ADDRESS 0x2 /end MEASUREMENT
/begin MEASUREMENT FaultBSW_HW2_FPGA_OverVoltVBatCounter "FaultBSW_HW2_FPGA_OverVoltVBatCount" UBYTE I_1 1 2 0 255 ECU_ADDRESS 0xFFFFFFEB /end MEASUREMENT
/begin MEASUREMENT FaultBSW_HW2_FPGA_OverVoltVBatDetected "FaultBSW_HW2_FPGA_OverVoltVBatDetected" UBYTE Bool_ON_OFF 1 2 0 1 BIT_MASK 0x01 ECU_ADDRESS 0x2 /end MEASUREMENT
/begin MEASUREMENT FaultBSW_HW2_FPGA_OverVoltVBatLogged "FaultBSW_HW2_FPGA_OverVoltVBatLogged" UBYTE Bool_ON_OFF 1 2 0 1 BIT_MASK 0x01 ECU_ADDRESS 0x2 /end MEASUREMENT
/begin MEASUREMENT FaultBSW_HW2_Logged "FaultBSW_HW2_Logged" UWORD I_1 1 2 0 65535 ECU_ADDRESS 0x2 /end MEASUREMENT
/begin MEASUREMENT FaultBSW_HW2_SafeTlib_PreRunAut "FaultBSW_HW2_SafeTlib_PreRunAut" UBYTE Bool_ON_OFF 1 2 0 1 BIT_MASK 0x02 ECU_ADDRESS 0x2 /end MEASUREMENT
/begin MEASUREMENT FaultBSW_HW2_SafeTlib_PreRunCounter "FaultBSW_HW2_SafeTlib_PreRunCount" UBYTE I_1 1 2 0 255 ECU_ADDRESS 0xFFFFFFEC /end MEASUREMENT
/begin MEASUREMENT FaultBSW_HW2_SafeTlib_PreRunDetected "FaultBSW_HW2_SafeTlib_PreRunDetected" UBYTE Bool_ON_OFF 1 2 0 1 BIT_MASK 0x02 ECU_ADDRESS 0x2 /end MEASUREMENT
/begin MEASUREMENT FaultBSW_HW2_SafeTlib_PreRunLogged "FaultBSW_HW2_SafeTlib_PreRunLogged" UBYTE Bool_ON_OFF 1 2 0 1 BIT_MASK 0x02 ECU_ADDRESS 0x2 /end MEASUREMENT
/begin MEASUREMENT FaultBSW_HW_Detected "FaultBSW_HW_Detected" UWORD I_1 1 2 0 65535 ECU_ADDRESS 0x4 /end MEASUREMENT
/begin MEASUREMENT FaultBSW_HW_EasAckFailAut "FaultBSW_HW_EasAckFailAut" UBYTE Bool_ON_OFF 1 2 0 1 BIT_MASK 0x01 ECU_ADDRESS 0x4 /end MEASUREMENT
/begin MEASUREMENT FaultBSW_HW_EasAckFailCounter "FaultBSW_HW_EasAckFailCount" UBYTE I_1 1 2 0 255 ECU_ADDRESS 0xFFFFFFED /end MEASUREMENT
/begin MEASUREMENT FaultBSW_HW_EasAckFailDetected "FaultBSW_HW_EasAckFailDetected" UBYTE Bool_ON_OFF 1 2 0 1 BIT_MASK 0x01 ECU_ADDRESS 0x4 /end MEASUREMENT
/begin MEASUREMENT FaultBSW_HW_EasAckFailLogged "FaultBSW_HW_EasAckFailLogged" UBYTE Bool_ON_OFF 1 2 0 1 BIT_MASK 0x01 ECU_ADDRESS 0x4 /end MEASUREMENT
/begin MEASUREMENT FaultBSW_HW_FPGA_IGBT_HAut "FaultBSW_HW_FPGA_IGBT_HAut" UBYTE Bool_ON_OFF 1 2 0 1 BIT_MASK 0x02 ECU_ADDRESS 0x4 /end MEASUREMENT
/begin MEASUREMENT FaultBSW_HW_FPGA_IGBT_HCounter "FaultBSW_HW_FPGA_IGBT_HCount" UBYTE I_1 1 2 0 255 ECU_ADDRESS 0xFFFFFFEE /end MEASUREMENT
/begin MEASUREMENT FaultBSW_HW_FPGA_IGBT_HDetected "FaultBSW_HW_FPGA_IGBT_HDetected" UBYTE Bool_ON_OFF 1 2 0 1 BIT_MASK 0x02 ECU_ADDRESS 0x4 /end MEASUREMENT
/begin MEASUREMENT FaultBSW_HW_FPGA_IGBT_HLogged "FaultBSW_HW_FPGA_IGBT_HLogged" UBYTE Bool_ON_OFF 1 2 0 1 BIT_MASK 0x02 ECU_ADDRESS 0x4 /end MEASUREMENT
/begin MEASUREMENT FaultBSW_HW_FPGA_IGBT_LAut "FaultBSW_HW_FPGA_IGBT_LAut" UBYTE Bool_ON_OFF 1 2 0 1 BIT_MASK 0x04 ECU_ADDRESS 0x4 /end MEASUREMENT
/begin MEASUREMENT FaultBSW_HW_FPGA_IGBT_LCounter "FaultBSW_HW_FPGA_IGBT_LCount" UBYTE I_1 1 2 0 255 ECU_ADDRESS 0xFFFFFFEF /end MEASUREMENT
/begin MEASUREMENT FaultBSW_HW_FPGA_IGBT_LDetected "FaultBSW_HW_FPGA_IGBT_LDetected" UBYTE Bool_ON_OFF 1 2 0 1 BIT_MASK 0x04 ECU_ADDRESS 0x4 /end MEASUREMENT
/begin MEASUREMENT FaultBSW_HW_FPGA_IGBT_LLogged "FaultBSW_HW_FPGA_IGBT_LLogged" UBYTE Bool_ON_OFF 1 2 0 1 BIT_MASK 0x04 ECU_ADDRESS 0x4 /end MEASUREMENT
/begin MEASUREMENT FaultBSW_HW_FPGA_OverUnderCurUIAut "FaultBSW_HW_FPGA_OverUnderCurUIAut" UBYTE Bool_ON_OFF 1 2 0 1 BIT_MASK 0x08 ECU_ADDRESS 0x4 /end MEASUREMENT
/begin MEASUREMENT FaultBSW_HW_FPGA_OverUnderCurUICounter "FaultBSW_HW_FPGA_OverUnderCurUICount" UBYTE I_1 1 2 0 255 ECU_ADDRESS 0xFFFFFFF0 /end MEASUREMENT
/begin MEASUREMENT FaultBSW_HW_FPGA_OverUnderCurUIDetected "FaultBSW_HW_FPGA_OverUnderCurUIDetected" UBYTE Bool_ON_OFF 1 2 0 1 BIT_MASK 0x08 ECU_ADDRESS 0x4 /end MEASUREMENT
/begin MEASUREMENT FaultBSW_HW_FPGA_OverUnderCurUILogged "FaultBSW_HW_FPGA_OverUnderCurUILogged" UBYTE Bool_ON_OFF 1 2 0 1 BIT_MASK 0x08 ECU_ADDRESS 0x4 /end MEASUREMENT
/begin MEASUREMENT FaultBSW_HW_FPGA_OverUnderCurVIAut "FaultBSW_HW_FPGA_OverUnderCurVIAut" UBYTE Bool_ON_OFF 1 2 0 1 BIT_MASK 0x10 ECU_ADDRESS 0x4 /end MEASUREMENT
/begin MEASUREMENT FaultBSW_HW_FPGA_OverUnderCurVICounter "FaultBSW_HW_FPGA_OverUnderCurVICount" UBYTE I_1 1 2 0 255 ECU_ADDRESS 0xFFFFFFF1 /end MEASUREMENT
/begin MEASUREMENT FaultBSW_HW_FPGA_OverUnderCurVIDetected "FaultBSW_HW_FPGA_OverUnderCurVIDetected" UBYTE Bool_ON_OFF 1 2 0 1 BIT_MASK 0x10 ECU_ADDRESS 0x4 /end MEASUREMENT
/begin MEASUREMENT FaultBSW_HW_FPGA_OverUnderCurVILogged "FaultBSW_HW_FPGA_OverUnderCurVILogged" UBYTE Bool_ON_OFF 1 2 0 1 BIT_MASK 0x10 ECU_ADDRESS 0x4 /end MEASUREMENT
/begin MEASUREMENT FaultBSW_HW_FPGA_OverUnderCurWIAut "FaultBSW_HW_FPGA_OverUnderCurWIAut" UBYTE Bool_ON_OFF 1 2 0 1 BIT_MASK 0x20 ECU_ADDRESS 0x4 /end MEASUREMENT
/begin MEASUREMENT FaultBSW_HW_FPGA_OverUnderCurWICounter "FaultBSW_HW_FPGA_OverUnderCurWICount" UBYTE I_1 1 2 0 255 ECU_ADDRESS 0xFFFFFFF2 /end MEASUREMENT
/begin MEASUREMENT FaultBSW_HW_FPGA_OverUnderCurWIDetected "FaultBSW_HW_FPGA_OverUnderCurWIDetected" UBYTE Bool_ON_OFF 1 2 0 1 BIT_MASK 0x20 ECU_ADDRESS 0x4 /end MEASUREMENT
/begin MEASUREMENT FaultBSW_HW_FPGA_OverUnderCurWILogged "FaultBSW_HW_FPGA_OverUnderCurWILogged" UBYTE Bool_ON_OFF 1 2 0 1 BIT_MASK 0x20 ECU_ADDRESS 0x4 /end MEASUREMENT
/begin MEASUREMENT FaultBSW_HW_Logged "FaultBSW_HW_Logged" UWORD I_1 1 2 0 65535 ECU_ADDRESS 0x4 /end MEASUREMENT
/begin MEASUREMENT FaultBSW_HW_OCDataNotRationalAut "FaultBSW_HW_OCDataNotRationalAut" UBYTE Bool_ON_OFF 1 2 0 1 BIT_MASK 0x40 ECU_ADDRESS 0x4 /end MEASUREMENT
/begin MEASUREMENT FaultBSW_HW_OCDataNotRationalCounter "FaultBSW_HW_OCDataNotRationalCount" UBYTE I_1 1 2 0 255 ECU_ADDRESS 0xFFFFFFF3 /end MEASUREMENT
/begin MEASUREMENT FaultBSW_HW_OCDataNotRationalDetected "FaultBSW_HW_OCDataNotRationalDetected" UBYTE Bool_ON_OFF 1 2 0 1 BIT_MASK 0x40 ECU_ADDRESS 0x4 /end MEASUREMENT
/begin MEASUREMENT FaultBSW_HW_OCDataNotRationalLogged "FaultBSW_HW_OCDataNotRationalLogged" UBYTE Bool_ON_OFF 1 2 0 1 BIT_MASK 0x40 ECU_ADDRESS 0x4 /end MEASUREMENT
/begin MEASUREMENT FaultBSW_SYS_Detected "FaultBSW_SYS_Detected" UWORD I_1 1 2 0 65535 ECU_ADDRESS 0x6 /end MEASUREMENT
/begin MEASUREMENT FaultBSW_SYS_Logged "FaultBSW_SYS_Logged" UWORD I_1 1 2 0 65535 ECU_ADDRESS 0x6 /end MEASUREMENT
/begin MEASUREMENT FaultBSW_SYS_RstHotAut "FaultBSW_SYS_RstHotAut" UBYTE Bool_ON_OFF 1 2 0 1 BIT_MASK 0x01 ECU_ADDRESS 0x6 /end MEASUREMENT
/begin MEASUREMENT FaultBSW_SYS_RstHotCounter "FaultBSW_SYS_RstHotCount" UBYTE I_1 1 2 0 255 ECU_ADDRESS 0xFFFFFFF4 /end MEASUREMENT
/begin MEASUREMENT FaultBSW_SYS_RstHotDetected "FaultBSW_SYS_RstHotDetected" UBYTE Bool_ON_OFF 1 2 0 1 BIT_MASK 0x01 ECU_ADDRESS 0x6 /end MEASUREMENT
/begin MEASUREMENT FaultBSW_SYS_RstHotLogged "FaultBSW_SYS_RstHotLogged" UBYTE Bool_ON_OFF 1 2 0 1 BIT_MASK 0x01 ECU_ADDRESS 0x6 /end MEASUREMENT
/begin MEASUREMENT FaultBSW_SYS_StackOverflowAut "FaultBSW_SYS_StackOverflowAut" UBYTE Bool_ON_OFF 1 2 0 1 BIT_MASK 0x02 ECU_ADDRESS 0x6 /end MEASUREMENT
/begin MEASUREMENT FaultBSW_SYS_StackOverflowCounter "FaultBSW_SYS_StackOverflowCount" UBYTE I_1 1 2 0 255 ECU_ADDRESS 0xFFFFFFF5 /end MEASUREMENT
/begin MEASUREMENT FaultBSW_SYS_StackOverflowDetected "FaultBSW_SYS_StackOverflowDetected" UBYTE Bool_ON_OFF 1 2 0 1 BIT_MASK 0x02 ECU_ADDRESS 0x6 /end MEASUREMENT
/begin MEASUREMENT FaultBSW_SYS_StackOverflowLogged "FaultBSW_SYS_StackOverflowLogged" UBYTE Bool_ON_OFF 1 2 0 1 BIT_MASK 0x02 ECU_ADDRESS 0x6 /end MEASUREMENT
/begin MEASUREMENT FaultBSW_VSI_Detected "FaultBSW_VSI_Detected" UWORD I_1 1 2 0 65535 ECU_ADDRESS 0x8 /end MEASUREMENT
/begin MEASUREMENT FaultBSW_VSI_Logged "FaultBSW_VSI_Logged" UWORD I_1 1 2 0 65535 ECU_ADDRESS 0x8 /end MEASUREMENT
/begin MEASUREMENT FaultBSW_VSI_TimeoutTCalcAut "FaultBSW_VSI_TimeoutTCalcAut" UBYTE Bool_ON_OFF 1 2 0 1 BIT_MASK 0x01 ECU_ADDRESS 0x8 /end MEASUREMENT
/begin MEASUREMENT FaultBSW_VSI_TimeoutTCalcCounter "FaultBSW_VSI_TimeoutTCalcCount" UBYTE I_1 1 2 0 255 ECU_ADDRESS 0xFFFFFFF6 /end MEASUREMENT
/begin MEASUREMENT FaultBSW_VSI_TimeoutTCalcDetected "FaultBSW_VSI_TimeoutTCalcDetected" UBYTE Bool_ON_OFF 1 2 0 1 BIT_MASK 0x01 ECU_ADDRESS 0x8 /end MEASUREMENT
/begin MEASUREMENT FaultBSW_VSI_TimeoutTCalcLogged "FaultBSW_VSI_TimeoutTCalcLogged" UBYTE Bool_ON_OFF 1 2 0 1 BIT_MASK 0x01 ECU_ADDRESS 0x8 /end MEASUREMENT
/begin MEASUREMENT FaultEraseRequest "FaultEraseRequest" UWORD I_1 1 2 0 65535 ECU_ADDRESS 0x0 /end MEASUREMENT
/begin MEASUREMENT FaultFSEVBHV_Detected "FaultFSEVBHV_Detected" UWORD I_1 1 2 0 65535 ECU_ADDRESS 0xA /end MEASUREMENT
/begin MEASUREMENT FaultFSEVBHV_Logged "FaultFSEVBHV_Logged" UWORD I_1 1 2 0 65535 ECU_ADDRESS 0xA /end MEASUREMENT
/begin MEASUREMENT FaultFSEVBHV_OverVoltageAut "FaultFSEVBHV_OverVoltageAut" UBYTE Bool_ON_OFF 1 2 0 1 BIT_MASK 0x01 ECU_ADDRESS 0xA /end MEASUREMENT
/begin MEASUREMENT FaultFSEVBHV_OverVoltageCounter "FaultFSEVBHV_OverVoltageCount" UBYTE I_1 1 2 0 255 ECU_ADDRESS 0xFFFFFFF7 /end MEASUREMENT
/begin MEASUREMENT FaultFSEVBHV_OverVoltageDetected "FaultFSEVBHV_OverVoltageDetected" UBYTE Bool_ON_OFF 1 2 0 1 BIT_MASK 0x01 ECU_ADDRESS 0xA /end MEASUREMENT
/begin MEASUREMENT FaultFSEVBHV_OverVoltageLogged "FaultFSEVBHV_OverVoltageLogged" UBYTE Bool_ON_OFF 1 2 0 1 BIT_MASK 0x01 ECU_ADDRESS 0xA /end MEASUREMENT
/begin MEASUREMENT FaultFSEVBHV_SampleVolOutRngHAut "FaultFSEVBHV_SampleVolOutRngHAut" UBYTE Bool_ON_OFF 1 2 0 1 BIT_MASK 0x02 ECU_ADDRESS 0xA /end MEASUREMENT
/begin MEASUREMENT FaultFSEVBHV_SampleVolOutRngHCounter "FaultFSEVBHV_SampleVolOutRngHCount" UBYTE I_1 1 2 0 255 ECU_ADDRESS 0xFFFFFFF8 /end MEASUREMENT
/begin MEASUREMENT FaultFSEVBHV_SampleVolOutRngHDetected "FaultFSEVBHV_SampleVolOutRngHDetected" UBYTE Bool_ON_OFF 1 2 0 1 BIT_MASK 0x02 ECU_ADDRESS 0xA /end MEASUREMENT
/begin MEASUREMENT FaultFSEVBHV_SampleVolOutRngHLogged "FaultFSEVBHV_SampleVolOutRngHLogged" UBYTE Bool_ON_OFF 1 2 0 1 BIT_MASK 0x02 ECU_ADDRESS 0xA /end MEASUREMENT
/begin MEASUREMENT FaultFSEVBHV_SampleVolOutRngLAut "FaultFSEVBHV_SampleVolOutRngLAut" UBYTE Bool_ON_OFF 1 2 0 1 BIT_MASK 0x04 ECU_ADDRESS 0xA /end MEASUREMENT
/begin MEASUREMENT FaultFSEVBHV_SampleVolOutRngLCounter "FaultFSEVBHV_SampleVolOutRngLCount" UBYTE I_1 1 2 0 255 ECU_ADDRESS 0xFFFFFFF9 /end MEASUREMENT
/begin MEASUREMENT FaultFSEVBHV_SampleVolOutRngLDetected "FaultFSEVBHV_SampleVolOutRngLDetected" UBYTE Bool_ON_OFF 1 2 0 1 BIT_MASK 0x04 ECU_ADDRESS 0xA /end MEASUREMENT
/begin MEASUREMENT FaultFSEVBHV_SampleVolOutRngLLogged "FaultFSEVBHV_SampleVolOutRngLLogged" UBYTE Bool_ON_OFF 1 2 0 1 BIT_MASK 0x04 ECU_ADDRESS 0xA /end MEASUREMENT
/begin MEASUREMENT FaultFSEVBHV_UnderDetected "FaultFSEVBHV_UnderDetected" UWORD I_1 1 2 0 65535 ECU_ADDRESS 0xC /end MEASUREMENT
/begin MEASUREMENT FaultFSEVBHV_UnderLogged "FaultFSEVBHV_UnderLogged" UWORD I_1 1 2 0 65535 ECU_ADDRESS 0xC /end MEASUREMENT
/begin MEASUREMENT FaultFSEVBHV_UnderVoltageAut "FaultFSEVBHV_UnderVoltageAut" UBYTE Bool_ON_OFF 1 2 0 1 BIT_MASK 0x08 ECU_ADDRESS 0xA /end MEASUREMENT
/begin MEASUREMENT FaultFSEVBHV_UnderVoltageCounter "FaultFSEVBHV_UnderVoltageCount" UBYTE I_1 1 2 0 255 ECU_ADDRESS 0xFFFFFFFA /end MEASUREMENT
/begin MEASUREMENT FaultFSEVBHV_UnderVoltageDetected "FaultFSEVBHV_UnderVoltageDetected" UBYTE Bool_ON_OFF 1 2 0 1 BIT_MASK 0x08 ECU_ADDRESS 0xA /end MEASUREMENT
/begin MEASUREMENT FaultFSEVBHV_UnderVoltageLogged "FaultFSEVBHV_UnderVoltageLogged" UBYTE Bool_ON_OFF 1 2 0 1 BIT_MASK 0x08 ECU_ADDRESS 0xA /end MEASUREMENT
/begin MEASUREMENT FaultFSEVBHV_UnderVoltageWarnAut "FaultFSEVBHV_UnderVoltageWarnAut" UBYTE Bool_ON_OFF 1 2 0 1 BIT_MASK 0x01 ECU_ADDRESS 0xC /end MEASUREMENT
/begin MEASUREMENT FaultFSEVBHV_UnderVoltageWarnCounter "FaultFSEVBHV_UnderVoltageWarnCount" UBYTE I_1 1 2 0 255 ECU_ADDRESS 0xFFFFFFFE /end MEASUREMENT
/begin MEASUREMENT FaultFSEVBHV_UnderVoltageWarnDetected "FaultFSEVBHV_UnderVoltageWarnDetected" UBYTE Bool_ON_OFF 1 2 0 1 BIT_MASK 0x01 ECU_ADDRESS 0xC /end MEASUREMENT
/begin MEASUREMENT FaultFSEVBHV_UnderVoltageWarnLogged "FaultFSEVBHV_UnderVoltageWarnLogged" UBYTE Bool_ON_OFF 1 2 0 1 BIT_MASK 0x01 ECU_ADDRESS 0xC /end MEASUREMENT
/begin MEASUREMENT FaultFSEVBHV_VolNotRationalAut "FaultFSEVBHV_VolNotRationalAut" UBYTE Bool_ON_OFF 1 2 0 1 BIT_MASK 0x10 ECU_ADDRESS 0xA /end MEASUREMENT
/begin MEASUREMENT FaultFSEVBHV_VolNotRationalCounter "FaultFSEVBHV_VolNotRationalCount" UBYTE I_1 1 2 0 255 ECU_ADDRESS 0xFFFFFFFB /end MEASUREMENT
/begin MEASUREMENT FaultFSEVBHV_VolNotRationalDetected "FaultFSEVBHV_VolNotRationalDetected" UBYTE Bool_ON_OFF 1 2 0 1 BIT_MASK 0x10 ECU_ADDRESS 0xA /end MEASUREMENT
/begin MEASUREMENT FaultFSEVBHV_VolNotRationalLogged "FaultFSEVBHV_VolNotRationalLogged" UBYTE Bool_ON_OFF 1 2 0 1 BIT_MASK 0x10 ECU_ADDRESS 0xA /end MEASUREMENT
/begin MEASUREMENT FaultFSEVBHV_VoltageGndAut "FaultFSEVBHV_VoltageGndAut" UBYTE Bool_ON_OFF 1 2 0 1 BIT_MASK 0x20 ECU_ADDRESS 0xA /end MEASUREMENT
/begin MEASUREMENT FaultFSEVBHV_VoltageGndCounter "FaultFSEVBHV_VoltageGndCount" UBYTE I_1 1 2 0 255 ECU_ADDRESS 0xFFFFFFFC /end MEASUREMENT
/begin MEASUREMENT FaultFSEVBHV_VoltageGndDetected "FaultFSEVBHV_VoltageGndDetected" UBYTE Bool_ON_OFF 1 2 0 1 BIT_MASK 0x20 ECU_ADDRESS 0xA /end MEASUREMENT
/begin MEASUREMENT FaultFSEVBHV_VoltageGndLogged "FaultFSEVBHV_VoltageGndLogged" UBYTE Bool_ON_OFF 1 2 0 1 BIT_MASK 0x20 ECU_ADDRESS 0xA /end MEASUREMENT
/begin MEASUREMENT FaultFSEVBHV_VoltageVccAut "FaultFSEVBHV_VoltageVccAut" UBYTE Bool_ON_OFF 1 2 0 1 BIT_MASK 0x40 ECU_ADDRESS 0xA /end MEASUREMENT
/begin MEASUREMENT FaultFSEVBHV_VoltageVccCounter "FaultFSEVBHV_VoltageVccCount" UBYTE I_1 1 2 0 255 ECU_ADDRESS 0xFFFFFFFD /end MEASUREMENT
/begin MEASUREMENT FaultFSEVBHV_VoltageVccDetected "FaultFSEVBHV_VoltageVccDetected" UBYTE Bool_ON_OFF 1 2 0 1 BIT_MASK 0x40 ECU_ADDRESS 0xA /end MEASUREMENT
/begin MEASUREMENT FaultFSEVBHV_VoltageVccLogged "FaultFSEVBHV_VoltageVccLogged" UBYTE Bool_ON_OFF 1 2 0 1 BIT_MASK 0x40 ECU_ADDRESS 0xA /end MEASUREMENT
/begin MEASUREMENT FaultFSEVBLV_Detected "FaultFSEVBLV_Detected" UWORD I_1 1 2 0 65535 ECU_ADDRESS 0xE /end MEASUREMENT
/begin MEASUREMENT FaultFSEVBLV_Logged "FaultFSEVBLV_Logged" UWORD I_1 1 2 0 65535 ECU_ADDRESS 0xE /end MEASUREMENT
/begin MEASUREMENT FaultFSEVBLV_OverVoltageAut "FaultFSEVBLV_OverVoltageAut" UBYTE Bool_ON_OFF 1 2 0 1 BIT_MASK 0x01 ECU_ADDRESS 0xE /end MEASUREMENT
/begin MEASUREMENT FaultFSEVBLV_OverVoltageCounter "FaultFSEVBLV_OverVoltageCount" UBYTE I_1 1 2 0 255 ECU_ADDRESS 0xFFFFFFFF /end MEASUREMENT
/begin MEASUREMENT FaultFSEVBLV_OverVoltageDetected "FaultFSEVBLV_OverVoltageDetected" UBYTE Bool_ON_OFF 1 2 0 1 BIT_MASK 0x01 ECU_ADDRESS 0xE /end MEASUREMENT
/begin MEASUREMENT FaultFSEVBLV_OverVoltageLogged "FaultFSEVBLV_OverVoltageLogged" UBYTE Bool_ON_OFF 1 2 0 1 BIT_MASK 0x01 ECU_ADDRESS 0xE /end MEASUREMENT
/begin MEASUREMENT FaultFSEVBLV_P5VRefADCFltAut "FaultFSEVBLV_P5VRefADCFltAut" UBYTE Bool_ON_OFF 1 2 0 1 BIT_MASK 0x02 ECU_ADDRESS 0xE /end MEASUREMENT
/begin MEASUREMENT FaultFSEVBLV_P5VRefADCFltCounter "FaultFSEVBLV_P5VRefADCFltCount" UBYTE I_1 1 2 0 255 ECU_ADDRESS 0x0 /end MEASUREMENT
/begin MEASUREMENT FaultFSEVBLV_P5VRefADCFltDetected "FaultFSEVBLV_P5VRefADCFltDetected" UBYTE Bool_ON_OFF 1 2 0 1 BIT_MASK 0x02 ECU_ADDRESS 0xE /end MEASUREMENT
/begin MEASUREMENT FaultFSEVBLV_P5VRefADCFltLogged "FaultFSEVBLV_P5VRefADCFltLogged" UBYTE Bool_ON_OFF 1 2 0 1 BIT_MASK 0x02 ECU_ADDRESS 0xE /end MEASUREMENT
/begin MEASUREMENT FaultFSEVBLV_UnderDetected "FaultFSEVBLV_UnderDetected" UWORD I_1 1 2 0 65535 ECU_ADDRESS 0x10 /end MEASUREMENT
/begin MEASUREMENT FaultFSEVBLV_UnderLogged "FaultFSEVBLV_UnderLogged" UWORD I_1 1 2 0 65535 ECU_ADDRESS 0x10 /end MEASUREMENT
/begin MEASUREMENT FaultFSEVBLV_UnderVoltageAut "FaultFSEVBLV_UnderVoltageAut" UBYTE Bool_ON_OFF 1 2 0 1 BIT_MASK 0x04 ECU_ADDRESS 0xE /end MEASUREMENT
/begin MEASUREMENT FaultFSEVBLV_UnderVoltageCounter "FaultFSEVBLV_UnderVoltageCount" UBYTE I_1 1 2 0 255 ECU_ADDRESS 0x1 /end MEASUREMENT
/begin MEASUREMENT FaultFSEVBLV_UnderVoltageDetected "FaultFSEVBLV_UnderVoltageDetected" UBYTE Bool_ON_OFF 1 2 0 1 BIT_MASK 0x04 ECU_ADDRESS 0xE /end MEASUREMENT
/begin MEASUREMENT FaultFSEVBLV_UnderVoltageLogged "FaultFSEVBLV_UnderVoltageLogged" UBYTE Bool_ON_OFF 1 2 0 1 BIT_MASK 0x04 ECU_ADDRESS 0xE /end MEASUREMENT
/begin MEASUREMENT FaultFSEVBLV_UnderVoltageWarnAut "FaultFSEVBLV_UnderVoltageWarnAut" UBYTE Bool_ON_OFF 1 2 0 1 BIT_MASK 0x01 ECU_ADDRESS 0x10 /end MEASUREMENT
/begin MEASUREMENT FaultFSEVBLV_UnderVoltageWarnCounter "FaultFSEVBLV_UnderVoltageWarnCount" UBYTE I_1 1 2 0 255 ECU_ADDRESS 0x4 /end MEASUREMENT
/begin MEASUREMENT FaultFSEVBLV_UnderVoltageWarnDetected "FaultFSEVBLV_UnderVoltageWarnDetected" UBYTE Bool_ON_OFF 1 2 0 1 BIT_MASK 0x01 ECU_ADDRESS 0x10 /end MEASUREMENT
/begin MEASUREMENT FaultFSEVBLV_UnderVoltageWarnLogged "FaultFSEVBLV_UnderVoltageWarnLogged" UBYTE Bool_ON_OFF 1 2 0 1 BIT_MASK 0x01 ECU_ADDRESS 0x10 /end MEASUREMENT
/begin MEASUREMENT FaultFSEVBLV_VoltageGndAut "FaultFSEVBLV_VoltageGndAut" UBYTE Bool_ON_OFF 1 2 0 1 BIT_MASK 0x08 ECU_ADDRESS 0xE /end MEASUREMENT
/begin MEASUREMENT FaultFSEVBLV_VoltageGndCounter "FaultFSEVBLV_VoltageGndCount" UBYTE I_1 1 2 0 255 ECU_ADDRESS 0x2 /end MEASUREMENT
/begin MEASUREMENT FaultFSEVBLV_VoltageGndDetected "FaultFSEVBLV_VoltageGndDetected" UBYTE Bool_ON_OFF 1 2 0 1 BIT_MASK 0x08 ECU_ADDRESS 0xE /end MEASUREMENT
/begin MEASUREMENT FaultFSEVBLV_VoltageGndLogged "FaultFSEVBLV_VoltageGndLogged" UBYTE Bool_ON_OFF 1 2 0 1 BIT_MASK 0x08 ECU_ADDRESS 0xE /end MEASUREMENT
/begin MEASUREMENT FaultFSEVBLV_VoltageVccAut "FaultFSEVBLV_VoltageVccAut" UBYTE Bool_ON_OFF 1 2 0 1 BIT_MASK 0x10 ECU_ADDRESS 0xE /end MEASUREMENT
/begin MEASUREMENT FaultFSEVBLV_VoltageVccCounter "FaultFSEVBLV_VoltageVccCount" UBYTE I_1 1 2 0 255 ECU_ADDRESS 0x3 /end MEASUREMENT
/begin MEASUREMENT FaultFSEVBLV_VoltageVccDetected "FaultFSEVBLV_VoltageVccDetected" UBYTE Bool_ON_OFF 1 2 0 1 BIT_MASK 0x10 ECU_ADDRESS 0xE /end MEASUREMENT
/begin MEASUREMENT FaultFSEVBLV_VoltageVccLogged "FaultFSEVBLV_VoltageVccLogged" UBYTE Bool_ON_OFF 1 2 0 1 BIT_MASK 0x10 ECU_ADDRESS 0xE /end MEASUREMENT
/begin MEASUREMENT FaultFSEVETA_Detected "FaultFSEVETA_Detected" UWORD I_1 1 2 0 65535 ECU_ADDRESS 0x12 /end MEASUREMENT
/begin MEASUREMENT FaultFSEVETA_DrvTempRationAut "FaultFSEVETA_DrvTempRationAut" UBYTE Bool_ON_OFF 1 2 0 1 BIT_MASK 0x01 ECU_ADDRESS 0x12 /end MEASUREMENT
/begin MEASUREMENT FaultFSEVETA_DrvTempRationCounter "FaultFSEVETA_DrvTempRationCount" UBYTE I_1 1 2 0 255 ECU_ADDRESS 0x5 /end MEASUREMENT
/begin MEASUREMENT FaultFSEVETA_DrvTempRationDetected "FaultFSEVETA_DrvTempRationDetected" UBYTE Bool_ON_OFF 1 2 0 1 BIT_MASK 0x01 ECU_ADDRESS 0x12 /end MEASUREMENT
/begin MEASUREMENT FaultFSEVETA_DrvTempRationLogged "FaultFSEVETA_DrvTempRationLogged" UBYTE Bool_ON_OFF 1 2 0 1 BIT_MASK 0x01 ECU_ADDRESS 0x12 /end MEASUREMENT
/begin MEASUREMENT FaultFSEVETA_IgbtTempRationalAut "FaultFSEVETA_IgbtTempRationalAut" UBYTE Bool_ON_OFF 1 2 0 1 BIT_MASK 0x02 ECU_ADDRESS 0x12 /end MEASUREMENT
/begin MEASUREMENT FaultFSEVETA_IgbtTempRationalCounter "FaultFSEVETA_IgbtTempRationalCount" UBYTE I_1 1 2 0 255 ECU_ADDRESS 0x6 /end MEASUREMENT
/begin MEASUREMENT FaultFSEVETA_IgbtTempRationalDetected "FaultFSEVETA_IgbtTempRationalDetected" UBYTE Bool_ON_OFF 1 2 0 1 BIT_MASK 0x02 ECU_ADDRESS 0x12 /end MEASUREMENT
/begin MEASUREMENT FaultFSEVETA_IgbtTempRationalLogged "FaultFSEVETA_IgbtTempRationalLogged" UBYTE Bool_ON_OFF 1 2 0 1 BIT_MASK 0x02 ECU_ADDRESS 0x12 /end MEASUREMENT
/begin MEASUREMENT FaultFSEVETA_Logged "FaultFSEVETA_Logged" UWORD I_1 1 2 0 65535 ECU_ADDRESS 0x12 /end MEASUREMENT
/begin MEASUREMENT FaultFSEVETA_OverDetected "FaultFSEVETA_OverDetected" UWORD I_1 1 2 0 65535 ECU_ADDRESS 0x14 /end MEASUREMENT
/begin MEASUREMENT FaultFSEVETA_OverLogged "FaultFSEVETA_OverLogged" UWORD I_1 1 2 0 65535 ECU_ADDRESS 0x14 /end MEASUREMENT
/begin MEASUREMENT FaultFSEVETA_OverTempDrvLeftAut "FaultFSEVETA_OverTempDrvLeftAut" UBYTE Bool_ON_OFF 1 2 0 1 BIT_MASK 0x01 ECU_ADDRESS 0x14 /end MEASUREMENT
/begin MEASUREMENT FaultFSEVETA_OverTempDrvLeftCounter "FaultFSEVETA_OverTempDrvLeftCount" UBYTE I_1 1 2 0 255 ECU_ADDRESS 0x9 /end MEASUREMENT
/begin MEASUREMENT FaultFSEVETA_OverTempDrvLeftDetected "FaultFSEVETA_OverTempDrvLeftDetected" UBYTE Bool_ON_OFF 1 2 0 1 BIT_MASK 0x01 ECU_ADDRESS 0x14 /end MEASUREMENT
/begin MEASUREMENT FaultFSEVETA_OverTempDrvLeftLogged "FaultFSEVETA_OverTempDrvLeftLogged" UBYTE Bool_ON_OFF 1 2 0 1 BIT_MASK 0x01 ECU_ADDRESS 0x14 /end MEASUREMENT
/begin MEASUREMENT FaultFSEVETA_OverTempIgbtLeftAut "FaultFSEVETA_OverTempIgbtLeftAut" UBYTE Bool_ON_OFF 1 2 0 1 BIT_MASK 0x02 ECU_ADDRESS 0x14 /end MEASUREMENT
/begin MEASUREMENT FaultFSEVETA_OverTempIgbtLeftCounter "FaultFSEVETA_OverTempIgbtLeftCount" UBYTE I_1 1 2 0 255 ECU_ADDRESS 0xA /end MEASUREMENT
/begin MEASUREMENT FaultFSEVETA_OverTempIgbtLeftDetected "FaultFSEVETA_OverTempIgbtLeftDetected" UBYTE Bool_ON_OFF 1 2 0 1 BIT_MASK 0x02 ECU_ADDRESS 0x14 /end MEASUREMENT
/begin MEASUREMENT FaultFSEVETA_OverTempIgbtLeftLogged "FaultFSEVETA_OverTempIgbtLeftLogged" UBYTE Bool_ON_OFF 1 2 0 1 BIT_MASK 0x02 ECU_ADDRESS 0x14 /end MEASUREMENT
/begin MEASUREMENT FaultFSEVETA_OverTempNTC1CmdBoardAut "FaultFSEVETA_OverTempNTC1CmdBoardAut" UBYTE Bool_ON_OFF 1 2 0 1 BIT_MASK 0x04 ECU_ADDRESS 0x14 /end MEASUREMENT
/begin MEASUREMENT FaultFSEVETA_OverTempNTC1CmdBoardCounter "FaultFSEVETA_OverTempNTC1CmdBoardCount" UBYTE I_1 1 2 0 255 ECU_ADDRESS 0xB /end MEASUREMENT
/begin MEASUREMENT FaultFSEVETA_OverTempNTC1CmdBoardDetected "FaultFSEVETA_OverTempNTC1CmdBoardDetected" UBYTE Bool_ON_OFF 1 2 0 1 BIT_MASK 0x04 ECU_ADDRESS 0x14 /end MEASUREMENT
/begin MEASUREMENT FaultFSEVETA_OverTempNTC1CmdBoardLogged "FaultFSEVETA_OverTempNTC1CmdBoardLogged" UBYTE Bool_ON_OFF 1 2 0 1 BIT_MASK 0x04 ECU_ADDRESS 0x14 /end MEASUREMENT
/begin MEASUREMENT FaultFSEVETA_SampleIgbtTempOutRngHAut "FaultFSEVETA_SampleIgbtTempOutRngHAut" UBYTE Bool_ON_OFF 1 2 0 1 BIT_MASK 0x04 ECU_ADDRESS 0x12 /end MEASUREMENT
/begin MEASUREMENT FaultFSEVETA_SampleIgbtTempOutRngHCounter "FaultFSEVETA_SampleIgbtTempOutRngHCount" UBYTE I_1 1 2 0 255 ECU_ADDRESS 0x7 /end MEASUREMENT
/begin MEASUREMENT FaultFSEVETA_SampleIgbtTempOutRngHDetected "FaultFSEVETA_SampleIgbtTempOutRngHDetected" UBYTE Bool_ON_OFF 1 2 0 1 BIT_MASK 0x04 ECU_ADDRESS 0x12 /end MEASUREMENT
/begin MEASUREMENT FaultFSEVETA_SampleIgbtTempOutRngHLogged "FaultFSEVETA_SampleIgbtTempOutRngHLogged" UBYTE Bool_ON_OFF 1 2 0 1 BIT_MASK 0x04 ECU_ADDRESS 0x12 /end MEASUREMENT
/begin MEASUREMENT FaultFSEVETA_SampleIgbtTempOutRngLAut "FaultFSEVETA_SampleIgbtTempOutRngLAut" UBYTE Bool_ON_OFF 1 2 0 1 BIT_MASK 0x08 ECU_ADDRESS 0x12 /end MEASUREMENT
/begin MEASUREMENT FaultFSEVETA_SampleIgbtTempOutRngLCounter "FaultFSEVETA_SampleIgbtTempOutRngLCount" UBYTE I_1 1 2 0 255 ECU_ADDRESS 0x8 /end MEASUREMENT
/begin MEASUREMENT FaultFSEVETA_SampleIgbtTempOutRngLDetected "FaultFSEVETA_SampleIgbtTempOutRngLDetected" UBYTE Bool_ON_OFF 1 2 0 1 BIT_MASK 0x08 ECU_ADDRESS 0x12 /end MEASUREMENT
/begin MEASUREMENT FaultFSEVETA_SampleIgbtTempOutRngLLogged "FaultFSEVETA_SampleIgbtTempOutRngLLogged" UBYTE Bool_ON_OFF 1 2 0 1 BIT_MASK 0x08 ECU_ADDRESS 0x12 /end MEASUREMENT
/begin MEASUREMENT FaultFSEVETA_TempDetected "FaultFSEVETA_TempDetected" UWORD I_1 1 2 0 65535 ECU_ADDRESS 0x16 /end MEASUREMENT
/begin MEASUREMENT FaultFSEVETA_TempDrvBoardLeftGndAut "FaultFSEVETA_TempDrvBoardLeftGndAut" UBYTE Bool_ON_OFF 1 2 0 1 BIT_MASK 0x01 ECU_ADDRESS 0x16 /end MEASUREMENT
/begin MEASUREMENT FaultFSEVETA_TempDrvBoardLeftGndCounter "FaultFSEVETA_TempDrvBoardLeftGndCount" UBYTE I_1 1 2 0 255 ECU_ADDRESS 0xC /end MEASUREMENT
/begin MEASUREMENT FaultFSEVETA_TempDrvBoardLeftGndDetected "FaultFSEVETA_TempDrvBoardLeftGndDetected" UBYTE Bool_ON_OFF 1 2 0 1 BIT_MASK 0x01 ECU_ADDRESS 0x16 /end MEASUREMENT
/begin MEASUREMENT FaultFSEVETA_TempDrvBoardLeftGndLogged "FaultFSEVETA_TempDrvBoardLeftGndLogged" UBYTE Bool_ON_OFF 1 2 0 1 BIT_MASK 0x01 ECU_ADDRESS 0x16 /end MEASUREMENT
/begin MEASUREMENT FaultFSEVETA_TempDrvBoardLeftVccAut "FaultFSEVETA_TempDrvBoardLeftVccAut" UBYTE Bool_ON_OFF 1 2 0 1 BIT_MASK 0x02 ECU_ADDRESS 0x16 /end MEASUREMENT
/begin MEASUREMENT FaultFSEVETA_TempDrvBoardLeftVccCounter "FaultFSEVETA_TempDrvBoardLeftVccCount" UBYTE I_1 1 2 0 255 ECU_ADDRESS 0xD /end MEASUREMENT
/begin MEASUREMENT FaultFSEVETA_TempDrvBoardLeftVccDetected "FaultFSEVETA_TempDrvBoardLeftVccDetected" UBYTE Bool_ON_OFF 1 2 0 1 BIT_MASK 0x02 ECU_ADDRESS 0x16 /end MEASUREMENT
/begin MEASUREMENT FaultFSEVETA_TempDrvBoardLeftVccLogged "FaultFSEVETA_TempDrvBoardLeftVccLogged" UBYTE Bool_ON_OFF 1 2 0 1 BIT_MASK 0x02 ECU_ADDRESS 0x16 /end MEASUREMENT
/begin MEASUREMENT FaultFSEVETA_TempIgbtLeftGndAut "FaultFSEVETA_TempIgbtLeftGndAut" UBYTE Bool_ON_OFF 1 2 0 1 BIT_MASK 0x04 ECU_ADDRESS 0x16 /end MEASUREMENT
/begin MEASUREMENT FaultFSEVETA_TempIgbtLeftGndCounter "FaultFSEVETA_TempIgbtLeftGndCount" UBYTE I_1 1 2 0 255 ECU_ADDRESS 0xE /end MEASUREMENT
/begin MEASUREMENT FaultFSEVETA_TempIgbtLeftGndDetected "FaultFSEVETA_TempIgbtLeftGndDetected" UBYTE Bool_ON_OFF 1 2 0 1 BIT_MASK 0x04 ECU_ADDRESS 0x16 /end MEASUREMENT
/begin MEASUREMENT FaultFSEVETA_TempIgbtLeftGndLogged "FaultFSEVETA_TempIgbtLeftGndLogged" UBYTE Bool_ON_OFF 1 2 0 1 BIT_MASK 0x04 ECU_ADDRESS 0x16 /end MEASUREMENT
/begin MEASUREMENT FaultFSEVETA_TempIgbtLeftVccAut "FaultFSEVETA_TempIgbtLeftVccAut" UBYTE Bool_ON_OFF 1 2 0 1 BIT_MASK 0x08 ECU_ADDRESS 0x16 /end MEASUREMENT
/begin MEASUREMENT FaultFSEVETA_TempIgbtLeftVccCounter "FaultFSEVETA_TempIgbtLeftVccCount" UBYTE I_1 1 2 0 255 ECU_ADDRESS 0xF /end MEASUREMENT
/begin MEASUREMENT FaultFSEVETA_TempIgbtLeftVccDetected "FaultFSEVETA_TempIgbtLeftVccDetected" UBYTE Bool_ON_OFF 1 2 0 1 BIT_MASK 0x08 ECU_ADDRESS 0x16 /end MEASUREMENT
/begin MEASUREMENT FaultFSEVETA_TempIgbtLeftVccLogged "FaultFSEVETA_TempIgbtLeftVccLogged" UBYTE Bool_ON_OFF 1 2 0 1 BIT_MASK 0x08 ECU_ADDRESS 0x16 /end MEASUREMENT
/begin MEASUREMENT FaultFSEVETA_TempLogged "FaultFSEVETA_TempLogged" UWORD I_1 1 2 0 65535 ECU_ADDRESS 0x16 /end MEASUREMENT
/begin MEASUREMENT FaultFSEVETA_TempNTC1CmdBoardGndAut "FaultFSEVETA_TempNTC1CmdBoardGndAut" UBYTE Bool_ON_OFF 1 2 0 1 BIT_MASK 0x10 ECU_ADDRESS 0x16 /end MEASUREMENT
/begin MEASUREMENT FaultFSEVETA_TempNTC1CmdBoardGndCounter "FaultFSEVETA_TempNTC1CmdBoardGndCount" UBYTE I_1 1 2 0 255 ECU_ADDRESS 0x10 /end MEASUREMENT
/begin MEASUREMENT FaultFSEVETA_TempNTC1CmdBoardGndDetected "FaultFSEVETA_TempNTC1CmdBoardGndDetected" UBYTE Bool_ON_OFF 1 2 0 1 BIT_MASK 0x10 ECU_ADDRESS 0x16 /end MEASUREMENT
/begin MEASUREMENT FaultFSEVETA_TempNTC1CmdBoardGndLogged "FaultFSEVETA_TempNTC1CmdBoardGndLogged" UBYTE Bool_ON_OFF 1 2 0 1 BIT_MASK 0x10 ECU_ADDRESS 0x16 /end MEASUREMENT
/begin MEASUREMENT FaultFSEVETA_TempNTC1CmdBoardVccAut "FaultFSEVETA_TempNTC1CmdBoardVccAut" UBYTE Bool_ON_OFF 1 2 0 1 BIT_MASK 0x20 ECU_ADDRESS 0x16 /end MEASUREMENT
/begin MEASUREMENT FaultFSEVETA_TempNTC1CmdBoardVccCounter "FaultFSEVETA_TempNTC1CmdBoardVccCount" UBYTE I_1 1 2 0 255 ECU_ADDRESS 0x11 /end MEASUREMENT
/begin MEASUREMENT FaultFSEVETA_TempNTC1CmdBoardVccDetected "FaultFSEVETA_TempNTC1CmdBoardVccDetected" UBYTE Bool_ON_OFF 1 2 0 1 BIT_MASK 0x20 ECU_ADDRESS 0x16 /end MEASUREMENT
/begin MEASUREMENT FaultFSEVETA_TempNTC1CmdBoardVccLogged "FaultFSEVETA_TempNTC1CmdBoardVccLogged" UBYTE Bool_ON_OFF 1 2 0 1 BIT_MASK 0x20 ECU_ADDRESS 0x16 /end MEASUREMENT
/begin MEASUREMENT FaultFSEVETA_UnderDetected "FaultFSEVETA_UnderDetected" UWORD I_1 1 2 0 65535 ECU_ADDRESS 0x18 /end MEASUREMENT
/begin MEASUREMENT FaultFSEVETA_UnderLogged "FaultFSEVETA_UnderLogged" UWORD I_1 1 2 0 65535 ECU_ADDRESS 0x18 /end MEASUREMENT
/begin MEASUREMENT FaultFSEVETA_UnderTempDrvLeftAut "FaultFSEVETA_UnderTempDrvLeftAut" UBYTE Bool_ON_OFF 1 2 0 1 BIT_MASK 0x01 ECU_ADDRESS 0x18 /end MEASUREMENT
/begin MEASUREMENT FaultFSEVETA_UnderTempDrvLeftCounter "FaultFSEVETA_UnderTempDrvLeftCount" UBYTE I_1 1 2 0 255 ECU_ADDRESS 0x12 /end MEASUREMENT
/begin MEASUREMENT FaultFSEVETA_UnderTempDrvLeftDetected "FaultFSEVETA_UnderTempDrvLeftDetected" UBYTE Bool_ON_OFF 1 2 0 1 BIT_MASK 0x01 ECU_ADDRESS 0x18 /end MEASUREMENT
/begin MEASUREMENT FaultFSEVETA_UnderTempDrvLeftLogged "FaultFSEVETA_UnderTempDrvLeftLogged" UBYTE Bool_ON_OFF 1 2 0 1 BIT_MASK 0x01 ECU_ADDRESS 0x18 /end MEASUREMENT
/begin MEASUREMENT FaultFSEVETA_UnderTempIgbtLeftAut "FaultFSEVETA_UnderTempIgbtLeftAut" UBYTE Bool_ON_OFF 1 2 0 1 BIT_MASK 0x02 ECU_ADDRESS 0x18 /end MEASUREMENT
/begin MEASUREMENT FaultFSEVETA_UnderTempIgbtLeftCounter "FaultFSEVETA_UnderTempIgbtLeftCount" UBYTE I_1 1 2 0 255 ECU_ADDRESS 0x13 /end MEASUREMENT
/begin MEASUREMENT FaultFSEVETA_UnderTempIgbtLeftDetected "FaultFSEVETA_UnderTempIgbtLeftDetected" UBYTE Bool_ON_OFF 1 2 0 1 BIT_MASK 0x02 ECU_ADDRESS 0x18 /end MEASUREMENT
/begin MEASUREMENT FaultFSEVETA_UnderTempIgbtLeftLogged "FaultFSEVETA_UnderTempIgbtLeftLogged" UBYTE Bool_ON_OFF 1 2 0 1 BIT_MASK 0x02 ECU_ADDRESS 0x18 /end MEASUREMENT
/begin MEASUREMENT FaultFSEVETA_UnderTempNTC1CmdBoardAut "FaultFSEVETA_UnderTempNTC1CmdBoardAut" UBYTE Bool_ON_OFF 1 2 0 1 BIT_MASK 0x04 ECU_ADDRESS 0x18 /end MEASUREMENT
/begin MEASUREMENT FaultFSEVETA_UnderTempNTC1CmdBoardCounter "FaultFSEVETA_UnderTempNTC1CmdBoardCount" UBYTE I_1 1 2 0 255 ECU_ADDRESS 0x14 /end MEASUREMENT
/begin MEASUREMENT FaultFSEVETA_UnderTempNTC1CmdBoardDetected "FaultFSEVETA_UnderTempNTC1CmdBoardDetected" UBYTE Bool_ON_OFF 1 2 0 1 BIT_MASK 0x04 ECU_ADDRESS 0x18 /end MEASUREMENT
/begin MEASUREMENT FaultFSEVETA_UnderTempNTC1CmdBoardLogged "FaultFSEVETA_UnderTempNTC1CmdBoardLogged" UBYTE Bool_ON_OFF 1 2 0 1 BIT_MASK 0x04 ECU_ADDRESS 0x18 /end MEASUREMENT
/begin MEASUREMENT FaultFSMTMTA_OverDetected "FaultFSMTMTA_OverDetected" UWORD I_1 1 2 0 65535 ECU_ADDRESS 0x1A /end MEASUREMENT
/begin MEASUREMENT FaultFSMTMTA_OverLogged "FaultFSMTMTA_OverLogged" UWORD I_1 1 2 0 65535 ECU_ADDRESS 0x1A /end MEASUREMENT
/begin MEASUREMENT FaultFSMTMTA_OverTempWdgHead1Aut "FaultFSMTMTA_OverTempWdgHead1Aut" UBYTE Bool_ON_OFF 1 2 0 1 BIT_MASK 0x01 ECU_ADDRESS 0x1A /end MEASUREMENT
/begin MEASUREMENT FaultFSMTMTA_OverTempWdgHead1Counter "FaultFSMTMTA_OverTempWdgHead1Count" UBYTE I_1 1 2 0 255 ECU_ADDRESS 0x15 /end MEASUREMENT
/begin MEASUREMENT FaultFSMTMTA_OverTempWdgHead1Detected "FaultFSMTMTA_OverTempWdgHead1Detected" UBYTE Bool_ON_OFF 1 2 0 1 BIT_MASK 0x01 ECU_ADDRESS 0x1A /end MEASUREMENT
/begin MEASUREMENT FaultFSMTMTA_OverTempWdgHead1Logged "FaultFSMTMTA_OverTempWdgHead1Logged" UBYTE Bool_ON_OFF 1 2 0 1 BIT_MASK 0x01 ECU_ADDRESS 0x1A /end MEASUREMENT
/begin MEASUREMENT FaultFSMTMTA_TempDetected "FaultFSMTMTA_TempDetected" UWORD I_1 1 2 0 65535 ECU_ADDRESS 0x1C /end MEASUREMENT
/begin MEASUREMENT FaultFSMTMTA_TempLogged "FaultFSMTMTA_TempLogged" UWORD I_1 1 2 0 65535 ECU_ADDRESS 0x1C /end MEASUREMENT
/begin MEASUREMENT FaultFSMTMTA_TempWindHead1OutRngHAut "FaultFSMTMTA_TempWindHead1OutRngHAut" UBYTE Bool_ON_OFF 1 2 0 1 BIT_MASK 0x01 ECU_ADDRESS 0x1C /end MEASUREMENT
/begin MEASUREMENT FaultFSMTMTA_TempWindHead1OutRngHCounter "FaultFSMTMTA_TempWindHead1OutRngHCount" UBYTE I_1 1 2 0 255 ECU_ADDRESS 0x16 /end MEASUREMENT
/begin MEASUREMENT FaultFSMTMTA_TempWindHead1OutRngHDetected "FaultFSMTMTA_TempWindHead1OutRngHDetected" UBYTE Bool_ON_OFF 1 2 0 1 BIT_MASK 0x01 ECU_ADDRESS 0x1C /end MEASUREMENT
/begin MEASUREMENT FaultFSMTMTA_TempWindHead1OutRngHLogged "FaultFSMTMTA_TempWindHead1OutRngHLogged" UBYTE Bool_ON_OFF 1 2 0 1 BIT_MASK 0x01 ECU_ADDRESS 0x1C /end MEASUREMENT
/begin MEASUREMENT FaultFSMTMTA_TempWindHead1OutRngLAut "FaultFSMTMTA_TempWindHead1OutRngLAut" UBYTE Bool_ON_OFF 1 2 0 1 BIT_MASK 0x02 ECU_ADDRESS 0x1C /end MEASUREMENT
/begin MEASUREMENT FaultFSMTMTA_TempWindHead1OutRngLCounter "FaultFSMTMTA_TempWindHead1OutRngLCount" UBYTE I_1 1 2 0 255 ECU_ADDRESS 0x17 /end MEASUREMENT
/begin MEASUREMENT FaultFSMTMTA_TempWindHead1OutRngLDetected "FaultFSMTMTA_TempWindHead1OutRngLDetected" UBYTE Bool_ON_OFF 1 2 0 1 BIT_MASK 0x02 ECU_ADDRESS 0x1C /end MEASUREMENT
/begin MEASUREMENT FaultFSMTMTA_TempWindHead1OutRngLLogged "FaultFSMTMTA_TempWindHead1OutRngLLogged" UBYTE Bool_ON_OFF 1 2 0 1 BIT_MASK 0x02 ECU_ADDRESS 0x1C /end MEASUREMENT
/begin MEASUREMENT FaultFSMTMTA_TempWindingHead1GndAut "FaultFSMTMTA_TempWindingHead1GndAut" UBYTE Bool_ON_OFF 1 2 0 1 BIT_MASK 0x04 ECU_ADDRESS 0x1C /end MEASUREMENT
/begin MEASUREMENT FaultFSMTMTA_TempWindingHead1GndCounter "FaultFSMTMTA_TempWindingHead1GndCount" UBYTE I_1 1 2 0 255 ECU_ADDRESS 0x18 /end MEASUREMENT
/begin MEASUREMENT FaultFSMTMTA_TempWindingHead1GndDetected "FaultFSMTMTA_TempWindingHead1GndDetected" UBYTE Bool_ON_OFF 1 2 0 1 BIT_MASK 0x04 ECU_ADDRESS 0x1C /end MEASUREMENT
/begin MEASUREMENT FaultFSMTMTA_TempWindingHead1GndLogged "FaultFSMTMTA_TempWindingHead1GndLogged" UBYTE Bool_ON_OFF 1 2 0 1 BIT_MASK 0x04 ECU_ADDRESS 0x1C /end MEASUREMENT
/begin MEASUREMENT FaultFSMTMTA_TempWindingHead1VccAut "FaultFSMTMTA_TempWindingHead1VccAut" UBYTE Bool_ON_OFF 1 2 0 1 BIT_MASK 0x08 ECU_ADDRESS 0x1C /end MEASUREMENT
/begin MEASUREMENT FaultFSMTMTA_TempWindingHead1VccCounter "FaultFSMTMTA_TempWindingHead1VccCount" UBYTE I_1 1 2 0 255 ECU_ADDRESS 0x19 /end MEASUREMENT
/begin MEASUREMENT FaultFSMTMTA_TempWindingHead1VccDetected "FaultFSMTMTA_TempWindingHead1VccDetected" UBYTE Bool_ON_OFF 1 2 0 1 BIT_MASK 0x08 ECU_ADDRESS 0x1C /end MEASUREMENT
/begin MEASUREMENT FaultFSMTMTA_TempWindingHead1VccLogged "FaultFSMTMTA_TempWindingHead1VccLogged" UBYTE Bool_ON_OFF 1 2 0 1 BIT_MASK 0x08 ECU_ADDRESS 0x1C /end MEASUREMENT
/begin MEASUREMENT FaultFSMTMTA_UnderDetected "FaultFSMTMTA_UnderDetected" UWORD I_1 1 2 0 65535 ECU_ADDRESS 0x1E /end MEASUREMENT
/begin MEASUREMENT FaultFSMTMTA_UnderLogged "FaultFSMTMTA_UnderLogged" UWORD I_1 1 2 0 65535 ECU_ADDRESS 0x1E /end MEASUREMENT
/begin MEASUREMENT FaultFSMTMTA_UnderTempWdgHead1Aut "FaultFSMTMTA_UnderTempWdgHead1Aut" UBYTE Bool_ON_OFF 1 2 0 1 BIT_MASK 0x01 ECU_ADDRESS 0x1E /end MEASUREMENT
/begin MEASUREMENT FaultFSMTMTA_UnderTempWdgHead1Counter "FaultFSMTMTA_UnderTempWdgHead1Count" UBYTE I_1 1 2 0 255 ECU_ADDRESS 0x1A /end MEASUREMENT
/begin MEASUREMENT FaultFSMTMTA_UnderTempWdgHead1Detected "FaultFSMTMTA_UnderTempWdgHead1Detected" UBYTE Bool_ON_OFF 1 2 0 1 BIT_MASK 0x01 ECU_ADDRESS 0x1E /end MEASUREMENT
/begin MEASUREMENT FaultFSMTMTA_UnderTempWdgHead1Logged "FaultFSMTMTA_UnderTempWdgHead1Logged" UBYTE Bool_ON_OFF 1 2 0 1 BIT_MASK 0x01 ECU_ADDRESS 0x1E /end MEASUREMENT
/begin MEASUREMENT FaultFSMTRDG_Detected "FaultFSMTRDG_Detected" UWORD I_1 1 2 0 65535 ECU_ADDRESS 0x20 /end MEASUREMENT
/begin MEASUREMENT FaultFSMTRDG_ExcGenerationAut "FaultFSMTRDG_ExcGenerationAut" UBYTE Bool_ON_OFF 1 2 0 1 BIT_MASK 0x01 ECU_ADDRESS 0x20 /end MEASUREMENT
/begin MEASUREMENT FaultFSMTRDG_ExcGenerationCounter "FaultFSMTRDG_ExcGenerationCount" UBYTE I_1 1 2 0 255 ECU_ADDRESS 0x1B /end MEASUREMENT
/begin MEASUREMENT FaultFSMTRDG_ExcGenerationDetected "FaultFSMTRDG_ExcGenerationDetected" UBYTE Bool_ON_OFF 1 2 0 1 BIT_MASK 0x01 ECU_ADDRESS 0x20 /end MEASUREMENT
/begin MEASUREMENT FaultFSMTRDG_ExcGenerationLogged "FaultFSMTRDG_ExcGenerationLogged" UBYTE Bool_ON_OFF 1 2 0 1 BIT_MASK 0x01 ECU_ADDRESS 0x20 /end MEASUREMENT
/begin MEASUREMENT FaultFSMTRDG_ExcSignalGNDAut "FaultFSMTRDG_ExcSignalGNDAut" UBYTE Bool_ON_OFF 1 2 0 1 BIT_MASK 0x02 ECU_ADDRESS 0x20 /end MEASUREMENT
/begin MEASUREMENT FaultFSMTRDG_ExcSignalGNDCounter "FaultFSMTRDG_ExcSignalGNDCount" UBYTE I_1 1 2 0 255 ECU_ADDRESS 0x1C /end MEASUREMENT
/begin MEASUREMENT FaultFSMTRDG_ExcSignalGNDDetected "FaultFSMTRDG_ExcSignalGNDDetected" UBYTE Bool_ON_OFF 1 2 0 1 BIT_MASK 0x02 ECU_ADDRESS 0x20 /end MEASUREMENT
/begin MEASUREMENT FaultFSMTRDG_ExcSignalGNDLogged "FaultFSMTRDG_ExcSignalGNDLogged" UBYTE Bool_ON_OFF 1 2 0 1 BIT_MASK 0x02 ECU_ADDRESS 0x20 /end MEASUREMENT
/begin MEASUREMENT FaultFSMTRDG_ExcSignalVCCAut "FaultFSMTRDG_ExcSignalVCCAut" UBYTE Bool_ON_OFF 1 2 0 1 BIT_MASK 0x04 ECU_ADDRESS 0x20 /end MEASUREMENT
/begin MEASUREMENT FaultFSMTRDG_ExcSignalVCCCounter "FaultFSMTRDG_ExcSignalVCCCount" UBYTE I_1 1 2 0 255 ECU_ADDRESS 0x1D /end MEASUREMENT
/begin MEASUREMENT FaultFSMTRDG_ExcSignalVCCDetected "FaultFSMTRDG_ExcSignalVCCDetected" UBYTE Bool_ON_OFF 1 2 0 1 BIT_MASK 0x04 ECU_ADDRESS 0x20 /end MEASUREMENT
/begin MEASUREMENT FaultFSMTRDG_ExcSignalVCCLogged "FaultFSMTRDG_ExcSignalVCCLogged" UBYTE Bool_ON_OFF 1 2 0 1 BIT_MASK 0x04 ECU_ADDRESS 0x20 /end MEASUREMENT
/begin MEASUREMENT FaultFSMTRDG_Logged "FaultFSMTRDG_Logged" UWORD I_1 1 2 0 65535 ECU_ADDRESS 0x20 /end MEASUREMENT
/begin MEASUREMENT FaultFSMTRDG_SinCosHLGndAut "FaultFSMTRDG_SinCosHLGndAut" UBYTE Bool_ON_OFF 1 2 0 1 BIT_MASK 0x08 ECU_ADDRESS 0x20 /end MEASUREMENT
/begin MEASUREMENT FaultFSMTRDG_SinCosHLGndCounter "FaultFSMTRDG_SinCosHLGndCount" UBYTE I_1 1 2 0 255 ECU_ADDRESS 0x1E /end MEASUREMENT
/begin MEASUREMENT FaultFSMTRDG_SinCosHLGndDetected "FaultFSMTRDG_SinCosHLGndDetected" UBYTE Bool_ON_OFF 1 2 0 1 BIT_MASK 0x08 ECU_ADDRESS 0x20 /end MEASUREMENT
/begin MEASUREMENT FaultFSMTRDG_SinCosHLGndLogged "FaultFSMTRDG_SinCosHLGndLogged" UBYTE Bool_ON_OFF 1 2 0 1 BIT_MASK 0x08 ECU_ADDRESS 0x20 /end MEASUREMENT
/begin MEASUREMENT FaultFSMTRDG_SinCosHLOpenAut "FaultFSMTRDG_SinCosHLOpenAut" UBYTE Bool_ON_OFF 1 2 0 1 BIT_MASK 0x10 ECU_ADDRESS 0x20 /end MEASUREMENT
/begin MEASUREMENT FaultFSMTRDG_SinCosHLOpenCounter "FaultFSMTRDG_SinCosHLOpenCount" UBYTE I_1 1 2 0 255 ECU_ADDRESS 0x1F /end MEASUREMENT
/begin MEASUREMENT FaultFSMTRDG_SinCosHLOpenDetected "FaultFSMTRDG_SinCosHLOpenDetected" UBYTE Bool_ON_OFF 1 2 0 1 BIT_MASK 0x10 ECU_ADDRESS 0x20 /end MEASUREMENT
/begin MEASUREMENT FaultFSMTRDG_SinCosHLOpenLogged "FaultFSMTRDG_SinCosHLOpenLogged" UBYTE Bool_ON_OFF 1 2 0 1 BIT_MASK 0x10 ECU_ADDRESS 0x20 /end MEASUREMENT
/begin MEASUREMENT FaultFSMTRDG_SinCosHLVccAut "FaultFSMTRDG_SinCosHLVccAut" UBYTE Bool_ON_OFF 1 2 0 1 BIT_MASK 0x20 ECU_ADDRESS 0x20 /end MEASUREMENT
/begin MEASUREMENT FaultFSMTRDG_SinCosHLVccCounter "FaultFSMTRDG_SinCosHLVccCount" UBYTE I_1 1 2 0 255 ECU_ADDRESS 0x20 /end MEASUREMENT
/begin MEASUREMENT FaultFSMTRDG_SinCosHLVccDetected "FaultFSMTRDG_SinCosHLVccDetected" UBYTE Bool_ON_OFF 1 2 0 1 BIT_MASK 0x20 ECU_ADDRESS 0x20 /end MEASUREMENT
/begin MEASUREMENT FaultFSMTRDG_SinCosHLVccLogged "FaultFSMTRDG_SinCosHLVccLogged" UBYTE Bool_ON_OFF 1 2 0 1 BIT_MASK 0x20 ECU_ADDRESS 0x20 /end MEASUREMENT
/begin MEASUREMENT FaultFSSMACS_AkdFailFlagAut "FaultFSSMACS_AkdFailFlagAut" UBYTE Bool_ON_OFF 1 2 0 1 BIT_MASK 0x01 ECU_ADDRESS 0x22 /end MEASUREMENT
/begin MEASUREMENT FaultFSSMACS_AkdFailFlagCounter "FaultFSSMACS_AkdFailFlagCount" UBYTE I_1 1 2 0 255 ECU_ADDRESS 0x21 /end MEASUREMENT
/begin MEASUREMENT FaultFSSMACS_AkdFailFlagDetected "FaultFSSMACS_AkdFailFlagDetected" UBYTE Bool_ON_OFF 1 2 0 1 BIT_MASK 0x01 ECU_ADDRESS 0x22 /end MEASUREMENT
/begin MEASUREMENT FaultFSSMACS_AkdFailFlagLogged "FaultFSSMACS_AkdFailFlagLogged" UBYTE Bool_ON_OFF 1 2 0 1 BIT_MASK 0x01 ECU_ADDRESS 0x22 /end MEASUREMENT
/begin MEASUREMENT FaultFSSMACS_Detected "FaultFSSMACS_Detected" UWORD I_1 1 2 0 65535 ECU_ADDRESS 0x22 /end MEASUREMENT
/begin MEASUREMENT FaultFSSMACS_Logged "FaultFSSMACS_Logged" UWORD I_1 1 2 0 65535 ECU_ADDRESS 0x22 /end MEASUREMENT
/begin MEASUREMENT FaultFTASBDS_BattVoltDeratingActAut "FaultFTASBDS_BattVoltDeratingActAut" UBYTE Bool_ON_OFF 1 2 0 1 BIT_MASK 0x01 ECU_ADDRESS 0x24 /end MEASUREMENT
/begin MEASUREMENT FaultFTASBDS_BattVoltDeratingActCounter "FaultFTASBDS_BattVoltDeratingActCount" UBYTE I_1 1 2 0 255 ECU_ADDRESS 0x22 /end MEASUREMENT
/begin MEASUREMENT FaultFTASBDS_BattVoltDeratingActDetected "FaultFTASBDS_BattVoltDeratingActDetected" UBYTE Bool_ON_OFF 1 2 0 1 BIT_MASK 0x01 ECU_ADDRESS 0x24 /end MEASUREMENT
/begin MEASUREMENT FaultFTASBDS_BattVoltDeratingActLogged "FaultFTASBDS_BattVoltDeratingActLogged" UBYTE Bool_ON_OFF 1 2 0 1 BIT_MASK 0x01 ECU_ADDRESS 0x24 /end MEASUREMENT
/begin MEASUREMENT FaultFTASBDS_Detected "FaultFTASBDS_Detected" UWORD I_1 1 2 0 65535 ECU_ADDRESS 0x24 /end MEASUREMENT
/begin MEASUREMENT FaultFTASBDS_Logged "FaultFTASBDS_Logged" UWORD I_1 1 2 0 65535 ECU_ADDRESS 0x24 /end MEASUREMENT
/begin MEASUREMENT FaultFTASETP_Detected "FaultFTASETP_Detected" UWORD I_1 1 2 0 65535 ECU_ADDRESS 0x26 /end MEASUREMENT
/begin MEASUREMENT FaultFTASETP_EstPmDeratingActAut "FaultFTASETP_EstPmDeratingActAut" UBYTE Bool_ON_OFF 1 2 0 1 BIT_MASK 0x01 ECU_ADDRESS 0x26 /end MEASUREMENT
/begin MEASUREMENT FaultFTASETP_EstPmDeratingActCounter "FaultFTASETP_EstPmDeratingActCount" UBYTE I_1 1 2 0 255 ECU_ADDRESS 0x23 /end MEASUREMENT
/begin MEASUREMENT FaultFTASETP_EstPmDeratingActDetected "FaultFTASETP_EstPmDeratingActDetected" UBYTE Bool_ON_OFF 1 2 0 1 BIT_MASK 0x01 ECU_ADDRESS 0x26 /end MEASUREMENT
/begin MEASUREMENT FaultFTASETP_EstPmDeratingActLogged "FaultFTASETP_EstPmDeratingActLogged" UBYTE Bool_ON_OFF 1 2 0 1 BIT_MASK 0x01 ECU_ADDRESS 0x26 /end MEASUREMENT
/begin MEASUREMENT FaultFTASETP_Logged "FaultFTASETP_Logged" UWORD I_1 1 2 0 65535 ECU_ADDRESS 0x26 /end MEASUREMENT
/begin MEASUREMENT FaultFTASETP_PmDeratingActAut "FaultFTASETP_PmDeratingActAut" UBYTE Bool_ON_OFF 1 2 0 1 BIT_MASK 0x02 ECU_ADDRESS 0x26 /end MEASUREMENT
/begin MEASUREMENT FaultFTASETP_PmDeratingActCounter "FaultFTASETP_PmDeratingActCount" UBYTE I_1 1 2 0 255 ECU_ADDRESS 0x24 /end MEASUREMENT
/begin MEASUREMENT FaultFTASETP_PmDeratingActDetected "FaultFTASETP_PmDeratingActDetected" UBYTE Bool_ON_OFF 1 2 0 1 BIT_MASK 0x02 ECU_ADDRESS 0x26 /end MEASUREMENT
/begin MEASUREMENT FaultFTASETP_PmDeratingActLogged "FaultFTASETP_PmDeratingActLogged" UBYTE Bool_ON_OFF 1 2 0 1 BIT_MASK 0x02 ECU_ADDRESS 0x26 /end MEASUREMENT
/begin MEASUREMENT FaultFTASMTP_Detected "FaultFTASMTP_Detected" UWORD I_1 1 2 0 65535 ECU_ADDRESS 0x28 /end MEASUREMENT
/begin MEASUREMENT FaultFTASMTP_Logged "FaultFTASMTP_Logged" UWORD I_1 1 2 0 65535 ECU_ADDRESS 0x28 /end MEASUREMENT
/begin MEASUREMENT FaultFTASMTP_Wndg1DeratingActAut "FaultFTASMTP_Wndg1DeratingActAut" UBYTE Bool_ON_OFF 1 2 0 1 BIT_MASK 0x01 ECU_ADDRESS 0x28 /end MEASUREMENT
/begin MEASUREMENT FaultFTASMTP_Wndg1DeratingActCounter "FaultFTASMTP_Wndg1DeratingActCount" UBYTE I_1 1 2 0 255 ECU_ADDRESS 0x25 /end MEASUREMENT
/begin MEASUREMENT FaultFTASMTP_Wndg1DeratingActDetected "FaultFTASMTP_Wndg1DeratingActDetected" UBYTE Bool_ON_OFF 1 2 0 1 BIT_MASK 0x01 ECU_ADDRESS 0x28 /end MEASUREMENT
/begin MEASUREMENT FaultFTASMTP_Wndg1DeratingActLogged "FaultFTASMTP_Wndg1DeratingActLogged" UBYTE Bool_ON_OFF 1 2 0 1 BIT_MASK 0x01 ECU_ADDRESS 0x28 /end MEASUREMENT
/begin MEASUREMENT FaultFTASOSP_Detected "FaultFTASOSP_Detected" UWORD I_1 1 2 0 65535 ECU_ADDRESS 0x2A /end MEASUREMENT
/begin MEASUREMENT FaultFTASOSP_Logged "FaultFTASOSP_Logged" UWORD I_1 1 2 0 65535 ECU_ADDRESS 0x2A /end MEASUREMENT
/begin MEASUREMENT FaultFTASOSP_MotorSpdDeratingActAut "FaultFTASOSP_MotorSpdDeratingActAut" UBYTE Bool_ON_OFF 1 2 0 1 BIT_MASK 0x01 ECU_ADDRESS 0x2A /end MEASUREMENT
/begin MEASUREMENT FaultFTASOSP_MotorSpdDeratingActCounter "FaultFTASOSP_MotorSpdDeratingActCount" UBYTE I_1 1 2 0 255 ECU_ADDRESS 0x26 /end MEASUREMENT
/begin MEASUREMENT FaultFTASOSP_MotorSpdDeratingActDetected "FaultFTASOSP_MotorSpdDeratingActDetected" UBYTE Bool_ON_OFF 1 2 0 1 BIT_MASK 0x01 ECU_ADDRESS 0x2A /end MEASUREMENT
/begin MEASUREMENT FaultFTASOSP_MotorSpdDeratingActLogged "FaultFTASOSP_MotorSpdDeratingActLogged" UBYTE Bool_ON_OFF 1 2 0 1 BIT_MASK 0x01 ECU_ADDRESS 0x2A /end MEASUREMENT
/begin MEASUREMENT FaultFTCMSCS_CtrlSatTimoutAut "FaultFTCMSCS_CtrlSatTimoutAut" UBYTE Bool_ON_OFF 1 2 0 1 BIT_MASK 0x01 ECU_ADDRESS 0x2C /end MEASUREMENT
/begin MEASUREMENT FaultFTCMSCS_CtrlSatTimoutCounter "FaultFTCMSCS_CtrlSatTimoutCount" UBYTE I_1 1 2 0 255 ECU_ADDRESS 0x27 /end MEASUREMENT
/begin MEASUREMENT FaultFTCMSCS_CtrlSatTimoutDetected "FaultFTCMSCS_CtrlSatTimoutDetected" UBYTE Bool_ON_OFF 1 2 0 1 BIT_MASK 0x01 ECU_ADDRESS 0x2C /end MEASUREMENT
/begin MEASUREMENT FaultFTCMSCS_CtrlSatTimoutLogged "FaultFTCMSCS_CtrlSatTimoutLogged" UBYTE Bool_ON_OFF 1 2 0 1 BIT_MASK 0x01 ECU_ADDRESS 0x2C /end MEASUREMENT
/begin MEASUREMENT FaultFTCMSCS_Detected "FaultFTCMSCS_Detected" UWORD I_1 1 2 0 65535 ECU_ADDRESS 0x2C /end MEASUREMENT
/begin MEASUREMENT FaultFTCMSCS_Logged "FaultFTCMSCS_Logged" UWORD I_1 1 2 0 65535 ECU_ADDRESS 0x2C /end MEASUREMENT
/begin MEASUREMENT FaultFTCMSCS_SpdOvershootAut "FaultFTCMSCS_SpdOvershootAut" UBYTE Bool_ON_OFF 1 2 0 1 BIT_MASK 0x02 ECU_ADDRESS 0x2C /end MEASUREMENT
/begin MEASUREMENT FaultFTCMSCS_SpdOvershootCounter "FaultFTCMSCS_SpdOvershootCount" UBYTE I_1 1 2 0 255 ECU_ADDRESS 0x28 /end MEASUREMENT
/begin MEASUREMENT FaultFTCMSCS_SpdOvershootDetected "FaultFTCMSCS_SpdOvershootDetected" UBYTE Bool_ON_OFF 1 2 0 1 BIT_MASK 0x02 ECU_ADDRESS 0x2C /end MEASUREMENT
/begin MEASUREMENT FaultFTCMSCS_SpdOvershootLogged "FaultFTCMSCS_SpdOvershootLogged" UBYTE Bool_ON_OFF 1 2 0 1 BIT_MASK 0x02 ECU_ADDRESS 0x2C /end MEASUREMENT
/begin MEASUREMENT FaultFTCMSCS_ZeroSpeedTimoutAut "FaultFTCMSCS_ZeroSpeedTimoutAut" UBYTE Bool_ON_OFF 1 2 0 1 BIT_MASK 0x04 ECU_ADDRESS 0x2C /end MEASUREMENT
/begin MEASUREMENT FaultFTCMSCS_ZeroSpeedTimoutCounter "FaultFTCMSCS_ZeroSpeedTimoutCount" UBYTE I_1 1 2 0 255 ECU_ADDRESS 0x29 /end MEASUREMENT
/begin MEASUREMENT FaultFTCMSCS_ZeroSpeedTimoutDetected "FaultFTCMSCS_ZeroSpeedTimoutDetected" UBYTE Bool_ON_OFF 1 2 0 1 BIT_MASK 0x04 ECU_ADDRESS 0x2C /end MEASUREMENT
/begin MEASUREMENT FaultFTCMSCS_ZeroSpeedTimoutLogged "FaultFTCMSCS_ZeroSpeedTimoutLogged" UBYTE Bool_ON_OFF 1 2 0 1 BIT_MASK 0x04 ECU_ADDRESS 0x2C /end MEASUREMENT
/begin MEASUREMENT FaultFTCMTCS_Detected "FaultFTCMTCS_Detected" UWORD I_1 1 2 0 65535 ECU_ADDRESS 0x2E /end MEASUREMENT
/begin MEASUREMENT FaultFTCMTCS_Logged "FaultFTCMTCS_Logged" UWORD I_1 1 2 0 65535 ECU_ADDRESS 0x2E /end MEASUREMENT
/begin MEASUREMENT FaultFTCMTCS_VoltageMarginLowAut "FaultFTCMTCS_VoltageMarginLowAut" UBYTE Bool_ON_OFF 1 2 0 1 BIT_MASK 0x01 ECU_ADDRESS 0x2E /end MEASUREMENT
/begin MEASUREMENT FaultFTCMTCS_VoltageMarginLowCounter "FaultFTCMTCS_VoltageMarginLowCount" UBYTE I_1 1 2 0 255 ECU_ADDRESS 0x2A /end MEASUREMENT
/begin MEASUREMENT FaultFTCMTCS_VoltageMarginLowDetected "FaultFTCMTCS_VoltageMarginLowDetected" UBYTE Bool_ON_OFF 1 2 0 1 BIT_MASK 0x01 ECU_ADDRESS 0x2E /end MEASUREMENT
/begin MEASUREMENT FaultFTCMTCS_VoltageMarginLowLogged "FaultFTCMTCS_VoltageMarginLowLogged" UBYTE Bool_ON_OFF 1 2 0 1 BIT_MASK 0x01 ECU_ADDRESS 0x2E /end MEASUREMENT
/begin MEASUREMENT FaultFTEVEIT_Detected "FaultFTEVEIT_Detected" UWORD I_1 1 2 0 65535 ECU_ADDRESS 0x30 /end MEASUREMENT
/begin MEASUREMENT FaultFTEVEIT_EstOverTempAut "FaultFTEVEIT_EstOverTempAut" UBYTE Bool_ON_OFF 1 2 0 1 BIT_MASK 0x01 ECU_ADDRESS 0x30 /end MEASUREMENT
/begin MEASUREMENT FaultFTEVEIT_EstOverTempCounter "FaultFTEVEIT_EstOverTempCount" UBYTE I_1 1 2 0 255 ECU_ADDRESS 0x2B /end MEASUREMENT
/begin MEASUREMENT FaultFTEVEIT_EstOverTempDetected "FaultFTEVEIT_EstOverTempDetected" UBYTE Bool_ON_OFF 1 2 0 1 BIT_MASK 0x01 ECU_ADDRESS 0x30 /end MEASUREMENT
/begin MEASUREMENT FaultFTEVEIT_EstOverTempLogged "FaultFTEVEIT_EstOverTempLogged" UBYTE Bool_ON_OFF 1 2 0 1 BIT_MASK 0x01 ECU_ADDRESS 0x30 /end MEASUREMENT
/begin MEASUREMENT FaultFTEVEIT_Logged "FaultFTEVEIT_Logged" UWORD I_1 1 2 0 65535 ECU_ADDRESS 0x30 /end MEASUREMENT
/begin MEASUREMENT FaultFTMTLCS_CurSenrPhaU_GNDAut "FaultFTMTLCS_CurSenrPhaU_GNDAut" UBYTE Bool_ON_OFF 1 2 0 1 BIT_MASK 0x02 ECU_ADDRESS 0x32 /end MEASUREMENT
/begin MEASUREMENT FaultFTMTLCS_CurSenrPhaU_GNDCounter "FaultFTMTLCS_CurSenrPhaU_GNDCount" UBYTE I_1 1 2 0 255 ECU_ADDRESS 0x2D /end MEASUREMENT
/begin MEASUREMENT FaultFTMTLCS_CurSenrPhaU_GNDDetected "FaultFTMTLCS_CurSenrPhaU_GNDDetected" UBYTE Bool_ON_OFF 1 2 0 1 BIT_MASK 0x02 ECU_ADDRESS 0x32 /end MEASUREMENT
/begin MEASUREMENT FaultFTMTLCS_CurSenrPhaU_GNDLogged "FaultFTMTLCS_CurSenrPhaU_GNDLogged" UBYTE Bool_ON_OFF 1 2 0 1 BIT_MASK 0x02 ECU_ADDRESS 0x32 /end MEASUREMENT
/begin MEASUREMENT FaultFTMTLCS_CurSenrPhaU_OutRngHAut "FaultFTMTLCS_CurSenrPhaU_OutRngHAut" UBYTE Bool_ON_OFF 1 2 0 1 BIT_MASK 0x04 ECU_ADDRESS 0x32 /end MEASUREMENT
/begin MEASUREMENT FaultFTMTLCS_CurSenrPhaU_OutRngHCounter "FaultFTMTLCS_CurSenrPhaU_OutRngHCount" UBYTE I_1 1 2 0 255 ECU_ADDRESS 0x2E /end MEASUREMENT
/begin MEASUREMENT FaultFTMTLCS_CurSenrPhaU_OutRngHDetected "FaultFTMTLCS_CurSenrPhaU_OutRngHDetected" UBYTE Bool_ON_OFF 1 2 0 1 BIT_MASK 0x04 ECU_ADDRESS 0x32 /end MEASUREMENT
/begin MEASUREMENT FaultFTMTLCS_CurSenrPhaU_OutRngHLogged "FaultFTMTLCS_CurSenrPhaU_OutRngHLogged" UBYTE Bool_ON_OFF 1 2 0 1 BIT_MASK 0x04 ECU_ADDRESS 0x32 /end MEASUREMENT
/begin MEASUREMENT FaultFTMTLCS_CurSenrPhaU_OutRngLAut "FaultFTMTLCS_CurSenrPhaU_OutRngLAut" UBYTE Bool_ON_OFF 1 2 0 1 BIT_MASK 0x08 ECU_ADDRESS 0x32 /end MEASUREMENT
/begin MEASUREMENT FaultFTMTLCS_CurSenrPhaU_OutRngLCounter "FaultFTMTLCS_CurSenrPhaU_OutRngLCount" UBYTE I_1 1 2 0 255 ECU_ADDRESS 0x2F /end MEASUREMENT
/begin MEASUREMENT FaultFTMTLCS_CurSenrPhaU_OutRngLDetected "FaultFTMTLCS_CurSenrPhaU_OutRngLDetected" UBYTE Bool_ON_OFF 1 2 0 1 BIT_MASK 0x08 ECU_ADDRESS 0x32 /end MEASUREMENT
/begin MEASUREMENT FaultFTMTLCS_CurSenrPhaU_OutRngLLogged "FaultFTMTLCS_CurSenrPhaU_OutRngLLogged" UBYTE Bool_ON_OFF 1 2 0 1 BIT_MASK 0x08 ECU_ADDRESS 0x32 /end MEASUREMENT
/begin MEASUREMENT FaultFTMTLCS_CurSenrPhaU_VCCAut "FaultFTMTLCS_CurSenrPhaU_VCCAut" UBYTE Bool_ON_OFF 1 2 0 1 BIT_MASK 0x10 ECU_ADDRESS 0x32 /end MEASUREMENT
/begin MEASUREMENT FaultFTMTLCS_CurSenrPhaU_VCCCounter "FaultFTMTLCS_CurSenrPhaU_VCCCount" UBYTE I_1 1 2 0 255 ECU_ADDRESS 0x30 /end MEASUREMENT
/begin MEASUREMENT FaultFTMTLCS_CurSenrPhaU_VCCDetected "FaultFTMTLCS_CurSenrPhaU_VCCDetected" UBYTE Bool_ON_OFF 1 2 0 1 BIT_MASK 0x10 ECU_ADDRESS 0x32 /end MEASUREMENT
/begin MEASUREMENT FaultFTMTLCS_CurSenrPhaU_VCCLogged "FaultFTMTLCS_CurSenrPhaU_VCCLogged" UBYTE Bool_ON_OFF 1 2 0 1 BIT_MASK 0x10 ECU_ADDRESS 0x32 /end MEASUREMENT
/begin MEASUREMENT FaultFTMTLCS_CurSenrPhaV_GNDAut "FaultFTMTLCS_CurSenrPhaV_GNDAut" UBYTE Bool_ON_OFF 1 2 0 1 BIT_MASK 0x20 ECU_ADDRESS 0x32 /end MEASUREMENT
/begin MEASUREMENT FaultFTMTLCS_CurSenrPhaV_GNDCounter "FaultFTMTLCS_CurSenrPhaV_GNDCount" UBYTE I_1 1 2 0 255 ECU_ADDRESS 0x31 /end MEASUREMENT
/begin MEASUREMENT FaultFTMTLCS_CurSenrPhaV_GNDDetected "FaultFTMTLCS_CurSenrPhaV_GNDDetected" UBYTE Bool_ON_OFF 1 2 0 1 BIT_MASK 0x20 ECU_ADDRESS 0x32 /end MEASUREMENT
/begin MEASUREMENT FaultFTMTLCS_CurSenrPhaV_GNDLogged "FaultFTMTLCS_CurSenrPhaV_GNDLogged" UBYTE Bool_ON_OFF 1 2 0 1 BIT_MASK 0x20 ECU_ADDRESS 0x32 /end MEASUREMENT
/begin MEASUREMENT FaultFTMTLCS_CurSenrPhaV_OutRngHAut "FaultFTMTLCS_CurSenrPhaV_OutRngHAut" UBYTE Bool_ON_OFF 1 2 0 1 BIT_MASK 0x40 ECU_ADDRESS 0x32 /end MEASUREMENT
/begin MEASUREMENT FaultFTMTLCS_CurSenrPhaV_OutRngHCounter "FaultFTMTLCS_CurSenrPhaV_OutRngHCount" UBYTE I_1 1 2 0 255 ECU_ADDRESS 0x32 /end MEASUREMENT
/begin MEASUREMENT FaultFTMTLCS_CurSenrPhaV_OutRngHDetected "FaultFTMTLCS_CurSenrPhaV_OutRngHDetected" UBYTE Bool_ON_OFF 1 2 0 1 BIT_MASK 0x40 ECU_ADDRESS 0x32 /end MEASUREMENT
/begin MEASUREMENT FaultFTMTLCS_CurSenrPhaV_OutRngHLogged "FaultFTMTLCS_CurSenrPhaV_OutRngHLogged" UBYTE Bool_ON_OFF 1 2 0 1 BIT_MASK 0x40 ECU_ADDRESS 0x32 /end MEASUREMENT
/begin MEASUREMENT FaultFTMTLCS_CurSenrPhaV_OutRngLAut "FaultFTMTLCS_CurSenrPhaV_OutRngLAut" UBYTE Bool_ON_OFF 1 2 0 1 BIT_MASK 0x80 ECU_ADDRESS 0x32 /end MEASUREMENT
/begin MEASUREMENT FaultFTMTLCS_CurSenrPhaV_OutRngLCounter "FaultFTMTLCS_CurSenrPhaV_OutRngLCount" UBYTE I_1 1 2 0 255 ECU_ADDRESS 0x33 /end MEASUREMENT
/begin MEASUREMENT FaultFTMTLCS_CurSenrPhaV_OutRngLDetected "FaultFTMTLCS_CurSenrPhaV_OutRngLDetected" UBYTE Bool_ON_OFF 1 2 0 1 BIT_MASK 0x80 ECU_ADDRESS 0x32 /end MEASUREMENT
/begin MEASUREMENT FaultFTMTLCS_CurSenrPhaV_OutRngLLogged "FaultFTMTLCS_CurSenrPhaV_OutRngLLogged" UBYTE Bool_ON_OFF 1 2 0 1 BIT_MASK 0x80 ECU_ADDRESS 0x32 /end MEASUREMENT
/begin MEASUREMENT FaultFTMTLCS_CurSenrPhaV_VCCAut "FaultFTMTLCS_CurSenrPhaV_VCCAut" UBYTE Bool_ON_OFF 1 2 0 1 BIT_MASK 0x01 ECU_ADDRESS 0x33 /end MEASUREMENT
/begin MEASUREMENT FaultFTMTLCS_CurSenrPhaV_VCCCounter "FaultFTMTLCS_CurSenrPhaV_VCCCount" UBYTE I_1 1 2 0 255 ECU_ADDRESS 0x34 /end MEASUREMENT
/begin MEASUREMENT FaultFTMTLCS_CurSenrPhaV_VCCDetected "FaultFTMTLCS_CurSenrPhaV_VCCDetected" UBYTE Bool_ON_OFF 1 2 0 1 BIT_MASK 0x01 ECU_ADDRESS 0x33 /end MEASUREMENT
/begin MEASUREMENT FaultFTMTLCS_CurSenrPhaV_VCCLogged "FaultFTMTLCS_CurSenrPhaV_VCCLogged" UBYTE Bool_ON_OFF 1 2 0 1 BIT_MASK 0x01 ECU_ADDRESS 0x33 /end MEASUREMENT
/begin MEASUREMENT FaultFTMTLCS_CurSenrPhaW_GNDAut "FaultFTMTLCS_CurSenrPhaW_GNDAut" UBYTE Bool_ON_OFF 1 2 0 1 BIT_MASK 0x02 ECU_ADDRESS 0x33 /end MEASUREMENT
/begin MEASUREMENT FaultFTMTLCS_CurSenrPhaW_GNDCounter "FaultFTMTLCS_CurSenrPhaW_GNDCount" UBYTE I_1 1 2 0 255 ECU_ADDRESS 0x35 /end MEASUREMENT
/begin MEASUREMENT FaultFTMTLCS_CurSenrPhaW_GNDDetected "FaultFTMTLCS_CurSenrPhaW_GNDDetected" UBYTE Bool_ON_OFF 1 2 0 1 BIT_MASK 0x02 ECU_ADDRESS 0x33 /end MEASUREMENT
/begin MEASUREMENT FaultFTMTLCS_CurSenrPhaW_GNDLogged "FaultFTMTLCS_CurSenrPhaW_GNDLogged" UBYTE Bool_ON_OFF 1 2 0 1 BIT_MASK 0x02 ECU_ADDRESS 0x33 /end MEASUREMENT
/begin MEASUREMENT FaultFTMTLCS_CurSenrPhaW_OutRngHAut "FaultFTMTLCS_CurSenrPhaW_OutRngHAut" UBYTE Bool_ON_OFF 1 2 0 1 BIT_MASK 0x04 ECU_ADDRESS 0x33 /end MEASUREMENT
/begin MEASUREMENT FaultFTMTLCS_CurSenrPhaW_OutRngHCounter "FaultFTMTLCS_CurSenrPhaW_OutRngHCount" UBYTE I_1 1 2 0 255 ECU_ADDRESS 0x36 /end MEASUREMENT
/begin MEASUREMENT FaultFTMTLCS_CurSenrPhaW_OutRngHDetected "FaultFTMTLCS_CurSenrPhaW_OutRngHDetected" UBYTE Bool_ON_OFF 1 2 0 1 BIT_MASK 0x04 ECU_ADDRESS 0x33 /end MEASUREMENT
/begin MEASUREMENT FaultFTMTLCS_CurSenrPhaW_OutRngHLogged "FaultFTMTLCS_CurSenrPhaW_OutRngHLogged" UBYTE Bool_ON_OFF 1 2 0 1 BIT_MASK 0x04 ECU_ADDRESS 0x33 /end MEASUREMENT
/begin MEASUREMENT FaultFTMTLCS_CurSenrPhaW_OutRngLAut "FaultFTMTLCS_CurSenrPhaW_OutRngLAut" UBYTE Bool_ON_OFF 1 2 0 1 BIT_MASK 0x08 ECU_ADDRESS 0x33 /end MEASUREMENT
/begin MEASUREMENT FaultFTMTLCS_CurSenrPhaW_OutRngLCounter "FaultFTMTLCS_CurSenrPhaW_OutRngLCount" UBYTE I_1 1 2 0 255 ECU_ADDRESS 0x37 /end MEASUREMENT
/begin MEASUREMENT FaultFTMTLCS_CurSenrPhaW_OutRngLDetected "FaultFTMTLCS_CurSenrPhaW_OutRngLDetected" UBYTE Bool_ON_OFF 1 2 0 1 BIT_MASK 0x08 ECU_ADDRESS 0x33 /end MEASUREMENT
/begin MEASUREMENT FaultFTMTLCS_CurSenrPhaW_OutRngLLogged "FaultFTMTLCS_CurSenrPhaW_OutRngLLogged" UBYTE Bool_ON_OFF 1 2 0 1 BIT_MASK 0x08 ECU_ADDRESS 0x33 /end MEASUREMENT
/begin MEASUREMENT FaultFTMTLCS_CurSenrPhaW_VCCAut "FaultFTMTLCS_CurSenrPhaW_VCCAut" UBYTE Bool_ON_OFF 1 2 0 1 BIT_MASK 0x10 ECU_ADDRESS 0x33 /end MEASUREMENT
/begin MEASUREMENT FaultFTMTLCS_CurSenrPhaW_VCCCounter "FaultFTMTLCS_CurSenrPhaW_VCCCount" UBYTE I_1 1 2 0 255 ECU_ADDRESS 0x38 /end MEASUREMENT
/begin MEASUREMENT FaultFTMTLCS_CurSenrPhaW_VCCDetected "FaultFTMTLCS_CurSenrPhaW_VCCDetected" UBYTE Bool_ON_OFF 1 2 0 1 BIT_MASK 0x10 ECU_ADDRESS 0x33 /end MEASUREMENT
/begin MEASUREMENT FaultFTMTLCS_CurSenrPhaW_VCCLogged "FaultFTMTLCS_CurSenrPhaW_VCCLogged" UBYTE Bool_ON_OFF 1 2 0 1 BIT_MASK 0x10 ECU_ADDRESS 0x33 /end MEASUREMENT
/begin MEASUREMENT FaultFTMTLCS_CurrentSumErrorAut "FaultFTMTLCS_CurrentSumErrorAut" UBYTE Bool_ON_OFF 1 2 0 1 BIT_MASK 0x01 ECU_ADDRESS 0x32 /end MEASUREMENT
/begin MEASUREMENT FaultFTMTLCS_CurrentSumErrorCounter "FaultFTMTLCS_CurrentSumErrorCount" UBYTE I_1 1 2 0 255 ECU_ADDRESS 0x2C /end MEASUREMENT
/begin MEASUREMENT FaultFTMTLCS_CurrentSumErrorDetected "FaultFTMTLCS_CurrentSumErrorDetected" UBYTE Bool_ON_OFF 1 2 0 1 BIT_MASK 0x01 ECU_ADDRESS 0x32 /end MEASUREMENT
/begin MEASUREMENT FaultFTMTLCS_CurrentSumErrorLogged "FaultFTMTLCS_CurrentSumErrorLogged" UBYTE Bool_ON_OFF 1 2 0 1 BIT_MASK 0x01 ECU_ADDRESS 0x32 /end MEASUREMENT
/begin MEASUREMENT FaultFTMTLCS_Detected "FaultFTMTLCS_Detected" UWORD I_1 1 2 0 65535 ECU_ADDRESS 0x32 /end MEASUREMENT
/begin MEASUREMENT FaultFTMTLCS_Logged "FaultFTMTLCS_Logged" UWORD I_1 1 2 0 65535 ECU_ADDRESS 0x32 /end MEASUREMENT
/begin MEASUREMENT FaultFailureLevel "FaultFailureLevel" UBYTE I_1 1 2 0 255 ECU_ADDRESS 0x0 /end MEASUREMENT
/begin MEASUREMENT FaultFunctionTypeDetectedArray "FaultFunctionTypeDetectedArray" UWORD I_1 1 2 0 65535 MATRIX_DIM 30 1 1 ECU_ADDRESS 0x0 /end MEASUREMENT
/begin MEASUREMENT FaultFunctionTypeDetectedArray[0] "FaultFunctionTypeDetectedArray[0]" UWORD I_1 1 2 0 65535 ECU_ADDRESS 0x0 /end MEASUREMENT
/begin MEASUREMENT FaultFunctionTypeDetectedArray[10] "FaultFunctionTypeDetectedArray[10]" UWORD I_1 1 2 0 65535 ECU_ADDRESS 0x0 /end MEASUREMENT
/begin MEASUREMENT FaultFunctionTypeDetectedArray[11] "FaultFunctionTypeDetectedArray[11]" UWORD I_1 1 2 0 65535 ECU_ADDRESS 0x0 /end MEASUREMENT
/begin MEASUREMENT FaultFunctionTypeDetectedArray[12] "FaultFunctionTypeDetectedArray[12]" UWORD I_1 1 2 0 65535 ECU_ADDRESS 0x0 /end MEASUREMENT
/begin MEASUREMENT FaultFunctionTypeDetectedArray[13] "FaultFunctionTypeDetectedArray[13]" UWORD I_1 1 2 0 65535 ECU_ADDRESS 0x0 /end MEASUREMENT
/begin MEASUREMENT FaultFunctionTypeDetectedArray[14] "FaultFunctionTypeDetectedArray[14]" UWORD I_1 1 2 0 65535 ECU_ADDRESS 0x0 /end MEASUREMENT
/begin MEASUREMENT FaultFunctionTypeDetectedArray[15] "FaultFunctionTypeDetectedArray[15]" UWORD I_1 1 2 0 65535 ECU_ADDRESS 0x0 /end MEASUREMENT
/begin MEASUREMENT FaultFunctionTypeDetectedArray[16] "FaultFunctionTypeDetectedArray[16]" UWORD I_1 1 2 0 65535 ECU_ADDRESS 0x0 /end MEASUREMENT
/begin MEASUREMENT FaultFunctionTypeDetectedArray[17] "FaultFunctionTypeDetectedArray[17]" UWORD I_1 1 2 0 65535 ECU_ADDRESS 0x0 /end MEASUREMENT
/begin MEASUREMENT FaultFunctionTypeDetectedArray[18] "FaultFunctionTypeDetectedArray[18]" UWORD I_1 1 2 0 65535 ECU_ADDRESS 0x0 /end MEASUREMENT
/begin MEASUREMENT FaultFunctionTypeDetectedArray[19] "FaultFunctionTypeDetectedArray[19]" UWORD I_1 1 2 0 65535 ECU_ADDRESS 0x0 /end MEASUREMENT
/begin MEASUREMENT FaultFunctionTypeDetectedArray[1] "FaultFunctionTypeDetectedArray[1]" UWORD I_1 1 2 0 65535 ECU_ADDRESS 0x0 /end MEASUREMENT
/begin MEASUREMENT FaultFunctionTypeDetectedArray[20] "FaultFunctionTypeDetectedArray[20]" UWORD I_1 1 2 0 65535 ECU_ADDRESS 0x0 /end MEASUREMENT
/begin MEASUREMENT FaultFunctionTypeDetectedArray[21] "FaultFunctionTypeDetectedArray[21]" UWORD I_1 1 2 0 65535 ECU_ADDRESS 0x0 /end MEASUREMENT
/begin MEASUREMENT FaultFunctionTypeDetectedArray[22] "FaultFunctionTypeDetectedArray[22]" UWORD I_1 1 2 0 65535 ECU_ADDRESS 0x0 /end MEASUREMENT
/begin MEASUREMENT FaultFunctionTypeDetectedArray[23] "FaultFunctionTypeDetectedArray[23]" UWORD I_1 1 2 0 65535 ECU_ADDRESS 0x0 /end MEASUREMENT
/begin MEASUREMENT FaultFunctionTypeDetectedArray[24] "FaultFunctionTypeDetectedArray[24]" UWORD I_1 1 2 0 65535 ECU_ADDRESS 0x0 /end MEASUREMENT
/begin MEASUREMENT FaultFunctionTypeDetectedArray[25] "FaultFunctionTypeDetectedArray[25]" UWORD I_1 1 2 0 65535 ECU_ADDRESS 0x0 /end MEASUREMENT
/begin MEASUREMENT FaultFunctionTypeDetectedArray[26] "FaultFunctionTypeDetectedArray[26]" UWORD I_1 1 2 0 65535 ECU_ADDRESS 0x0 /end MEASUREMENT
/begin MEASUREMENT FaultFunctionTypeDetectedArray[27] "FaultFunctionTypeDetectedArray[27]" UWORD I_1 1 2 0 65535 ECU_ADDRESS 0x0 /end MEASUREMENT
/begin MEASUREMENT FaultFunctionTypeDetectedArray[28] "FaultFunctionTypeDetectedArray[28]" UWORD I_1 1 2 0 65535 ECU_ADDRESS 0x0 /end MEASUREMENT
/begin MEASUREMENT FaultFunctionTypeDetectedArray[29] "FaultFunctionTypeDetectedArray[29]" UWORD I_1 1 2 0 65535 ECU_ADDRESS 0x0 /end MEASUREMENT
/begin MEASUREMENT FaultFunctionTypeDetectedArray[2] "FaultFunctionTypeDetectedArray[2]" UWORD I_1 1 2 0 65535 ECU_ADDRESS 0x0 /end MEASUREMENT
/begin MEASUREMENT FaultFunctionTypeDetectedArray[3] "FaultFunctionTypeDetectedArray[3]" UWORD I_1 1 2 0 65535 ECU_ADDRESS 0x0 /end MEASUREMENT
/begin MEASUREMENT FaultFunctionTypeDetectedArray[4] "FaultFunctionTypeDetectedArray[4]" UWORD I_1 1 2 0 65535 ECU_ADDRESS 0x0 /end MEASUREMENT
/begin MEASUREMENT FaultFunctionTypeDetectedArray[5] "FaultFunctionTypeDetectedArray[5]" UWORD I_1 1 2 0 65535 ECU_ADDRESS 0x0 /end MEASUREMENT
/begin MEASUREMENT FaultFunctionTypeDetectedArray[6] "FaultFunctionTypeDetectedArray[6]" UWORD I_1 1 2 0 65535 ECU_ADDRESS 0x0 /end MEASUREMENT
/begin MEASUREMENT FaultFunctionTypeDetectedArray[7] "FaultFunctionTypeDetectedArray[7]" UWORD I_1 1 2 0 65535 ECU_ADDRESS 0x0 /end MEASUREMENT
/begin MEASUREMENT FaultFunctionTypeDetectedArray[8] "FaultFunctionTypeDetectedArray[8]" UWORD I_1 1 2 0 65535 ECU_ADDRESS 0x0 /end MEASUREMENT
/begin MEASUREMENT FaultFunctionTypeDetectedArray[9] "FaultFunctionTypeDetectedArray[9]" UWORD I_1 1 2 0 65535 ECU_ADDRESS 0x0 /end MEASUREMENT
/begin MEASUREMENT FaultFunctionTypeLoggedArray "FaultFunctionTypeLoggedArray" UWORD I_1 1 2 0 65535 MATRIX_DIM 30 1 1 ECU_ADDRESS 0x0 /end MEASUREMENT
/begin MEASUREMENT FaultFunctionTypeLoggedArray[0] "FaultFunctionTypeLoggedArray[0]" UWORD I_1 1 2 0 65535 ECU_ADDRESS 0x0 /end MEASUREMENT
/begin MEASUREMENT FaultFunctionTypeLoggedArray[10] "FaultFunctionTypeLoggedArray[10]" UWORD I_1 1 2 0 65535 ECU_ADDRESS 0x0 /end MEASUREMENT
/begin MEASUREMENT FaultFunctionTypeLoggedArray[11] "FaultFunctionTypeLoggedArray[11]" UWORD I_1 1 2 0 65535 ECU_ADDRESS 0x0 /end MEASUREMENT
/begin MEASUREMENT FaultFunctionTypeLoggedArray[12] "FaultFunctionTypeLoggedArray[12]" UWORD I_1 1 2 0 65535 ECU_ADDRESS 0x0 /end MEASUREMENT
/begin MEASUREMENT FaultFunctionTypeLoggedArray[13] "FaultFunctionTypeLoggedArray[13]" UWORD I_1 1 2 0 65535 ECU_ADDRESS 0x0 /end MEASUREMENT
/begin MEASUREMENT FaultFunctionTypeLoggedArray[14] "FaultFunctionTypeLoggedArray[14]" UWORD I_1 1 2 0 65535 ECU_ADDRESS 0x0 /end MEASUREMENT
/begin MEASUREMENT FaultFunctionTypeLoggedArray[15] "FaultFunctionTypeLoggedArray[15]" UWORD I_1 1 2 0 65535 ECU_ADDRESS 0x0 /end MEASUREMENT
/begin MEASUREMENT FaultFunctionTypeLoggedArray[16] "FaultFunctionTypeLoggedArray[16]" UWORD I_1 1 2 0 65535 ECU_ADDRESS 0x0 /end MEASUREMENT
/begin MEASUREMENT FaultFunctionTypeLoggedArray[17] "FaultFunctionTypeLoggedArray[17]" UWORD I_1 1 2 0 65535 ECU_ADDRESS 0x0 /end MEASUREMENT
/begin MEASUREMENT FaultFunctionTypeLoggedArray[18] "FaultFunctionTypeLoggedArray[18]" UWORD I_1 1 2 0 65535 ECU_ADDRESS 0x0 /end MEASUREMENT
/begin MEASUREMENT FaultFunctionTypeLoggedArray[19] "FaultFunctionTypeLoggedArray[19]" UWORD I_1 1 2 0 65535 ECU_ADDRESS 0x0 /end MEASUREMENT
/begin MEASUREMENT FaultFunctionTypeLoggedArray[1] "FaultFunctionTypeLoggedArray[1]" UWORD I_1 1 2 0 65535 ECU_ADDRESS 0x0 /end MEASUREMENT
/begin MEASUREMENT FaultFunctionTypeLoggedArray[20] "FaultFunctionTypeLoggedArray[20]" UWORD I_1 1 2 0 65535 ECU_ADDRESS 0x0 /end MEASUREMENT
/begin MEASUREMENT FaultFunctionTypeLoggedArray[21] "FaultFunctionTypeLoggedArray[21]" UWORD I_1 1 2 0 65535 ECU_ADDRESS 0x0 /end MEASUREMENT
/begin MEASUREMENT FaultFunctionTypeLoggedArray[22] "FaultFunctionTypeLoggedArray[22]" UWORD I_1 1 2 0 65535 ECU_ADDRESS 0x0 /end MEASUREMENT
/begin MEASUREMENT FaultFunctionTypeLoggedArray[23] "FaultFunctionTypeLoggedArray[23]" UWORD I_1 1 2 0 65535 ECU_ADDRESS 0x0 /end MEASUREMENT
/begin MEASUREMENT FaultFunctionTypeLoggedArray[24] "FaultFunctionTypeLoggedArray[24]" UWORD I_1 1 2 0 65535 ECU_ADDRESS 0x0 /end MEASUREMENT
/begin MEASUREMENT FaultFunctionTypeLoggedArray[25] "FaultFunctionTypeLoggedArray[25]" UWORD I_1 1 2 0 65535 ECU_ADDRESS 0x0 /end MEASUREMENT
/begin MEASUREMENT FaultFunctionTypeLoggedArray[26] "FaultFunctionTypeLoggedArray[26]" UWORD I_1 1 2 0 65535 ECU_ADDRESS 0x0 /end MEASUREMENT
/begin MEASUREMENT FaultFunctionTypeLoggedArray[27] "FaultFunctionTypeLoggedArray[27]" UWORD I_1 1 2 0 65535 ECU_ADDRESS 0x0 /end MEASUREMENT
/begin MEASUREMENT FaultFunctionTypeLoggedArray[28] "FaultFunctionTypeLoggedArray[28]" UWORD I_1 1 2 0 65535 ECU_ADDRESS 0x0 /end MEASUREMENT
/begin MEASUREMENT FaultFunctionTypeLoggedArray[29] "FaultFunctionTypeLoggedArray[29]" UWORD I_1 1 2 0 65535 ECU_ADDRESS 0x0 /end MEASUREMENT
/begin MEASUREMENT FaultFunctionTypeLoggedArray[2] "FaultFunctionTypeLoggedArray[2]" UWORD I_1 1 2 0 65535 ECU_ADDRESS 0x0 /end MEASUREMENT
/begin MEASUREMENT FaultFunctionTypeLoggedArray[3] "FaultFunctionTypeLoggedArray[3]" UWORD I_1 1 2 0 65535 ECU_ADDRESS 0x0 /end MEASUREMENT
/begin MEASUREMENT FaultFunctionTypeLoggedArray[4] "FaultFunctionTypeLoggedArray[4]" UWORD I_1 1 2 0 65535 ECU_ADDRESS 0x0 /end MEASUREMENT
/begin MEASUREMENT FaultFunctionTypeLoggedArray[5] "FaultFunctionTypeLoggedArray[5]" UWORD I_1 1 2 0 65535 ECU_ADDRESS 0x0 /end MEASUREMENT
/begin MEASUREMENT FaultFunctionTypeLoggedArray[6] "FaultFunctionTypeLoggedArray[6]" UWORD I_1 1 2 0 65535 ECU_ADDRESS 0x0 /end MEASUREMENT
/begin MEASUREMENT FaultFunctionTypeLoggedArray[7] "FaultFunctionTypeLoggedArray[7]" UWORD I_1 1 2 0 65535 ECU_ADDRESS 0x0 /end MEASUREMENT
/begin MEASUREMENT FaultFunctionTypeLoggedArray[8] "FaultFunctionTypeLoggedArray[8]" UWORD I_1 1 2 0 65535 ECU_ADDRESS 0x0 /end MEASUREMENT
/begin MEASUREMENT FaultFunctionTypeLoggedArray[9] "FaultFunctionTypeLoggedArray[9]" UWORD I_1 1 2 0 65535 ECU_ADDRESS 0x0 /end MEASUREMENT
/begin MEASUREMENT FaultSDMTMEP_CosGndAut "FaultSDMTMEP_CosGndAut" UBYTE Bool_ON_OFF 1 2 0 1 BIT_MASK 0x01 ECU_ADDRESS 0x34 /end MEASUREMENT
/begin MEASUREMENT FaultSDMTMEP_CosGndCounter "FaultSDMTMEP_CosGndCount" UBYTE I_1 1 2 0 255 ECU_ADDRESS 0x39 /end MEASUREMENT
/begin MEASUREMENT FaultSDMTMEP_CosGndDetected "FaultSDMTMEP_CosGndDetected" UBYTE Bool_ON_OFF 1 2 0 1 BIT_MASK 0x01 ECU_ADDRESS 0x34 /end MEASUREMENT
/begin MEASUREMENT FaultSDMTMEP_CosGndLogged "FaultSDMTMEP_CosGndLogged" UBYTE Bool_ON_OFF 1 2 0 1 BIT_MASK 0x01 ECU_ADDRESS 0x34 /end MEASUREMENT
/begin MEASUREMENT FaultSDMTMEP_CosOutRangeHighAut "FaultSDMTMEP_CosOutRangeHighAut" UBYTE Bool_ON_OFF 1 2 0 1 BIT_MASK 0x02 ECU_ADDRESS 0x34 /end MEASUREMENT
/begin MEASUREMENT FaultSDMTMEP_CosOutRangeHighCounter "FaultSDMTMEP_CosOutRangeHighCount" UBYTE I_1 1 2 0 255 ECU_ADDRESS 0x3A /end MEASUREMENT
/begin MEASUREMENT FaultSDMTMEP_CosOutRangeHighDetected "FaultSDMTMEP_CosOutRangeHighDetected" UBYTE Bool_ON_OFF 1 2 0 1 BIT_MASK 0x02 ECU_ADDRESS 0x34 /end MEASUREMENT
/begin MEASUREMENT FaultSDMTMEP_CosOutRangeHighLogged "FaultSDMTMEP_CosOutRangeHighLogged" UBYTE Bool_ON_OFF 1 2 0 1 BIT_MASK 0x02 ECU_ADDRESS 0x34 /end MEASUREMENT
/begin MEASUREMENT FaultSDMTMEP_CosOutRangeLowAut "FaultSDMTMEP_CosOutRangeLowAut" UBYTE Bool_ON_OFF 1 2 0 1 BIT_MASK 0x04 ECU_ADDRESS 0x34 /end MEASUREMENT
/begin MEASUREMENT FaultSDMTMEP_CosOutRangeLowCounter "FaultSDMTMEP_CosOutRangeLowCount" UBYTE I_1 1 2 0 255 ECU_ADDRESS 0x3B /end MEASUREMENT
/begin MEASUREMENT FaultSDMTMEP_CosOutRangeLowDetected "FaultSDMTMEP_CosOutRangeLowDetected" UBYTE Bool_ON_OFF 1 2 0 1 BIT_MASK 0x04 ECU_ADDRESS 0x34 /end MEASUREMENT
/begin MEASUREMENT FaultSDMTMEP_CosOutRangeLowLogged "FaultSDMTMEP_CosOutRangeLowLogged" UBYTE Bool_ON_OFF 1 2 0 1 BIT_MASK 0x04 ECU_ADDRESS 0x34 /end MEASUREMENT
/begin MEASUREMENT FaultSDMTMEP_CosVccAut "FaultSDMTMEP_CosVccAut" UBYTE Bool_ON_OFF 1 2 0 1 BIT_MASK 0x08 ECU_ADDRESS 0x34 /end MEASUREMENT
/begin MEASUREMENT FaultSDMTMEP_CosVccCounter "FaultSDMTMEP_CosVccCount" UBYTE I_1 1 2 0 255 ECU_ADDRESS 0x3C /end MEASUREMENT
/begin MEASUREMENT FaultSDMTMEP_CosVccDetected "FaultSDMTMEP_CosVccDetected" UBYTE Bool_ON_OFF 1 2 0 1 BIT_MASK 0x08 ECU_ADDRESS 0x34 /end MEASUREMENT
/begin MEASUREMENT FaultSDMTMEP_CosVccLogged "FaultSDMTMEP_CosVccLogged" UBYTE Bool_ON_OFF 1 2 0 1 BIT_MASK 0x08 ECU_ADDRESS 0x34 /end MEASUREMENT
/begin MEASUREMENT FaultSDMTMEP_Detected "FaultSDMTMEP_Detected" UWORD I_1 1 2 0 65535 ECU_ADDRESS 0x34 /end MEASUREMENT
/begin MEASUREMENT FaultSDMTMEP_Logged "FaultSDMTMEP_Logged" UWORD I_1 1 2 0 65535 ECU_ADDRESS 0x34 /end MEASUREMENT
/begin MEASUREMENT FaultSDMTMEP_OverSpeedAut "FaultSDMTMEP_OverSpeedAut" UBYTE Bool_ON_OFF 1 2 0 1 BIT_MASK 0x10 ECU_ADDRESS 0x34 /end MEASUREMENT
/begin MEASUREMENT FaultSDMTMEP_OverSpeedCounter "FaultSDMTMEP_OverSpeedCount" UBYTE I_1 1 2 0 255 ECU_ADDRESS 0x3D /end MEASUREMENT
/begin MEASUREMENT FaultSDMTMEP_OverSpeedDetected "FaultSDMTMEP_OverSpeedDetected" UBYTE Bool_ON_OFF 1 2 0 1 BIT_MASK 0x10 ECU_ADDRESS 0x34 /end MEASUREMENT
/begin MEASUREMENT FaultSDMTMEP_OverSpeedLogged "FaultSDMTMEP_OverSpeedLogged" UBYTE Bool_ON_OFF 1 2 0 1 BIT_MASK 0x10 ECU_ADDRESS 0x34 /end MEASUREMENT
/begin MEASUREMENT FaultSDMTMEP_ResSquaSumErrByFTAut "FaultSDMTMEP_ResSquaSumErrByFTAut" UBYTE Bool_ON_OFF 1 2 0 1 BIT_MASK 0x20 ECU_ADDRESS 0x34 /end MEASUREMENT
/begin MEASUREMENT FaultSDMTMEP_ResSquaSumErrByFTCounter "FaultSDMTMEP_ResSquaSumErrByFTCount" UBYTE I_1 1 2 0 255 ECU_ADDRESS 0x3E /end MEASUREMENT
/begin MEASUREMENT FaultSDMTMEP_ResSquaSumErrByFTDetected "FaultSDMTMEP_ResSquaSumErrByFTDetected" UBYTE Bool_ON_OFF 1 2 0 1 BIT_MASK 0x20 ECU_ADDRESS 0x34 /end MEASUREMENT
/begin MEASUREMENT FaultSDMTMEP_ResSquaSumErrByFTLogged "FaultSDMTMEP_ResSquaSumErrByFTLogged" UBYTE Bool_ON_OFF 1 2 0 1 BIT_MASK 0x20 ECU_ADDRESS 0x34 /end MEASUREMENT
/begin MEASUREMENT FaultSDMTMEP_SinGndAut "FaultSDMTMEP_SinGndAut" UBYTE Bool_ON_OFF 1 2 0 1 BIT_MASK 0x40 ECU_ADDRESS 0x34 /end MEASUREMENT
/begin MEASUREMENT FaultSDMTMEP_SinGndCounter "FaultSDMTMEP_SinGndCount" UBYTE I_1 1 2 0 255 ECU_ADDRESS 0x3F /end MEASUREMENT
/begin MEASUREMENT FaultSDMTMEP_SinGndDetected "FaultSDMTMEP_SinGndDetected" UBYTE Bool_ON_OFF 1 2 0 1 BIT_MASK 0x40 ECU_ADDRESS 0x34 /end MEASUREMENT
/begin MEASUREMENT FaultSDMTMEP_SinGndLogged "FaultSDMTMEP_SinGndLogged" UBYTE Bool_ON_OFF 1 2 0 1 BIT_MASK 0x40 ECU_ADDRESS 0x34 /end MEASUREMENT
/begin MEASUREMENT FaultSDMTMEP_SinOutRangeHighAut "FaultSDMTMEP_SinOutRangeHighAut" UBYTE Bool_ON_OFF 1 2 0 1 BIT_MASK 0x80 ECU_ADDRESS 0x34 /end MEASUREMENT
/begin MEASUREMENT FaultSDMTMEP_SinOutRangeHighCounter "FaultSDMTMEP_SinOutRangeHighCount" UBYTE I_1 1 2 0 255 ECU_ADDRESS 0x40 /end MEASUREMENT
/begin MEASUREMENT FaultSDMTMEP_SinOutRangeHighDetected "FaultSDMTMEP_SinOutRangeHighDetected" UBYTE Bool_ON_OFF 1 2 0 1 BIT_MASK 0x80 ECU_ADDRESS 0x34 /end MEASUREMENT
/begin MEASUREMENT FaultSDMTMEP_SinOutRangeHighLogged "FaultSDMTMEP_SinOutRangeHighLogged" UBYTE Bool_ON_OFF 1 2 0 1 BIT_MASK 0x80 ECU_ADDRESS 0x34 /end MEASUREMENT
/begin MEASUREMENT FaultSDMTMEP_SinOutRangeLowAut "FaultSDMTMEP_SinOutRangeLowAut" UBYTE Bool_ON_OFF 1 2 0 1 BIT_MASK 0x01 ECU_ADDRESS 0x35 /end MEASUREMENT
/begin MEASUREMENT FaultSDMTMEP_SinOutRangeLowCounter "FaultSDMTMEP_SinOutRangeLowCount" UBYTE I_1 1 2 0 255 ECU_ADDRESS 0x41 /end MEASUREMENT
/begin MEASUREMENT FaultSDMTMEP_SinOutRangeLowDetected "FaultSDMTMEP_SinOutRangeLowDetected" UBYTE Bool_ON_OFF 1 2 0 1 BIT_MASK 0x01 ECU_ADDRESS 0x35 /end MEASUREMENT
/begin MEASUREMENT FaultSDMTMEP_SinOutRangeLowLogged "FaultSDMTMEP_SinOutRangeLowLogged" UBYTE Bool_ON_OFF 1 2 0 1 BIT_MASK 0x01 ECU_ADDRESS 0x35 /end MEASUREMENT
/begin MEASUREMENT FaultSDMTMEP_SinVccAut "FaultSDMTMEP_SinVccAut" UBYTE Bool_ON_OFF 1 2 0 1 BIT_MASK 0x02 ECU_ADDRESS 0x35 /end MEASUREMENT
/begin MEASUREMENT FaultSDMTMEP_SinVccCounter "FaultSDMTMEP_SinVccCount" UBYTE I_1 1 2 0 255 ECU_ADDRESS 0x42 /end MEASUREMENT
/begin MEASUREMENT FaultSDMTMEP_SinVccDetected "FaultSDMTMEP_SinVccDetected" UBYTE Bool_ON_OFF 1 2 0 1 BIT_MASK 0x02 ECU_ADDRESS 0x35 /end MEASUREMENT
/begin MEASUREMENT FaultSDMTMEP_SinVccLogged "FaultSDMTMEP_SinVccLogged" UBYTE Bool_ON_OFF 1 2 0 1 BIT_MASK 0x02 ECU_ADDRESS 0x35 /end MEASUREMENT
/begin MEASUREMENT FaultSDMTMEP_UnderSpeedAut "FaultSDMTMEP_UnderSpeedAut" UBYTE Bool_ON_OFF 1 2 0 1 BIT_MASK 0x04 ECU_ADDRESS 0x35 /end MEASUREMENT
/begin MEASUREMENT FaultSDMTMEP_UnderSpeedCounter "FaultSDMTMEP_UnderSpeedCount" UBYTE I_1 1 2 0 255 ECU_ADDRESS 0x43 /end MEASUREMENT
/begin MEASUREMENT FaultSDMTMEP_UnderSpeedDetected "FaultSDMTMEP_UnderSpeedDetected" UBYTE Bool_ON_OFF 1 2 0 1 BIT_MASK 0x04 ECU_ADDRESS 0x35 /end MEASUREMENT
/begin MEASUREMENT FaultSDMTMEP_UnderSpeedLogged "FaultSDMTMEP_UnderSpeedLogged" UBYTE Bool_ON_OFF 1 2 0 1 BIT_MASK 0x04 ECU_ADDRESS 0x35 /end MEASUREMENT
/begin MEASUREMENT FaultTableFuncTypeCounter1 "FaultTableFuncTypeCounter1" UBYTE I_1 1 2 0 255 MATRIX_DIM 133 1 1 ECU_ADDRESS 0x0 /end MEASUREMENT
/begin MEASUREMENT FaultTableFuncTypeCounter1[0] "FaultTableFuncTypeCounter1[0]" UBYTE I_1 1 2 0 255 ECU_ADDRESS 0x0 /end MEASUREMENT
/begin MEASUREMENT FaultTableFuncTypeCounter1[100] "FaultTableFuncTypeCounter1[100]" UBYTE I_1 1 2 0 255 ECU_ADDRESS 0x0 /end MEASUREMENT
/begin MEASUREMENT FaultTableFuncTypeCounter1[101] "FaultTableFuncTypeCounter1[101]" UBYTE I_1 1 2 0 255 ECU_ADDRESS 0x0 /end MEASUREMENT
/begin MEASUREMENT FaultTableFuncTypeCounter1[102] "FaultTableFuncTypeCounter1[102]" UBYTE I_1 1 2 0 255 ECU_ADDRESS 0x0 /end MEASUREMENT
/begin MEASUREMENT FaultTableFuncTypeCounter1[103] "FaultTableFuncTypeCounter1[103]" UBYTE I_1 1 2 0 255 ECU_ADDRESS 0x0 /end MEASUREMENT
/begin MEASUREMENT FaultTableFuncTypeCounter1[104] "FaultTableFuncTypeCounter1[104]" UBYTE I_1 1 2 0 255 ECU_ADDRESS 0x0 /end MEASUREMENT
/begin MEASUREMENT FaultTableFuncTypeCounter1[105] "FaultTableFuncTypeCounter1[105]" UBYTE I_1 1 2 0 255 ECU_ADDRESS 0x0 /end MEASUREMENT
/begin MEASUREMENT FaultTableFuncTypeCounter1[106] "FaultTableFuncTypeCounter1[106]" UBYTE I_1 1 2 0 255 ECU_ADDRESS 0x0 /end MEASUREMENT
/begin MEASUREMENT FaultTableFuncTypeCounter1[107] "FaultTableFuncTypeCounter1[107]" UBYTE I_1 1 2 0 255 ECU_ADDRESS 0x0 /end MEASUREMENT
/begin MEASUREMENT FaultTableFuncTypeCounter1[108] "FaultTableFuncTypeCounter1[108]" UBYTE I_1 1 2 0 255 ECU_ADDRESS 0x0 /end MEASUREMENT
/begin MEASUREMENT FaultTableFuncTypeCounter1[109] "FaultTableFuncTypeCounter1[109]" UBYTE I_1 1 2 0 255 ECU_ADDRESS 0x0 /end MEASUREMENT
/begin MEASUREMENT FaultTableFuncTypeCounter1[10] "FaultTableFuncTypeCounter1[10]" UBYTE I_1 1 2 0 255 ECU_ADDRESS 0x0 /end MEASUREMENT
/begin MEASUREMENT FaultTableFuncTypeCounter1[110] "FaultTableFuncTypeCounter1[110]" UBYTE I_1 1 2 0 255 ECU_ADDRESS 0x0 /end MEASUREMENT
/begin MEASUREMENT FaultTableFuncTypeCounter1[111] "FaultTableFuncTypeCounter1[111]" UBYTE I_1 1 2 0 255 ECU_ADDRESS 0x0 /end MEASUREMENT
/begin MEASUREMENT FaultTableFuncTypeCounter1[112] "FaultTableFuncTypeCounter1[112]" UBYTE I_1 1 2 0 255 ECU_ADDRESS 0x0 /end MEASUREMENT
/begin MEASUREMENT FaultTableFuncTypeCounter1[113] "FaultTableFuncTypeCounter1[113]" UBYTE I_1 1 2 0 255 ECU_ADDRESS 0x0 /end MEASUREMENT
/begin MEASUREMENT FaultTableFuncTypeCounter1[114] "FaultTableFuncTypeCounter1[114]" UBYTE I_1 1 2 0 255 ECU_ADDRESS 0x0 /end MEASUREMENT
/begin MEASUREMENT FaultTableFuncTypeCounter1[115] "FaultTableFuncTypeCounter1[115]" UBYTE I_1 1 2 0 255 ECU_ADDRESS 0x0 /end MEASUREMENT
/begin MEASUREMENT FaultTableFuncTypeCounter1[116] "FaultTableFuncTypeCounter1[116]" UBYTE I_1 1 2 0 255 ECU_ADDRESS 0x0 /end MEASUREMENT
/begin MEASUREMENT FaultTableFuncTypeCounter1[117] "FaultTableFuncTypeCounter1[117]" UBYTE I_1 1 2 0 255 ECU_ADDRESS 0x0 /end MEASUREMENT
/begin MEASUREMENT FaultTableFuncTypeCounter1[118] "FaultTableFuncTypeCounter1[118]" UBYTE I_1 1 2 0 255 ECU_ADDRESS 0x0 /end MEASUREMENT
/begin MEASUREMENT FaultTableFuncTypeCounter1[119] "FaultTableFuncTypeCounter1[119]" UBYTE I_1 1 2 0 255 ECU_ADDRESS 0x0 /end MEASUREMENT
/begin MEASUREMENT FaultTableFuncTypeCounter1[11] "FaultTableFuncTypeCounter1[11]" UBYTE I_1 1 2 0 255 ECU_ADDRESS 0x0 /end MEASUREMENT
/begin MEASUREMENT FaultTableFuncTypeCounter1[120] "FaultTableFuncTypeCounter1[120]" UBYTE I_1 1 2 0 255 ECU_ADDRESS 0x0 /end MEASUREMENT
/begin MEASUREMENT FaultTableFuncTypeCounter1[121] "FaultTableFuncTypeCounter1[121]" UBYTE I_1 1 2 0 255 ECU_ADDRESS 0x0 /end MEASUREMENT
/begin MEASUREMENT FaultTableFuncTypeCounter1[122] "FaultTableFuncTypeCounter1[122]" UBYTE I_1 1 2 0 255 ECU_ADDRESS 0x0 /end MEASUREMENT
/begin MEASUREMENT FaultTableFuncTypeCounter1[123] "FaultTableFuncTypeCounter1[123]" UBYTE I_1 1 2 0 255 ECU_ADDRESS 0x0 /end MEASUREMENT
/begin MEASUREMENT FaultTableFuncTypeCounter1[124] "FaultTableFuncTypeCounter1[124]" UBYTE I_1 1 2 0 255 ECU_ADDRESS 0x0 /end MEASUREMENT
/begin MEASUREMENT FaultTableFuncTypeCounter1[125] "FaultTableFuncTypeCounter1[125]" UBYTE I_1 1 2 0 255 ECU_ADDRESS 0x0 /end MEASUREMENT
/begin MEASUREMENT FaultTableFuncTypeCounter1[126] "FaultTableFuncTypeCounter1[126]" UBYTE I_1 1 2 0 255 ECU_ADDRESS 0x0 /end MEASUREMENT
/begin MEASUREMENT FaultTableFuncTypeCounter1[127] "FaultTableFuncTypeCounter1[127]" UBYTE I_1 1 2 0 255 ECU_ADDRESS 0x0 /end MEASUREMENT
/begin MEASUREMENT FaultTableFuncTypeCounter1[128] "FaultTableFuncTypeCounter1[128]" UBYTE I_1 1 2 0 255 ECU_ADDRESS 0x0 /end MEASUREMENT
/begin MEASUREMENT FaultTableFuncTypeCounter1[129] "FaultTableFuncTypeCounter1[129]" UBYTE I_1 1 2 0 255 ECU_ADDRESS 0x0 /end MEASUREMENT
/begin MEASUREMENT FaultTableFuncTypeCounter1[12] "FaultTableFuncTypeCounter1[12]" UBYTE I_1 1 2 0 255 ECU_ADDRESS 0x0 /end MEASUREMENT
/begin MEASUREMENT FaultTableFuncTypeCounter1[130] "FaultTableFuncTypeCounter1[130]" UBYTE I_1 1 2 0 255 ECU_ADDRESS 0x0 /end MEASUREMENT
/begin MEASUREMENT FaultTableFuncTypeCounter1[131] "FaultTableFuncTypeCounter1[131]" UBYTE I_1 1 2 0 255 ECU_ADDRESS 0x0 /end MEASUREMENT
/begin MEASUREMENT FaultTableFuncTypeCounter1[132] "FaultTableFuncTypeCounter1[132]" UBYTE I_1 1 2 0 255 ECU_ADDRESS 0x0 /end MEASUREMENT
/begin MEASUREMENT FaultTableFuncTypeCounter1[13] "FaultTableFuncTypeCounter1[13]" UBYTE I_1 1 2 0 255 ECU_ADDRESS 0x0 /end MEASUREMENT
/begin MEASUREMENT FaultTableFuncTypeCounter1[14] "FaultTableFuncTypeCounter1[14]" UBYTE I_1 1 2 0 255 ECU_ADDRESS 0x0 /end MEASUREMENT
/begin MEASUREMENT FaultTableFuncTypeCounter1[15] "FaultTableFuncTypeCounter1[15]" UBYTE I_1 1 2 0 255 ECU_ADDRESS 0x0 /end MEASUREMENT
/begin MEASUREMENT FaultTableFuncTypeCounter1[16] "FaultTableFuncTypeCounter1[16]" UBYTE I_1 1 2 0 255 ECU_ADDRESS 0x0 /end MEASUREMENT
/begin MEASUREMENT FaultTableFuncTypeCounter1[17] "FaultTableFuncTypeCounter1[17]" UBYTE I_1 1 2 0 255 ECU_ADDRESS 0x0 /end MEASUREMENT
/begin MEASUREMENT FaultTableFuncTypeCounter1[18] "FaultTableFuncTypeCounter1[18]" UBYTE I_1 1 2 0 255 ECU_ADDRESS 0x0 /end MEASUREMENT
/begin MEASUREMENT FaultTableFuncTypeCounter1[19] "FaultTableFuncTypeCounter1[19]" UBYTE I_1 1 2 0 255 ECU_ADDRESS 0x0 /end MEASUREMENT
/begin MEASUREMENT GBSW_bOCDataNotRation "..." UBYTE Bool_ON_OFF 1 2 0 1 BIT_MASK 0x01 ECU_ADDRESS 0x0 /end MEASUREMENT
/begin MEASUREMENT Presence_devaid "Presence_devaid" UWORD I_1 1 2 0 65535 ECU_ADDRESS 0x0 /end MEASUREMENT
/begin COMPU_METHOD I_1 "" RAT_FUNC "%9.2" "-" COEFFS 0 1 0 0 0 1 /end COMPU_METHOD
/begin COMPU_METHOD I_3 "" RAT_FUNC "%9.2" "" COEFFS 0 1 0 0 0 1 /end COMPU_METHOD
/begin COMPU_METHOD F_1_p0_4 "" RAT_FUNC "%9.2" "-" COEFFS 0 1 0 0 0 1 /end COMPU_METHOD
/begin COMPU_METHOD F_100_p0_5 "" RAT_FUNC "%9.2" "%" COEFFS 0 1 0 0 0 100 /end COMPU_METHOD
/begin COMPU_METHOD F_10_p0_6 "" RAT_FUNC "%9.2" "ms" COEFFS 0 1 0 0 0 10 /end COMPU_METHOD
/begin COMPU_METHOD F_0v05_p0_7 "" RAT_FUNC "%9.2" "ms" COEFFS 0 1 0 0 0 0.05 /end COMPU_METHOD
/begin COMPU_METHOD F_0v001_p0_9 "" RAT_FUNC "%9.3" "s" COEFFS 0 1 0 0 0 0.001 /end COMPU_METHOD
/begin COMPU_METHOD F_0v0012210012_p0_10 "" RAT_FUNC "%9.3" "V" COEFFS 0 1 0 0 0 0.001221 /end COMPU_METHOD
/begin COMPU_METHOD F_4_p0_11 "" RAT_FUNC "%9.2" "Bytes" COEFFS 0 1 0 0 0 4 /end COMPU_METHOD
/begin COMPU_METHOD F_0v01_p0_12 "" RAT_FUNC "%9.2" "ï¿½s" COEFFS 0 1 0 0 0 0.01 /end COMPU_METHOD
/begin COMPU_METHOD I_15 "" RAT_FUNC "%9.2" "V" COEFFS 0 1 0 0 0 1 /end COMPU_METHOD
/begin COMPU_METHOD I_23 "" RAT_FUNC "%9.2" "uint8" COEFFS 0 1 0 0 0 1 /end COMPU_METHOD
/begin COMPU_METHOD F_5_p0_30 "" RAT_FUNC "%9.2" "ms" COEFFS 0 1 0 0 0 5 /end COMPU_METHOD
/begin COMPU_METHOD F_0v0128205128_p0_31 "" RAT_FUNC "%9.2" "V" COEFFS 0 1 0 0 0 0.0128205 /end COMPU_METHOD
/begin COMPU_METHOD Id_0x00 "" RAT_FUNC "%9.2" "." COEFFS 0 1 0 0 0 1 /end COMPU_METHOD
/begin COMPU_METHOD Bool_ON_OFF "" TAB_VERB "%8.4" "." COMPU_TAB_REF Bool_ON_OFF_table /end COMPU_METHOD
/begin COMPU_VTAB Bool_ON_OFF_table "" TAB_VERB 2 0 "OFF" 1 "ON" /end COMPU_VTAB
/begin FUNCTION BLDC ""
 /begin DEF_CHARACTERISTIC BLDC_bHallInvalidFltTestOnC BLDC_bHallUndefFltTestOnC BLDC_bHwPinAscEnaC BLDC_bOilPressShortGndFltTestOnC BLDC_bOilPressShortVccFltTestOnC BLDC_bP5vAD2SOverVolFltTestOnC BLDC_bP5vAD2SUnderVolFltTestOnC BLDC_bTestPinEnaC BLDC_kf32LVThdHighC BLDC_kf32LVThdLowC BLDC_kf32MidPotMaxMonitorDutyC BLDC_kf32MidPotMinMonitorDutyC BLDC_kf32MidPotShrtGndDutyC BLDC_kf32MidPotShrtVccDutyC BLDC_kf32MidPotTgtHighC BLDC_kf32MidPotTgtLowC BLDC_kf32MotorSpeedC BLDC_kf32P5vAD2SOverVolC BLDC_kf32P5vAD2SUnderVolC BLDC_kf32TgtDutyDeltMaxC BLDC_ku16MidPotFltConfirmC BLDC_ku16MidPotFltIncStepC BLDC_ku16MidPotRcvTimC BLDC_ku16RvsDutyDelayC BLDC_ku16TgtDutyRisingTimC /end DEF_CHARACTERISTIC
 /begin OUT_MEASUREMENT BLDC_bClrTrapReq BLDC_bEnterSleepMod BLDC_bHallInvalidFlt BLDC_bHallUndefFlt BLDC_bHwFaultDcOvVolt BLDC_bHwFaultIgbtH BLDC_bHwFaultIgbtL BLDC_bHwFaultOvcU BLDC_bHwFaultOvcV BLDC_bHwFaultOvcW BLDC_bIsBldcStart BLDC_bMotorSpdRdy BLDC_bOilPressShortGndFlt BLDC_bOilPressShortVccFlt BLDC_bP5vAD2SOverVolFlt BLDC_bP5vAD2SUnderVolFlt BLDC_bTrapTrigger BLDC_bUShortGnd BLDC_bUShortVs BLDC_bUvwShortGnd BLDC_bUvwShortVs BLDC_bVShortGnd BLDC_bVShortVs BLDC_bWShortGnd BLDC_bWShortVs BLDC_f32BatteryVoltage BLDC_f32BkpVoltage BLDC_f32BldcPosDuty BLDC_f32MotorSpeed BLDC_f32P5vAD2SPhys BLDC_f32Pfb1DutyPhys BLDC_f32Pfb1DutyPhys[0] BLDC_f32Pfb1DutyPhys[1] BLDC_f32Pfb1DutyPhys[2] BLDC_f32Pfb1DutyPhys[3] BLDC_f32Pfb1DutyPhys[4] BLDC_f32Pfb1DutyPhys[5] BLDC_f32Pfb1DutyPhys[6] BLDC_f32Pfb1DutyPhys[7] BLDC_f32Pfb1DutyPhysSum BLDC_f32Pfb2DutyPhys BLDC_f32Pfb2DutyPhys[0] BLDC_f32Pfb2DutyPhys[1] BLDC_f32Pfb2DutyPhys[2] BLDC_f32Pfb2DutyPhys[3] BLDC_f32Pfb2DutyPhys[4] BLDC_f32Pfb2DutyPhys[5] BLDC_f32Pfb2DutyPhys[6] BLDC_f32Pfb2DutyPhys[7] BLDC_f32Pfb2DutyPhysSum BLDC_f32Pfb3DutyPhys BLDC_f32Pfb3DutyPhys[0] BLDC_f32Pfb3DutyPhys[1] BLDC_f32Pfb3DutyPhys[2] BLDC_f32Pfb3DutyPhys[3] BLDC_f32Pfb3DutyPhys[4] BLDC_f32Pfb3DutyPhys[5] BLDC_f32Pfb3DutyPhys[6] BLDC_f32Pfb3DutyPhys[7] BLDC_f32Pfb3DutyPhysSum BLDC_f32PrevTgtDuty BLDC_f32TgtDutyDeltVal BLDC_f32TgtDutyPhys BLDC_f32TgtDutyPhys[0] BLDC_f32TgtDutyPhys[1] BLDC_f32TgtDutyPhys[2] BLDC_f32TgtDutyPhys[3] BLDC_f32TgtDutyPhys[4] BLDC_f32TgtDutyPhys[5] BLDC_f32TgtDutyPhys[6] BLDC_f32TgtDutyPhys[7] BLDC_f32TgtDutyPhysSum BLDC_u16DutyDelayCnt BLDC_u16McuAscSttDelay BLDC_u16OilPressureRaw BLDC_u16P5vAD2SRaw BLDC_u16PowerOnDelay BLDC_u16PwmMaxDutyCyc BLDC_u16PwmMinDutyCyc BLDC_u16ShortConfirmCnt BLDC_u16ShortRecoveryCnt BLDC_u16T12PeriodVal BLDC_u16T13CmpVal BLDC_u16T13PeriodVal BLDC_u16TgtDutyRisingDelay BLDC_u32MotPosSigDuty BLDC_u32MotPosSigPerd BLDC_u32T12IsrCounter BLDC_u32TrapCreq BLDC_u8ConfirmDirSts BLDC_u8CurDirSts BLDC_u8CurHallStt BLDC_u8DiagHallStt BLDC_u8DiagHallSttPre BLDC_u8DutyModeStt BLDC_u8HallStt BLDC_u8McuAscSttStep BLDC_u8PfbDutyCnt BLDC_u8PrevDirSts BLDC_u8PwmState BLDC_u8WrCurHallStt BLDC_u8WrExpHallStt BLDC_u8WrExpOutput BLDC_u8WrExpOutputLast /end OUT_MEASUREMENT
/end FUNCTION
/begin FUNCTION BSW ""
 /begin DEF_CHARACTERISTIC BSW_bGCUTOutTestOnC BSW_bIntLockDetEnaC BSW_bOBDEnaC BSW_bSPYBenchOnC BSW_ku16VSIRdyChkTimoutC /end DEF_CHARACTERISTIC
 /begin OUT_MEASUREMENT BSW_bAppMsgTxEna BSW_bCAN0BusOff BSW_bCAN1BusOff BSW_bCbkRxTOutFlag_SGBCM_pepsReq BSW_bCbkRxTOutFlag_SGRx10Req BSW_bCbkRxTOutFlag_SGRx11Req BSW_bCbkRxTOutFlag_SGRx12Req BSW_bCbkRxTOutFlag_SGRx13Req BSW_bCbkRxTOutFlag_SGRx14Req BSW_bCbkRxTOutFlag_SGRx15Req BSW_bCbkRxTOutFlag_SGRx16Req BSW_bCbkRxTOutFlag_SGRx17Req BSW_bCbkRxTOutFlag_SGRx18Req BSW_bCbkRxTOutFlag_SGRx19Req BSW_bCbkRxTOutFlag_SGRx1Req BSW_bCbkRxTOutFlag_SGRx20Req BSW_bCbkRxTOutFlag_SGRx21Req BSW_bCbkRxTOutFlag_SGRx22Req BSW_bCbkRxTOutFlag_SGRx23Req BSW_bCbkRxTOutFlag_SGRx24Req BSW_bCbkRxTOutFlag_SGRx25Req BSW_bCbkRxTOutFlag_SGRx26Req BSW_bCbkRxTOutFlag_SGRx27Req BSW_bCbkRxTOutFlag_SGRx2Req BSW_bCbkRxTOutFlag_SGRx3Req BSW_bCbkRxTOutFlag_SGRx4Req BSW_bCbkRxTOutFlag_SGRx5Req BSW_bCbkRxTOutFlag_SGRx6Req BSW_bCbkRxTOutFlag_SGRx7Req BSW_bCbkRxTOutFlag_SGRx8Req BSW_bCbkRxTOutFlag_SGRx9Req BSW_bCsumErrFlag_SGGcu2Req BSW_bCsumErrFlag_SGGcu4Req BSW_bCsumErrFlag_SGPdcm_acu_epsReq BSW_bCsumErrFlag_SGPdcm_gcuReq BSW_bCsumErrFlag_SGPdcm_ic_acuReq BSW_bCsumErrFlag_SGRx1Req BSW_bCsumErrFlag_SGRx2Req BSW_bEnableCalcWriteNvMMaxTime BSW_bIntLockDetEna BSW_bIntLockOccurFlg BSW_bMKeyOnStatus BSW_bMSGTrigTxFlag_Mcu7Req BSW_bNvmWrTrig BSW_bOCDataNotRation BSW_bRcErrFlag_SGGcu2Req BSW_bRcErrFlag_SGGcu4Req BSW_bRcErrFlag_SGPdcm_acu_epsReq BSW_bRcErrFlag_SGPdcm_gcuReq BSW_bRcErrFlag_SGPdcm_ic_acuReq BSW_bRcErrFlag_SGRx1Req BSW_bRcErrFlag_SGRx2Req BSW_bStackOverflowWarning BSW_bUdsFunctionReqFlg BSW_bVsiReadySts BSW_u16CurWriteNvMTime BSW_u16IntLockDelayTim BSW_u16NvmStoreDelay BSW_u16NvMWriteCmd BSW_u16RawVolMonCurOcpH BSW_u16RawVolMonCurOcpL BSW_u16RawVolMonDcOvpSele BSW_u16RawVolP16VMulti BSW_u16RawVolP5VHS BSW_u16RawVolP5VHsREF BSW_u16RawVolP5VLS BSW_u16RawVolP5VLsREF BSW_u16RawVolP5VREF BSW_u16RawVolt15VRdc BSW_u16RawVoltDclinkFIL BSW_u16SelfChkDelay BSW_u16Var1 BSW_u16VsiReadyDelay BSW_u16WriteNvMMaxTime BSW_u32CbkRxAckCntSGPepsMsgSts BSW_u32FeeNextFreePageAddr BSW_u32RcvUdsCanId BSW_u32StackUsed BSW_u32VSICounterCkreq BSW_u32VSICounterSafeCkreq BSW_u32VSICounterTimeoutCs BSW_u32VSICounterTimeoutFrame BSW_u32VSICounterTimeoutSafeTCalc BSW_u32VSICounterTimeoutSyncPos BSW_u32VSICounterTimeoutTCalc BSW_u32VSISafeTimeDuration BSW_u32VSISafeTimeDurationMax BSW_u32VSISafeTimeDurationMin BSW_u32VSITimeDuration BSW_u32VSITimeDurationMax BSW_u32VSITimeDurationMin BSW_u8CAN0BusOffCounter BSW_u8CAN1BusOffCounter BSW_u8FeeCurSector BSW_u8FeeSectorChangeCnt BSW_u8Gcu2CsumErrCnt BSW_u8Gcu2RcErrCnt BSW_u8Gcu2RcLast BSW_u8Gcu2RcNow BSW_u8Gcu4CsumErrCnt BSW_u8Gcu4RcErrCnt BSW_u8Gcu4RcLast BSW_u8Gcu4RcNow BSW_u8IntLockErrCnt BSW_u8McuMotTrqRollCnt BSW_u8McuStsRollCnt BSW_u8NvmMngStt BSW_u8NvMReturnResult BSW_u8Pdcm_acu_epsCsumErrCnt BSW_u8Pdcm_acu_epsRcErrCnt BSW_u8Pdcm_acu_epsRcLast BSW_u8Pdcm_acu_epsRcNow BSW_u8Pdcm_gcuCsumErrCnt BSW_u8Pdcm_gcuRcErrCnt BSW_u8Pdcm_gcuRcLast BSW_u8Pdcm_gcuRcNow BSW_u8Pdcm_ic_acuCsumErrCnt BSW_u8Pdcm_ic_acuRcErrCnt BSW_u8Pdcm_ic_acuRcLast BSW_u8Pdcm_ic_acuRcNow BSW_u8Rx1CsumErrCnt BSW_u8Rx1RcErrCnt BSW_u8Rx1RcLast BSW_u8Rx1RcUnchangedErrCnt BSW_u8Rx2CsumErrCnt BSW_u8Rx2RcErrCnt BSW_u8Rx2RcLast BSW_u8Rx2RcUnchangedErrCnt BSW_u8SelfChkErr GBSW_bOCDataNotRation Presence_devaid /end OUT_MEASUREMENT
/end FUNCTION
/begin FUNCTION CALUSR "" /begin DEF_CHARACTERISTIC CalUsr_ku32CalibUpdEnaMskA CalUsr_ku32CalibUpdEnaMskB /end DEF_CHARACTERISTIC
 /begin OUT_MEASUREMENT CalUsr_bIsCalibUpdEna CalUsr_u32ChkDataCrc CalUsr_u32POCalibDnEnaMskA CalUsr_u32POCalibDnEnaMskB CalUsr_u32PODataCRC /end OUT_MEASUREMENT
/end FUNCTION
/begin FUNCTION CCU6 ""
 /begin DEF_CHARACTERISTIC CCU6_bAlimFreqChgEnaC CCU6_bDualSmpEnaC CCU6_bHwOvcFltDetEnaC CCU6_bHwPinAscEnaC CCU6_f32DrvClkDutyThdHighC CCU6_f32DrvClkDutyThdLowC CCU6_kbDrvBdClkEnaC CCU6_kf32MidPointDutyHC CCU6_kf32MidPointDutyLC CCU6_ku16AlimDutyCycRawC CCU6_ku32AlimFreqRawC CCU6_ku8AscRecoverCntMaxC CCU6_ku8PwmMidPointFaultC /end DEF_CHARACTERISTIC
 /begin OUT_MEASUREMENT CCU6_au32PWMOnTime CCU6_au32PWMOnTime[0] CCU6_au32PWMOnTime[1] CCU6_au32PWMOnTime[2] CCU6_bAkdAfterAscReq CCU6_bClrTrapReq CCU6_bHighVoltStdbyFlg CCU6_bHwFaultDcOvVolt CCU6_bHwFaultIgbtH CCU6_bHwFaultIgbtL CCU6_bHwFaultOvcU CCU6_bHwFaultOvcV CCU6_bHwFaultOvcW CCU6_bIgbtHighSideShort CCU6_bIgbtLowSideShort CCU6_bIsCCU6Start CCU6_bIuvwCompReq CCU6_bMotorSpdRdy CCU6_bP5VDiagReinitCmd CCU6_bP5VHSFltFlg CCU6_bP5VLSFltFlg CCU6_bPwmMidPointU CCU6_bPwmMidPointV CCU6_bPwmMidPointW CCU6_bPwmOnGoingFlg CCU6_bT12ZeroMatchFlg CCU6_bTrapTrigger CCU6_f32DrvClkHsDuty CCU6_f32DrvClkLsDuty CCU6_f32HighVolPhys CCU6_f32PwmDutyPhysUZ CCU6_f32PwmDutyPhysVZ CCU6_f32PwmDutyPhysWZ CCU6_u16AlimPowerOnDelay CCU6_u16CCU6T13CmpVal CCU6_u16HighVolAdc CCU6_u16McuAscSttDelay CCU6_u16P5VHSAdc CCU6_u16PowerOnDelay CCU6_u16PwmMaxDutyCyc CCU6_u16PwmMidPointErrCnt CCU6_u16PwmMinDutyCyc CCU6_u16PwmModReq CCU6_u16T12CntVal CCU6_u16T12PeriodVal CCU6_u16T13PeriodVal CCU6_u32DrvClkHsDutyRaw CCU6_u32DrvClkHsPerdRaw CCU6_u32DrvClkLsDutyRaw CCU6_u32DrvClkLsPerdRaw CCU6_u32TrapCreq CCU6_u8AscRecoverCnt CCU6_u8McuAscSttStep CCU6_u8McuAscType CCU6_u8P5VHSFltCnt CCU6_u8P5VLSFltCnt CCU6_u8P5VPowerMngStt CCU6_u8P5VSelfTstStt CCU6_u8P5VSelfTstTimCnt CCU6_u8PreTestStep CCU6_u8PwmState /end OUT_MEASUREMENT
/end FUNCTION
/begin FUNCTION COMMUSR ""
 /begin OUT_MEASUREMENT ASWNM_bBusSleep ASWNM_bStayAwake ASWNM_u16AfterRunDelayTimes ASWNM_u16Kl15Sts COMMUSR_bComNoComModeReqed COMMUSR_bPwrDnRunFlg COMMUSR_bShutdownReq COMMUSR_bStayAwakeReq COMMUSR_bStayAwakeReqDiag COMMUSR_bTrigPwrDownFlg COMMUSR_bWkpByCAN COMMUSR_u16DiagToutCtr COMMUSR_u8NmState COMMUSR_u8NvmJobRes COMMUSR_u8PrevNmState COMMUSR_u8State COMMUSR_u8StayAwakeReason COMMUSR_u8WakeReason /end OUT_MEASUREMENT
/end FUNCTION
/begin FUNCTION DET ""
 /begin OUT_MEASUREMENT Det_astrRecordedErrors[0].u16ModuleId Det_astrRecordedErrors[0].u8ApiId Det_astrRecordedErrors[0].u8ErrorId Det_astrRecordedErrors[0].u8InstanceId Det_astrRecordedErrors[1].u16ModuleId Det_astrRecordedErrors[1].u8ApiId Det_astrRecordedErrors[1].u8ErrorId Det_astrRecordedErrors[1].u8InstanceId Det_astrRecordedErrors[2].u16ModuleId Det_astrRecordedErrors[2].u8ApiId Det_astrRecordedErrors[2].u8ErrorId Det_astrRecordedErrors[2].u8InstanceId Det_astrRecordedErrors[3].u16ModuleId Det_astrRecordedErrors[3].u8ApiId Det_astrRecordedErrors[3].u8ErrorId Det_astrRecordedErrors[3].u8InstanceId Det_astrRecordedErrors[4].u16ModuleId Det_astrRecordedErrors[4].u8ApiId Det_astrRecordedErrors[4].u8ErrorId Det_astrRecordedErrors[4].u8InstanceId Det_bOverflowOccured Det_u8BufferHead Det_u8NumberOfErrors /end OUT_MEASUREMENT
/end FUNCTION
/begin FUNCTION DEVHAL "" /begin OUT_MEASUREMENT DEVHAL_bIsInitialized DEVHAL_u8CheckEngineState /end OUT_MEASUREMENT /end FUNCTION
/begin FUNCTION DFLASH "" /begin OUT_MEASUREMENT DFApp_u8DflashMainState /end OUT_MEASUREMENT /end FUNCTION
/begin FUNCTION DSM "" /begin DEF_CHARACTERISTIC FaultEraseRequestC /end DEF_CHARACTERISTIC
 /begin OUT_MEASUREMENT DSM_DtcNumber DSM_DtcNumber[0] DSM_DtcNumber[1] DSM_DtcNumber[2] DSM_DtcNumber[3] DSM_DtcNumber[4] DSM_DtcNumber[5] DSM_DtcNumber[6] DSM_DtcNumber[7] DSM_DtcNumber[8] DSM_DtcNumber[9] DSM_DtcStatusNvm DSM_DtcStatusNvm[0] DSM_DtcStatusNvm[1] DSM_DtcStatusNvm[2] DSM_DtcStatusNvm[3] DSM_DtcStatusNvm[4] DSM_DtcStatusNvm[5] DSM_DtcStatusNvm[6] DSM_DtcStatusNvm[7] DSM_DtcStatusNvm[8] DSM_DtcStatusNvm[9] DSM_FaultFailureLevel DSM_FaultFailureLevel[0] DSM_FaultFailureLevel[1] FaultEraseRequest FaultFailureLevel /end OUT_MEASUREMENT
/end FUNCTION
/begin FUNCTION EAS ""
 /begin DEF_CHARACTERISTIC EAS_bDefaultEskPassC EAS_bRN32EnaOnC EAS_u8Chg1DelayTimoutC /end DEF_CHARACTERISTIC
 /begin OUT_MEASUREMENT EAS_au8ComChallengeVal EAS_au8ComChallengeVal[0] EAS_au8ComChallengeVal[1] EAS_au8ComChallengeVal[2] EAS_au8ComChallengeVal[3] EAS_au8ComChallengeVal[4] EAS_au8ComChallengeVal[5] EAS_au8ComChallengeVal[6] EAS_au8ComChallengeVal[7] EAS_au8ComImmoCode EAS_au8ComImmoCode[0] EAS_au8ComImmoCode[1] EAS_au8ComImmoCode[2] EAS_au8ComImmoCode[3] EAS_au8ComImmoCode[4] EAS_au8ComImmoCode[5] EAS_au8ComImmoCode[6] EAS_au8ComImmoCode[7] EAS_au8ParmCC64Nvm EAS_au8ParmCC64Nvm[0] EAS_au8ParmCC64Nvm[1] EAS_au8ParmCC64Nvm[2] EAS_au8ParmCC64Nvm[3] EAS_au8ParmCC64Nvm[4] EAS_au8ParmCC64Nvm[5] EAS_au8ParmCC64Nvm[6] EAS_au8ParmCC64Nvm[7] EAS_au8ParmEacEncr EAS_au8ParmEacEncr[0] EAS_au8ParmEacEncr[10] EAS_au8ParmEacEncr[11] EAS_au8ParmEacEncr[12] EAS_au8ParmEacEncr[13] EAS_au8ParmEacEncr[14] EAS_au8ParmEacEncr[15] EAS_au8ParmEacEncr[1] EAS_au8ParmEacEncr[2] EAS_au8ParmEacEncr[3] EAS_au8ParmEacEncr[4] EAS_au8ParmEacEncr[5] EAS_au8ParmEacEncr[6] EAS_au8ParmEacEncr[7] EAS_au8ParmEacEncr[8] EAS_au8ParmEacEncr[9] EAS_au8ParmEacSeed EAS_au8ParmEacSeed[0] EAS_au8ParmEacSeed[10] EAS_au8ParmEacSeed[11] EAS_au8ParmEacSeed[12] EAS_au8ParmEacSeed[13] EAS_au8ParmEacSeed[14] EAS_au8ParmEacSeed[15] EAS_au8ParmEacSeed[1] EAS_au8ParmEacSeed[2] EAS_au8ParmEacSeed[3] EAS_au8ParmEacSeed[4] EAS_au8ParmEacSeed[5] EAS_au8ParmEacSeed[6] EAS_au8ParmEacSeed[7] EAS_au8ParmEacSeed[8] EAS_au8ParmEacSeed[9] EAS_au8ParmEarEncr1 EAS_au8ParmEarEncr1[0] EAS_au8ParmEarEncr1[10] EAS_au8ParmEarEncr1[11] EAS_au8ParmEarEncr1[12] EAS_au8ParmEarEncr1[13] EAS_au8ParmEarEncr1[14] EAS_au8ParmEarEncr1[15] EAS_au8ParmEarEncr1[1] EAS_au8ParmEarEncr1[2] EAS_au8ParmEarEncr1[3] EAS_au8ParmEarEncr1[4] EAS_au8ParmEarEncr1[5] EAS_au8ParmEarEncr1[6] EAS_au8ParmEarEncr1[7] EAS_au8ParmEarEncr1[8] EAS_au8ParmEarEncr1[9] EAS_au8ParmEarEncr2 EAS_au8ParmEarEncr2[0] EAS_au8ParmEarEncr2[10] EAS_au8ParmEarEncr2[11] EAS_au8ParmEarEncr2[12] EAS_au8ParmEarEncr2[13] EAS_au8ParmEarEncr2[14] EAS_au8ParmEarEncr2[15] EAS_au8ParmEarEncr2[1] EAS_au8ParmEarEncr2[2] EAS_au8ParmEarEncr2[3] EAS_au8ParmEarEncr2[4] EAS_au8ParmEarEncr2[5] EAS_au8ParmEarEncr2[6] EAS_au8ParmEarEncr2[7] EAS_au8ParmEarEncr2[8] EAS_au8ParmEarEncr2[9] EAS_au8ParmRN32 EAS_au8ParmRN32[0] EAS_au8ParmRN32[1] EAS_au8ParmRN32[2] EAS_au8ParmRN32[3] EAS_au8ParmSC32Nvm EAS_au8ParmSC32Nvm[0] EAS_au8ParmSC32Nvm[1] EAS_au8ParmSC32Nvm[2] EAS_au8ParmSC32Nvm[3] EAS_au8ParmSK128Nvm EAS_au8ParmSK128Nvm[0] EAS_au8ParmSK128Nvm[10] EAS_au8ParmSK128Nvm[11] EAS_au8ParmSK128Nvm[12] EAS_au8ParmSK128Nvm[13] EAS_au8ParmSK128Nvm[14] EAS_au8ParmSK128Nvm[15] EAS_au8ParmSK128Nvm[1] EAS_au8ParmSK128Nvm[2] EAS_au8ParmSK128Nvm[3] EAS_au8ParmSK128Nvm[4] EAS_au8ParmSK128Nvm[5] EAS_au8ParmSK128Nvm[6] EAS_au8ParmSK128Nvm[7] EAS_au8ParmSK128Nvm[8] EAS_au8ParmSK128Nvm[9] EAS_bAesVerifyRes EAS_bDefaultEskFlg EAS_bImmoCodRcvFlg EAS_bSendNewChalgFlg EAS_u8AuthFailedCnt EAS_u8AuthState EAS_u8AuthVerifyCnt EAS_u8Chg1DelayCnt EAS_u8ImmFailReason EAS_u8SttTimerCnt EAS_u8TMReleaseSig /end OUT_MEASUREMENT
/end FUNCTION
/begin FUNCTION ESM "" /begin DEF_CHARACTERISTIC ESM_u16PowerLatchTempoC ESM_u8RestartDelayCntC /end DEF_CHARACTERISTIC
 /begin OUT_MEASUREMENT ESM_EcuState ESM_OPERATIONAL_MODE ESM_POWER_OFF_MODE ESM_POWERLATCH_MODE ESM_STARTUP_I_MODE ESM_STARTUP_II_MODE ESM_u16PowerLatchTempo /end OUT_MEASUREMENT
/end FUNCTION
/begin FUNCTION FAIL "" /begin DEF_CHARACTERISTIC FAIL_bCanErrCheckonC /end DEF_CHARACTERISTIC
 /begin OUT_MEASUREMENT FAIL_bCanErrChkDisabled FAIL_bComLostDiagTEna FAIL_bComLostDiagVEna FAIL_bComLostDiagVHigh FAIL_bComLostDiagVLow FAIL_bDebug1 FAIL_bRstHotFlag FAIL_bRstHotFlagNvm FAIL_bRstHotFlagNvm_def FAIL_u16ComLostDiagEnaCnt FAIL_u16ComLostDiagVRecCnt FAIL_u16KeyOnDelay FAIL_u16KeyOnValue FAIL_u16LvBatVoltRaw FAIL_u16RstHotCntNvm FAIL_u16RstHotCntNvm_def FAIL_u16RstStartUpCntNvm FAIL_u16RstStartUpCntNvm_def FAIL_u16TimestampIgnNvm FAIL_u16TimestampIgnNvm_def FAIL_u32TimestampLifeNvm FAIL_u32TimestampLifeNvm_def FAIL_u8Can1BusoffCnt FAIL_u8CCP_FaultLevel /end OUT_MEASUREMENT
/end FUNCTION
/begin FUNCTION FAULT ""
 /begin OUT_MEASUREMENT FaultBSW_COM_BusOff_CAN1Aut FaultBSW_COM_BusOff_CAN1Counter FaultBSW_COM_BusOff_CAN1Detected FaultBSW_COM_BusOff_CAN1Logged FaultBSW_COM_ChecksumErrVCUAut FaultBSW_COM_ChecksumErrVCUCounter FaultBSW_COM_ChecksumErrVCUDetected FaultBSW_COM_ChecksumErrVCULogged FaultBSW_COM_Detected FaultBSW_COM_InterFaultVCUAut FaultBSW_COM_InterFaultVCUCounter FaultBSW_COM_InterFaultVCUDetected FaultBSW_COM_InterFaultVCULogged FaultBSW_COM_Logged FaultBSW_COM_RollCntErrVCUAut FaultBSW_COM_RollCntErrVCUCounter FaultBSW_COM_RollCntErrVCUDetected FaultBSW_COM_RollCntErrVCULogged FaultBSW_COM_TimoutRxBCMAut FaultBSW_COM_TimoutRxBCMCounter FaultBSW_COM_TimoutRxBCMDetected FaultBSW_COM_TimoutRxBCMLogged FaultBSW_COM_TimoutRxBMSHAut FaultBSW_COM_TimoutRxBMSHCounter FaultBSW_COM_TimoutRxBMSHDetected FaultBSW_COM_TimoutRxBMSHLogged FaultBSW_COM_TimoutRxEMSAut FaultBSW_COM_TimoutRxEMSCounter FaultBSW_COM_TimoutRxEMSDetected FaultBSW_COM_TimoutRxEMSLogged FaultBSW_COM_TimoutRxGCUAut FaultBSW_COM_TimoutRxGCUCounter FaultBSW_COM_TimoutRxGCUDetected FaultBSW_COM_TimoutRxGCULogged FaultBSW_COM_TimoutRxIPCAut FaultBSW_COM_TimoutRxIPCCounter FaultBSW_COM_TimoutRxIPCDetected FaultBSW_COM_TimoutRxIPCLogged FaultBSW_COM_TimoutRxTBOXAut FaultBSW_COM_TimoutRxTBOXCounter FaultBSW_COM_TimoutRxTBOXDetected FaultBSW_COM_TimoutRxTBOXLogged FaultBSW_COM_TimoutRxVCUAut FaultBSW_COM_TimoutRxVCUCounter FaultBSW_COM_TimoutRxVCUDetected FaultBSW_COM_TimoutRxVCULogged FaultBSW_HW2_Detected FaultBSW_HW2_FPGA_OverVoltVBatAut FaultBSW_HW2_FPGA_OverVoltVBatCounter FaultBSW_HW2_FPGA_OverVoltVBatDetected FaultBSW_HW2_FPGA_OverVoltVBatLogged FaultBSW_HW2_Logged FaultBSW_HW2_SafeTlib_PreRunAut FaultBSW_HW2_SafeTlib_PreRunCounter FaultBSW_HW2_SafeTlib_PreRunDetected FaultBSW_HW2_SafeTlib_PreRunLogged FaultBSW_HW_Detected FaultBSW_HW_EasAckFailAut FaultBSW_HW_EasAckFailCounter FaultBSW_HW_EasAckFailDetected FaultBSW_HW_EasAckFailLogged FaultBSW_HW_FPGA_IGBT_HAut FaultBSW_HW_FPGA_IGBT_HCounter FaultBSW_HW_FPGA_IGBT_HDetected FaultBSW_HW_FPGA_IGBT_HLogged FaultBSW_HW_FPGA_IGBT_LAut FaultBSW_HW_FPGA_IGBT_LCounter FaultBSW_HW_FPGA_IGBT_LDetected FaultBSW_HW_FPGA_IGBT_LLogged FaultBSW_HW_FPGA_OverUnderCurUIAut FaultBSW_HW_FPGA_OverUnderCurUICounter FaultBSW_HW_FPGA_OverUnderCurUIDetected FaultBSW_HW_FPGA_OverUnderCurUILogged FaultBSW_HW_FPGA_OverUnderCurVIAut FaultBSW_HW_FPGA_OverUnderCurVICounter FaultBSW_HW_FPGA_OverUnderCurVIDetected FaultBSW_HW_FPGA_OverUnderCurVILogged FaultBSW_HW_FPGA_OverUnderCurWIAut FaultBSW_HW_FPGA_OverUnderCurWICounter FaultBSW_HW_FPGA_OverUnderCurWIDetected FaultBSW_HW_FPGA_OverUnderCurWILogged FaultBSW_HW_Logged FaultBSW_HW_OCDataNotRationalAut FaultBSW_HW_OCDataNotRationalCounter FaultBSW_HW_OCDataNotRationalDetected FaultBSW_HW_OCDataNotRationalLogged FaultBSW_SYS_Detected FaultBSW_SYS_Logged FaultBSW_SYS_RstHotAut FaultBSW_SYS_RstHotCounter FaultBSW_SYS_RstHotDetected FaultBSW_SYS_RstHotLogged FaultBSW_SYS_StackOverflowAut FaultBSW_SYS_StackOverflowCounter FaultBSW_SYS_StackOverflowDetected FaultBSW_SYS_StackOverflowLogged FaultBSW_VSI_Detected FaultBSW_VSI_Logged FaultBSW_VSI_TimeoutTCalcAut FaultBSW_VSI_TimeoutTCalcCounter FaultBSW_VSI_TimeoutTCalcDetected FaultBSW_VSI_TimeoutTCalcLogged FaultFSEVBHV_Detected FaultFSEVBHV_Logged FaultFSEVBHV_OverVoltageAut FaultFSEVBHV_OverVoltageCounter FaultFSEVBHV_OverVoltageDetected FaultFSEVBHV_OverVoltageLogged FaultFSEVBHV_SampleVolOutRngHAut FaultFSEVBHV_SampleVolOutRngHCounter FaultFSEVBHV_SampleVolOutRngHDetected FaultFSEVBHV_SampleVolOutRngHLogged FaultFSEVBHV_SampleVolOutRngLAut FaultFSEVBHV_SampleVolOutRngLCounter FaultFSEVBHV_SampleVolOutRngLDetected FaultFSEVBHV_SampleVolOutRngLLogged FaultFSEVBHV_UnderDetected FaultFSEVBHV_UnderLogged FaultFSEVBHV_UnderVoltageAut FaultFSEVBHV_UnderVoltageCounter FaultFSEVBHV_UnderVoltageDetected FaultFSEVBHV_UnderVoltageLogged FaultFSEVBHV_UnderVoltageWarnAut FaultFSEVBHV_UnderVoltageWarnCounter FaultFSEVBHV_UnderVoltageWarnDetected FaultFSEVBHV_UnderVoltageWarnLogged FaultFSEVBHV_VolNotRationalAut FaultFSEVBHV_VolNotRationalCounter FaultFSEVBHV_VolNotRationalDetected FaultFSEVBHV_VolNotRationalLogged FaultFSEVBHV_VoltageGndAut FaultFSEVBHV_VoltageGndCounter FaultFSEVBHV_VoltageGndDetected FaultFSEVBHV_VoltageGndLogged FaultFSEVBHV_VoltageVccAut FaultFSEVBHV_VoltageVccCounter FaultFSEVBHV_VoltageVccDetected FaultFSEVBHV_VoltageVccLogged FaultFSEVBLV_Detected FaultFSEVBLV_Logged FaultFSEVBLV_OverVoltageAut FaultFSEVBLV_OverVoltageCounter FaultFSEVBLV_OverVoltageDetected FaultFSEVBLV_OverVoltageLogged FaultFSEVBLV_P5VRefADCFltAut FaultFSEVBLV_P5VRefADCFltCounter FaultFSEVBLV_P5VRefADCFltDetected FaultFSEVBLV_P5VRefADCFltLogged FaultFSEVBLV_UnderDetected FaultFSEVBLV_UnderLogged FaultFSEVBLV_UnderVoltageAut FaultFSEVBLV_UnderVoltageCounter FaultFSEVBLV_UnderVoltageDetected FaultFSEVBLV_UnderVoltageLogged FaultFSEVBLV_UnderVoltageWarnAut FaultFSEVBLV_UnderVoltageWarnCounter FaultFSEVBLV_UnderVoltageWarnDetected FaultFSEVBLV_UnderVoltageWarnLogged FaultFSEVBLV_VoltageGndAut FaultFSEVBLV_VoltageGndCounter FaultFSEVBLV_VoltageGndDetected FaultFSEVBLV_VoltageGndLogged FaultFSEVBLV_VoltageVccAut FaultFSEVBLV_VoltageVccCounter FaultFSEVBLV_VoltageVccDetected FaultFSEVBLV_VoltageVccLogged FaultFSEVETA_Detected FaultFSEVETA_DrvTempRationAut FaultFSEVETA_DrvTempRationCounter FaultFSEVETA_DrvTempRationDetected FaultFSEVETA_DrvTempRationLogged FaultFSEVETA_IgbtTempRationalAut FaultFSEVETA_IgbtTempRationalCounter FaultFSEVETA_IgbtTempRationalDetected FaultFSEVETA_IgbtTempRationalLogged FaultFSEVETA_Logged FaultFSEVETA_OverDetected FaultFSEVETA_OverLogged FaultFSEVETA_OverTempDrvLeftAut FaultFSEVETA_OverTempDrvLeftCounter FaultFSEVETA_OverTempDrvLeftDetected FaultFSEVETA_OverTempDrvLeftLogged FaultFSEVETA_OverTempIgbtLeftAut FaultFSEVETA_OverTempIgbtLeftCounter FaultFSEVETA_OverTempIgbtLeftDetected FaultFSEVETA_OverTempIgbtLeftLogged FaultFSEVETA_OverTempNTC1CmdBoardAut FaultFSEVETA_OverTempNTC1CmdBoardCounter FaultFSEVETA_OverTempNTC1CmdBoardDetected FaultFSEVETA_OverTempNTC1CmdBoardLogged FaultFSEVETA_SampleIgbtTempOutRngHAut FaultFSEVETA_SampleIgbtTempOutRngHCounter FaultFSEVETA_SampleIgbtTempOutRngHDetected FaultFSEVETA_SampleIgbtTempOutRngHLogged FaultFSEVETA_SampleIgbtTempOutRngLAut FaultFSEVETA_SampleIgbtTempOutRngLCounter FaultFSEVETA_SampleIgbtTempOutRngLDetected FaultFSEVETA_SampleIgbtTempOutRngLLogged FaultFSEVETA_TempDetected FaultFSEVETA_TempDrvBoardLeftGndAut FaultFSEVETA_TempDrvBoardLeftGndCounter FaultFSEVETA_TempDrvBoardLeftGndDetected FaultFSEVETA_TempDrvBoardLeftGndLogged FaultFSEVETA_TempDrvBoardLeftVccAut FaultFSEVETA_TempDrvBoardLeftVccCounter FaultFSEVETA_TempDrvBoardLeftVccDetected FaultFSEVETA_TempDrvBoardLeftVccLogged FaultFSEVETA_TempIgbtLeftGndAut FaultFSEVETA_TempIgbtLeftGndCounter FaultFSEVETA_TempIgbtLeftGndDetected FaultFSEVETA_TempIgbtLeftGndLogged FaultFSEVETA_TempIgbtLeftVccAut FaultFSEVETA_TempIgbtLeftVccCounter FaultFSEVETA_TempIgbtLeftVccDetected FaultFSEVETA_TempIgbtLeftVccLogged FaultFSEVETA_TempLogged FaultFSEVETA_TempNTC1CmdBoardGndAut FaultFSEVETA_TempNTC1CmdBoardGndCounter FaultFSEVETA_TempNTC1CmdBoardGndDetected FaultFSEVETA_TempNTC1CmdBoardGndLogged FaultFSEVETA_TempNTC1CmdBoardVccAut FaultFSEVETA_TempNTC1CmdBoardVccCounter FaultFSEVETA_TempNTC1CmdBoardVccDetected FaultFSEVETA_TempNTC1CmdBoardVccLogged FaultFSEVETA_UnderDetected FaultFSEVETA_UnderLogged FaultFSEVETA_UnderTempDrvLeftAut FaultFSEVETA_UnderTempDrvLeftCounter FaultFSEVETA_UnderTempDrvLeftDetected FaultFSEVETA_UnderTempDrvLeftLogged FaultFSEVETA_UnderTempIgbtLeftAut FaultFSEVETA_UnderTempIgbtLeftCounter FaultFSEVETA_UnderTempIgbtLeftDetected FaultFSEVETA_UnderTempIgbtLeftLogged FaultFSEVETA_UnderTempNTC1CmdBoardAut FaultFSEVETA_UnderTempNTC1CmdBoardCounter FaultFSEVETA_UnderTempNTC1CmdBoardDetected FaultFSEVETA_UnderTempNTC1CmdBoardLogged FaultFSMTMTA_OverDetected FaultFSMTMTA_OverLogged FaultFSMTMTA_OverTempWdgHead1Aut FaultFSMTMTA_OverTempWdgHead1Counter FaultFSMTMTA_OverTempWdgHead1Detected FaultFSMTMTA_OverTempWdgHead1Logged FaultFSMTMTA_TempDetected FaultFSMTMTA_TempLogged FaultFSMTMTA_TempWindHead1OutRngHAut FaultFSMTMTA_TempWindHead1OutRngHCounter FaultFSMTMTA_TempWindHead1OutRngHDetected FaultFSMTMTA_TempWindHead1OutRngHLogged FaultFSMTMTA_TempWindHead1OutRngLAut FaultFSMTMTA_TempWindHead1OutRngLCounter FaultFSMTMTA_TempWindHead1OutRngLDetected FaultFSMTMTA_TempWindHead1OutRngLLogged FaultFSMTMTA_TempWindingHead1GndAut FaultFSMTMTA_TempWindingHead1GndCounter FaultFSMTMTA_TempWindingHead1GndDetected FaultFSMTMTA_TempWindingHead1GndLogged FaultFSMTMTA_TempWindingHead1VccAut FaultFSMTMTA_TempWindingHead1VccCounter FaultFSMTMTA_TempWindingHead1VccDetected FaultFSMTMTA_TempWindingHead1VccLogged FaultFSMTMTA_UnderDetected FaultFSMTMTA_UnderLogged FaultFSMTMTA_UnderTempWdgHead1Aut FaultFSMTMTA_UnderTempWdgHead1Counter FaultFSMTMTA_UnderTempWdgHead1Detected FaultFSMTMTA_UnderTempWdgHead1Logged FaultFSMTRDG_Detected FaultFSMTRDG_ExcGenerationAut FaultFSMTRDG_ExcGenerationCounter FaultFSMTRDG_ExcGenerationDetected FaultFSMTRDG_ExcGenerationLogged FaultFSMTRDG_ExcSignalGNDAut FaultFSMTRDG_ExcSignalGNDCounter FaultFSMTRDG_ExcSignalGNDDetected FaultFSMTRDG_ExcSignalGNDLogged FaultFSMTRDG_ExcSignalVCCAut FaultFSMTRDG_ExcSignalVCCCounter FaultFSMTRDG_ExcSignalVCCDetected FaultFSMTRDG_ExcSignalVCCLogged FaultFSMTRDG_Logged FaultFSMTRDG_SinCosHLGndAut FaultFSMTRDG_SinCosHLGndCounter FaultFSMTRDG_SinCosHLGndDetected FaultFSMTRDG_SinCosHLGndLogged FaultFSMTRDG_SinCosHLOpenAut FaultFSMTRDG_SinCosHLOpenCounter FaultFSMTRDG_SinCosHLOpenDetected FaultFSMTRDG_SinCosHLOpenLogged FaultFSMTRDG_SinCosHLVccAut FaultFSMTRDG_SinCosHLVccCounter FaultFSMTRDG_SinCosHLVccDetected FaultFSMTRDG_SinCosHLVccLogged FaultFSSMACS_AkdFailFlagAut FaultFSSMACS_AkdFailFlagCounter FaultFSSMACS_AkdFailFlagDetected FaultFSSMACS_AkdFailFlagLogged FaultFSSMACS_Detected FaultFSSMACS_Logged FaultFTASBDS_BattVoltDeratingActAut FaultFTASBDS_BattVoltDeratingActCounter FaultFTASBDS_BattVoltDeratingActDetected FaultFTASBDS_BattVoltDeratingActLogged FaultFTASBDS_Detected FaultFTASBDS_Logged FaultFTASETP_Detected FaultFTASETP_EstPmDeratingActAut FaultFTASETP_EstPmDeratingActCounter FaultFTASETP_EstPmDeratingActDetected FaultFTASETP_EstPmDeratingActLogged FaultFTASETP_Logged FaultFTASETP_PmDeratingActAut FaultFTASETP_PmDeratingActCounter FaultFTASETP_PmDeratingActDetected FaultFTASETP_PmDeratingActLogged FaultFTASMTP_Detected FaultFTASMTP_Logged FaultFTASMTP_Wndg1DeratingActAut FaultFTASMTP_Wndg1DeratingActCounter FaultFTASMTP_Wndg1DeratingActDetected FaultFTASMTP_Wndg1DeratingActLogged FaultFTASOSP_Detected FaultFTASOSP_Logged FaultFTASOSP_MotorSpdDeratingActAut FaultFTASOSP_MotorSpdDeratingActCounter FaultFTASOSP_MotorSpdDeratingActDetected FaultFTASOSP_MotorSpdDeratingActLogged FaultFTCMSCS_CtrlSatTimoutAut FaultFTCMSCS_CtrlSatTimoutCounter FaultFTCMSCS_CtrlSatTimoutDetected FaultFTCMSCS_CtrlSatTimoutLogged FaultFTCMSCS_Detected FaultFTCMSCS_Logged FaultFTCMSCS_SpdOvershootAut FaultFTCMSCS_SpdOvershootCounter FaultFTCMSCS_SpdOvershootDetected FaultFTCMSCS_SpdOvershootLogged FaultFTCMSCS_ZeroSpeedTimoutAut FaultFTCMSCS_ZeroSpeedTimoutCounter FaultFTCMSCS_ZeroSpeedTimoutDetected FaultFTCMSCS_ZeroSpeedTimoutLogged FaultFTCMTCS_Detected FaultFTCMTCS_Logged FaultFTCMTCS_VoltageMarginLowAut FaultFTCMTCS_VoltageMarginLowCounter FaultFTCMTCS_VoltageMarginLowDetected FaultFTCMTCS_VoltageMarginLowLogged FaultFTEVEIT_Detected FaultFTEVEIT_EstOverTempAut FaultFTEVEIT_EstOverTempCounter FaultFTEVEIT_EstOverTempDetected FaultFTEVEIT_EstOverTempLogged FaultFTEVEIT_Logged FaultFTMTLCS_CurrentSumErrorAut FaultFTMTLCS_CurrentSumErrorCounter FaultFTMTLCS_CurrentSumErrorDetected FaultFTMTLCS_CurrentSumErrorLogged FaultFTMTLCS_CurSenrPhaU_GNDAut FaultFTMTLCS_CurSenrPhaU_GNDCounter FaultFTMTLCS_CurSenrPhaU_GNDDetected FaultFTMTLCS_CurSenrPhaU_GNDLogged FaultFTMTLCS_CurSenrPhaU_OutRngHAut FaultFTMTLCS_CurSenrPhaU_OutRngHCounter FaultFTMTLCS_CurSenrPhaU_OutRngHDetected FaultFTMTLCS_CurSenrPhaU_OutRngHLogged FaultFTMTLCS_CurSenrPhaU_OutRngLAut FaultFTMTLCS_CurSenrPhaU_OutRngLCounter FaultFTMTLCS_CurSenrPhaU_OutRngLDetected FaultFTMTLCS_CurSenrPhaU_OutRngLLogged FaultFTMTLCS_CurSenrPhaU_VCCAut FaultFTMTLCS_CurSenrPhaU_VCCCounter FaultFTMTLCS_CurSenrPhaU_VCCDetected FaultFTMTLCS_CurSenrPhaU_VCCLogged FaultFTMTLCS_CurSenrPhaV_GNDAut FaultFTMTLCS_CurSenrPhaV_GNDCounter FaultFTMTLCS_CurSenrPhaV_GNDDetected FaultFTMTLCS_CurSenrPhaV_GNDLogged FaultFTMTLCS_CurSenrPhaV_OutRngHAut FaultFTMTLCS_CurSenrPhaV_OutRngHCounter FaultFTMTLCS_CurSenrPhaV_OutRngHDetected FaultFTMTLCS_CurSenrPhaV_OutRngHLogged FaultFTMTLCS_CurSenrPhaV_OutRngLAut FaultFTMTLCS_CurSenrPhaV_OutRngLCounter FaultFTMTLCS_CurSenrPhaV_OutRngLDetected FaultFTMTLCS_CurSenrPhaV_OutRngLLogged FaultFTMTLCS_CurSenrPhaV_VCCAut FaultFTMTLCS_CurSenrPhaV_VCCCounter FaultFTMTLCS_CurSenrPhaV_VCCDetected FaultFTMTLCS_CurSenrPhaV_VCCLogged FaultFTMTLCS_CurSenrPhaW_GNDAut FaultFTMTLCS_CurSenrPhaW_GNDCounter FaultFTMTLCS_CurSenrPhaW_GNDDetected FaultFTMTLCS_CurSenrPhaW_GNDLogged FaultFTMTLCS_CurSenrPhaW_OutRngHAut FaultFTMTLCS_CurSenrPhaW_OutRngHCounter FaultFTMTLCS_CurSenrPhaW_OutRngHDetected FaultFTMTLCS_CurSenrPhaW_OutRngHLogged FaultFTMTLCS_CurSenrPhaW_OutRngLAut FaultFTMTLCS_CurSenrPhaW_OutRngLCounter FaultFTMTLCS_CurSenrPhaW_OutRngLDetected FaultFTMTLCS_CurSenrPhaW_OutRngLLogged FaultFTMTLCS_CurSenrPhaW_VCCAut FaultFTMTLCS_CurSenrPhaW_VCCCounter FaultFTMTLCS_CurSenrPhaW_VCCDetected FaultFTMTLCS_CurSenrPhaW_VCCLogged FaultFTMTLCS_Detected FaultFTMTLCS_Logged FaultFunctionTypeDetectedArray FaultFunctionTypeDetectedArray[0] FaultFunctionTypeDetectedArray[10] FaultFunctionTypeDetectedArray[11] FaultFunctionTypeDetectedArray[12] FaultFunctionTypeDetectedArray[13] FaultFunctionTypeDetectedArray[14] FaultFunctionTypeDetectedArray[15] FaultFunctionTypeDetectedArray[16] FaultFunctionTypeDetectedArray[17] FaultFunctionTypeDetectedArray[18] FaultFunctionTypeDetectedArray[19] FaultFunctionTypeDetectedArray[1] FaultFunctionTypeDetectedArray[20] FaultFunctionTypeDetectedArray[21] FaultFunctionTypeDetectedArray[22] FaultFunctionTypeDetectedArray[23] FaultFunctionTypeDetectedArray[24] FaultFunctionTypeDetectedArray[25] FaultFunctionTypeDetectedArray[26] FaultFunctionTypeDetectedArray[27] FaultFunctionTypeDetectedArray[28] FaultFunctionTypeDetectedArray[29] FaultFunctionTypeDetectedArray[2] FaultFunctionTypeDetectedArray[3] FaultFunctionTypeDetectedArray[4] FaultFunctionTypeDetectedArray[5] FaultFunctionTypeDetectedArray[6] FaultFunctionTypeDetectedArray[7] FaultFunctionTypeDetectedArray[8] FaultFunctionTypeDetectedArray[9] FaultFunctionTypeLoggedArray FaultFunctionTypeLoggedArray[0] FaultFunctionTypeLoggedArray[10] FaultFunctionTypeLoggedArray[11] FaultFunctionTypeLoggedArray[12] FaultFunctionTypeLoggedArray[13] FaultFunctionTypeLoggedArray[14] FaultFunctionTypeLoggedArray[15] FaultFunctionTypeLoggedArray[16] FaultFunctionTypeLoggedArray[17] FaultFunctionTypeLoggedArray[18] FaultFunctionTypeLoggedArray[19] FaultFunctionTypeLoggedArray[1] FaultFunctionTypeLoggedArray[20] FaultFunctionTypeLoggedArray[21] FaultFunctionTypeLoggedArray[22] FaultFunctionTypeLoggedArray[23] FaultFunctionTypeLoggedArray[24] FaultFunctionTypeLoggedArray[25] FaultFunctionTypeLoggedArray[26] FaultFunctionTypeLoggedArray[27] FaultFunctionTypeLoggedArray[28] FaultFunctionTypeLoggedArray[29] FaultFunctionTypeLoggedArray[2] FaultFunctionTypeLoggedArray[3] FaultFunctionTypeLoggedArray[4] FaultFunctionTypeLoggedArray[5] FaultFunctionTypeLoggedArray[6] FaultFunctionTypeLoggedArray[7] FaultFunctionTypeLoggedArray[8] FaultFunctionTypeLoggedArray[9] FaultSDMTMEP_CosGndAut FaultSDMTMEP_CosGndCounter FaultSDMTMEP_CosGndDetected FaultSDMTMEP_CosGndLogged FaultSDMTMEP_CosOutRangeHighAut FaultSDMTMEP_CosOutRangeHighCounter FaultSDMTMEP_CosOutRangeHighDetected FaultSDMTMEP_CosOutRangeHighLogged FaultSDMTMEP_CosOutRangeLowAut FaultSDMTMEP_CosOutRangeLowCounter FaultSDMTMEP_CosOutRangeLowDetected FaultSDMTMEP_CosOutRangeLowLogged FaultSDMTMEP_CosVccAut FaultSDMTMEP_CosVccCounter FaultSDMTMEP_CosVccDetected FaultSDMTMEP_CosVccLogged FaultSDMTMEP_Detected FaultSDMTMEP_Logged FaultSDMTMEP_OverSpeedAut FaultSDMTMEP_OverSpeedCounter FaultSDMTMEP_OverSpeedDetected FaultSDMTMEP_OverSpeedLogged FaultSDMTMEP_ResSquaSumErrByFTAut FaultSDMTMEP_ResSquaSumErrByFTCounter FaultSDMTMEP_ResSquaSumErrByFTDetected FaultSDMTMEP_ResSquaSumErrByFTLogged FaultSDMTMEP_SinGndAut FaultSDMTMEP_SinGndCounter FaultSDMTMEP_SinGndDetected FaultSDMTMEP_SinGndLogged FaultSDMTMEP_SinOutRangeHighAut FaultSDMTMEP_SinOutRangeHighCounter FaultSDMTMEP_SinOutRangeHighDetected FaultSDMTMEP_SinOutRangeHighLogged FaultSDMTMEP_SinOutRangeLowAut FaultSDMTMEP_SinOutRangeLowCounter FaultSDMTMEP_SinOutRangeLowDetected FaultSDMTMEP_SinOutRangeLowLogged FaultSDMTMEP_SinVccAut FaultSDMTMEP_SinVccCounter FaultSDMTMEP_SinVccDetected FaultSDMTMEP_SinVccLogged FaultSDMTMEP_UnderSpeedAut FaultSDMTMEP_UnderSpeedCounter FaultSDMTMEP_UnderSpeedDetected FaultSDMTMEP_UnderSpeedLogged FaultTableFuncTypeCounter1 FaultTableFuncTypeCounter1[0] FaultTableFuncTypeCounter1[100] FaultTableFuncTypeCounter1[101] FaultTableFuncTypeCounter1[102] FaultTableFuncTypeCounter1[103] FaultTableFuncTypeCounter1[104] FaultTableFuncTypeCounter1[105] FaultTableFuncTypeCounter1[106] FaultTableFuncTypeCounter1[107] FaultTableFuncTypeCounter1[108] FaultTableFuncTypeCounter1[109] FaultTableFuncTypeCounter1[10] FaultTableFuncTypeCounter1[110] FaultTableFuncTypeCounter1[111] FaultTableFuncTypeCounter1[112] FaultTableFuncTypeCounter1[113] FaultTableFuncTypeCounter1[114] FaultTableFuncTypeCounter1[115] FaultTableFuncTypeCounter1[116] FaultTableFuncTypeCounter1[117] FaultTableFuncTypeCounter1[118] FaultTableFuncTypeCounter1[119] FaultTableFuncTypeCounter1[11] FaultTableFuncTypeCounter1[120] FaultTableFuncTypeCounter1[121] FaultTableFuncTypeCounter1[122] FaultTableFuncTypeCounter1[123] FaultTableFuncTypeCounter1[124] FaultTableFuncTypeCounter1[125] FaultTableFuncTypeCounter1[126] FaultTableFuncTypeCounter1[127] FaultTableFuncTypeCounter1[128] FaultTableFuncTypeCounter1[129] FaultTableFuncTypeCounter1[12] FaultTableFuncTypeCounter1[130] FaultTableFuncTypeCounter1[131] FaultTableFuncTypeCounter1[132] FaultTableFuncTypeCounter1[13] FaultTableFuncTypeCounter1[14] FaultTableFuncTypeCounter1[15] FaultTableFuncTypeCounter1[16] FaultTableFuncTypeCounter1[17] FaultTableFuncTypeCounter1[18] FaultTableFuncTypeCounter1[19] /end OUT_MEASUREMENT
/end FUNCTION
/end MODULE
/end PROJECT
