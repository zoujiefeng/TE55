ASAP2_VERSION 1 3
/begin PROJECT D_TC387_PLATFORM_0_0 "D_TC387_PLATFORM_0_0"
/begin HEADER "" VERSION "5210.00" PROJECT_NO D0 /end HEADER
/begin MODULE D_TC387_PLATFORM_0_0 "Invt"
/begin MOD_COMMON "" DEPOSIT ABSOLUTE ALIGNMENT_BYTE 1 ALIGNMENT_WORD 2 ALIGNMENT_LONG 4 ALIGNMENT_FLOAT32_IEEE 4 ALIGNMENT_FLOAT64_IEEE 8 BYTE_ORDER MSB_LAST /end MOD_COMMON
/begin RECORD_LAYOUT DATA_RECORD_UBYTE FNC_VALUES 1 UBYTE ROW_DIR DIRECT /end RECORD_LAYOUT
/begin RECORD_LAYOUT DATA_RECORD_UWORD FNC_VALUES 1 UWORD ROW_DIR DIRECT /end RECORD_LAYOUT
/begin RECORD_LAYOUT DATA_RECORD_ULONG FNC_VALUES 1 ULONG ROW_DIR DIRECT /end RECORD_LAYOUT
/begin RECORD_LAYOUT DATA_RECORD_FLOAT32_IEEE FNC_VALUES 1 FLOAT32_IEEE ROW_DIR DIRECT /end RECORD_LAYOUT
/begin RECORD_LAYOUT AXIS_PTS_X_SBYTE_VEMS AXIS_PTS_X 1 SBYTE INDEX_INCR DIRECT /end RECORD_LAYOUT
/begin RECORD_LAYOUT AXIS_PTS_X_UWORD_VEMS AXIS_PTS_X 1 UWORD INDEX_INCR DIRECT /end RECORD_LAYOUT
/begin RECORD_LAYOUT AXIS_PTS_X_SWORD_VEMS AXIS_PTS_X 1 SWORD INDEX_INCR DIRECT /end RECORD_LAYOUT
/begin RECORD_LAYOUT AXIS_PTS_X_ULONG_VEMS AXIS_PTS_X 1 ULONG INDEX_INCR DIRECT /end RECORD_LAYOUT
/begin RECORD_LAYOUT AXIS_PTS_X_SLONG_VEMS AXIS_PTS_X 1 SLONG INDEX_INCR DIRECT /end RECORD_LAYOUT
/begin RECORD_LAYOUT AXIS_PTS_X_FLOAT32_IEEE_VEMS AXIS_PTS_X 1 FLOAT32_IEEE INDEX_INCR DIRECT /end RECORD_LAYOUT
/begin RECORD_LAYOUT AXIS_PTS_X_FLOAT64_IEEE_VEMS AXIS_PTS_X 1 FLOAT64_IEEE INDEX_INCR DIRECT /end RECORD_LAYOUT
/begin RECORD_LAYOUT AXIS_PTS_X_UBYTE NO_AXIS_PTS_X 1 UBYTE AXIS_PTS_X 2 UBYTE INDEX_INCR DIRECT /end RECORD_LAYOUT
/begin RECORD_LAYOUT AXIS_PTS_X_SBYTE NO_AXIS_PTS_X 1 SBYTE AXIS_PTS_X 2 SBYTE INDEX_INCR DIRECT /end RECORD_LAYOUT
/begin RECORD_LAYOUT AXIS_PTS_X_UWORD NO_AXIS_PTS_X 1 UWORD AXIS_PTS_X 2 UWORD INDEX_INCR DIRECT /end RECORD_LAYOUT
/begin RECORD_LAYOUT AXIS_PTS_X_SWORD NO_AXIS_PTS_X 1 SWORD AXIS_PTS_X 2 SWORD INDEX_INCR DIRECT /end RECORD_LAYOUT
/begin RECORD_LAYOUT AXIS_PTS_X_ULONG NO_AXIS_PTS_X 1 ULONG AXIS_PTS_X 2 ULONG INDEX_INCR DIRECT /end RECORD_LAYOUT
/begin RECORD_LAYOUT AXIS_PTS_X_SLONG NO_AXIS_PTS_X 1 SLONG AXIS_PTS_X 2 SLONG INDEX_INCR DIRECT /end RECORD_LAYOUT
/begin RECORD_LAYOUT AXIS_PTS_X_FLOAT32_IEEE NO_AXIS_PTS_X 1 FLOAT32_IEEE AXIS_PTS_X 2 FLOAT32_IEEE INDEX_INCR DIRECT /end RECORD_LAYOUT
/begin RECORD_LAYOUT AXIS_PTS_X_FLOAT64_IEEE NO_AXIS_PTS_X 1 FLOAT64_IEEE AXIS_PTS_X 2 FLOAT64_IEEE INDEX_INCR DIRECT /end RECORD_LAYOUT
/begin CHARACTERISTIC ESM_bPowerOffModeInhC "ESM POWER_OFF_MODE state inhibition" VALUE 0x0000 DATA_RECORD_UBYTE 1 Bool_ON_OFF 0 1 BIT_MASK 0x01 /end CHARACTERISTIC
/begin CHARACTERISTIC ESM_ku16AfterrunToutCntC "ESM_ku16AfterrunToutCntC" VALUE 0x0000 DATA_RECORD_UWORD 327675 F_5_p0_30 0 327675 /end CHARACTERISTIC
/begin CHARACTERISTIC GESM_bPowerOffModeInhC "ESM POWER_OFF_MODE state inhibition" VALUE 0x0000 DATA_RECORD_UBYTE 1 Bool_ON_OFF 0 1 BIT_MASK 0x01 /end CHARACTERISTIC
/begin CHARACTERISTIC GESM_ku16AfterrunToutCntC "GESM_ku16AfterrunToutCntC" VALUE 0x0000 DATA_RECORD_UWORD 327675 F_5_p0_30 0 327675 /end CHARACTERISTIC
/begin CHARACTERISTIC SCU_ku16MaxDieTempThrd "Temperature max threshold" VALUE 0x0000 DATA_RECORD_UWORD 30767.60563 F_0v4694835681_m284v9765258216_75 -284.9765258 30482.62911 /end CHARACTERISTIC
/begin CHARACTERISTIC SCU_ku16MinDieTempThrd "Temperature min threshold" VALUE 0x0000 DATA_RECORD_UWORD 30767.60563 F_0v4694835681_m284v9765258216_75 -284.9765258 30482.62911 /end CHARACTERISTIC
/begin CHARACTERISTIC TLE9180_bDrvOverCurrentTestOnC "TLE9180_bDrvOverCurrentTestOnC" VALUE 0x0000 DATA_RECORD_UBYTE 1 Bool_ON_OFF 0 1 BIT_MASK 0x01 /end CHARACTERISTIC
/begin CHARACTERISTIC TLE9180_bDrvOverTempTestOnC "TLE9180_bDrvOverTempTestOnC" VALUE 0x0000 DATA_RECORD_UBYTE 1 Bool_ON_OFF 0 1 BIT_MASK 0x01 /end CHARACTERISTIC
/begin CHARACTERISTIC TLE9180_bDrvOverVoltageTestOnC "TLE9180_bDrvOverVoltageTestOnC" VALUE 0x0000 DATA_RECORD_UBYTE 1 Bool_ON_OFF 0 1 BIT_MASK 0x01 /end CHARACTERISTIC
/begin CHARACTERISTIC TLE9180_bDrvUnderVoltageTestOnC "TLE9180_bDrvUnderVoltageTestOnC" VALUE 0x0000 DATA_RECORD_UBYTE 1 Bool_ON_OFF 0 1 BIT_MASK 0x01 /end CHARACTERISTIC
/begin CHARACTERISTIC TLE9180_bManualReadRegC "TLE9180_bManualReadRegC" VALUE 0x0000 DATA_RECORD_UBYTE 1 Bool_ON_OFF 0 1 BIT_MASK 0x01 /end CHARACTERISTIC
/begin CHARACTERISTIC TLE9180_bPhasePerfTestOnC "TLE9180_bPhasePerfTestOnC" VALUE 0x0000 DATA_RECORD_UBYTE 1 Bool_ON_OFF 0 1 BIT_MASK 0x01 /end CHARACTERISTIC
/begin CHARACTERISTIC TLE9180_bPhaseShortHighTestOnC "TLE9180_bPhaseShortHighTestOnC" VALUE 0x0000 DATA_RECORD_UBYTE 1 Bool_ON_OFF 0 1 BIT_MASK 0x01 /end CHARACTERISTIC
/begin CHARACTERISTIC TLE9180_bPhaseShortLowTestOnC "TLE9180_bPhaseShortLowTestOnC" VALUE 0x0000 DATA_RECORD_UBYTE 1 Bool_ON_OFF 0 1 BIT_MASK 0x01 /end CHARACTERISTIC
/begin CHARACTERISTIC TLE9180_bPhsOverVoltTestOnC "TLE9180_bPhsOverVoltTestOnC" VALUE 0x0000 DATA_RECORD_UBYTE 1 Bool_ON_OFF 0 1 BIT_MASK 0x01 /end CHARACTERISTIC
/begin CHARACTERISTIC TLE9180_kf32PhsTempFaultC "TLE9180_kf32PhsTempFaultC" VALUE 0x0000 DATA_RECORD_FLOAT32_IEEE 3.402823466E+038 I_1 -3.402823466E+038 3.402823466E+038 /end CHARACTERISTIC
/begin CHARACTERISTIC TLE9180_kf32PhsTempFltRecoverC "TLE9180_kf32PhsTempFltRecoverC" VALUE 0x0000 DATA_RECORD_FLOAT32_IEEE 3.402823466E+038 I_1 -3.402823466E+038 3.402823466E+038 /end CHARACTERISTIC
/begin CHARACTERISTIC TLE9180_ku16EnaResetTimeC "TLE9180_ku16EnaResetTimeC" VALUE 0x0000 DATA_RECORD_UWORD 65535 I_1 0 65535 /end CHARACTERISTIC
/begin CHARACTERISTIC TLE9180_ku16ErrPinChkTimC "TLE9180_ku16ErrPinChkTimC" VALUE 0x0000 DATA_RECORD_UWORD 65535 I_1 0 65535 /end CHARACTERISTIC
/begin CHARACTERISTIC TLE9180_ku8EnaResetCntC "TLE9180_ku8EnaResetCntC" VALUE 0x0000 DATA_RECORD_UBYTE 255 I_1 0 255 /end CHARACTERISTIC
/begin CHARACTERISTIC TLE9180_ku8ErrRecvMaxNumC "TLE9180_ku8ErrRecvMaxNumC" VALUE 0x0000 DATA_RECORD_UBYTE 255 I_1 0 255 /end CHARACTERISTIC
/begin CHARACTERISTIC UDS_SecurAccessBenchOnC "Deactivate the security access protection" VALUE 0x0000 DATA_RECORD_UBYTE 1 Bool_ON_OFF 0 1 BIT_MASK 0x01 /end CHARACTERISTIC
/begin CHARACTERISTIC VADC_aku16MaxThrdGrp "Voltage threshold for groups" CURVE 0x0000 DATA_RECORD_UWORD 80.07697947 F_0v0012218964_p0_80 0 80.07697947
 /begin AXIS_DESCR FIX_AXIS NO_INPUT_QUANTITY Id_0x00 4 0 3 MAX_GRAD 100.0 FIX_AXIS_PAR_DIST 0 1 4 /end AXIS_DESCR
/end CHARACTERISTIC
/begin CHARACTERISTIC VADC_aku16MinThrdGrp "Voltage threshold for groups" CURVE 0x0000 DATA_RECORD_UWORD 80.07697947 F_0v0012218964_p0_80 0 80.07697947
 /begin AXIS_DESCR FIX_AXIS NO_INPUT_QUANTITY Id_0x00 4 0 3 MAX_GRAD 100.0 FIX_AXIS_PAR_DIST 0 1 4 /end AXIS_DESCR
/end CHARACTERISTIC
/begin CHARACTERISTIC VADC_ku16MaxThrdGlobal "Global voltage threshold" VALUE 0x0000 DATA_RECORD_UWORD 80.07697947 F_0v0012218964_p0_80 0 80.07697947 /end CHARACTERISTIC
/begin CHARACTERISTIC VADC_ku16MinThrdGlobal "Global voltage threshold" VALUE 0x0000 DATA_RECORD_UWORD 80.07697947 F_0v0012218964_p0_80 0 80.07697947 /end CHARACTERISTIC
/begin CHARACTERISTIC VSI_bBenchFrameRxChkOffC "VSI Rx Chk off" VALUE 0x0000 DATA_RECORD_UBYTE 1 Bool_ON_OFF 0 1 BIT_MASK 0x01 /end CHARACTERISTIC
/begin CHARACTERISTIC VSI_u16Cal1OverCurThBatC "Over current threshold, for battery (MAJ OC140)" VALUE 0x0000 DATA_RECORD_UWORD 80.01831502 F_0v0012210012_p0_10 0 80.01831502 /end CHARACTERISTIC
/begin CHARACTERISTIC VSI_u16Cal1OverCurThMotC "Over current threshold, for motor (MAJ OC140)" VALUE 0x0000 DATA_RECORD_UWORD 80.01831502 F_0v0012210012_p0_10 0 80.01831502 /end CHARACTERISTIC
/begin CHARACTERISTIC VSI_u16Cal1OverVoltVbatThC "Over voltage Vbat threshold" VALUE 0x0000 DATA_RECORD_UWORD 80.01831502 F_0v0012210012_p0_10 0 80.01831502 /end CHARACTERISTIC
/begin CHARACTERISTIC VSI_u16Cal1PwmDeadtimeC "VSI Dead Time" VALUE 0x0000 DATA_RECORD_UWORD 1638.375 F_0v025_p0_81 0 1638.375 /end CHARACTERISTIC
/begin CHARACTERISTIC VSI_u16Cal1PwmFreqC "SPI Timer Max" VALUE 0x0000 DATA_RECORD_UWORD 19999.69482 D_2_0v00005_p0_82 0.3051804379 20000 /end CHARACTERISTIC
/begin CHARACTERISTIC VSI_u16Cal1PwmInitValUlC "VSI_u16Cal1PwmInitValUlC" VALUE 0x0000 DATA_RECORD_UWORD 65535 I_1 0 65535 /end CHARACTERISTIC
/begin CHARACTERISTIC VSI_u16Cal1PwmInitValUrC "VSI_u16Cal1PwmInitValUrC" VALUE 0x0000 DATA_RECORD_UWORD 65535 I_1 0 65535 /end CHARACTERISTIC
/begin CHARACTERISTIC VSI_u16Cal1PwmInitValVlC "VSI_u16Cal1PwmInitValVlC" VALUE 0x0000 DATA_RECORD_UWORD 65535 I_1 0 65535 /end CHARACTERISTIC
/begin CHARACTERISTIC VSI_u16Cal1PwmInitValVrC "VSI_u16Cal1PwmInitValVrC" VALUE 0x0000 DATA_RECORD_UWORD 65535 I_1 0 65535 /end CHARACTERISTIC
/begin CHARACTERISTIC VSI_u16Cal1PwmInitValWlC "VSI_u16Cal1PwmInitValWlC" VALUE 0x0000 DATA_RECORD_UWORD 65535 I_1 0 65535 /end CHARACTERISTIC
/begin CHARACTERISTIC VSI_u16Cal1PwmInitValWrC "VSI_u16Cal1PwmInitValWrC" VALUE 0x0000 DATA_RECORD_UWORD 65535 I_1 0 65535 /end CHARACTERISTIC
/begin CHARACTERISTIC VSI_u16Cal1SynchroDelayC "Frame Synchronisation delay" VALUE 0x0000 DATA_RECORD_UWORD 1638375 F_25_p0_83 0 1638375 /end CHARACTERISTIC
/begin CHARACTERISTIC VSI_u32SafeTreatDelayC "Delay between the failling edge of the CS signal and firing Safe CPU0 ISR" VALUE 0x0000 DATA_RECORD_ULONG 429496729.5 F_0v1_p0_70 0 429496729.5 /end CHARACTERISTIC
/begin CHARACTERISTIC VSI_u32TimeoutCsC "Time before Timeout Chip Select VSI" VALUE 0x0000 DATA_RECORD_ULONG 2147483648 F_0v5_p0v5_84 0.5 2147483648 /end CHARACTERISTIC
/begin CHARACTERISTIC VSI_u32TimeoutEmailC "Timeout of email" VALUE 0x0000 DATA_RECORD_ULONG 429496729.5 F_0v1_p0_70 0 429496729.5 /end CHARACTERISTIC
/begin CHARACTERISTIC VSI_u32TimeoutSafeTcalcC "Time before Timeout treatment Safe VSI Treatment" VALUE 0x0000 DATA_RECORD_ULONG 429496729.5 F_0v1_p0_70 0 429496729.5 /end CHARACTERISTIC
/begin CHARACTERISTIC VSI_u32TimeoutSyncPosC "Time before Timeout Synchro Pos" VALUE 0x0000 DATA_RECORD_ULONG 2147483648 F_0v5_p0v5_84 0.5 2147483648 /end CHARACTERISTIC
/begin CHARACTERISTIC VSI_u32TimeoutTcalcC "Time before Timeout VSI Treatment" VALUE 0x0000 DATA_RECORD_ULONG 429496729.5 F_0v1_p0_70 0 429496729.5 /end CHARACTERISTIC
/begin MEASUREMENT ESM_ESM_MODE_FT "ESM_ESM_MODE_FT" UBYTE Bool_ON_OFF 1 2 0 1 BIT_MASK 0x04 ECU_ADDRESS 0x0 /end MEASUREMENT
/begin MEASUREMENT ESM_ESM_MODE_NF "ESM_ESM_MODE_NF" UBYTE Bool_ON_OFF 1 2 0 1 BIT_MASK 0x01 ECU_ADDRESS 0x0 /end MEASUREMENT
/begin MEASUREMENT ESM_EsmMode "ESM_EsmMode" UWORD ESM_EsmMode_conv 1 2 1 4 ECU_ADDRESS 0x0 /end MEASUREMENT
/begin MEASUREMENT ESM_OpFtState "ESM_OpFtState" UWORD I_1 1 2 0 65535 ECU_ADDRESS 0x0 /end MEASUREMENT
/begin MEASUREMENT ESM_OpNfState "ESM_OpNfState" UWORD I_1 1 2 0 65535 ECU_ADDRESS 0x0 /end MEASUREMENT
/begin MEASUREMENT ESM_PwrLFtState "ESM_PwrLFtState" UWORD I_1 1 2 0 65535 ECU_ADDRESS 0x0 /end MEASUREMENT
/begin MEASUREMENT ESM_PwrLNfState "ESM_PwrLNfState" UWORD I_1 1 2 0 65535 ECU_ADDRESS 0x0 /end MEASUREMENT
/begin MEASUREMENT ESM_StpIIFtState "ESM_StpIIFtState" UWORD I_1 1 2 0 65535 ECU_ADDRESS 0x0 /end MEASUREMENT
/begin MEASUREMENT ESM_StpIINfState "ESM_StpIINfState" UWORD I_1 1 2 0 65535 ECU_ADDRESS 0x0 /end MEASUREMENT
/begin MEASUREMENT ESM_StpIState "ESM_StpIState" UWORD I_1 1 2 0 65535 ECU_ADDRESS 0x0 /end MEASUREMENT
/begin MEASUREMENT ESM_bAfterrunFin "ESM_bAfterrunFin" UBYTE Bool_ON_OFF 1 2 0 1 BIT_MASK 0x01 ECU_ADDRESS 0x0 /end MEASUREMENT
/begin MEASUREMENT ESM_bAfterrunReq "ESM_bAfterrunReq" UBYTE Bool_ON_OFF 1 2 0 1 BIT_MASK 0x01 ECU_ADDRESS 0x0 /end MEASUREMENT
/begin MEASUREMENT ESM_bCallAppliOn "ESM_bCallAppliOn" UBYTE Bool_ON_OFF 1 2 0 1 BIT_MASK 0x01 ECU_ADDRESS 0x0 /end MEASUREMENT
/begin MEASUREMENT ESM_bMcuEnaReq "ESM_bMcuEnaReq" UBYTE Bool_ON_OFF 1 2 0 1 BIT_MASK 0x01 ECU_ADDRESS 0x0 /end MEASUREMENT
/begin MEASUREMENT ESM_bPwrDnReadyFlg "ESM_bPwrDnReadyFlg" UBYTE Bool_ON_OFF 1 2 0 1 BIT_MASK 0x01 ECU_ADDRESS 0x0 /end MEASUREMENT
/begin MEASUREMENT ESM_bPwrLNfClrFltFinsh "ESM_bPwrLNfClrFltFinsh" UBYTE Bool_ON_OFF 1 2 0 1 BIT_MASK 0x01 ECU_ADDRESS 0x0 /end MEASUREMENT
/begin MEASUREMENT ESM_u16AfterrunCnt "ESM_u16AfterrunCnt" UWORD I_1 1 2 0 65535 ECU_ADDRESS 0x0 /end MEASUREMENT
/begin MEASUREMENT ESM_u16CmdReq "ESM_u16CmdReq" UWORD I_1 1 2 0 65535 ECU_ADDRESS 0x0 /end MEASUREMENT
/begin MEASUREMENT ESM_u16CmdReqNm1 "ESM_u16CmdReqNm1" UWORD I_1 1 2 0 65535 ECU_ADDRESS 0x0 /end MEASUREMENT
/begin MEASUREMENT ESM_u16CmdRes "ESM_u16CmdRes" UWORD I_1 1 2 0 65535 ECU_ADDRESS 0x0 /end MEASUREMENT
/begin MEASUREMENT ESM_u8AllowPwrDnDelay "ESM_u8AllowPwrDnDelay" UBYTE I_1 1 2 0 255 ECU_ADDRESS 0x0 /end MEASUREMENT
/begin MEASUREMENT ESM_u8PwrLNfStep "ESM_u8PwrLNfStep" UBYTE I_1 1 2 0 255 ECU_ADDRESS 0x0 /end MEASUREMENT
/begin MEASUREMENT ESM_u8PwrOffTim "ESM_u8PwrOffTim" UBYTE I_1 1 2 0 255 ECU_ADDRESS 0x0 /end MEASUREMENT
/begin MEASUREMENT ESM_u8RestartDelayCnt "ESM_u8RestartDelayCnt" UBYTE I_1 1 2 0 255 ECU_ADDRESS 0x0 /end MEASUREMENT
/begin MEASUREMENT GESM_ESM_MODE_FT "GESM_ESM_MODE_FT" UBYTE Bool_ON_OFF 1 2 0 1 BIT_MASK 0x04 ECU_ADDRESS 0x0 /end MEASUREMENT
/begin MEASUREMENT GESM_ESM_MODE_NF "GESM_ESM_MODE_NF" UBYTE Bool_ON_OFF 1 2 0 1 BIT_MASK 0x01 ECU_ADDRESS 0x0 /end MEASUREMENT
/begin MEASUREMENT GESM_EsmMode "GESM_EsmMode" UWORD GESM_EsmMode_conv 1 2 1 4 ECU_ADDRESS 0x0 /end MEASUREMENT
/begin MEASUREMENT GESM_OpFtState "GESM_OpFtState" UWORD I_1 1 2 0 65535 ECU_ADDRESS 0x0 /end MEASUREMENT
/begin MEASUREMENT GESM_OpNfState "GESM_OpNfState" UWORD I_1 1 2 0 65535 ECU_ADDRESS 0x0 /end MEASUREMENT
/begin MEASUREMENT GESM_PwrLFtState "GESM_PwrLFtState" UWORD I_1 1 2 0 65535 ECU_ADDRESS 0x0 /end MEASUREMENT
/begin MEASUREMENT GESM_PwrLNfState "GESM_PwrLNfState" UWORD I_1 1 2 0 65535 ECU_ADDRESS 0x0 /end MEASUREMENT
/begin MEASUREMENT GESM_StpIIFtState "GESM_StpIIFtState" UWORD I_1 1 2 0 65535 ECU_ADDRESS 0x0 /end MEASUREMENT
/begin MEASUREMENT GESM_StpIINfState "GESM_StpIINfState" UWORD I_1 1 2 0 65535 ECU_ADDRESS 0x0 /end MEASUREMENT
/begin MEASUREMENT GESM_StpIState "GESM_StpIState" UWORD I_1 1 2 0 65535 ECU_ADDRESS 0x0 /end MEASUREMENT
/begin MEASUREMENT GESM_bAfterrunFin "GESM_bAfterrunFin" UBYTE Bool_ON_OFF 1 2 0 1 BIT_MASK 0x01 ECU_ADDRESS 0x0 /end MEASUREMENT
/begin MEASUREMENT GESM_bAfterrunReq "GESM_bAfterrunReq" UBYTE Bool_ON_OFF 1 2 0 1 BIT_MASK 0x01 ECU_ADDRESS 0x0 /end MEASUREMENT
/begin MEASUREMENT GESM_bCallAppliOn "GESM_bCallAppliOn" UBYTE Bool_ON_OFF 1 2 0 1 BIT_MASK 0x01 ECU_ADDRESS 0x0 /end MEASUREMENT
/begin MEASUREMENT GESM_bMcuEnaReq "GESM_bMcuEnaReq" UBYTE Bool_ON_OFF 1 2 0 1 BIT_MASK 0x01 ECU_ADDRESS 0x0 /end MEASUREMENT
/begin MEASUREMENT GESM_bPwrDnReadyFlg "GESM_bPwrDnReadyFlg" UBYTE Bool_ON_OFF 1 2 0 1 BIT_MASK 0x01 ECU_ADDRESS 0x0 /end MEASUREMENT
/begin MEASUREMENT GESM_bPwrLNfClrFltFinsh "GESM_bPwrLNfClrFltFinsh" UBYTE Bool_ON_OFF 1 2 0 1 BIT_MASK 0x01 ECU_ADDRESS 0x0 /end MEASUREMENT
/begin MEASUREMENT GESM_u16AfterrunCnt "GESM_u16AfterrunCnt" UWORD I_1 1 2 0 65535 ECU_ADDRESS 0x0 /end MEASUREMENT
/begin MEASUREMENT GESM_u16CmdReq "GESM_u16CmdReq" UWORD I_1 1 2 0 65535 ECU_ADDRESS 0x0 /end MEASUREMENT
/begin MEASUREMENT GESM_u16CmdReqNm1 "GESM_u16CmdReqNm1" UWORD I_1 1 2 0 65535 ECU_ADDRESS 0x0 /end MEASUREMENT
/begin MEASUREMENT GESM_u16CmdRes "GESM_u16CmdRes" UWORD I_1 1 2 0 65535 ECU_ADDRESS 0x0 /end MEASUREMENT
/begin MEASUREMENT GESM_u8AllowPwrDnDelay "GESM_u8AllowPwrDnDelay" UBYTE I_1 1 2 0 255 ECU_ADDRESS 0x0 /end MEASUREMENT
/begin MEASUREMENT GESM_u8PwrLNfStep "GESM_u8PwrLNfStep" UBYTE I_1 1 2 0 255 ECU_ADDRESS 0x0 /end MEASUREMENT
/begin MEASUREMENT GESM_u8PwrOffTim "GESM_u8PwrOffTim" UBYTE I_1 1 2 0 255 ECU_ADDRESS 0x0 /end MEASUREMENT
/begin MEASUREMENT GESM_u8RestartDelayCnt "GESM_u8RestartDelayCnt" UBYTE I_1 1 2 0 255 ECU_ADDRESS 0x0 /end MEASUREMENT
/begin MEASUREMENT SBC_au16ConfigRegs "SBC_au16ConfigRegs" UWORD I_74 1 2 0 65535 MATRIX_DIM 12 1 1 ECU_ADDRESS 0x0 /end MEASUREMENT
/begin MEASUREMENT SBC_au16ConfigRegs[0] "SBC_au16ConfigRegs[0]" UWORD I_74 1 2 0 65535 ECU_ADDRESS 0x0 /end MEASUREMENT
/begin MEASUREMENT SBC_au16ConfigRegs[10] "SBC_au16ConfigRegs[10]" UWORD I_74 1 2 0 65535 ECU_ADDRESS 0x0 /end MEASUREMENT
/begin MEASUREMENT SBC_au16ConfigRegs[11] "SBC_au16ConfigRegs[11]" UWORD I_74 1 2 0 65535 ECU_ADDRESS 0x0 /end MEASUREMENT
/begin MEASUREMENT SBC_au16ConfigRegs[1] "SBC_au16ConfigRegs[1]" UWORD I_74 1 2 0 65535 ECU_ADDRESS 0x0 /end MEASUREMENT
/begin MEASUREMENT SBC_au16ConfigRegs[2] "SBC_au16ConfigRegs[2]" UWORD I_74 1 2 0 65535 ECU_ADDRESS 0x0 /end MEASUREMENT
/begin MEASUREMENT SBC_au16ConfigRegs[3] "SBC_au16ConfigRegs[3]" UWORD I_74 1 2 0 65535 ECU_ADDRESS 0x0 /end MEASUREMENT
/begin MEASUREMENT SBC_au16ConfigRegs[4] "SBC_au16ConfigRegs[4]" UWORD I_74 1 2 0 65535 ECU_ADDRESS 0x0 /end MEASUREMENT
/begin MEASUREMENT SBC_au16ConfigRegs[5] "SBC_au16ConfigRegs[5]" UWORD I_74 1 2 0 65535 ECU_ADDRESS 0x0 /end MEASUREMENT
/begin MEASUREMENT SBC_au16ConfigRegs[6] "SBC_au16ConfigRegs[6]" UWORD I_74 1 2 0 65535 ECU_ADDRESS 0x0 /end MEASUREMENT
/begin MEASUREMENT SBC_au16ConfigRegs[7] "SBC_au16ConfigRegs[7]" UWORD I_74 1 2 0 65535 ECU_ADDRESS 0x0 /end MEASUREMENT
/begin MEASUREMENT SBC_au16ConfigRegs[8] "SBC_au16ConfigRegs[8]" UWORD I_74 1 2 0 65535 ECU_ADDRESS 0x0 /end MEASUREMENT
/begin MEASUREMENT SBC_au16ConfigRegs[9] "SBC_au16ConfigRegs[9]" UWORD I_74 1 2 0 65535 ECU_ADDRESS 0x0 /end MEASUREMENT
/begin MEASUREMENT SBC_au16SpiRxStsData "SBC_au16SpiRxStsData" UWORD I_74 1 2 0 65535 MATRIX_DIM 30 1 1 ECU_ADDRESS 0x0 /end MEASUREMENT
/begin MEASUREMENT SBC_au16SpiRxStsData[0] "SBC_au16SpiRxStsData[0]" UWORD I_74 1 2 0 65535 ECU_ADDRESS 0x0 /end MEASUREMENT
/begin MEASUREMENT SBC_au16SpiRxStsData[10] "SBC_au16SpiRxStsData[10]" UWORD I_74 1 2 0 65535 ECU_ADDRESS 0x0 /end MEASUREMENT
/begin MEASUREMENT SBC_au16SpiRxStsData[11] "SBC_au16SpiRxStsData[11]" UWORD I_74 1 2 0 65535 ECU_ADDRESS 0x0 /end MEASUREMENT
/begin MEASUREMENT SBC_au16SpiRxStsData[12] "SBC_au16SpiRxStsData[12]" UWORD I_74 1 2 0 65535 ECU_ADDRESS 0x0 /end MEASUREMENT
/begin MEASUREMENT SBC_au16SpiRxStsData[13] "SBC_au16SpiRxStsData[13]" UWORD I_74 1 2 0 65535 ECU_ADDRESS 0x0 /end MEASUREMENT
/begin MEASUREMENT SBC_au16SpiRxStsData[14] "SBC_au16SpiRxStsData[14]" UWORD I_74 1 2 0 65535 ECU_ADDRESS 0x0 /end MEASUREMENT
/begin MEASUREMENT SBC_au16SpiRxStsData[15] "SBC_au16SpiRxStsData[15]" UWORD I_74 1 2 0 65535 ECU_ADDRESS 0x0 /end MEASUREMENT
/begin MEASUREMENT SBC_au16SpiRxStsData[16] "SBC_au16SpiRxStsData[16]" UWORD I_74 1 2 0 65535 ECU_ADDRESS 0x0 /end MEASUREMENT
/begin MEASUREMENT SBC_au16SpiRxStsData[17] "SBC_au16SpiRxStsData[17]" UWORD I_74 1 2 0 65535 ECU_ADDRESS 0x0 /end MEASUREMENT
/begin MEASUREMENT SBC_au16SpiRxStsData[18] "SBC_au16SpiRxStsData[18]" UWORD I_74 1 2 0 65535 ECU_ADDRESS 0x0 /end MEASUREMENT
/begin MEASUREMENT SBC_au16SpiRxStsData[19] "SBC_au16SpiRxStsData[19]" UWORD I_74 1 2 0 65535 ECU_ADDRESS 0x0 /end MEASUREMENT
/begin MEASUREMENT SBC_au16SpiRxStsData[1] "SBC_au16SpiRxStsData[1]" UWORD I_74 1 2 0 65535 ECU_ADDRESS 0x0 /end MEASUREMENT
/begin MEASUREMENT SBC_au16SpiRxStsData[20] "SBC_au16SpiRxStsData[20]" UWORD I_74 1 2 0 65535 ECU_ADDRESS 0x0 /end MEASUREMENT
/begin MEASUREMENT SBC_au16SpiRxStsData[21] "SBC_au16SpiRxStsData[21]" UWORD I_74 1 2 0 65535 ECU_ADDRESS 0x0 /end MEASUREMENT
/begin MEASUREMENT SBC_au16SpiRxStsData[22] "SBC_au16SpiRxStsData[22]" UWORD I_74 1 2 0 65535 ECU_ADDRESS 0x0 /end MEASUREMENT
/begin MEASUREMENT SBC_au16SpiRxStsData[23] "SBC_au16SpiRxStsData[23]" UWORD I_74 1 2 0 65535 ECU_ADDRESS 0x0 /end MEASUREMENT
/begin MEASUREMENT SBC_au16SpiRxStsData[24] "SBC_au16SpiRxStsData[24]" UWORD I_74 1 2 0 65535 ECU_ADDRESS 0x0 /end MEASUREMENT
/begin MEASUREMENT SBC_au16SpiRxStsData[25] "SBC_au16SpiRxStsData[25]" UWORD I_74 1 2 0 65535 ECU_ADDRESS 0x0 /end MEASUREMENT
/begin MEASUREMENT SBC_au16SpiRxStsData[26] "SBC_au16SpiRxStsData[26]" UWORD I_74 1 2 0 65535 ECU_ADDRESS 0x0 /end MEASUREMENT
/begin MEASUREMENT SBC_au16SpiRxStsData[27] "SBC_au16SpiRxStsData[27]" UWORD I_74 1 2 0 65535 ECU_ADDRESS 0x0 /end MEASUREMENT
/begin MEASUREMENT SBC_au16SpiRxStsData[28] "SBC_au16SpiRxStsData[28]" UWORD I_74 1 2 0 65535 ECU_ADDRESS 0x0 /end MEASUREMENT
/begin MEASUREMENT SBC_au16SpiRxStsData[29] "SBC_au16SpiRxStsData[29]" UWORD I_74 1 2 0 65535 ECU_ADDRESS 0x0 /end MEASUREMENT
/begin MEASUREMENT SBC_au16SpiRxStsData[2] "SBC_au16SpiRxStsData[2]" UWORD I_74 1 2 0 65535 ECU_ADDRESS 0x0 /end MEASUREMENT
/begin MEASUREMENT SBC_au16SpiRxStsData[3] "SBC_au16SpiRxStsData[3]" UWORD I_74 1 2 0 65535 ECU_ADDRESS 0x0 /end MEASUREMENT
/begin MEASUREMENT SBC_au16SpiRxStsData[4] "SBC_au16SpiRxStsData[4]" UWORD I_74 1 2 0 65535 ECU_ADDRESS 0x0 /end MEASUREMENT
/begin MEASUREMENT SBC_au16SpiRxStsData[5] "SBC_au16SpiRxStsData[5]" UWORD I_74 1 2 0 65535 ECU_ADDRESS 0x0 /end MEASUREMENT
/begin MEASUREMENT SBC_au16SpiRxStsData[6] "SBC_au16SpiRxStsData[6]" UWORD I_74 1 2 0 65535 ECU_ADDRESS 0x0 /end MEASUREMENT
/begin MEASUREMENT SBC_au16SpiRxStsData[7] "SBC_au16SpiRxStsData[7]" UWORD I_74 1 2 0 65535 ECU_ADDRESS 0x0 /end MEASUREMENT
/begin MEASUREMENT SBC_au16SpiRxStsData[8] "SBC_au16SpiRxStsData[8]" UWORD I_74 1 2 0 65535 ECU_ADDRESS 0x0 /end MEASUREMENT
/begin MEASUREMENT SBC_au16SpiRxStsData[9] "SBC_au16SpiRxStsData[9]" UWORD I_74 1 2 0 65535 ECU_ADDRESS 0x0 /end MEASUREMENT
/begin MEASUREMENT SBC_au16SpiTxAddr "SBC_au16SpiTxAddr" UWORD I_74 1 2 0 65535 MATRIX_DIM 30 1 1 ECU_ADDRESS 0x0 /end MEASUREMENT
/begin MEASUREMENT SBC_au16SpiTxAddr[0] "SBC_au16SpiTxAddr[0]" UWORD I_74 1 2 0 65535 ECU_ADDRESS 0x0 /end MEASUREMENT
/begin MEASUREMENT SBC_au16SpiTxAddr[10] "SBC_au16SpiTxAddr[10]" UWORD I_74 1 2 0 65535 ECU_ADDRESS 0x0 /end MEASUREMENT
/begin MEASUREMENT SBC_au16SpiTxAddr[11] "SBC_au16SpiTxAddr[11]" UWORD I_74 1 2 0 65535 ECU_ADDRESS 0x0 /end MEASUREMENT
/begin MEASUREMENT SBC_au16SpiTxAddr[12] "SBC_au16SpiTxAddr[12]" UWORD I_74 1 2 0 65535 ECU_ADDRESS 0x0 /end MEASUREMENT
/begin MEASUREMENT SBC_au16SpiTxAddr[13] "SBC_au16SpiTxAddr[13]" UWORD I_74 1 2 0 65535 ECU_ADDRESS 0x0 /end MEASUREMENT
/begin MEASUREMENT SBC_au16SpiTxAddr[14] "SBC_au16SpiTxAddr[14]" UWORD I_74 1 2 0 65535 ECU_ADDRESS 0x0 /end MEASUREMENT
/begin MEASUREMENT SBC_au16SpiTxAddr[15] "SBC_au16SpiTxAddr[15]" UWORD I_74 1 2 0 65535 ECU_ADDRESS 0x0 /end MEASUREMENT
/begin MEASUREMENT SBC_au16SpiTxAddr[16] "SBC_au16SpiTxAddr[16]" UWORD I_74 1 2 0 65535 ECU_ADDRESS 0x0 /end MEASUREMENT
/begin MEASUREMENT SBC_au16SpiTxAddr[17] "SBC_au16SpiTxAddr[17]" UWORD I_74 1 2 0 65535 ECU_ADDRESS 0x0 /end MEASUREMENT
/begin MEASUREMENT SBC_au16SpiTxAddr[18] "SBC_au16SpiTxAddr[18]" UWORD I_74 1 2 0 65535 ECU_ADDRESS 0x0 /end MEASUREMENT
/begin MEASUREMENT SBC_au16SpiTxAddr[19] "SBC_au16SpiTxAddr[19]" UWORD I_74 1 2 0 65535 ECU_ADDRESS 0x0 /end MEASUREMENT
/begin MEASUREMENT SBC_au16SpiTxAddr[1] "SBC_au16SpiTxAddr[1]" UWORD I_74 1 2 0 65535 ECU_ADDRESS 0x0 /end MEASUREMENT
/begin MEASUREMENT SBC_au16SpiTxAddr[20] "SBC_au16SpiTxAddr[20]" UWORD I_74 1 2 0 65535 ECU_ADDRESS 0x0 /end MEASUREMENT
/begin MEASUREMENT SBC_au16SpiTxAddr[21] "SBC_au16SpiTxAddr[21]" UWORD I_74 1 2 0 65535 ECU_ADDRESS 0x0 /end MEASUREMENT
/begin MEASUREMENT SBC_au16SpiTxAddr[22] "SBC_au16SpiTxAddr[22]" UWORD I_74 1 2 0 65535 ECU_ADDRESS 0x0 /end MEASUREMENT
/begin MEASUREMENT SBC_au16SpiTxAddr[23] "SBC_au16SpiTxAddr[23]" UWORD I_74 1 2 0 65535 ECU_ADDRESS 0x0 /end MEASUREMENT
/begin MEASUREMENT SBC_au16SpiTxAddr[24] "SBC_au16SpiTxAddr[24]" UWORD I_74 1 2 0 65535 ECU_ADDRESS 0x0 /end MEASUREMENT
/begin MEASUREMENT SBC_au16SpiTxAddr[25] "SBC_au16SpiTxAddr[25]" UWORD I_74 1 2 0 65535 ECU_ADDRESS 0x0 /end MEASUREMENT
/begin MEASUREMENT SBC_au16SpiTxAddr[26] "SBC_au16SpiTxAddr[26]" UWORD I_74 1 2 0 65535 ECU_ADDRESS 0x0 /end MEASUREMENT
/begin MEASUREMENT SBC_au16SpiTxAddr[27] "SBC_au16SpiTxAddr[27]" UWORD I_74 1 2 0 65535 ECU_ADDRESS 0x0 /end MEASUREMENT
/begin MEASUREMENT SBC_au16SpiTxAddr[28] "SBC_au16SpiTxAddr[28]" UWORD I_74 1 2 0 65535 ECU_ADDRESS 0x0 /end MEASUREMENT
/begin MEASUREMENT SBC_au16SpiTxAddr[29] "SBC_au16SpiTxAddr[29]" UWORD I_74 1 2 0 65535 ECU_ADDRESS 0x0 /end MEASUREMENT
/begin MEASUREMENT SBC_au16SpiTxAddr[2] "SBC_au16SpiTxAddr[2]" UWORD I_74 1 2 0 65535 ECU_ADDRESS 0x0 /end MEASUREMENT
/begin MEASUREMENT SBC_au16SpiTxAddr[3] "SBC_au16SpiTxAddr[3]" UWORD I_74 1 2 0 65535 ECU_ADDRESS 0x0 /end MEASUREMENT
/begin MEASUREMENT SBC_au16SpiTxAddr[4] "SBC_au16SpiTxAddr[4]" UWORD I_74 1 2 0 65535 ECU_ADDRESS 0x0 /end MEASUREMENT
/begin MEASUREMENT SBC_au16SpiTxAddr[5] "SBC_au16SpiTxAddr[5]" UWORD I_74 1 2 0 65535 ECU_ADDRESS 0x0 /end MEASUREMENT
/begin MEASUREMENT SBC_au16SpiTxAddr[6] "SBC_au16SpiTxAddr[6]" UWORD I_74 1 2 0 65535 ECU_ADDRESS 0x0 /end MEASUREMENT
/begin MEASUREMENT SBC_au16SpiTxAddr[7] "SBC_au16SpiTxAddr[7]" UWORD I_74 1 2 0 65535 ECU_ADDRESS 0x0 /end MEASUREMENT
/begin MEASUREMENT SBC_au16SpiTxAddr[8] "SBC_au16SpiTxAddr[8]" UWORD I_74 1 2 0 65535 ECU_ADDRESS 0x0 /end MEASUREMENT
/begin MEASUREMENT SBC_au16SpiTxAddr[9] "SBC_au16SpiTxAddr[9]" UWORD I_74 1 2 0 65535 ECU_ADDRESS 0x0 /end MEASUREMENT
/begin MEASUREMENT SBC_au16SpiTxData "SBC_au16SpiTxData" UWORD I_74 1 2 0 65535 MATRIX_DIM 30 1 1 ECU_ADDRESS 0x0 /end MEASUREMENT
/begin MEASUREMENT SBC_au16SpiTxData[0] "SBC_au16SpiTxData[0]" UWORD I_74 1 2 0 65535 ECU_ADDRESS 0x0 /end MEASUREMENT
/begin MEASUREMENT SBC_au16SpiTxData[10] "SBC_au16SpiTxData[10]" UWORD I_74 1 2 0 65535 ECU_ADDRESS 0x0 /end MEASUREMENT
/begin MEASUREMENT SBC_au16SpiTxData[11] "SBC_au16SpiTxData[11]" UWORD I_74 1 2 0 65535 ECU_ADDRESS 0x0 /end MEASUREMENT
/begin MEASUREMENT SBC_au16SpiTxData[12] "SBC_au16SpiTxData[12]" UWORD I_74 1 2 0 65535 ECU_ADDRESS 0x0 /end MEASUREMENT
/begin MEASUREMENT SBC_au16SpiTxData[13] "SBC_au16SpiTxData[13]" UWORD I_74 1 2 0 65535 ECU_ADDRESS 0x0 /end MEASUREMENT
/begin MEASUREMENT SBC_au16SpiTxData[14] "SBC_au16SpiTxData[14]" UWORD I_74 1 2 0 65535 ECU_ADDRESS 0x0 /end MEASUREMENT
/begin MEASUREMENT SBC_au16SpiTxData[15] "SBC_au16SpiTxData[15]" UWORD I_74 1 2 0 65535 ECU_ADDRESS 0x0 /end MEASUREMENT
/begin MEASUREMENT SBC_au16SpiTxData[16] "SBC_au16SpiTxData[16]" UWORD I_74 1 2 0 65535 ECU_ADDRESS 0x0 /end MEASUREMENT
/begin MEASUREMENT SBC_au16SpiTxData[17] "SBC_au16SpiTxData[17]" UWORD I_74 1 2 0 65535 ECU_ADDRESS 0x0 /end MEASUREMENT
/begin MEASUREMENT SBC_au16SpiTxData[18] "SBC_au16SpiTxData[18]" UWORD I_74 1 2 0 65535 ECU_ADDRESS 0x0 /end MEASUREMENT
/begin MEASUREMENT SBC_au16SpiTxData[19] "SBC_au16SpiTxData[19]" UWORD I_74 1 2 0 65535 ECU_ADDRESS 0x0 /end MEASUREMENT
/begin MEASUREMENT SBC_au16SpiTxData[1] "SBC_au16SpiTxData[1]" UWORD I_74 1 2 0 65535 ECU_ADDRESS 0x0 /end MEASUREMENT
/begin MEASUREMENT SBC_au16SpiTxData[20] "SBC_au16SpiTxData[20]" UWORD I_74 1 2 0 65535 ECU_ADDRESS 0x0 /end MEASUREMENT
/begin MEASUREMENT SBC_au16SpiTxData[21] "SBC_au16SpiTxData[21]" UWORD I_74 1 2 0 65535 ECU_ADDRESS 0x0 /end MEASUREMENT
/begin MEASUREMENT SBC_au16SpiTxData[22] "SBC_au16SpiTxData[22]" UWORD I_74 1 2 0 65535 ECU_ADDRESS 0x0 /end MEASUREMENT
/begin MEASUREMENT SBC_au16SpiTxData[23] "SBC_au16SpiTxData[23]" UWORD I_74 1 2 0 65535 ECU_ADDRESS 0x0 /end MEASUREMENT
/begin MEASUREMENT SBC_au16SpiTxData[24] "SBC_au16SpiTxData[24]" UWORD I_74 1 2 0 65535 ECU_ADDRESS 0x0 /end MEASUREMENT
/begin MEASUREMENT SBC_au16SpiTxData[25] "SBC_au16SpiTxData[25]" UWORD I_74 1 2 0 65535 ECU_ADDRESS 0x0 /end MEASUREMENT
/begin MEASUREMENT SBC_au16SpiTxData[26] "SBC_au16SpiTxData[26]" UWORD I_74 1 2 0 65535 ECU_ADDRESS 0x0 /end MEASUREMENT
/begin MEASUREMENT SBC_au16SpiTxData[27] "SBC_au16SpiTxData[27]" UWORD I_74 1 2 0 65535 ECU_ADDRESS 0x0 /end MEASUREMENT
/begin MEASUREMENT SBC_au16SpiTxData[28] "SBC_au16SpiTxData[28]" UWORD I_74 1 2 0 65535 ECU_ADDRESS 0x0 /end MEASUREMENT
/begin MEASUREMENT SBC_au16SpiTxData[29] "SBC_au16SpiTxData[29]" UWORD I_74 1 2 0 65535 ECU_ADDRESS 0x0 /end MEASUREMENT
/begin MEASUREMENT SBC_au16SpiTxData[2] "SBC_au16SpiTxData[2]" UWORD I_74 1 2 0 65535 ECU_ADDRESS 0x0 /end MEASUREMENT
/begin MEASUREMENT SBC_au16SpiTxData[3] "SBC_au16SpiTxData[3]" UWORD I_74 1 2 0 65535 ECU_ADDRESS 0x0 /end MEASUREMENT
/begin MEASUREMENT SBC_au16SpiTxData[4] "SBC_au16SpiTxData[4]" UWORD I_74 1 2 0 65535 ECU_ADDRESS 0x0 /end MEASUREMENT
/begin MEASUREMENT SBC_au16SpiTxData[5] "SBC_au16SpiTxData[5]" UWORD I_74 1 2 0 65535 ECU_ADDRESS 0x0 /end MEASUREMENT
/begin MEASUREMENT SBC_au16SpiTxData[6] "SBC_au16SpiTxData[6]" UWORD I_74 1 2 0 65535 ECU_ADDRESS 0x0 /end MEASUREMENT
/begin MEASUREMENT SBC_au16SpiTxData[7] "SBC_au16SpiTxData[7]" UWORD I_74 1 2 0 65535 ECU_ADDRESS 0x0 /end MEASUREMENT
/begin MEASUREMENT SBC_au16SpiTxData[8] "SBC_au16SpiTxData[8]" UWORD I_74 1 2 0 65535 ECU_ADDRESS 0x0 /end MEASUREMENT
/begin MEASUREMENT SBC_au16SpiTxData[9] "SBC_au16SpiTxData[9]" UWORD I_74 1 2 0 65535 ECU_ADDRESS 0x0 /end MEASUREMENT
/begin MEASUREMENT SBC_au16StatusRegs "SBC_au16StatusRegs" UWORD I_74 1 2 0 65535 MATRIX_DIM 18 1 1 ECU_ADDRESS 0x0 /end MEASUREMENT
/begin MEASUREMENT SBC_au16StatusRegsNvm "SBC_au16StatusRegsNvm" UWORD I_74 1 2 0 65535 MATRIX_DIM 18 1 1 ECU_ADDRESS 0x0 /end MEASUREMENT
/begin MEASUREMENT SBC_au16StatusRegsNvm[0] "SBC_au16StatusRegsNvm[0]" UWORD I_74 1 2 0 65535 ECU_ADDRESS 0x0 /end MEASUREMENT
/begin MEASUREMENT SBC_au16StatusRegsNvm[10] "SBC_au16StatusRegsNvm[10]" UWORD I_74 1 2 0 65535 ECU_ADDRESS 0x0 /end MEASUREMENT
/begin MEASUREMENT SBC_au16StatusRegsNvm[11] "SBC_au16StatusRegsNvm[11]" UWORD I_74 1 2 0 65535 ECU_ADDRESS 0x0 /end MEASUREMENT
/begin MEASUREMENT SBC_au16StatusRegsNvm[12] "SBC_au16StatusRegsNvm[12]" UWORD I_74 1 2 0 65535 ECU_ADDRESS 0x0 /end MEASUREMENT
/begin MEASUREMENT SBC_au16StatusRegsNvm[13] "SBC_au16StatusRegsNvm[13]" UWORD I_74 1 2 0 65535 ECU_ADDRESS 0x0 /end MEASUREMENT
/begin MEASUREMENT SBC_au16StatusRegsNvm[14] "SBC_au16StatusRegsNvm[14]" UWORD I_74 1 2 0 65535 ECU_ADDRESS 0x0 /end MEASUREMENT
/begin MEASUREMENT SBC_au16StatusRegsNvm[15] "SBC_au16StatusRegsNvm[15]" UWORD I_74 1 2 0 65535 ECU_ADDRESS 0x0 /end MEASUREMENT
/begin MEASUREMENT SBC_au16StatusRegsNvm[16] "SBC_au16StatusRegsNvm[16]" UWORD I_74 1 2 0 65535 ECU_ADDRESS 0x0 /end MEASUREMENT
/begin MEASUREMENT SBC_au16StatusRegsNvm[17] "SBC_au16StatusRegsNvm[17]" UWORD I_74 1 2 0 65535 ECU_ADDRESS 0x0 /end MEASUREMENT
/begin MEASUREMENT SBC_au16StatusRegsNvm[1] "SBC_au16StatusRegsNvm[1]" UWORD I_74 1 2 0 65535 ECU_ADDRESS 0x0 /end MEASUREMENT
/begin MEASUREMENT SBC_au16StatusRegsNvm[2] "SBC_au16StatusRegsNvm[2]" UWORD I_74 1 2 0 65535 ECU_ADDRESS 0x0 /end MEASUREMENT
/begin MEASUREMENT SBC_au16StatusRegsNvm[3] "SBC_au16StatusRegsNvm[3]" UWORD I_74 1 2 0 65535 ECU_ADDRESS 0x0 /end MEASUREMENT
/begin MEASUREMENT SBC_au16StatusRegsNvm[4] "SBC_au16StatusRegsNvm[4]" UWORD I_74 1 2 0 65535 ECU_ADDRESS 0x0 /end MEASUREMENT
/begin MEASUREMENT SBC_au16StatusRegsNvm[5] "SBC_au16StatusRegsNvm[5]" UWORD I_74 1 2 0 65535 ECU_ADDRESS 0x0 /end MEASUREMENT
/begin MEASUREMENT SBC_au16StatusRegsNvm[6] "SBC_au16StatusRegsNvm[6]" UWORD I_74 1 2 0 65535 ECU_ADDRESS 0x0 /end MEASUREMENT
/begin MEASUREMENT SBC_au16StatusRegsNvm[7] "SBC_au16StatusRegsNvm[7]" UWORD I_74 1 2 0 65535 ECU_ADDRESS 0x0 /end MEASUREMENT
/begin MEASUREMENT SBC_au16StatusRegsNvm[8] "SBC_au16StatusRegsNvm[8]" UWORD I_74 1 2 0 65535 ECU_ADDRESS 0x0 /end MEASUREMENT
/begin MEASUREMENT SBC_au16StatusRegsNvm[9] "SBC_au16StatusRegsNvm[9]" UWORD I_74 1 2 0 65535 ECU_ADDRESS 0x0 /end MEASUREMENT
/begin MEASUREMENT SBC_au16StatusRegs[0] "SBC_au16StatusRegs[0]" UWORD I_74 1 2 0 65535 ECU_ADDRESS 0x0 /end MEASUREMENT
/begin MEASUREMENT SBC_au16StatusRegs[10] "SBC_au16StatusRegs[10]" UWORD I_74 1 2 0 65535 ECU_ADDRESS 0x0 /end MEASUREMENT
/begin MEASUREMENT SBC_au16StatusRegs[11] "SBC_au16StatusRegs[11]" UWORD I_74 1 2 0 65535 ECU_ADDRESS 0x0 /end MEASUREMENT
/begin MEASUREMENT SBC_au16StatusRegs[12] "SBC_au16StatusRegs[12]" UWORD I_74 1 2 0 65535 ECU_ADDRESS 0x0 /end MEASUREMENT
/begin MEASUREMENT SBC_au16StatusRegs[13] "SBC_au16StatusRegs[13]" UWORD I_74 1 2 0 65535 ECU_ADDRESS 0x0 /end MEASUREMENT
/begin MEASUREMENT SBC_au16StatusRegs[14] "SBC_au16StatusRegs[14]" UWORD I_74 1 2 0 65535 ECU_ADDRESS 0x0 /end MEASUREMENT
/begin MEASUREMENT SBC_au16StatusRegs[15] "SBC_au16StatusRegs[15]" UWORD I_74 1 2 0 65535 ECU_ADDRESS 0x0 /end MEASUREMENT
/begin MEASUREMENT SBC_au16StatusRegs[16] "SBC_au16StatusRegs[16]" UWORD I_74 1 2 0 65535 ECU_ADDRESS 0x0 /end MEASUREMENT
/begin MEASUREMENT SBC_au16StatusRegs[17] "SBC_au16StatusRegs[17]" UWORD I_74 1 2 0 65535 ECU_ADDRESS 0x0 /end MEASUREMENT
/begin MEASUREMENT SBC_au16StatusRegs[1] "SBC_au16StatusRegs[1]" UWORD I_74 1 2 0 65535 ECU_ADDRESS 0x0 /end MEASUREMENT
/begin MEASUREMENT SBC_au16StatusRegs[2] "SBC_au16StatusRegs[2]" UWORD I_74 1 2 0 65535 ECU_ADDRESS 0x0 /end MEASUREMENT
/begin MEASUREMENT SBC_au16StatusRegs[3] "SBC_au16StatusRegs[3]" UWORD I_74 1 2 0 65535 ECU_ADDRESS 0x0 /end MEASUREMENT
/begin MEASUREMENT SBC_au16StatusRegs[4] "SBC_au16StatusRegs[4]" UWORD I_74 1 2 0 65535 ECU_ADDRESS 0x0 /end MEASUREMENT
/begin MEASUREMENT SBC_au16StatusRegs[5] "SBC_au16StatusRegs[5]" UWORD I_74 1 2 0 65535 ECU_ADDRESS 0x0 /end MEASUREMENT
/begin MEASUREMENT SBC_au16StatusRegs[6] "SBC_au16StatusRegs[6]" UWORD I_74 1 2 0 65535 ECU_ADDRESS 0x0 /end MEASUREMENT
/begin MEASUREMENT SBC_au16StatusRegs[7] "SBC_au16StatusRegs[7]" UWORD I_74 1 2 0 65535 ECU_ADDRESS 0x0 /end MEASUREMENT
/begin MEASUREMENT SBC_au16StatusRegs[8] "SBC_au16StatusRegs[8]" UWORD I_74 1 2 0 65535 ECU_ADDRESS 0x0 /end MEASUREMENT
/begin MEASUREMENT SBC_au16StatusRegs[9] "SBC_au16StatusRegs[9]" UWORD I_74 1 2 0 65535 ECU_ADDRESS 0x0 /end MEASUREMENT
/begin MEASUREMENT SBC_bClrStsRegs "SBC_bClrStsRegs" UBYTE Bool_ON_OFF 1 2 0 1 BIT_MASK 0x01 ECU_ADDRESS 0x0 /end MEASUREMENT
/begin MEASUREMENT SBC_bDeintWdgCmd "SBC_bDeintWdgCmd" UBYTE Bool_ON_OFF 1 2 0 1 BIT_MASK 0x01 ECU_ADDRESS 0x0 /end MEASUREMENT
/begin MEASUREMENT SBC_bFaultSts "SBC_bFaultSts" UBYTE Bool_ON_OFF 1 2 0 1 BIT_MASK 0x01 ECU_ADDRESS 0x0 /end MEASUREMENT
/begin MEASUREMENT SBC_bFaultStsCom "SBC_bFaultStsCom" UBYTE Bool_ON_OFF 1 2 0 1 BIT_MASK 0x01 ECU_ADDRESS 0x0 /end MEASUREMENT
/begin MEASUREMENT SBC_bFaultStsInit "SBC_bFaultStsInit" UBYTE Bool_ON_OFF 1 2 0 1 BIT_MASK 0x01 ECU_ADDRESS 0x0 /end MEASUREMENT
/begin MEASUREMENT SBC_bFaultStsTemp "SBC_bFaultStsTemp" UBYTE Bool_ON_OFF 1 2 0 1 BIT_MASK 0x01 ECU_ADDRESS 0x0 /end MEASUREMENT
/begin MEASUREMENT SBC_bFaultStsVolt "SBC_bFaultStsVolt" UBYTE Bool_ON_OFF 1 2 0 1 BIT_MASK 0x01 ECU_ADDRESS 0x0 /end MEASUREMENT
/begin MEASUREMENT SBC_bPwOnFltClred "SBC_bPwOnFltClred" UBYTE Bool_ON_OFF 1 2 0 1 BIT_MASK 0x01 ECU_ADDRESS 0x0 /end MEASUREMENT
/begin MEASUREMENT SBC_bPwrOnFaultCleared "SBC_bPwrOnFaultCleared" UBYTE Bool_ON_OFF 1 2 0 1 BIT_MASK 0x01 ECU_ADDRESS 0x0 /end MEASUREMENT
/begin MEASUREMENT SBC_bStdbyStsFlag "SBC_bStdbyStsFlag" UBYTE Bool_ON_OFF 1 2 0 1 BIT_MASK 0x01 ECU_ADDRESS 0x0 /end MEASUREMENT
/begin MEASUREMENT SBC_f32BatteryVoltage "SBC_f32BatteryVoltage" FLOAT32_IEEE I_3 1 2 -3.402823466E+038 3.402823466E+038 ECU_ADDRESS 0x0 /end MEASUREMENT
/begin MEASUREMENT SBC_f32BkpVoltage "SBC_f32BkpVoltage" FLOAT32_IEEE I_3 1 2 -3.402823466E+038 3.402823466E+038 ECU_ADDRESS 0x0 /end MEASUREMENT
/begin MEASUREMENT SBC_u8ReadingRegObj "SBC_u8ReadingRegObj" UBYTE I_3 1 2 0 255 ECU_ADDRESS 0x0 /end MEASUREMENT
/begin MEASUREMENT SBC_u8SpiWriteNum "SBC_u8SpiWriteNum" UBYTE I_3 1 2 0 255 ECU_ADDRESS 0x0 /end MEASUREMENT
/begin MEASUREMENT SBC_u8State "SBC_u8State" UBYTE I_23 1 2 0 255 ECU_ADDRESS 0x0 /end MEASUREMENT
/begin MEASUREMENT SCU_u16DieTemp "SCU_u16DieTemp" UWORD F_0v4694835681_m284v9765258216_75 1 2 -284.9765258 30482.62911 ECU_ADDRESS 0x0 /end MEASUREMENT
/begin MEASUREMENT SPY_bBufFull "SPY_bBufFull" UBYTE Bool_ON_OFF 1 2 0 1 BIT_MASK 0x01 ECU_ADDRESS 0x0 /end MEASUREMENT
/begin MEASUREMENT SPY_u16DaqListFirstElmIdx "SPY_u16DaqListFirstElmIdx" UWORD I_1 1 2 0 65535 ECU_ADDRESS 0x0 /end MEASUREMENT
/begin MEASUREMENT SPY_u16NrOfElmsToTx "SPY_u16NrOfElmsToTx" UWORD I_1 1 2 0 65535 ECU_ADDRESS 0x0 /end MEASUREMENT
/begin MEASUREMENT SPY_u16PreTrigSmplIdx "SPY_u16PreTrigSmplIdx" UWORD I_1 1 2 0 65535 ECU_ADDRESS 0x0 /end MEASUREMENT
/begin MEASUREMENT SPY_u16RmngSmplIdx "SPY_u16RmngSmplIdx" UWORD I_1 1 2 0 65535 ECU_ADDRESS 0x0 /end MEASUREMENT
/begin MEASUREMENT SPY_u16SmplIdx "SPY_u16SmplIdx" UWORD I_1 1 2 0 65535 ECU_ADDRESS 0x0 /end MEASUREMENT
/begin MEASUREMENT SPY_u16TrigSmplIdx "SPY_u16TrigSmplIdx" UWORD I_1 1 2 0 65535 ECU_ADDRESS 0x0 /end MEASUREMENT
/begin MEASUREMENT SWFAIL_audtSaveContext "SWFAIL_audtSaveContext" ULONG I_1 1 2 0 4294967295 MATRIX_DIM 32 1 1 ECU_ADDRESS 0x0 /end MEASUREMENT
/begin MEASUREMENT SWFAIL_audtSaveContext[0] "SWFAIL_audtSaveContext[0]" ULONG I_1 1 2 0 4294967295 ECU_ADDRESS 0x0 /end MEASUREMENT
/begin MEASUREMENT SWFAIL_audtSaveContext[10] "SWFAIL_audtSaveContext[10]" ULONG I_1 1 2 0 4294967295 ECU_ADDRESS 0x0 /end MEASUREMENT
/begin MEASUREMENT SWFAIL_audtSaveContext[11] "SWFAIL_audtSaveContext[11]" ULONG I_1 1 2 0 4294967295 ECU_ADDRESS 0x0 /end MEASUREMENT
/begin MEASUREMENT SWFAIL_audtSaveContext[12] "SWFAIL_audtSaveContext[12]" ULONG I_1 1 2 0 4294967295 ECU_ADDRESS 0x0 /end MEASUREMENT
/begin MEASUREMENT SWFAIL_audtSaveContext[13] "SWFAIL_audtSaveContext[13]" ULONG I_1 1 2 0 4294967295 ECU_ADDRESS 0x0 /end MEASUREMENT
/begin MEASUREMENT SWFAIL_audtSaveContext[14] "SWFAIL_audtSaveContext[14]" ULONG I_1 1 2 0 4294967295 ECU_ADDRESS 0x0 /end MEASUREMENT
/begin MEASUREMENT SWFAIL_audtSaveContext[15] "SWFAIL_audtSaveContext[15]" ULONG I_1 1 2 0 4294967295 ECU_ADDRESS 0x0 /end MEASUREMENT
/begin MEASUREMENT SWFAIL_audtSaveContext[16] "SWFAIL_audtSaveContext[16]" ULONG I_1 1 2 0 4294967295 ECU_ADDRESS 0x0 /end MEASUREMENT
/begin MEASUREMENT SWFAIL_audtSaveContext[17] "SWFAIL_audtSaveContext[17]" ULONG I_1 1 2 0 4294967295 ECU_ADDRESS 0x0 /end MEASUREMENT
/begin MEASUREMENT SWFAIL_audtSaveContext[18] "SWFAIL_audtSaveContext[18]" ULONG I_1 1 2 0 4294967295 ECU_ADDRESS 0x0 /end MEASUREMENT
/begin MEASUREMENT SWFAIL_audtSaveContext[19] "SWFAIL_audtSaveContext[19]" ULONG I_1 1 2 0 4294967295 ECU_ADDRESS 0x0 /end MEASUREMENT
/begin MEASUREMENT SWFAIL_audtSaveContext[1] "SWFAIL_audtSaveContext[1]" ULONG I_1 1 2 0 4294967295 ECU_ADDRESS 0x0 /end MEASUREMENT
/begin MEASUREMENT SWFAIL_audtSaveContext[20] "SWFAIL_audtSaveContext[20]" ULONG I_1 1 2 0 4294967295 ECU_ADDRESS 0x0 /end MEASUREMENT
/begin MEASUREMENT SWFAIL_audtSaveContext[21] "SWFAIL_audtSaveContext[21]" ULONG I_1 1 2 0 4294967295 ECU_ADDRESS 0x0 /end MEASUREMENT
/begin MEASUREMENT SWFAIL_audtSaveContext[22] "SWFAIL_audtSaveContext[22]" ULONG I_1 1 2 0 4294967295 ECU_ADDRESS 0x0 /end MEASUREMENT
/begin MEASUREMENT SWFAIL_audtSaveContext[23] "SWFAIL_audtSaveContext[23]" ULONG I_1 1 2 0 4294967295 ECU_ADDRESS 0x0 /end MEASUREMENT
/begin MEASUREMENT SWFAIL_audtSaveContext[24] "SWFAIL_audtSaveContext[24]" ULONG I_1 1 2 0 4294967295 ECU_ADDRESS 0x0 /end MEASUREMENT
/begin MEASUREMENT SWFAIL_audtSaveContext[25] "SWFAIL_audtSaveContext[25]" ULONG I_1 1 2 0 4294967295 ECU_ADDRESS 0x0 /end MEASUREMENT
/begin MEASUREMENT SWFAIL_audtSaveContext[26] "SWFAIL_audtSaveContext[26]" ULONG I_1 1 2 0 4294967295 ECU_ADDRESS 0x0 /end MEASUREMENT
/begin MEASUREMENT SWFAIL_audtSaveContext[27] "SWFAIL_audtSaveContext[27]" ULONG I_1 1 2 0 4294967295 ECU_ADDRESS 0x0 /end MEASUREMENT
/begin MEASUREMENT SWFAIL_audtSaveContext[28] "SWFAIL_audtSaveContext[28]" ULONG I_1 1 2 0 4294967295 ECU_ADDRESS 0x0 /end MEASUREMENT
/begin MEASUREMENT SWFAIL_audtSaveContext[29] "SWFAIL_audtSaveContext[29]" ULONG I_1 1 2 0 4294967295 ECU_ADDRESS 0x0 /end MEASUREMENT
/begin MEASUREMENT SWFAIL_audtSaveContext[2] "SWFAIL_audtSaveContext[2]" ULONG I_1 1 2 0 4294967295 ECU_ADDRESS 0x0 /end MEASUREMENT
/begin MEASUREMENT SWFAIL_audtSaveContext[30] "SWFAIL_audtSaveContext[30]" ULONG I_1 1 2 0 4294967295 ECU_ADDRESS 0x0 /end MEASUREMENT
/begin MEASUREMENT SWFAIL_audtSaveContext[31] "SWFAIL_audtSaveContext[31]" ULONG I_1 1 2 0 4294967295 ECU_ADDRESS 0x0 /end MEASUREMENT
/begin MEASUREMENT SWFAIL_audtSaveContext[3] "SWFAIL_audtSaveContext[3]" ULONG I_1 1 2 0 4294967295 ECU_ADDRESS 0x0 /end MEASUREMENT
/begin MEASUREMENT SWFAIL_audtSaveContext[4] "SWFAIL_audtSaveContext[4]" ULONG I_1 1 2 0 4294967295 ECU_ADDRESS 0x0 /end MEASUREMENT
/begin MEASUREMENT SWFAIL_audtSaveContext[5] "SWFAIL_audtSaveContext[5]" ULONG I_1 1 2 0 4294967295 ECU_ADDRESS 0x0 /end MEASUREMENT
/begin MEASUREMENT SWFAIL_audtSaveContext[6] "SWFAIL_audtSaveContext[6]" ULONG I_1 1 2 0 4294967295 ECU_ADDRESS 0x0 /end MEASUREMENT
/begin MEASUREMENT SWFAIL_audtSaveContext[7] "SWFAIL_audtSaveContext[7]" ULONG I_1 1 2 0 4294967295 ECU_ADDRESS 0x0 /end MEASUREMENT
/begin MEASUREMENT SWFAIL_audtSaveContext[8] "SWFAIL_audtSaveContext[8]" ULONG I_1 1 2 0 4294967295 ECU_ADDRESS 0x0 /end MEASUREMENT
/begin MEASUREMENT SWFAIL_audtSaveContext[9] "SWFAIL_audtSaveContext[9]" ULONG I_1 1 2 0 4294967295 ECU_ADDRESS 0x0 /end MEASUREMENT
/begin MEASUREMENT SWFAIL_bfErrorType "SWFAIL_bfErrorType" ULONG I_1 1 2 0 4294967295 ECU_ADDRESS 0x0 /end MEASUREMENT
/begin MEASUREMENT SWFAIL_bfTrapType "SWFAIL_bfTrapType" ULONG I_1 1 2 0 4294967295 ECU_ADDRESS 0x0 /end MEASUREMENT
/begin MEASUREMENT SWFAIL_pfErrorAddress "SWFAIL_pfErrorAddress" ULONG I_1 1 2 0 4294967295 ECU_ADDRESS 0x0 /end MEASUREMENT
/begin MEASUREMENT SWFAIL_pfu32IllegalInstruction "SWFAIL_pfu32IllegalInstruction" ULONG I_1 1 2 0 4294967295 ECU_ADDRESS 0x0 /end MEASUREMENT
/begin MEASUREMENT SWFAIL_pfu32ProgramReturnError "SWFAIL_pfu32ProgramReturnError" ULONG I_1 1 2 0 4294967295 ECU_ADDRESS 0x0 /end MEASUREMENT
/begin MEASUREMENT SWFAIL_u16ExceptionErrorCounter "SWFAIL_u16ExceptionErrorCounter" UWORD I_1 1 2 0 65535 ECU_ADDRESS 0x0 /end MEASUREMENT
/begin MEASUREMENT SWFAIL_u16SoftwareErrorCounter "SWFAIL_u16SoftwareErrorCounter" UWORD I_1 1 2 0 65535 ECU_ADDRESS 0x0 /end MEASUREMENT
/begin MEASUREMENT SWFAIL_u16StackErrorCounter "SWFAIL_u16StackErrorCounter" UWORD I_1 1 2 0 65535 ECU_ADDRESS 0x0 /end MEASUREMENT
/begin MEASUREMENT SWFAIL_u32StatusRegisterError "SWFAIL_u32StatusRegisterError" ULONG I_1 1 2 0 4294967295 ECU_ADDRESS 0x0 /end MEASUREMENT
/begin MEASUREMENT SWFAIL_u8CoreIdx "SWFAIL_u8CoreIdx" UBYTE I_1 1 2 0 255 ECU_ADDRESS 0x0 /end MEASUREMENT
/begin MEASUREMENT SWFAIL_udtStackIdx "SWFAIL_udtStackIdx" UBYTE I_1 1 2 0 255 ECU_ADDRESS 0x0 /end MEASUREMENT
/begin MEASUREMENT TJA1145_au16SpiReadFrame "TJA1145_au16SpiReadFrame" UWORD I_1 1 2 0 65535 MATRIX_DIM 30 1 1 ECU_ADDRESS 0x0 /end MEASUREMENT
/begin MEASUREMENT TJA1145_au16SpiReadFrame[0] "TJA1145_au16SpiReadFrame[0]" UWORD I_1 1 2 0 65535 ECU_ADDRESS 0x0 /end MEASUREMENT
/begin MEASUREMENT TJA1145_au16SpiReadFrame[10] "TJA1145_au16SpiReadFrame[10]" UWORD I_1 1 2 0 65535 ECU_ADDRESS 0x0 /end MEASUREMENT
/begin MEASUREMENT TJA1145_au16SpiReadFrame[11] "TJA1145_au16SpiReadFrame[11]" UWORD I_1 1 2 0 65535 ECU_ADDRESS 0x0 /end MEASUREMENT
/begin MEASUREMENT TJA1145_au16SpiReadFrame[12] "TJA1145_au16SpiReadFrame[12]" UWORD I_1 1 2 0 65535 ECU_ADDRESS 0x0 /end MEASUREMENT
/begin MEASUREMENT TJA1145_au16SpiReadFrame[13] "TJA1145_au16SpiReadFrame[13]" UWORD I_1 1 2 0 65535 ECU_ADDRESS 0x0 /end MEASUREMENT
/begin MEASUREMENT TJA1145_au16SpiReadFrame[14] "TJA1145_au16SpiReadFrame[14]" UWORD I_1 1 2 0 65535 ECU_ADDRESS 0x0 /end MEASUREMENT
/begin MEASUREMENT TJA1145_au16SpiReadFrame[15] "TJA1145_au16SpiReadFrame[15]" UWORD I_1 1 2 0 65535 ECU_ADDRESS 0x0 /end MEASUREMENT
/begin MEASUREMENT TJA1145_au16SpiReadFrame[16] "TJA1145_au16SpiReadFrame[16]" UWORD I_1 1 2 0 65535 ECU_ADDRESS 0x0 /end MEASUREMENT
/begin MEASUREMENT TJA1145_au16SpiReadFrame[17] "TJA1145_au16SpiReadFrame[17]" UWORD I_1 1 2 0 65535 ECU_ADDRESS 0x0 /end MEASUREMENT
/begin MEASUREMENT TJA1145_au16SpiReadFrame[18] "TJA1145_au16SpiReadFrame[18]" UWORD I_1 1 2 0 65535 ECU_ADDRESS 0x0 /end MEASUREMENT
/begin MEASUREMENT TJA1145_au16SpiReadFrame[19] "TJA1145_au16SpiReadFrame[19]" UWORD I_1 1 2 0 65535 ECU_ADDRESS 0x0 /end MEASUREMENT
/begin MEASUREMENT TJA1145_au16SpiReadFrame[1] "TJA1145_au16SpiReadFrame[1]" UWORD I_1 1 2 0 65535 ECU_ADDRESS 0x0 /end MEASUREMENT
/begin MEASUREMENT TJA1145_au16SpiReadFrame[20] "TJA1145_au16SpiReadFrame[20]" UWORD I_1 1 2 0 65535 ECU_ADDRESS 0x0 /end MEASUREMENT
/begin MEASUREMENT TJA1145_au16SpiReadFrame[21] "TJA1145_au16SpiReadFrame[21]" UWORD I_1 1 2 0 65535 ECU_ADDRESS 0x0 /end MEASUREMENT
/begin MEASUREMENT TJA1145_au16SpiReadFrame[22] "TJA1145_au16SpiReadFrame[22]" UWORD I_1 1 2 0 65535 ECU_ADDRESS 0x0 /end MEASUREMENT
/begin MEASUREMENT TJA1145_au16SpiReadFrame[23] "TJA1145_au16SpiReadFrame[23]" UWORD I_1 1 2 0 65535 ECU_ADDRESS 0x0 /end MEASUREMENT
/begin MEASUREMENT TJA1145_au16SpiReadFrame[24] "TJA1145_au16SpiReadFrame[24]" UWORD I_1 1 2 0 65535 ECU_ADDRESS 0x0 /end MEASUREMENT
/begin MEASUREMENT TJA1145_au16SpiReadFrame[25] "TJA1145_au16SpiReadFrame[25]" UWORD I_1 1 2 0 65535 ECU_ADDRESS 0x0 /end MEASUREMENT
/begin MEASUREMENT TJA1145_au16SpiReadFrame[26] "TJA1145_au16SpiReadFrame[26]" UWORD I_1 1 2 0 65535 ECU_ADDRESS 0x0 /end MEASUREMENT
/begin MEASUREMENT TJA1145_au16SpiReadFrame[27] "TJA1145_au16SpiReadFrame[27]" UWORD I_1 1 2 0 65535 ECU_ADDRESS 0x0 /end MEASUREMENT
/begin MEASUREMENT TJA1145_au16SpiReadFrame[28] "TJA1145_au16SpiReadFrame[28]" UWORD I_1 1 2 0 65535 ECU_ADDRESS 0x0 /end MEASUREMENT
/begin MEASUREMENT TJA1145_au16SpiReadFrame[29] "TJA1145_au16SpiReadFrame[29]" UWORD I_1 1 2 0 65535 ECU_ADDRESS 0x0 /end MEASUREMENT
/begin MEASUREMENT TJA1145_au16SpiReadFrame[2] "TJA1145_au16SpiReadFrame[2]" UWORD I_1 1 2 0 65535 ECU_ADDRESS 0x0 /end MEASUREMENT
/begin MEASUREMENT TJA1145_au16SpiReadFrame[3] "TJA1145_au16SpiReadFrame[3]" UWORD I_1 1 2 0 65535 ECU_ADDRESS 0x0 /end MEASUREMENT
/begin MEASUREMENT TJA1145_au16SpiReadFrame[4] "TJA1145_au16SpiReadFrame[4]" UWORD I_1 1 2 0 65535 ECU_ADDRESS 0x0 /end MEASUREMENT
/begin MEASUREMENT TJA1145_au16SpiReadFrame[5] "TJA1145_au16SpiReadFrame[5]" UWORD I_1 1 2 0 65535 ECU_ADDRESS 0x0 /end MEASUREMENT
/begin MEASUREMENT TJA1145_au16SpiReadFrame[6] "TJA1145_au16SpiReadFrame[6]" UWORD I_1 1 2 0 65535 ECU_ADDRESS 0x0 /end MEASUREMENT
/begin MEASUREMENT TJA1145_au16SpiReadFrame[7] "TJA1145_au16SpiReadFrame[7]" UWORD I_1 1 2 0 65535 ECU_ADDRESS 0x0 /end MEASUREMENT
/begin MEASUREMENT TJA1145_au16SpiReadFrame[8] "TJA1145_au16SpiReadFrame[8]" UWORD I_1 1 2 0 65535 ECU_ADDRESS 0x0 /end MEASUREMENT
/begin MEASUREMENT TJA1145_au16SpiReadFrame[9] "TJA1145_au16SpiReadFrame[9]" UWORD I_1 1 2 0 65535 ECU_ADDRESS 0x0 /end MEASUREMENT
/begin MEASUREMENT TJA1145_au16SpiWriteFrame "TJA1145_au16SpiWriteFrame" UWORD I_1 1 2 0 65535 MATRIX_DIM 30 1 1 ECU_ADDRESS 0x0 /end MEASUREMENT
/begin MEASUREMENT TJA1145_au16SpiWriteFrame[0] "TJA1145_au16SpiWriteFrame[0]" UWORD I_1 1 2 0 65535 ECU_ADDRESS 0x0 /end MEASUREMENT
/begin MEASUREMENT TJA1145_au16SpiWriteFrame[10] "TJA1145_au16SpiWriteFrame[10]" UWORD I_1 1 2 0 65535 ECU_ADDRESS 0x0 /end MEASUREMENT
/begin MEASUREMENT TJA1145_au16SpiWriteFrame[11] "TJA1145_au16SpiWriteFrame[11]" UWORD I_1 1 2 0 65535 ECU_ADDRESS 0x0 /end MEASUREMENT
/begin MEASUREMENT TJA1145_au16SpiWriteFrame[12] "TJA1145_au16SpiWriteFrame[12]" UWORD I_1 1 2 0 65535 ECU_ADDRESS 0x0 /end MEASUREMENT
/begin MEASUREMENT TJA1145_au16SpiWriteFrame[13] "TJA1145_au16SpiWriteFrame[13]" UWORD I_1 1 2 0 65535 ECU_ADDRESS 0x0 /end MEASUREMENT
/begin MEASUREMENT TJA1145_au16SpiWriteFrame[14] "TJA1145_au16SpiWriteFrame[14]" UWORD I_1 1 2 0 65535 ECU_ADDRESS 0x0 /end MEASUREMENT
/begin MEASUREMENT TJA1145_au16SpiWriteFrame[15] "TJA1145_au16SpiWriteFrame[15]" UWORD I_1 1 2 0 65535 ECU_ADDRESS 0x0 /end MEASUREMENT
/begin MEASUREMENT TJA1145_au16SpiWriteFrame[16] "TJA1145_au16SpiWriteFrame[16]" UWORD I_1 1 2 0 65535 ECU_ADDRESS 0x0 /end MEASUREMENT
/begin MEASUREMENT TJA1145_au16SpiWriteFrame[17] "TJA1145_au16SpiWriteFrame[17]" UWORD I_1 1 2 0 65535 ECU_ADDRESS 0x0 /end MEASUREMENT
/begin MEASUREMENT TJA1145_au16SpiWriteFrame[18] "TJA1145_au16SpiWriteFrame[18]" UWORD I_1 1 2 0 65535 ECU_ADDRESS 0x0 /end MEASUREMENT
/begin MEASUREMENT TJA1145_au16SpiWriteFrame[19] "TJA1145_au16SpiWriteFrame[19]" UWORD I_1 1 2 0 65535 ECU_ADDRESS 0x0 /end MEASUREMENT
/begin MEASUREMENT TJA1145_au16SpiWriteFrame[1] "TJA1145_au16SpiWriteFrame[1]" UWORD I_1 1 2 0 65535 ECU_ADDRESS 0x0 /end MEASUREMENT
/begin MEASUREMENT TJA1145_au16SpiWriteFrame[20] "TJA1145_au16SpiWriteFrame[20]" UWORD I_1 1 2 0 65535 ECU_ADDRESS 0x0 /end MEASUREMENT
/begin MEASUREMENT TJA1145_au16SpiWriteFrame[21] "TJA1145_au16SpiWriteFrame[21]" UWORD I_1 1 2 0 65535 ECU_ADDRESS 0x0 /end MEASUREMENT
/begin MEASUREMENT TJA1145_au16SpiWriteFrame[22] "TJA1145_au16SpiWriteFrame[22]" UWORD I_1 1 2 0 65535 ECU_ADDRESS 0x0 /end MEASUREMENT
/begin MEASUREMENT TJA1145_au16SpiWriteFrame[23] "TJA1145_au16SpiWriteFrame[23]" UWORD I_1 1 2 0 65535 ECU_ADDRESS 0x0 /end MEASUREMENT
/begin MEASUREMENT TJA1145_au16SpiWriteFrame[24] "TJA1145_au16SpiWriteFrame[24]" UWORD I_1 1 2 0 65535 ECU_ADDRESS 0x0 /end MEASUREMENT
/begin MEASUREMENT TJA1145_au16SpiWriteFrame[25] "TJA1145_au16SpiWriteFrame[25]" UWORD I_1 1 2 0 65535 ECU_ADDRESS 0x0 /end MEASUREMENT
/begin MEASUREMENT TJA1145_au16SpiWriteFrame[26] "TJA1145_au16SpiWriteFrame[26]" UWORD I_1 1 2 0 65535 ECU_ADDRESS 0x0 /end MEASUREMENT
/begin MEASUREMENT TJA1145_au16SpiWriteFrame[27] "TJA1145_au16SpiWriteFrame[27]" UWORD I_1 1 2 0 65535 ECU_ADDRESS 0x0 /end MEASUREMENT
/begin MEASUREMENT TJA1145_au16SpiWriteFrame[28] "TJA1145_au16SpiWriteFrame[28]" UWORD I_1 1 2 0 65535 ECU_ADDRESS 0x0 /end MEASUREMENT
/begin MEASUREMENT TJA1145_au16SpiWriteFrame[29] "TJA1145_au16SpiWriteFrame[29]" UWORD I_1 1 2 0 65535 ECU_ADDRESS 0x0 /end MEASUREMENT
/begin MEASUREMENT TJA1145_au16SpiWriteFrame[2] "TJA1145_au16SpiWriteFrame[2]" UWORD I_1 1 2 0 65535 ECU_ADDRESS 0x0 /end MEASUREMENT
/begin MEASUREMENT TJA1145_au16SpiWriteFrame[3] "TJA1145_au16SpiWriteFrame[3]" UWORD I_1 1 2 0 65535 ECU_ADDRESS 0x0 /end MEASUREMENT
/begin MEASUREMENT TJA1145_au16SpiWriteFrame[4] "TJA1145_au16SpiWriteFrame[4]" UWORD I_1 1 2 0 65535 ECU_ADDRESS 0x0 /end MEASUREMENT
/begin MEASUREMENT TJA1145_au16SpiWriteFrame[5] "TJA1145_au16SpiWriteFrame[5]" UWORD I_1 1 2 0 65535 ECU_ADDRESS 0x0 /end MEASUREMENT
/begin MEASUREMENT TJA1145_au16SpiWriteFrame[6] "TJA1145_au16SpiWriteFrame[6]" UWORD I_1 1 2 0 65535 ECU_ADDRESS 0x0 /end MEASUREMENT
/begin MEASUREMENT TJA1145_au16SpiWriteFrame[7] "TJA1145_au16SpiWriteFrame[7]" UWORD I_1 1 2 0 65535 ECU_ADDRESS 0x0 /end MEASUREMENT
/begin MEASUREMENT TJA1145_au16SpiWriteFrame[8] "TJA1145_au16SpiWriteFrame[8]" UWORD I_1 1 2 0 65535 ECU_ADDRESS 0x0 /end MEASUREMENT
/begin MEASUREMENT TJA1145_au16SpiWriteFrame[9] "TJA1145_au16SpiWriteFrame[9]" UWORD I_1 1 2 0 65535 ECU_ADDRESS 0x0 /end MEASUREMENT
/begin MEASUREMENT TJA1145_bEnableTest "..." UBYTE Bool_ON_OFF 1 2 0 1 BIT_MASK 0x01 ECU_ADDRESS 0x0 /end MEASUREMENT
/begin MEASUREMENT TJA1145_bFrameErrOverFlow "..." UBYTE Bool_ON_OFF 1 2 0 1 BIT_MASK 0x01 ECU_ADDRESS 0x0 /end MEASUREMENT
/begin MEASUREMENT TJA1145_bFrameFinish "..." UBYTE Bool_ON_OFF 1 2 0 1 BIT_MASK 0x01 ECU_ADDRESS 0x0 /end MEASUREMENT
/begin MEASUREMENT TJA1145_bNormSlpFinsh "..." UBYTE Bool_ON_OFF 1 2 0 1 BIT_MASK 0x01 ECU_ADDRESS 0x0 /end MEASUREMENT
/begin MEASUREMENT TJA1145_bSpiComError "..." UBYTE Bool_ON_OFF 1 2 0 1 BIT_MASK 0x01 ECU_ADDRESS 0x0 /end MEASUREMENT
/begin MEASUREMENT TJA1145_u8Add2Read "..." UBYTE I_1 1 2 0 255 ECU_ADDRESS 0x0 /end MEASUREMENT
/begin MEASUREMENT TJA1145_u8ChipTesting "..." UBYTE I_1 1 2 0 255 ECU_ADDRESS 0x0 /end MEASUREMENT
/begin MEASUREMENT TJA1145_u8ChipUsed "..." UBYTE I_1 1 2 0 255 ECU_ADDRESS 0x0 /end MEASUREMENT
/begin MEASUREMENT TJA1145_u8DONE "..." UBYTE I_1 1 2 0 255 ECU_ADDRESS 0x0 /end MEASUREMENT
/begin MEASUREMENT TJA1145_u8ErrorFrameCnt "..." UBYTE I_1 1 2 0 255 ECU_ADDRESS 0x0 /end MEASUREMENT
/begin MEASUREMENT TJA1145_u8IndexFrame "..." UBYTE I_1 1 2 0 255 ECU_ADDRESS 0x0 /end MEASUREMENT
/begin MEASUREMENT TJA1145_u8SpiTxFrameMaxNb "..." UBYTE I_1 1 2 0 255 ECU_ADDRESS 0x0 /end MEASUREMENT
/begin MEASUREMENT TJA1145_u8WakeupSrc "..." UBYTE I_1 1 2 0 255 ECU_ADDRESS 0x0 /end MEASUREMENT
/begin MEASUREMENT TLE9180_af32ReadPhsTempPhys "TLE9180_af32ReadPhsTempPhys" FLOAT32_IEEE I_1 1 2 -3.402823466E+038 3.402823466E+038 MATRIX_DIM 6 1 1 ECU_ADDRESS 0x0 /end MEASUREMENT
/begin MEASUREMENT TLE9180_af32ReadPhsTempPhys[0] "TLE9180_af32ReadPhsTempPhys[0]" FLOAT32_IEEE I_1 1 2 -3.402823466E+038 3.402823466E+038 ECU_ADDRESS 0x0 /end MEASUREMENT
/begin MEASUREMENT TLE9180_af32ReadPhsTempPhys[1] "TLE9180_af32ReadPhsTempPhys[1]" FLOAT32_IEEE I_1 1 2 -3.402823466E+038 3.402823466E+038 ECU_ADDRESS 0x0 /end MEASUREMENT
/begin MEASUREMENT TLE9180_af32ReadPhsTempPhys[2] "TLE9180_af32ReadPhsTempPhys[2]" FLOAT32_IEEE I_1 1 2 -3.402823466E+038 3.402823466E+038 ECU_ADDRESS 0x0 /end MEASUREMENT
/begin MEASUREMENT TLE9180_af32ReadPhsTempPhys[3] "TLE9180_af32ReadPhsTempPhys[3]" FLOAT32_IEEE I_1 1 2 -3.402823466E+038 3.402823466E+038 ECU_ADDRESS 0x0 /end MEASUREMENT
/begin MEASUREMENT TLE9180_af32ReadPhsTempPhys[4] "TLE9180_af32ReadPhsTempPhys[4]" FLOAT32_IEEE I_1 1 2 -3.402823466E+038 3.402823466E+038 ECU_ADDRESS 0x0 /end MEASUREMENT
/begin MEASUREMENT TLE9180_af32ReadPhsTempPhys[5] "TLE9180_af32ReadPhsTempPhys[5]" FLOAT32_IEEE I_1 1 2 -3.402823466E+038 3.402823466E+038 ECU_ADDRESS 0x0 /end MEASUREMENT
/begin MEASUREMENT TLE9180_au32SpiReadFrame "TLE9180_au32SpiReadFrame" ULONG I_1 1 2 0 4294967295 MATRIX_DIM 30 1 1 ECU_ADDRESS 0x0 /end MEASUREMENT
/begin MEASUREMENT TLE9180_au32SpiReadFrame[0] "TLE9180_au32SpiReadFrame[0]" ULONG I_1 1 2 0 4294967295 ECU_ADDRESS 0x0 /end MEASUREMENT
/begin MEASUREMENT TLE9180_au32SpiReadFrame[10] "TLE9180_au32SpiReadFrame[10]" ULONG I_1 1 2 0 4294967295 ECU_ADDRESS 0x0 /end MEASUREMENT
/begin MEASUREMENT TLE9180_au32SpiReadFrame[11] "TLE9180_au32SpiReadFrame[11]" ULONG I_1 1 2 0 4294967295 ECU_ADDRESS 0x0 /end MEASUREMENT
/begin MEASUREMENT TLE9180_au32SpiReadFrame[12] "TLE9180_au32SpiReadFrame[12]" ULONG I_1 1 2 0 4294967295 ECU_ADDRESS 0x0 /end MEASUREMENT
/begin MEASUREMENT TLE9180_au32SpiReadFrame[13] "TLE9180_au32SpiReadFrame[13]" ULONG I_1 1 2 0 4294967295 ECU_ADDRESS 0x0 /end MEASUREMENT
/begin MEASUREMENT TLE9180_au32SpiReadFrame[14] "TLE9180_au32SpiReadFrame[14]" ULONG I_1 1 2 0 4294967295 ECU_ADDRESS 0x0 /end MEASUREMENT
/begin MEASUREMENT TLE9180_au32SpiReadFrame[15] "TLE9180_au32SpiReadFrame[15]" ULONG I_1 1 2 0 4294967295 ECU_ADDRESS 0x0 /end MEASUREMENT
/begin MEASUREMENT TLE9180_au32SpiReadFrame[16] "TLE9180_au32SpiReadFrame[16]" ULONG I_1 1 2 0 4294967295 ECU_ADDRESS 0x0 /end MEASUREMENT
/begin MEASUREMENT TLE9180_au32SpiReadFrame[17] "TLE9180_au32SpiReadFrame[17]" ULONG I_1 1 2 0 4294967295 ECU_ADDRESS 0x0 /end MEASUREMENT
/begin MEASUREMENT TLE9180_au32SpiReadFrame[18] "TLE9180_au32SpiReadFrame[18]" ULONG I_1 1 2 0 4294967295 ECU_ADDRESS 0x0 /end MEASUREMENT
/begin MEASUREMENT TLE9180_au32SpiReadFrame[19] "TLE9180_au32SpiReadFrame[19]" ULONG I_1 1 2 0 4294967295 ECU_ADDRESS 0x0 /end MEASUREMENT
/begin MEASUREMENT TLE9180_au32SpiReadFrame[1] "TLE9180_au32SpiReadFrame[1]" ULONG I_1 1 2 0 4294967295 ECU_ADDRESS 0x0 /end MEASUREMENT
/begin MEASUREMENT TLE9180_au32SpiReadFrame[20] "TLE9180_au32SpiReadFrame[20]" ULONG I_1 1 2 0 4294967295 ECU_ADDRESS 0x0 /end MEASUREMENT
/begin MEASUREMENT TLE9180_au32SpiReadFrame[21] "TLE9180_au32SpiReadFrame[21]" ULONG I_1 1 2 0 4294967295 ECU_ADDRESS 0x0 /end MEASUREMENT
/begin MEASUREMENT TLE9180_au32SpiReadFrame[22] "TLE9180_au32SpiReadFrame[22]" ULONG I_1 1 2 0 4294967295 ECU_ADDRESS 0x0 /end MEASUREMENT
/begin MEASUREMENT TLE9180_au32SpiReadFrame[23] "TLE9180_au32SpiReadFrame[23]" ULONG I_1 1 2 0 4294967295 ECU_ADDRESS 0x0 /end MEASUREMENT
/begin MEASUREMENT TLE9180_au32SpiReadFrame[24] "TLE9180_au32SpiReadFrame[24]" ULONG I_1 1 2 0 4294967295 ECU_ADDRESS 0x0 /end MEASUREMENT
/begin MEASUREMENT TLE9180_au32SpiReadFrame[25] "TLE9180_au32SpiReadFrame[25]" ULONG I_1 1 2 0 4294967295 ECU_ADDRESS 0x0 /end MEASUREMENT
/begin MEASUREMENT TLE9180_au32SpiReadFrame[26] "TLE9180_au32SpiReadFrame[26]" ULONG I_1 1 2 0 4294967295 ECU_ADDRESS 0x0 /end MEASUREMENT
/begin MEASUREMENT TLE9180_au32SpiReadFrame[27] "TLE9180_au32SpiReadFrame[27]" ULONG I_1 1 2 0 4294967295 ECU_ADDRESS 0x0 /end MEASUREMENT
/begin MEASUREMENT TLE9180_au32SpiReadFrame[28] "TLE9180_au32SpiReadFrame[28]" ULONG I_1 1 2 0 4294967295 ECU_ADDRESS 0x0 /end MEASUREMENT
/begin MEASUREMENT TLE9180_au32SpiReadFrame[29] "TLE9180_au32SpiReadFrame[29]" ULONG I_1 1 2 0 4294967295 ECU_ADDRESS 0x0 /end MEASUREMENT
/begin MEASUREMENT TLE9180_au32SpiReadFrame[2] "TLE9180_au32SpiReadFrame[2]" ULONG I_1 1 2 0 4294967295 ECU_ADDRESS 0x0 /end MEASUREMENT
/begin MEASUREMENT TLE9180_au32SpiReadFrame[3] "TLE9180_au32SpiReadFrame[3]" ULONG I_1 1 2 0 4294967295 ECU_ADDRESS 0x0 /end MEASUREMENT
/begin MEASUREMENT TLE9180_au32SpiReadFrame[4] "TLE9180_au32SpiReadFrame[4]" ULONG I_1 1 2 0 4294967295 ECU_ADDRESS 0x0 /end MEASUREMENT
/begin MEASUREMENT TLE9180_au32SpiReadFrame[5] "TLE9180_au32SpiReadFrame[5]" ULONG I_1 1 2 0 4294967295 ECU_ADDRESS 0x0 /end MEASUREMENT
/begin MEASUREMENT TLE9180_au32SpiReadFrame[6] "TLE9180_au32SpiReadFrame[6]" ULONG I_1 1 2 0 4294967295 ECU_ADDRESS 0x0 /end MEASUREMENT
/begin MEASUREMENT TLE9180_au32SpiReadFrame[7] "TLE9180_au32SpiReadFrame[7]" ULONG I_1 1 2 0 4294967295 ECU_ADDRESS 0x0 /end MEASUREMENT
/begin MEASUREMENT TLE9180_au32SpiReadFrame[8] "TLE9180_au32SpiReadFrame[8]" ULONG I_1 1 2 0 4294967295 ECU_ADDRESS 0x0 /end MEASUREMENT
/begin MEASUREMENT TLE9180_au32SpiReadFrame[9] "TLE9180_au32SpiReadFrame[9]" ULONG I_1 1 2 0 4294967295 ECU_ADDRESS 0x0 /end MEASUREMENT
/begin MEASUREMENT TLE9180_au32SpiWriteFrame "TLE9180_au32SpiWriteFrame" ULONG I_1 1 2 0 4294967295 MATRIX_DIM 30 1 1 ECU_ADDRESS 0x0 /end MEASUREMENT
/begin MEASUREMENT TLE9180_au32SpiWriteFrame[0] "TLE9180_au32SpiWriteFrame[0]" ULONG I_1 1 2 0 4294967295 ECU_ADDRESS 0x0 /end MEASUREMENT
/begin MEASUREMENT TLE9180_au32SpiWriteFrame[10] "TLE9180_au32SpiWriteFrame[10]" ULONG I_1 1 2 0 4294967295 ECU_ADDRESS 0x0 /end MEASUREMENT
/begin MEASUREMENT TLE9180_au32SpiWriteFrame[11] "TLE9180_au32SpiWriteFrame[11]" ULONG I_1 1 2 0 4294967295 ECU_ADDRESS 0x0 /end MEASUREMENT
/begin MEASUREMENT TLE9180_au32SpiWriteFrame[12] "TLE9180_au32SpiWriteFrame[12]" ULONG I_1 1 2 0 4294967295 ECU_ADDRESS 0x0 /end MEASUREMENT
/begin MEASUREMENT TLE9180_au32SpiWriteFrame[13] "TLE9180_au32SpiWriteFrame[13]" ULONG I_1 1 2 0 4294967295 ECU_ADDRESS 0x0 /end MEASUREMENT
/begin MEASUREMENT TLE9180_au32SpiWriteFrame[14] "TLE9180_au32SpiWriteFrame[14]" ULONG I_1 1 2 0 4294967295 ECU_ADDRESS 0x0 /end MEASUREMENT
/begin MEASUREMENT TLE9180_au32SpiWriteFrame[15] "TLE9180_au32SpiWriteFrame[15]" ULONG I_1 1 2 0 4294967295 ECU_ADDRESS 0x0 /end MEASUREMENT
/begin MEASUREMENT TLE9180_au32SpiWriteFrame[16] "TLE9180_au32SpiWriteFrame[16]" ULONG I_1 1 2 0 4294967295 ECU_ADDRESS 0x0 /end MEASUREMENT
/begin MEASUREMENT TLE9180_au32SpiWriteFrame[17] "TLE9180_au32SpiWriteFrame[17]" ULONG I_1 1 2 0 4294967295 ECU_ADDRESS 0x0 /end MEASUREMENT
/begin MEASUREMENT TLE9180_au32SpiWriteFrame[18] "TLE9180_au32SpiWriteFrame[18]" ULONG I_1 1 2 0 4294967295 ECU_ADDRESS 0x0 /end MEASUREMENT
/begin MEASUREMENT TLE9180_au32SpiWriteFrame[19] "TLE9180_au32SpiWriteFrame[19]" ULONG I_1 1 2 0 4294967295 ECU_ADDRESS 0x0 /end MEASUREMENT
/begin MEASUREMENT TLE9180_au32SpiWriteFrame[1] "TLE9180_au32SpiWriteFrame[1]" ULONG I_1 1 2 0 4294967295 ECU_ADDRESS 0x0 /end MEASUREMENT
/begin MEASUREMENT TLE9180_au32SpiWriteFrame[20] "TLE9180_au32SpiWriteFrame[20]" ULONG I_1 1 2 0 4294967295 ECU_ADDRESS 0x0 /end MEASUREMENT
/begin MEASUREMENT TLE9180_au32SpiWriteFrame[21] "TLE9180_au32SpiWriteFrame[21]" ULONG I_1 1 2 0 4294967295 ECU_ADDRESS 0x0 /end MEASUREMENT
/begin MEASUREMENT TLE9180_au32SpiWriteFrame[22] "TLE9180_au32SpiWriteFrame[22]" ULONG I_1 1 2 0 4294967295 ECU_ADDRESS 0x0 /end MEASUREMENT
/begin MEASUREMENT TLE9180_au32SpiWriteFrame[23] "TLE9180_au32SpiWriteFrame[23]" ULONG I_1 1 2 0 4294967295 ECU_ADDRESS 0x0 /end MEASUREMENT
/begin MEASUREMENT TLE9180_au32SpiWriteFrame[24] "TLE9180_au32SpiWriteFrame[24]" ULONG I_1 1 2 0 4294967295 ECU_ADDRESS 0x0 /end MEASUREMENT
/begin MEASUREMENT TLE9180_au32SpiWriteFrame[25] "TLE9180_au32SpiWriteFrame[25]" ULONG I_1 1 2 0 4294967295 ECU_ADDRESS 0x0 /end MEASUREMENT
/begin MEASUREMENT TLE9180_au32SpiWriteFrame[26] "TLE9180_au32SpiWriteFrame[26]" ULONG I_1 1 2 0 4294967295 ECU_ADDRESS 0x0 /end MEASUREMENT
/begin MEASUREMENT TLE9180_au32SpiWriteFrame[27] "TLE9180_au32SpiWriteFrame[27]" ULONG I_1 1 2 0 4294967295 ECU_ADDRESS 0x0 /end MEASUREMENT
/begin MEASUREMENT TLE9180_au32SpiWriteFrame[28] "TLE9180_au32SpiWriteFrame[28]" ULONG I_1 1 2 0 4294967295 ECU_ADDRESS 0x0 /end MEASUREMENT
/begin MEASUREMENT TLE9180_au32SpiWriteFrame[29] "TLE9180_au32SpiWriteFrame[29]" ULONG I_1 1 2 0 4294967295 ECU_ADDRESS 0x0 /end MEASUREMENT
/begin MEASUREMENT TLE9180_au32SpiWriteFrame[2] "TLE9180_au32SpiWriteFrame[2]" ULONG I_1 1 2 0 4294967295 ECU_ADDRESS 0x0 /end MEASUREMENT
/begin MEASUREMENT TLE9180_au32SpiWriteFrame[3] "TLE9180_au32SpiWriteFrame[3]" ULONG I_1 1 2 0 4294967295 ECU_ADDRESS 0x0 /end MEASUREMENT
/begin MEASUREMENT TLE9180_au32SpiWriteFrame[4] "TLE9180_au32SpiWriteFrame[4]" ULONG I_1 1 2 0 4294967295 ECU_ADDRESS 0x0 /end MEASUREMENT
/begin MEASUREMENT TLE9180_au32SpiWriteFrame[5] "TLE9180_au32SpiWriteFrame[5]" ULONG I_1 1 2 0 4294967295 ECU_ADDRESS 0x0 /end MEASUREMENT
/begin MEASUREMENT TLE9180_au32SpiWriteFrame[6] "TLE9180_au32SpiWriteFrame[6]" ULONG I_1 1 2 0 4294967295 ECU_ADDRESS 0x0 /end MEASUREMENT
/begin MEASUREMENT TLE9180_au32SpiWriteFrame[7] "TLE9180_au32SpiWriteFrame[7]" ULONG I_1 1 2 0 4294967295 ECU_ADDRESS 0x0 /end MEASUREMENT
/begin MEASUREMENT TLE9180_au32SpiWriteFrame[8] "TLE9180_au32SpiWriteFrame[8]" ULONG I_1 1 2 0 4294967295 ECU_ADDRESS 0x0 /end MEASUREMENT
/begin MEASUREMENT TLE9180_au32SpiWriteFrame[9] "TLE9180_au32SpiWriteFrame[9]" ULONG I_1 1 2 0 4294967295 ECU_ADDRESS 0x0 /end MEASUREMENT
/begin MEASUREMENT TLE9180_au8CfgRegReadBk "TLE9180_au8CfgRegReadBk" UBYTE I_1 1 2 0 255 MATRIX_DIM 30 1 1 ECU_ADDRESS 0x0 /end MEASUREMENT
/begin MEASUREMENT TLE9180_au8CfgRegReadBk[0] "TLE9180_au8CfgRegReadBk[0]" UBYTE I_1 1 2 0 255 ECU_ADDRESS 0x0 /end MEASUREMENT
/begin MEASUREMENT TLE9180_au8CfgRegReadBk[10] "TLE9180_au8CfgRegReadBk[10]" UBYTE I_1 1 2 0 255 ECU_ADDRESS 0x0 /end MEASUREMENT
/begin MEASUREMENT TLE9180_au8CfgRegReadBk[11] "TLE9180_au8CfgRegReadBk[11]" UBYTE I_1 1 2 0 255 ECU_ADDRESS 0x0 /end MEASUREMENT
/begin MEASUREMENT TLE9180_au8CfgRegReadBk[12] "TLE9180_au8CfgRegReadBk[12]" UBYTE I_1 1 2 0 255 ECU_ADDRESS 0x0 /end MEASUREMENT
/begin MEASUREMENT TLE9180_au8CfgRegReadBk[13] "TLE9180_au8CfgRegReadBk[13]" UBYTE I_1 1 2 0 255 ECU_ADDRESS 0x0 /end MEASUREMENT
/begin MEASUREMENT TLE9180_au8CfgRegReadBk[14] "TLE9180_au8CfgRegReadBk[14]" UBYTE I_1 1 2 0 255 ECU_ADDRESS 0x0 /end MEASUREMENT
/begin MEASUREMENT TLE9180_au8CfgRegReadBk[15] "TLE9180_au8CfgRegReadBk[15]" UBYTE I_1 1 2 0 255 ECU_ADDRESS 0x0 /end MEASUREMENT
/begin MEASUREMENT TLE9180_au8CfgRegReadBk[16] "TLE9180_au8CfgRegReadBk[16]" UBYTE I_1 1 2 0 255 ECU_ADDRESS 0x0 /end MEASUREMENT
/begin MEASUREMENT TLE9180_au8CfgRegReadBk[17] "TLE9180_au8CfgRegReadBk[17]" UBYTE I_1 1 2 0 255 ECU_ADDRESS 0x0 /end MEASUREMENT
/begin MEASUREMENT TLE9180_au8CfgRegReadBk[18] "TLE9180_au8CfgRegReadBk[18]" UBYTE I_1 1 2 0 255 ECU_ADDRESS 0x0 /end MEASUREMENT
/begin MEASUREMENT TLE9180_au8CfgRegReadBk[19] "TLE9180_au8CfgRegReadBk[19]" UBYTE I_1 1 2 0 255 ECU_ADDRESS 0x0 /end MEASUREMENT
/begin MEASUREMENT TLE9180_au8CfgRegReadBk[1] "TLE9180_au8CfgRegReadBk[1]" UBYTE I_1 1 2 0 255 ECU_ADDRESS 0x0 /end MEASUREMENT
/begin MEASUREMENT TLE9180_au8CfgRegReadBk[20] "TLE9180_au8CfgRegReadBk[20]" UBYTE I_1 1 2 0 255 ECU_ADDRESS 0x0 /end MEASUREMENT
/begin MEASUREMENT TLE9180_au8CfgRegReadBk[21] "TLE9180_au8CfgRegReadBk[21]" UBYTE I_1 1 2 0 255 ECU_ADDRESS 0x0 /end MEASUREMENT
/begin MEASUREMENT TLE9180_au8CfgRegReadBk[22] "TLE9180_au8CfgRegReadBk[22]" UBYTE I_1 1 2 0 255 ECU_ADDRESS 0x0 /end MEASUREMENT
/begin MEASUREMENT TLE9180_au8CfgRegReadBk[23] "TLE9180_au8CfgRegReadBk[23]" UBYTE I_1 1 2 0 255 ECU_ADDRESS 0x0 /end MEASUREMENT
/begin MEASUREMENT TLE9180_au8CfgRegReadBk[24] "TLE9180_au8CfgRegReadBk[24]" UBYTE I_1 1 2 0 255 ECU_ADDRESS 0x0 /end MEASUREMENT
/begin MEASUREMENT TLE9180_au8CfgRegReadBk[25] "TLE9180_au8CfgRegReadBk[25]" UBYTE I_1 1 2 0 255 ECU_ADDRESS 0x0 /end MEASUREMENT
/begin MEASUREMENT TLE9180_au8CfgRegReadBk[26] "TLE9180_au8CfgRegReadBk[26]" UBYTE I_1 1 2 0 255 ECU_ADDRESS 0x0 /end MEASUREMENT
/begin MEASUREMENT TLE9180_au8CfgRegReadBk[27] "TLE9180_au8CfgRegReadBk[27]" UBYTE I_1 1 2 0 255 ECU_ADDRESS 0x0 /end MEASUREMENT
/begin MEASUREMENT TLE9180_au8CfgRegReadBk[28] "TLE9180_au8CfgRegReadBk[28]" UBYTE I_1 1 2 0 255 ECU_ADDRESS 0x0 /end MEASUREMENT
/begin MEASUREMENT TLE9180_au8CfgRegReadBk[29] "TLE9180_au8CfgRegReadBk[29]" UBYTE I_1 1 2 0 255 ECU_ADDRESS 0x0 /end MEASUREMENT
/begin MEASUREMENT TLE9180_au8CfgRegReadBk[2] "TLE9180_au8CfgRegReadBk[2]" UBYTE I_1 1 2 0 255 ECU_ADDRESS 0x0 /end MEASUREMENT
/begin MEASUREMENT TLE9180_au8CfgRegReadBk[3] "TLE9180_au8CfgRegReadBk[3]" UBYTE I_1 1 2 0 255 ECU_ADDRESS 0x0 /end MEASUREMENT
/begin MEASUREMENT TLE9180_au8CfgRegReadBk[4] "TLE9180_au8CfgRegReadBk[4]" UBYTE I_1 1 2 0 255 ECU_ADDRESS 0x0 /end MEASUREMENT
/begin MEASUREMENT TLE9180_au8CfgRegReadBk[5] "TLE9180_au8CfgRegReadBk[5]" UBYTE I_1 1 2 0 255 ECU_ADDRESS 0x0 /end MEASUREMENT
/begin MEASUREMENT TLE9180_au8CfgRegReadBk[6] "TLE9180_au8CfgRegReadBk[6]" UBYTE I_1 1 2 0 255 ECU_ADDRESS 0x0 /end MEASUREMENT
/begin MEASUREMENT TLE9180_au8CfgRegReadBk[7] "TLE9180_au8CfgRegReadBk[7]" UBYTE I_1 1 2 0 255 ECU_ADDRESS 0x0 /end MEASUREMENT
/begin MEASUREMENT TLE9180_au8CfgRegReadBk[8] "TLE9180_au8CfgRegReadBk[8]" UBYTE I_1 1 2 0 255 ECU_ADDRESS 0x0 /end MEASUREMENT
/begin MEASUREMENT TLE9180_au8CfgRegReadBk[9] "TLE9180_au8CfgRegReadBk[9]" UBYTE I_1 1 2 0 255 ECU_ADDRESS 0x0 /end MEASUREMENT
/begin MEASUREMENT TLE9180_au8CfgRegister "TLE9180_au8CfgRegister" UBYTE I_1 1 2 0 255 MATRIX_DIM 30 1 1 ECU_ADDRESS 0x0 /end MEASUREMENT
/begin MEASUREMENT TLE9180_au8CfgRegister[0] "TLE9180_au8CfgRegister[0]" UBYTE I_1 1 2 0 255 ECU_ADDRESS 0x0 /end MEASUREMENT
/begin MEASUREMENT TLE9180_au8CfgRegister[10] "TLE9180_au8CfgRegister[10]" UBYTE I_1 1 2 0 255 ECU_ADDRESS 0x0 /end MEASUREMENT
/begin MEASUREMENT TLE9180_au8CfgRegister[11] "TLE9180_au8CfgRegister[11]" UBYTE I_1 1 2 0 255 ECU_ADDRESS 0x0 /end MEASUREMENT
/begin MEASUREMENT TLE9180_au8CfgRegister[12] "TLE9180_au8CfgRegister[12]" UBYTE I_1 1 2 0 255 ECU_ADDRESS 0x0 /end MEASUREMENT
/begin MEASUREMENT TLE9180_au8CfgRegister[13] "TLE9180_au8CfgRegister[13]" UBYTE I_1 1 2 0 255 ECU_ADDRESS 0x0 /end MEASUREMENT
/begin MEASUREMENT TLE9180_au8CfgRegister[14] "TLE9180_au8CfgRegister[14]" UBYTE I_1 1 2 0 255 ECU_ADDRESS 0x0 /end MEASUREMENT
/begin MEASUREMENT TLE9180_au8CfgRegister[15] "TLE9180_au8CfgRegister[15]" UBYTE I_1 1 2 0 255 ECU_ADDRESS 0x0 /end MEASUREMENT
/begin MEASUREMENT TLE9180_au8CfgRegister[16] "TLE9180_au8CfgRegister[16]" UBYTE I_1 1 2 0 255 ECU_ADDRESS 0x0 /end MEASUREMENT
/begin MEASUREMENT TLE9180_au8CfgRegister[17] "TLE9180_au8CfgRegister[17]" UBYTE I_1 1 2 0 255 ECU_ADDRESS 0x0 /end MEASUREMENT
/begin MEASUREMENT TLE9180_au8CfgRegister[18] "TLE9180_au8CfgRegister[18]" UBYTE I_1 1 2 0 255 ECU_ADDRESS 0x0 /end MEASUREMENT
/begin MEASUREMENT TLE9180_au8CfgRegister[19] "TLE9180_au8CfgRegister[19]" UBYTE I_1 1 2 0 255 ECU_ADDRESS 0x0 /end MEASUREMENT
/begin MEASUREMENT TLE9180_au8CfgRegister[1] "TLE9180_au8CfgRegister[1]" UBYTE I_1 1 2 0 255 ECU_ADDRESS 0x0 /end MEASUREMENT
/begin MEASUREMENT TLE9180_au8CfgRegister[20] "TLE9180_au8CfgRegister[20]" UBYTE I_1 1 2 0 255 ECU_ADDRESS 0x0 /end MEASUREMENT
/begin MEASUREMENT TLE9180_au8CfgRegister[21] "TLE9180_au8CfgRegister[21]" UBYTE I_1 1 2 0 255 ECU_ADDRESS 0x0 /end MEASUREMENT
/begin MEASUREMENT TLE9180_au8CfgRegister[22] "TLE9180_au8CfgRegister[22]" UBYTE I_1 1 2 0 255 ECU_ADDRESS 0x0 /end MEASUREMENT
/begin MEASUREMENT TLE9180_au8CfgRegister[23] "TLE9180_au8CfgRegister[23]" UBYTE I_1 1 2 0 255 ECU_ADDRESS 0x0 /end MEASUREMENT
/begin MEASUREMENT TLE9180_au8CfgRegister[24] "TLE9180_au8CfgRegister[24]" UBYTE I_1 1 2 0 255 ECU_ADDRESS 0x0 /end MEASUREMENT
/begin MEASUREMENT TLE9180_au8CfgRegister[25] "TLE9180_au8CfgRegister[25]" UBYTE I_1 1 2 0 255 ECU_ADDRESS 0x0 /end MEASUREMENT
/begin MEASUREMENT TLE9180_au8CfgRegister[26] "TLE9180_au8CfgRegister[26]" UBYTE I_1 1 2 0 255 ECU_ADDRESS 0x0 /end MEASUREMENT
/begin MEASUREMENT TLE9180_au8CfgRegister[27] "TLE9180_au8CfgRegister[27]" UBYTE I_1 1 2 0 255 ECU_ADDRESS 0x0 /end MEASUREMENT
/begin MEASUREMENT TLE9180_au8CfgRegister[28] "TLE9180_au8CfgRegister[28]" UBYTE I_1 1 2 0 255 ECU_ADDRESS 0x0 /end MEASUREMENT
/begin MEASUREMENT TLE9180_au8CfgRegister[29] "TLE9180_au8CfgRegister[29]" UBYTE I_1 1 2 0 255 ECU_ADDRESS 0x0 /end MEASUREMENT
/begin MEASUREMENT TLE9180_au8CfgRegister[2] "TLE9180_au8CfgRegister[2]" UBYTE I_1 1 2 0 255 ECU_ADDRESS 0x0 /end MEASUREMENT
/begin MEASUREMENT TLE9180_au8CfgRegister[3] "TLE9180_au8CfgRegister[3]" UBYTE I_1 1 2 0 255 ECU_ADDRESS 0x0 /end MEASUREMENT
/begin MEASUREMENT TLE9180_au8CfgRegister[4] "TLE9180_au8CfgRegister[4]" UBYTE I_1 1 2 0 255 ECU_ADDRESS 0x0 /end MEASUREMENT
/begin MEASUREMENT TLE9180_au8CfgRegister[5] "TLE9180_au8CfgRegister[5]" UBYTE I_1 1 2 0 255 ECU_ADDRESS 0x0 /end MEASUREMENT
/begin MEASUREMENT TLE9180_au8CfgRegister[6] "TLE9180_au8CfgRegister[6]" UBYTE I_1 1 2 0 255 ECU_ADDRESS 0x0 /end MEASUREMENT
/begin MEASUREMENT TLE9180_au8CfgRegister[7] "TLE9180_au8CfgRegister[7]" UBYTE I_1 1 2 0 255 ECU_ADDRESS 0x0 /end MEASUREMENT
/begin MEASUREMENT TLE9180_au8CfgRegister[8] "TLE9180_au8CfgRegister[8]" UBYTE I_1 1 2 0 255 ECU_ADDRESS 0x0 /end MEASUREMENT
/begin MEASUREMENT TLE9180_au8CfgRegister[9] "TLE9180_au8CfgRegister[9]" UBYTE I_1 1 2 0 255 ECU_ADDRESS 0x0 /end MEASUREMENT
/begin MEASUREMENT TLE9180_au8ReadPhsTemp "TLE9180_au8ReadPhsTemp" UBYTE I_1 1 2 0 255 MATRIX_DIM 6 1 1 ECU_ADDRESS 0x0 /end MEASUREMENT
/begin MEASUREMENT TLE9180_au8ReadPhsTemp[0] "TLE9180_au8ReadPhsTemp[0]" UBYTE I_1 1 2 0 255 ECU_ADDRESS 0x0 /end MEASUREMENT
/begin MEASUREMENT TLE9180_au8ReadPhsTemp[1] "TLE9180_au8ReadPhsTemp[1]" UBYTE I_1 1 2 0 255 ECU_ADDRESS 0x0 /end MEASUREMENT
/begin MEASUREMENT TLE9180_au8ReadPhsTemp[2] "TLE9180_au8ReadPhsTemp[2]" UBYTE I_1 1 2 0 255 ECU_ADDRESS 0x0 /end MEASUREMENT
/begin MEASUREMENT TLE9180_au8ReadPhsTemp[3] "TLE9180_au8ReadPhsTemp[3]" UBYTE I_1 1 2 0 255 ECU_ADDRESS 0x0 /end MEASUREMENT
/begin MEASUREMENT TLE9180_au8ReadPhsTemp[4] "TLE9180_au8ReadPhsTemp[4]" UBYTE I_1 1 2 0 255 ECU_ADDRESS 0x0 /end MEASUREMENT
/begin MEASUREMENT TLE9180_au8ReadPhsTemp[5] "TLE9180_au8ReadPhsTemp[5]" UBYTE I_1 1 2 0 255 ECU_ADDRESS 0x0 /end MEASUREMENT
/begin MEASUREMENT TLE9180_au8ReadRegs "TLE9180_au8ReadRegs" UBYTE I_1 1 2 0 255 MATRIX_DIM 30 1 1 ECU_ADDRESS 0x0 /end MEASUREMENT
/begin MEASUREMENT TLE9180_au8ReadRegs[0] "TLE9180_au8ReadRegs[0]" UBYTE I_1 1 2 0 255 ECU_ADDRESS 0x0 /end MEASUREMENT
/begin MEASUREMENT TLE9180_au8ReadRegs[10] "TLE9180_au8ReadRegs[10]" UBYTE I_1 1 2 0 255 ECU_ADDRESS 0x0 /end MEASUREMENT
/begin MEASUREMENT TLE9180_au8ReadRegs[11] "TLE9180_au8ReadRegs[11]" UBYTE I_1 1 2 0 255 ECU_ADDRESS 0x0 /end MEASUREMENT
/begin MEASUREMENT TLE9180_au8ReadRegs[12] "TLE9180_au8ReadRegs[12]" UBYTE I_1 1 2 0 255 ECU_ADDRESS 0x0 /end MEASUREMENT
/begin MEASUREMENT TLE9180_au8ReadRegs[13] "TLE9180_au8ReadRegs[13]" UBYTE I_1 1 2 0 255 ECU_ADDRESS 0x0 /end MEASUREMENT
/begin MEASUREMENT TLE9180_au8ReadRegs[14] "TLE9180_au8ReadRegs[14]" UBYTE I_1 1 2 0 255 ECU_ADDRESS 0x0 /end MEASUREMENT
/begin MEASUREMENT TLE9180_au8ReadRegs[15] "TLE9180_au8ReadRegs[15]" UBYTE I_1 1 2 0 255 ECU_ADDRESS 0x0 /end MEASUREMENT
/begin MEASUREMENT TLE9180_au8ReadRegs[16] "TLE9180_au8ReadRegs[16]" UBYTE I_1 1 2 0 255 ECU_ADDRESS 0x0 /end MEASUREMENT
/begin MEASUREMENT TLE9180_au8ReadRegs[17] "TLE9180_au8ReadRegs[17]" UBYTE I_1 1 2 0 255 ECU_ADDRESS 0x0 /end MEASUREMENT
/begin MEASUREMENT TLE9180_au8ReadRegs[18] "TLE9180_au8ReadRegs[18]" UBYTE I_1 1 2 0 255 ECU_ADDRESS 0x0 /end MEASUREMENT
/begin MEASUREMENT TLE9180_au8ReadRegs[19] "TLE9180_au8ReadRegs[19]" UBYTE I_1 1 2 0 255 ECU_ADDRESS 0x0 /end MEASUREMENT
/begin MEASUREMENT TLE9180_au8ReadRegs[1] "TLE9180_au8ReadRegs[1]" UBYTE I_1 1 2 0 255 ECU_ADDRESS 0x0 /end MEASUREMENT
/begin MEASUREMENT TLE9180_au8ReadRegs[20] "TLE9180_au8ReadRegs[20]" UBYTE I_1 1 2 0 255 ECU_ADDRESS 0x0 /end MEASUREMENT
/begin MEASUREMENT TLE9180_au8ReadRegs[21] "TLE9180_au8ReadRegs[21]" UBYTE I_1 1 2 0 255 ECU_ADDRESS 0x0 /end MEASUREMENT
/begin MEASUREMENT TLE9180_au8ReadRegs[22] "TLE9180_au8ReadRegs[22]" UBYTE I_1 1 2 0 255 ECU_ADDRESS 0x0 /end MEASUREMENT
/begin MEASUREMENT TLE9180_au8ReadRegs[23] "TLE9180_au8ReadRegs[23]" UBYTE I_1 1 2 0 255 ECU_ADDRESS 0x0 /end MEASUREMENT
/begin MEASUREMENT TLE9180_au8ReadRegs[24] "TLE9180_au8ReadRegs[24]" UBYTE I_1 1 2 0 255 ECU_ADDRESS 0x0 /end MEASUREMENT
/begin MEASUREMENT TLE9180_au8ReadRegs[25] "TLE9180_au8ReadRegs[25]" UBYTE I_1 1 2 0 255 ECU_ADDRESS 0x0 /end MEASUREMENT
/begin MEASUREMENT TLE9180_au8ReadRegs[26] "TLE9180_au8ReadRegs[26]" UBYTE I_1 1 2 0 255 ECU_ADDRESS 0x0 /end MEASUREMENT
/begin MEASUREMENT TLE9180_au8ReadRegs[27] "TLE9180_au8ReadRegs[27]" UBYTE I_1 1 2 0 255 ECU_ADDRESS 0x0 /end MEASUREMENT
/begin MEASUREMENT TLE9180_au8ReadRegs[28] "TLE9180_au8ReadRegs[28]" UBYTE I_1 1 2 0 255 ECU_ADDRESS 0x0 /end MEASUREMENT
/begin MEASUREMENT TLE9180_au8ReadRegs[29] "TLE9180_au8ReadRegs[29]" UBYTE I_1 1 2 0 255 ECU_ADDRESS 0x0 /end MEASUREMENT
/begin MEASUREMENT TLE9180_au8ReadRegs[2] "TLE9180_au8ReadRegs[2]" UBYTE I_1 1 2 0 255 ECU_ADDRESS 0x0 /end MEASUREMENT
/begin MEASUREMENT TLE9180_au8ReadRegs[3] "TLE9180_au8ReadRegs[3]" UBYTE I_1 1 2 0 255 ECU_ADDRESS 0x0 /end MEASUREMENT
/begin MEASUREMENT TLE9180_au8ReadRegs[4] "TLE9180_au8ReadRegs[4]" UBYTE I_1 1 2 0 255 ECU_ADDRESS 0x0 /end MEASUREMENT
/begin MEASUREMENT TLE9180_au8ReadRegs[5] "TLE9180_au8ReadRegs[5]" UBYTE I_1 1 2 0 255 ECU_ADDRESS 0x0 /end MEASUREMENT
/begin MEASUREMENT TLE9180_au8ReadRegs[6] "TLE9180_au8ReadRegs[6]" UBYTE I_1 1 2 0 255 ECU_ADDRESS 0x0 /end MEASUREMENT
/begin MEASUREMENT TLE9180_au8ReadRegs[7] "TLE9180_au8ReadRegs[7]" UBYTE I_1 1 2 0 255 ECU_ADDRESS 0x0 /end MEASUREMENT
/begin MEASUREMENT TLE9180_au8ReadRegs[8] "TLE9180_au8ReadRegs[8]" UBYTE I_1 1 2 0 255 ECU_ADDRESS 0x0 /end MEASUREMENT
/begin MEASUREMENT TLE9180_au8ReadRegs[9] "TLE9180_au8ReadRegs[9]" UBYTE I_1 1 2 0 255 ECU_ADDRESS 0x0 /end MEASUREMENT
/begin MEASUREMENT TLE9180_bDataTransferDone "..." UBYTE Bool_ON_OFF 1 2 0 1 BIT_MASK 0x01 ECU_ADDRESS 0x0 /end MEASUREMENT
/begin MEASUREMENT TLE9180_bDrvOverCurrent "..." UBYTE Bool_ON_OFF 1 2 0 1 BIT_MASK 0x01 ECU_ADDRESS 0x0 /end MEASUREMENT
/begin MEASUREMENT TLE9180_bDrvOverTemp "..." UBYTE Bool_ON_OFF 1 2 0 1 BIT_MASK 0x01 ECU_ADDRESS 0x0 /end MEASUREMENT
/begin MEASUREMENT TLE9180_bDrvOverVoltage "..." UBYTE Bool_ON_OFF 1 2 0 1 BIT_MASK 0x01 ECU_ADDRESS 0x0 /end MEASUREMENT
/begin MEASUREMENT TLE9180_bDrvUnderVoltage "..." UBYTE Bool_ON_OFF 1 2 0 1 BIT_MASK 0x01 ECU_ADDRESS 0x0 /end MEASUREMENT
/begin MEASUREMENT TLE9180_bErrorFlag "..." UBYTE Bool_ON_OFF 1 2 0 1 BIT_MASK 0x01 ECU_ADDRESS 0x0 /end MEASUREMENT
/begin MEASUREMENT TLE9180_bErrorPinLevel "..." UBYTE Bool_ON_OFF 1 2 0 1 BIT_MASK 0x01 ECU_ADDRESS 0x0 /end MEASUREMENT
/begin MEASUREMENT TLE9180_bHALOverVolt "..." UBYTE Bool_ON_OFF 1 2 0 1 BIT_MASK 0x01 ECU_ADDRESS 0x0 /end MEASUREMENT
/begin MEASUREMENT TLE9180_bHALUnderVolt "..." UBYTE Bool_ON_OFF 1 2 0 1 BIT_MASK 0x01 ECU_ADDRESS 0x0 /end MEASUREMENT
/begin MEASUREMENT TLE9180_bInitFailFlg "..." UBYTE Bool_ON_OFF 1 2 0 1 BIT_MASK 0x01 ECU_ADDRESS 0x0 /end MEASUREMENT
/begin MEASUREMENT TLE9180_bPhasePerf "..." UBYTE Bool_ON_OFF 1 2 0 1 BIT_MASK 0x01 ECU_ADDRESS 0x0 /end MEASUREMENT
/begin MEASUREMENT TLE9180_bPhaseShortHigh "..." UBYTE Bool_ON_OFF 1 2 0 1 BIT_MASK 0x01 ECU_ADDRESS 0x0 /end MEASUREMENT
/begin MEASUREMENT TLE9180_bPhaseShortLow "..." UBYTE Bool_ON_OFF 1 2 0 1 BIT_MASK 0x01 ECU_ADDRESS 0x0 /end MEASUREMENT
/begin MEASUREMENT TLE9180_bPhsOverVolt "..." UBYTE Bool_ON_OFF 1 2 0 1 BIT_MASK 0x01 ECU_ADDRESS 0x0 /end MEASUREMENT
/begin MEASUREMENT TLE9180_bReadErrInfoFlg "..." UBYTE Bool_ON_OFF 1 2 0 1 BIT_MASK 0x01 ECU_ADDRESS 0x0 /end MEASUREMENT
/begin MEASUREMENT TLE9180_bTempWarning "..." UBYTE Bool_ON_OFF 1 2 0 1 BIT_MASK 0x01 ECU_ADDRESS 0x0 /end MEASUREMENT
/begin MEASUREMENT TLE9180_bTestReadErrRegs "..." UBYTE Bool_ON_OFF 1 2 0 1 BIT_MASK 0x01 ECU_ADDRESS 0x0 /end MEASUREMENT
/begin MEASUREMENT TLE9180_bTestReadReg "..." UBYTE Bool_ON_OFF 1 2 0 1 BIT_MASK 0x01 ECU_ADDRESS 0x0 /end MEASUREMENT
/begin MEASUREMENT TLE9180_bTestWriteReg "..." UBYTE Bool_ON_OFF 1 2 0 1 BIT_MASK 0x01 ECU_ADDRESS 0x0 /end MEASUREMENT
/begin MEASUREMENT TLE9180_f32MaxPhsTempPhys "..." FLOAT32_IEEE I_1 1 2 -3.402823466E+038 3.402823466E+038 ECU_ADDRESS 0x0 /end MEASUREMENT
/begin MEASUREMENT TLE9180_u16EnaResetTime "..." UWORD I_1 1 2 0 65535 ECU_ADDRESS 0x0 /end MEASUREMENT
/begin MEASUREMENT TLE9180_u16ErrPinChkCnt "..." UWORD I_1 1 2 0 65535 ECU_ADDRESS 0x0 /end MEASUREMENT
/begin MEASUREMENT TLE9180_u16HallSupVolt "..." UWORD I_1 1 2 0 65535 ECU_ADDRESS 0x0 /end MEASUREMENT
/begin MEASUREMENT TLE9180_u8CurOperMode "..." UBYTE I_1 1 2 0 255 ECU_ADDRESS 0x0 /end MEASUREMENT
/begin MEASUREMENT TLE9180_u8EnaResetCnt "..." UBYTE I_1 1 2 0 255 ECU_ADDRESS 0x0 /end MEASUREMENT
/begin MEASUREMENT TLE9180_u8ErrRecoverCnt "..." UBYTE I_1 1 2 0 255 ECU_ADDRESS 0x0 /end MEASUREMENT
/begin MEASUREMENT TLE9180_u8ErrorFrameCnt "..." UBYTE I_1 1 2 0 255 ECU_ADDRESS 0x0 /end MEASUREMENT
/begin MEASUREMENT TLE9180_u8FeedBackAddr "..." UBYTE I_1 1 2 0 255 ECU_ADDRESS 0x0 /end MEASUREMENT
/begin MEASUREMENT TLE9180_u8FeedBackData "..." UBYTE I_1 1 2 0 255 ECU_ADDRESS 0x0 /end MEASUREMENT
/begin MEASUREMENT TLE9180_u8FeedBackStatus "..." UBYTE I_1 1 2 0 255 ECU_ADDRESS 0x0 /end MEASUREMENT
/begin MEASUREMENT TLE9180_u8HallSupVolt "..." UBYTE I_1 1 2 0 255 ECU_ADDRESS 0x0 /end MEASUREMENT
/begin MEASUREMENT TLE9180_u8IndexFrame "..." UBYTE I_1 1 2 0 255 ECU_ADDRESS 0x0 /end MEASUREMENT
/begin MEASUREMENT TLE9180_u8Mode "..." UBYTE I_1 1 2 0 255 ECU_ADDRESS 0x0 /end MEASUREMENT
/begin MEASUREMENT TLE9180_u8RdRegTimCnt "..." UBYTE I_1 1 2 0 255 ECU_ADDRESS 0x0 /end MEASUREMENT
/begin MEASUREMENT TLE9180_u8ReadRegAddr "..." UBYTE I_1 1 2 0 255 ECU_ADDRESS 0x0 /end MEASUREMENT
/begin MEASUREMENT TLE9180_u8SelfTestStep "..." UBYTE I_1 1 2 0 255 ECU_ADDRESS 0x0 /end MEASUREMENT
/begin MEASUREMENT TLE9180_u8SelfTstModChk "..." UBYTE I_1 1 2 0 255 ECU_ADDRESS 0x0 /end MEASUREMENT
/begin MEASUREMENT TLE9180_u8SpiTxFrameMaxNb "..." UBYTE I_1 1 2 0 255 ECU_ADDRESS 0x0 /end MEASUREMENT
/begin MEASUREMENT TLE9180_u8TestMode "..." UBYTE I_1 1 2 0 255 ECU_ADDRESS 0x0 /end MEASUREMENT
/begin MEASUREMENT TLE9180_u8WriteData "..." UBYTE I_1 1 2 0 255 ECU_ADDRESS 0x0 /end MEASUREMENT
/begin MEASUREMENT TLE9180_u8WriteRegAddr "..." UBYTE I_1 1 2 0 255 ECU_ADDRESS 0x0 /end MEASUREMENT
/begin MEASUREMENT UDS_au8CalibSoftId "UDS_au8CalibSoftId" UBYTE F_1_p0_4 1 2 0 255 MATRIX_DIM 16 1 1 ECU_ADDRESS 0x0 /end MEASUREMENT
/begin MEASUREMENT UDS_au8CalibSoftId[0] "UDS_au8CalibSoftId[0]" UBYTE F_1_p0_4 1 2 0 255 ECU_ADDRESS 0x0 /end MEASUREMENT
/begin MEASUREMENT UDS_au8CalibSoftId[10] "UDS_au8CalibSoftId[10]" UBYTE F_1_p0_4 1 2 0 255 ECU_ADDRESS 0x0 /end MEASUREMENT
/begin MEASUREMENT UDS_au8CalibSoftId[11] "UDS_au8CalibSoftId[11]" UBYTE F_1_p0_4 1 2 0 255 ECU_ADDRESS 0x0 /end MEASUREMENT
/begin MEASUREMENT UDS_au8CalibSoftId[12] "UDS_au8CalibSoftId[12]" UBYTE F_1_p0_4 1 2 0 255 ECU_ADDRESS 0x0 /end MEASUREMENT
/begin MEASUREMENT UDS_au8CalibSoftId[13] "UDS_au8CalibSoftId[13]" UBYTE F_1_p0_4 1 2 0 255 ECU_ADDRESS 0x0 /end MEASUREMENT
/begin MEASUREMENT UDS_au8CalibSoftId[14] "UDS_au8CalibSoftId[14]" UBYTE F_1_p0_4 1 2 0 255 ECU_ADDRESS 0x0 /end MEASUREMENT
/begin MEASUREMENT UDS_au8CalibSoftId[15] "UDS_au8CalibSoftId[15]" UBYTE F_1_p0_4 1 2 0 255 ECU_ADDRESS 0x0 /end MEASUREMENT
/begin MEASUREMENT UDS_au8CalibSoftId[1] "UDS_au8CalibSoftId[1]" UBYTE F_1_p0_4 1 2 0 255 ECU_ADDRESS 0x0 /end MEASUREMENT
/begin MEASUREMENT UDS_au8CalibSoftId[2] "UDS_au8CalibSoftId[2]" UBYTE F_1_p0_4 1 2 0 255 ECU_ADDRESS 0x0 /end MEASUREMENT
/begin MEASUREMENT UDS_au8CalibSoftId[3] "UDS_au8CalibSoftId[3]" UBYTE F_1_p0_4 1 2 0 255 ECU_ADDRESS 0x0 /end MEASUREMENT
/begin MEASUREMENT UDS_au8CalibSoftId[4] "UDS_au8CalibSoftId[4]" UBYTE F_1_p0_4 1 2 0 255 ECU_ADDRESS 0x0 /end MEASUREMENT
/begin MEASUREMENT UDS_au8CalibSoftId[5] "UDS_au8CalibSoftId[5]" UBYTE F_1_p0_4 1 2 0 255 ECU_ADDRESS 0x0 /end MEASUREMENT
/begin MEASUREMENT UDS_au8CalibSoftId[6] "UDS_au8CalibSoftId[6]" UBYTE F_1_p0_4 1 2 0 255 ECU_ADDRESS 0x0 /end MEASUREMENT
/begin MEASUREMENT UDS_au8CalibSoftId[7] "UDS_au8CalibSoftId[7]" UBYTE F_1_p0_4 1 2 0 255 ECU_ADDRESS 0x0 /end MEASUREMENT
/begin MEASUREMENT UDS_au8CalibSoftId[8] "UDS_au8CalibSoftId[8]" UBYTE F_1_p0_4 1 2 0 255 ECU_ADDRESS 0x0 /end MEASUREMENT
/begin MEASUREMENT UDS_au8CalibSoftId[9] "UDS_au8CalibSoftId[9]" UBYTE F_1_p0_4 1 2 0 255 ECU_ADDRESS 0x0 /end MEASUREMENT
/begin MEASUREMENT UDS_au8DiagVers "UDS_au8DiagVers" UBYTE I_1 1 2 0 255 MATRIX_DIM 4 1 1 ECU_ADDRESS 0x0 /end MEASUREMENT
/begin MEASUREMENT UDS_au8DiagVers[0] "UDS_au8DiagVers[0]" UBYTE I_1 1 2 0 255 ECU_ADDRESS 0x0 /end MEASUREMENT
/begin MEASUREMENT UDS_au8DiagVers[1] "UDS_au8DiagVers[1]" UBYTE I_1 1 2 0 255 ECU_ADDRESS 0x0 /end MEASUREMENT
/begin MEASUREMENT UDS_au8DiagVers[2] "UDS_au8DiagVers[2]" UBYTE I_1 1 2 0 255 ECU_ADDRESS 0x0 /end MEASUREMENT
/begin MEASUREMENT UDS_au8DiagVers[3] "UDS_au8DiagVers[3]" UBYTE I_1 1 2 0 255 ECU_ADDRESS 0x0 /end MEASUREMENT
/begin MEASUREMENT UDS_au8ECUInstallDateNvm "UDS_au8ECUInstallDateNvm" UBYTE Id_0x00 1 2 0 255 MATRIX_DIM 4 1 1 ECU_ADDRESS 0x0 /end MEASUREMENT
/begin MEASUREMENT UDS_au8ECUInstallDateNvm[0] "UDS_au8ECUInstallDateNvm[0]" UBYTE Id_0x00 1 2 0 255 ECU_ADDRESS 0x0 /end MEASUREMENT
/begin MEASUREMENT UDS_au8ECUInstallDateNvm[1] "UDS_au8ECUInstallDateNvm[1]" UBYTE Id_0x00 1 2 0 255 ECU_ADDRESS 0x0 /end MEASUREMENT
/begin MEASUREMENT UDS_au8ECUInstallDateNvm[2] "UDS_au8ECUInstallDateNvm[2]" UBYTE Id_0x00 1 2 0 255 ECU_ADDRESS 0x0 /end MEASUREMENT
/begin MEASUREMENT UDS_au8ECUInstallDateNvm[3] "UDS_au8ECUInstallDateNvm[3]" UBYTE Id_0x00 1 2 0 255 ECU_ADDRESS 0x0 /end MEASUREMENT
/begin MEASUREMENT UDS_au8ESKWriteNvm "UDS_au8ESKWriteNvm" UBYTE Id_0x00 1 2 0 255 MATRIX_DIM 16 1 1 ECU_ADDRESS 0x0 /end MEASUREMENT
/begin MEASUREMENT UDS_au8ESKWriteNvm[0] "UDS_au8ESKWriteNvm[0]" UBYTE Id_0x00 1 2 0 255 ECU_ADDRESS 0x0 /end MEASUREMENT
/begin MEASUREMENT UDS_au8ESKWriteNvm[10] "UDS_au8ESKWriteNvm[10]" UBYTE Id_0x00 1 2 0 255 ECU_ADDRESS 0x0 /end MEASUREMENT
/begin MEASUREMENT UDS_au8ESKWriteNvm[11] "UDS_au8ESKWriteNvm[11]" UBYTE Id_0x00 1 2 0 255 ECU_ADDRESS 0x0 /end MEASUREMENT
/begin MEASUREMENT UDS_au8ESKWriteNvm[12] "UDS_au8ESKWriteNvm[12]" UBYTE Id_0x00 1 2 0 255 ECU_ADDRESS 0x0 /end MEASUREMENT
/begin MEASUREMENT UDS_au8ESKWriteNvm[13] "UDS_au8ESKWriteNvm[13]" UBYTE Id_0x00 1 2 0 255 ECU_ADDRESS 0x0 /end MEASUREMENT
/begin MEASUREMENT UDS_au8ESKWriteNvm[14] "UDS_au8ESKWriteNvm[14]" UBYTE Id_0x00 1 2 0 255 ECU_ADDRESS 0x0 /end MEASUREMENT
/begin MEASUREMENT UDS_au8ESKWriteNvm[15] "UDS_au8ESKWriteNvm[15]" UBYTE Id_0x00 1 2 0 255 ECU_ADDRESS 0x0 /end MEASUREMENT
/begin MEASUREMENT UDS_au8ESKWriteNvm[1] "UDS_au8ESKWriteNvm[1]" UBYTE Id_0x00 1 2 0 255 ECU_ADDRESS 0x0 /end MEASUREMENT
/begin MEASUREMENT UDS_au8ESKWriteNvm[2] "UDS_au8ESKWriteNvm[2]" UBYTE Id_0x00 1 2 0 255 ECU_ADDRESS 0x0 /end MEASUREMENT
/begin MEASUREMENT UDS_au8ESKWriteNvm[3] "UDS_au8ESKWriteNvm[3]" UBYTE Id_0x00 1 2 0 255 ECU_ADDRESS 0x0 /end MEASUREMENT
/begin MEASUREMENT UDS_au8ESKWriteNvm[4] "UDS_au8ESKWriteNvm[4]" UBYTE Id_0x00 1 2 0 255 ECU_ADDRESS 0x0 /end MEASUREMENT
/begin MEASUREMENT UDS_au8ESKWriteNvm[5] "UDS_au8ESKWriteNvm[5]" UBYTE Id_0x00 1 2 0 255 ECU_ADDRESS 0x0 /end MEASUREMENT
/begin MEASUREMENT UDS_au8ESKWriteNvm[6] "UDS_au8ESKWriteNvm[6]" UBYTE Id_0x00 1 2 0 255 ECU_ADDRESS 0x0 /end MEASUREMENT
/begin MEASUREMENT UDS_au8ESKWriteNvm[7] "UDS_au8ESKWriteNvm[7]" UBYTE Id_0x00 1 2 0 255 ECU_ADDRESS 0x0 /end MEASUREMENT
/begin MEASUREMENT UDS_au8ESKWriteNvm[8] "UDS_au8ESKWriteNvm[8]" UBYTE Id_0x00 1 2 0 255 ECU_ADDRESS 0x0 /end MEASUREMENT
/begin MEASUREMENT UDS_au8ESKWriteNvm[9] "UDS_au8ESKWriteNvm[9]" UBYTE Id_0x00 1 2 0 255 ECU_ADDRESS 0x0 /end MEASUREMENT
/begin MEASUREMENT UDS_au8FaultDiagVers "UDS_au8FaultDiagVers" UBYTE F_1_p0_4 1 2 0 255 MATRIX_DIM 4 1 1 ECU_ADDRESS 0x0 /end MEASUREMENT
/begin MEASUREMENT UDS_au8FaultDiagVers[0] "UDS_au8FaultDiagVers[0]" UBYTE F_1_p0_4 1 2 0 255 ECU_ADDRESS 0x0 /end MEASUREMENT
/begin MEASUREMENT UDS_au8FaultDiagVers[1] "UDS_au8FaultDiagVers[1]" UBYTE F_1_p0_4 1 2 0 255 ECU_ADDRESS 0x0 /end MEASUREMENT
/begin MEASUREMENT UDS_au8FaultDiagVers[2] "UDS_au8FaultDiagVers[2]" UBYTE F_1_p0_4 1 2 0 255 ECU_ADDRESS 0x0 /end MEASUREMENT
/begin MEASUREMENT UDS_au8FaultDiagVers[3] "UDS_au8FaultDiagVers[3]" UBYTE F_1_p0_4 1 2 0 255 ECU_ADDRESS 0x0 /end MEASUREMENT
/begin MEASUREMENT UDS_au8VehManufEcuSwVersNvm "UDS_au8VehManufEcuSwVersNvm" UBYTE Id_0x00 1 2 0 255 MATRIX_DIM 16 1 1 ECU_ADDRESS 0x0 /end MEASUREMENT
/begin MEASUREMENT UDS_au8VehManufEcuSwVersNvm[0] "UDS_au8VehManufEcuSwVersNvm[0]" UBYTE Id_0x00 1 2 0 255 ECU_ADDRESS 0x0 /end MEASUREMENT
/begin MEASUREMENT UDS_au8VehManufEcuSwVersNvm[10] "UDS_au8VehManufEcuSwVersNvm[10]" UBYTE Id_0x00 1 2 0 255 ECU_ADDRESS 0x0 /end MEASUREMENT
/begin MEASUREMENT UDS_au8VehManufEcuSwVersNvm[11] "UDS_au8VehManufEcuSwVersNvm[11]" UBYTE Id_0x00 1 2 0 255 ECU_ADDRESS 0x0 /end MEASUREMENT
/begin MEASUREMENT UDS_au8VehManufEcuSwVersNvm[12] "UDS_au8VehManufEcuSwVersNvm[12]" UBYTE Id_0x00 1 2 0 255 ECU_ADDRESS 0x0 /end MEASUREMENT
/begin MEASUREMENT UDS_au8VehManufEcuSwVersNvm[13] "UDS_au8VehManufEcuSwVersNvm[13]" UBYTE Id_0x00 1 2 0 255 ECU_ADDRESS 0x0 /end MEASUREMENT
/begin MEASUREMENT UDS_au8VehManufEcuSwVersNvm[14] "UDS_au8VehManufEcuSwVersNvm[14]" UBYTE Id_0x00 1 2 0 255 ECU_ADDRESS 0x0 /end MEASUREMENT
/begin MEASUREMENT UDS_au8VehManufEcuSwVersNvm[15] "UDS_au8VehManufEcuSwVersNvm[15]" UBYTE Id_0x00 1 2 0 255 ECU_ADDRESS 0x0 /end MEASUREMENT
/begin MEASUREMENT UDS_au8VehManufEcuSwVersNvm[1] "UDS_au8VehManufEcuSwVersNvm[1]" UBYTE Id_0x00 1 2 0 255 ECU_ADDRESS 0x0 /end MEASUREMENT
/begin MEASUREMENT UDS_au8VehManufEcuSwVersNvm[2] "UDS_au8VehManufEcuSwVersNvm[2]" UBYTE Id_0x00 1 2 0 255 ECU_ADDRESS 0x0 /end MEASUREMENT
/begin MEASUREMENT UDS_au8VehManufEcuSwVersNvm[3] "UDS_au8VehManufEcuSwVersNvm[3]" UBYTE Id_0x00 1 2 0 255 ECU_ADDRESS 0x0 /end MEASUREMENT
/begin MEASUREMENT UDS_au8VehManufEcuSwVersNvm[4] "UDS_au8VehManufEcuSwVersNvm[4]" UBYTE Id_0x00 1 2 0 255 ECU_ADDRESS 0x0 /end MEASUREMENT
/begin MEASUREMENT UDS_au8VehManufEcuSwVersNvm[5] "UDS_au8VehManufEcuSwVersNvm[5]" UBYTE Id_0x00 1 2 0 255 ECU_ADDRESS 0x0 /end MEASUREMENT
/begin MEASUREMENT UDS_au8VehManufEcuSwVersNvm[6] "UDS_au8VehManufEcuSwVersNvm[6]" UBYTE Id_0x00 1 2 0 255 ECU_ADDRESS 0x0 /end MEASUREMENT
/begin MEASUREMENT UDS_au8VehManufEcuSwVersNvm[7] "UDS_au8VehManufEcuSwVersNvm[7]" UBYTE Id_0x00 1 2 0 255 ECU_ADDRESS 0x0 /end MEASUREMENT
/begin MEASUREMENT UDS_au8VehManufEcuSwVersNvm[8] "UDS_au8VehManufEcuSwVersNvm[8]" UBYTE Id_0x00 1 2 0 255 ECU_ADDRESS 0x0 /end MEASUREMENT
/begin MEASUREMENT UDS_au8VehManufEcuSwVersNvm[9] "UDS_au8VehManufEcuSwVersNvm[9]" UBYTE Id_0x00 1 2 0 255 ECU_ADDRESS 0x0 /end MEASUREMENT
/begin MEASUREMENT UDS_au8VehNetConfigNvm "UDS_au8VehNetConfigNvm" UBYTE Id_0x00 1 2 0 255 MATRIX_DIM 8 1 1 ECU_ADDRESS 0x0 /end MEASUREMENT
/begin MEASUREMENT UDS_au8VehNetConfigNvm[0] "UDS_au8VehNetConfigNvm[0]" UBYTE Id_0x00 1 2 0 255 ECU_ADDRESS 0x0 /end MEASUREMENT
/begin MEASUREMENT UDS_au8VehNetConfigNvm[1] "UDS_au8VehNetConfigNvm[1]" UBYTE Id_0x00 1 2 0 255 ECU_ADDRESS 0x0 /end MEASUREMENT
/begin MEASUREMENT UDS_au8VehNetConfigNvm[2] "UDS_au8VehNetConfigNvm[2]" UBYTE Id_0x00 1 2 0 255 ECU_ADDRESS 0x0 /end MEASUREMENT
/begin MEASUREMENT UDS_au8VehNetConfigNvm[3] "UDS_au8VehNetConfigNvm[3]" UBYTE Id_0x00 1 2 0 255 ECU_ADDRESS 0x0 /end MEASUREMENT
/begin MEASUREMENT UDS_au8VehNetConfigNvm[4] "UDS_au8VehNetConfigNvm[4]" UBYTE Id_0x00 1 2 0 255 ECU_ADDRESS 0x0 /end MEASUREMENT
/begin MEASUREMENT UDS_au8VehNetConfigNvm[5] "UDS_au8VehNetConfigNvm[5]" UBYTE Id_0x00 1 2 0 255 ECU_ADDRESS 0x0 /end MEASUREMENT
/begin MEASUREMENT UDS_au8VehNetConfigNvm[6] "UDS_au8VehNetConfigNvm[6]" UBYTE Id_0x00 1 2 0 255 ECU_ADDRESS 0x0 /end MEASUREMENT
/begin MEASUREMENT UDS_au8VehNetConfigNvm[7] "UDS_au8VehNetConfigNvm[7]" UBYTE Id_0x00 1 2 0 255 ECU_ADDRESS 0x0 /end MEASUREMENT
/begin MEASUREMENT UDS_bDisaNmComFlg "..." UBYTE Bool_ON_OFF 1 2 0 1 BIT_MASK 0x01 ECU_ADDRESS 0x0 /end MEASUREMENT
/begin MEASUREMENT UDS_bDisableComFlg "..." UBYTE Bool_ON_OFF 1 2 0 1 BIT_MASK 0x01 ECU_ADDRESS 0x0 /end MEASUREMENT
/begin MEASUREMENT UDS_bDisableDtcSettingFlg "..." UBYTE Bool_ON_OFF 1 2 0 1 BIT_MASK 0x01 ECU_ADDRESS 0x0 /end MEASUREMENT
/begin MEASUREMENT UDS_bKeyOffOnResetActivated "UDS $11 02 KeyOffOnReset is activated" UBYTE Bool_ON_OFF 1 2 0 1 BIT_MASK 0x01 ECU_ADDRESS 0x0 /end MEASUREMENT
/begin MEASUREMENT UDS_bResetAndBootCondition "UDS $11 and $31 01 02 03 can execute" UBYTE Bool_ON_OFF 1 2 0 1 BIT_MASK 0x01 ECU_ADDRESS 0x0 /end MEASUREMENT
/begin MEASUREMENT UDS_kau8ESKWriteNvm_def "UDS_kau8ESKWriteNvm_def" UBYTE Id_0x00 1 2 0 255 MATRIX_DIM 16 1 1 ECU_ADDRESS 0x0 /end MEASUREMENT
/begin MEASUREMENT UDS_kau8ESKWriteNvm_def[0] "UDS_kau8ESKWriteNvm_def[0]" UBYTE Id_0x00 1 2 0 255 ECU_ADDRESS 0x0 /end MEASUREMENT
/begin MEASUREMENT UDS_kau8ESKWriteNvm_def[10] "UDS_kau8ESKWriteNvm_def[10]" UBYTE Id_0x00 1 2 0 255 ECU_ADDRESS 0x0 /end MEASUREMENT
/begin MEASUREMENT UDS_kau8ESKWriteNvm_def[11] "UDS_kau8ESKWriteNvm_def[11]" UBYTE Id_0x00 1 2 0 255 ECU_ADDRESS 0x0 /end MEASUREMENT
/begin MEASUREMENT UDS_kau8ESKWriteNvm_def[12] "UDS_kau8ESKWriteNvm_def[12]" UBYTE Id_0x00 1 2 0 255 ECU_ADDRESS 0x0 /end MEASUREMENT
/begin MEASUREMENT UDS_kau8ESKWriteNvm_def[13] "UDS_kau8ESKWriteNvm_def[13]" UBYTE Id_0x00 1 2 0 255 ECU_ADDRESS 0x0 /end MEASUREMENT
/begin MEASUREMENT UDS_kau8ESKWriteNvm_def[14] "UDS_kau8ESKWriteNvm_def[14]" UBYTE Id_0x00 1 2 0 255 ECU_ADDRESS 0x0 /end MEASUREMENT
/begin MEASUREMENT UDS_kau8ESKWriteNvm_def[15] "UDS_kau8ESKWriteNvm_def[15]" UBYTE Id_0x00 1 2 0 255 ECU_ADDRESS 0x0 /end MEASUREMENT
/begin MEASUREMENT UDS_kau8ESKWriteNvm_def[1] "UDS_kau8ESKWriteNvm_def[1]" UBYTE Id_0x00 1 2 0 255 ECU_ADDRESS 0x0 /end MEASUREMENT
/begin MEASUREMENT UDS_kau8ESKWriteNvm_def[2] "UDS_kau8ESKWriteNvm_def[2]" UBYTE Id_0x00 1 2 0 255 ECU_ADDRESS 0x0 /end MEASUREMENT
/begin MEASUREMENT UDS_kau8ESKWriteNvm_def[3] "UDS_kau8ESKWriteNvm_def[3]" UBYTE Id_0x00 1 2 0 255 ECU_ADDRESS 0x0 /end MEASUREMENT
/begin MEASUREMENT UDS_kau8ESKWriteNvm_def[4] "UDS_kau8ESKWriteNvm_def[4]" UBYTE Id_0x00 1 2 0 255 ECU_ADDRESS 0x0 /end MEASUREMENT
/begin MEASUREMENT UDS_kau8ESKWriteNvm_def[5] "UDS_kau8ESKWriteNvm_def[5]" UBYTE Id_0x00 1 2 0 255 ECU_ADDRESS 0x0 /end MEASUREMENT
/begin MEASUREMENT UDS_kau8ESKWriteNvm_def[6] "UDS_kau8ESKWriteNvm_def[6]" UBYTE Id_0x00 1 2 0 255 ECU_ADDRESS 0x0 /end MEASUREMENT
/begin MEASUREMENT UDS_kau8ESKWriteNvm_def[7] "UDS_kau8ESKWriteNvm_def[7]" UBYTE Id_0x00 1 2 0 255 ECU_ADDRESS 0x0 /end MEASUREMENT
/begin MEASUREMENT UDS_kau8ESKWriteNvm_def[8] "UDS_kau8ESKWriteNvm_def[8]" UBYTE Id_0x00 1 2 0 255 ECU_ADDRESS 0x0 /end MEASUREMENT
/begin MEASUREMENT UDS_kau8ESKWriteNvm_def[9] "UDS_kau8ESKWriteNvm_def[9]" UBYTE Id_0x00 1 2 0 255 ECU_ADDRESS 0x0 /end MEASUREMENT
/begin MEASUREMENT UDS_u16Autophs "..." UWORD I_1 1 2 0 65535 ECU_ADDRESS 0x0 /end MEASUREMENT
/begin MEASUREMENT UDS_u16AutophsCrc "..." UWORD I_1 1 2 0 65535 ECU_ADDRESS 0x0 /end MEASUREMENT
/begin MEASUREMENT UDS_u16EngineRPM "UDS_u16EngineRPM" UWORD I_1 1 2 0 65535 ECU_ADDRESS 0x0 /end MEASUREMENT
/begin MEASUREMENT UDS_u16ISGCurrTorq "UDS_u16ISGCurrTorq" UWORD I_1 1 2 0 65535 ECU_ADDRESS 0x0 /end MEASUREMENT
/begin MEASUREMENT UDS_u16IvtrSysTqReq "UDS_u16IvtrSysTqReq" UWORD I_1 1 2 0 65535 ECU_ADDRESS 0x0 /end MEASUREMENT
/begin MEASUREMENT UDS_u16ReprogAttemptCntNvm "DID 0201 -> Reprogramming attempt counter" UWORD F_1_p0_4 1 2 0 65535 ECU_ADDRESS 0x0 /end MEASUREMENT
/begin MEASUREMENT UDS_u16ReprogAttemptCntNvm_def "DID 0201 -> Reprogramming attempt counter" UWORD F_1_p0_4 1 2 0 65535 ECU_ADDRESS 0x0 /end MEASUREMENT
/begin MEASUREMENT UDS_u16ReprogCntNvm "DID 0200 -> successfully reprogramming counter" UWORD F_1_p0_4 1 2 0 65535 ECU_ADDRESS 0x0 /end MEASUREMENT
/begin MEASUREMENT UDS_u16ReprogCntNvm_def "DID 0200 -> successfully reprogramming counter" UWORD F_1_p0_4 1 2 0 65535 ECU_ADDRESS 0x0 /end MEASUREMENT
/begin MEASUREMENT UDS_u16RmsCurU "UDS_u16RmsCurU" UWORD I_1 1 2 0 65535 ECU_ADDRESS 0x0 /end MEASUREMENT
/begin MEASUREMENT UDS_u16RmsCurV "UDS_u16RmsCurV" UWORD I_1 1 2 0 65535 ECU_ADDRESS 0x0 /end MEASUREMENT
/begin MEASUREMENT UDS_u16RmsCurW "UDS_u16RmsCurW" UWORD I_1 1 2 0 65535 ECU_ADDRESS 0x0 /end MEASUREMENT
/begin MEASUREMENT UDS_u16SupplyVolt "UDS_u16SupplyVolt" UWORD I_1 1 2 0 65535 ECU_ADDRESS 0x0 /end MEASUREMENT
/begin MEASUREMENT UDS_u16VCU_TMPwrLimMax "UDS_u16VCU_TMPwrLimMax" UWORD I_1 1 2 0 65535 ECU_ADDRESS 0x0 /end MEASUREMENT
/begin MEASUREMENT UDS_u16VCU_TMPwrLimMin "UDS_u16VCU_TMPwrLimMin" UWORD I_1 1 2 0 65535 ECU_ADDRESS 0x0 /end MEASUREMENT
/begin MEASUREMENT UDS_u32Jump2PreBotCode "PreBoot" ULONG I_1 1 2 0 4294967295 ECU_ADDRESS 0x0 /end MEASUREMENT
/begin MEASUREMENT UDS_u32SecurKeyVal "UDS_u32SecurKeyVal" ULONG I_1 1 2 0 4294967295 ECU_ADDRESS 0x0 /end MEASUREMENT
/begin MEASUREMENT UDS_u8ComCtrlType "UDS_u8ComCtrlType" UBYTE I_1 1 2 0 255 ECU_ADDRESS 0x0 /end MEASUREMENT
/begin MEASUREMENT UDS_u8DCDCTemp "UDS_u8DCDCTemp" UWORD I_1 1 2 0 65535 ECU_ADDRESS 0x0 /end MEASUREMENT
/begin MEASUREMENT UDS_u8DtcSettingControlNvm "DID 120 -> DTC Setting Control" UBYTE F_1_p0_4 1 2 0 255 MATRIX_DIM 12 1 1 ECU_ADDRESS 0x0 /end MEASUREMENT
/begin MEASUREMENT UDS_u8DtcSettingControlNvm[0] "UDS_u8DtcSettingControlNvm[0]" UBYTE F_1_p0_4 1 2 0 255 ECU_ADDRESS 0x0 /end MEASUREMENT
/begin MEASUREMENT UDS_u8DtcSettingControlNvm[10] "UDS_u8DtcSettingControlNvm[10]" UBYTE F_1_p0_4 1 2 0 255 ECU_ADDRESS 0x0 /end MEASUREMENT
/begin MEASUREMENT UDS_u8DtcSettingControlNvm[11] "UDS_u8DtcSettingControlNvm[11]" UBYTE F_1_p0_4 1 2 0 255 ECU_ADDRESS 0x0 /end MEASUREMENT
/begin MEASUREMENT UDS_u8DtcSettingControlNvm[1] "UDS_u8DtcSettingControlNvm[1]" UBYTE F_1_p0_4 1 2 0 255 ECU_ADDRESS 0x0 /end MEASUREMENT
/begin MEASUREMENT UDS_u8DtcSettingControlNvm[2] "UDS_u8DtcSettingControlNvm[2]" UBYTE F_1_p0_4 1 2 0 255 ECU_ADDRESS 0x0 /end MEASUREMENT
/begin MEASUREMENT UDS_u8DtcSettingControlNvm[3] "UDS_u8DtcSettingControlNvm[3]" UBYTE F_1_p0_4 1 2 0 255 ECU_ADDRESS 0x0 /end MEASUREMENT
/begin MEASUREMENT UDS_u8DtcSettingControlNvm[4] "UDS_u8DtcSettingControlNvm[4]" UBYTE F_1_p0_4 1 2 0 255 ECU_ADDRESS 0x0 /end MEASUREMENT
/begin MEASUREMENT UDS_u8DtcSettingControlNvm[5] "UDS_u8DtcSettingControlNvm[5]" UBYTE F_1_p0_4 1 2 0 255 ECU_ADDRESS 0x0 /end MEASUREMENT
/begin MEASUREMENT UDS_u8DtcSettingControlNvm[6] "UDS_u8DtcSettingControlNvm[6]" UBYTE F_1_p0_4 1 2 0 255 ECU_ADDRESS 0x0 /end MEASUREMENT
/begin MEASUREMENT UDS_u8DtcSettingControlNvm[7] "UDS_u8DtcSettingControlNvm[7]" UBYTE F_1_p0_4 1 2 0 255 ECU_ADDRESS 0x0 /end MEASUREMENT
/begin MEASUREMENT UDS_u8DtcSettingControlNvm[8] "UDS_u8DtcSettingControlNvm[8]" UBYTE F_1_p0_4 1 2 0 255 ECU_ADDRESS 0x0 /end MEASUREMENT
/begin MEASUREMENT UDS_u8DtcSettingControlNvm[9] "UDS_u8DtcSettingControlNvm[9]" UBYTE F_1_p0_4 1 2 0 255 ECU_ADDRESS 0x0 /end MEASUREMENT
/begin MEASUREMENT UDS_u8DtcSettingControlNvm_def "DID 120 -> DTC Setting Control" UBYTE F_1_p0_4 1 2 0 255 MATRIX_DIM 12 1 1 ECU_ADDRESS 0x0 /end MEASUREMENT
/begin MEASUREMENT UDS_u8DtcSettingControlNvm_def[0] "UDS_u8DtcSettingControlNvm_def[0]" UBYTE F_1_p0_4 1 2 0 255 ECU_ADDRESS 0x0 /end MEASUREMENT
/begin MEASUREMENT UDS_u8DtcSettingControlNvm_def[10] "UDS_u8DtcSettingControlNvm_def[10]" UBYTE F_1_p0_4 1 2 0 255 ECU_ADDRESS 0x0 /end MEASUREMENT
/begin MEASUREMENT UDS_u8DtcSettingControlNvm_def[11] "UDS_u8DtcSettingControlNvm_def[11]" UBYTE F_1_p0_4 1 2 0 255 ECU_ADDRESS 0x0 /end MEASUREMENT
/begin MEASUREMENT UDS_u8DtcSettingControlNvm_def[1] "UDS_u8DtcSettingControlNvm_def[1]" UBYTE F_1_p0_4 1 2 0 255 ECU_ADDRESS 0x0 /end MEASUREMENT
/begin MEASUREMENT UDS_u8DtcSettingControlNvm_def[2] "UDS_u8DtcSettingControlNvm_def[2]" UBYTE F_1_p0_4 1 2 0 255 ECU_ADDRESS 0x0 /end MEASUREMENT
/begin MEASUREMENT UDS_u8DtcSettingControlNvm_def[3] "UDS_u8DtcSettingControlNvm_def[3]" UBYTE F_1_p0_4 1 2 0 255 ECU_ADDRESS 0x0 /end MEASUREMENT
/begin MEASUREMENT UDS_u8DtcSettingControlNvm_def[4] "UDS_u8DtcSettingControlNvm_def[4]" UBYTE F_1_p0_4 1 2 0 255 ECU_ADDRESS 0x0 /end MEASUREMENT
/begin MEASUREMENT UDS_u8DtcSettingControlNvm_def[5] "UDS_u8DtcSettingControlNvm_def[5]" UBYTE F_1_p0_4 1 2 0 255 ECU_ADDRESS 0x0 /end MEASUREMENT
/begin MEASUREMENT UDS_u8DtcSettingControlNvm_def[6] "UDS_u8DtcSettingControlNvm_def[6]" UBYTE F_1_p0_4 1 2 0 255 ECU_ADDRESS 0x0 /end MEASUREMENT
/begin MEASUREMENT UDS_u8DtcSettingControlNvm_def[7] "UDS_u8DtcSettingControlNvm_def[7]" UBYTE F_1_p0_4 1 2 0 255 ECU_ADDRESS 0x0 /end MEASUREMENT
/begin MEASUREMENT UDS_u8DtcSettingControlNvm_def[8] "UDS_u8DtcSettingControlNvm_def[8]" UBYTE F_1_p0_4 1 2 0 255 ECU_ADDRESS 0x0 /end MEASUREMENT
/begin MEASUREMENT UDS_u8DtcSettingControlNvm_def[9] "UDS_u8DtcSettingControlNvm_def[9]" UBYTE F_1_p0_4 1 2 0 255 ECU_ADDRESS 0x0 /end MEASUREMENT
/begin MEASUREMENT UDS_u8ESKWriteStatus "UDS_u8ESKWriteStatus" UBYTE I_1 1 2 0 255 ECU_ADDRESS 0x0 /end MEASUREMENT
/begin MEASUREMENT UDS_u8IPUMode "UDS_u8IPUMode" UBYTE I_1 1 2 0 255 ECU_ADDRESS 0x0 /end MEASUREMENT
/begin MEASUREMENT UDS_u8ManufactoryModeNvm "DID 120 -> Manufactory mode" UBYTE F_1_p0_4 1 2 0 255 ECU_ADDRESS 0x0 /end MEASUREMENT
/begin MEASUREMENT UDS_u8ManufactoryModeNvm_def "DID 120 -> Manufactory mode" UBYTE F_1_p0_4 1 2 0 255 ECU_ADDRESS 0x0 /end MEASUREMENT
/begin MEASUREMENT UDS_u8MotTempSnsr1 "UDS_u8MotTempSnsr1" UBYTE I_1 1 2 0 255 ECU_ADDRESS 0x0 /end MEASUREMENT
/begin MEASUREMENT UDS_u8MotTempSnsr2 "UDS_u8MotTempSnsr2" UBYTE I_1 1 2 0 255 ECU_ADDRESS 0x0 /end MEASUREMENT
/begin MEASUREMENT UDS_u8MtocNvm "DID F102 -> MTOC" UBYTE F_1_p0_4 1 2 0 255 MATRIX_DIM 17 1 1 ECU_ADDRESS 0x0 /end MEASUREMENT
/begin MEASUREMENT UDS_u8MtocNvm[0] "UDS_u8MtocNvm[0]" UBYTE F_1_p0_4 1 2 0 255 ECU_ADDRESS 0x0 /end MEASUREMENT
/begin MEASUREMENT UDS_u8MtocNvm[10] "UDS_u8MtocNvm[10]" UBYTE F_1_p0_4 1 2 0 255 ECU_ADDRESS 0x0 /end MEASUREMENT
/begin MEASUREMENT UDS_u8MtocNvm[11] "UDS_u8MtocNvm[11]" UBYTE F_1_p0_4 1 2 0 255 ECU_ADDRESS 0x0 /end MEASUREMENT
/begin MEASUREMENT UDS_u8MtocNvm[12] "UDS_u8MtocNvm[12]" UBYTE F_1_p0_4 1 2 0 255 ECU_ADDRESS 0x0 /end MEASUREMENT
/begin MEASUREMENT UDS_u8MtocNvm[13] "UDS_u8MtocNvm[13]" UBYTE F_1_p0_4 1 2 0 255 ECU_ADDRESS 0x0 /end MEASUREMENT
/begin MEASUREMENT UDS_u8MtocNvm[14] "UDS_u8MtocNvm[14]" UBYTE F_1_p0_4 1 2 0 255 ECU_ADDRESS 0x0 /end MEASUREMENT
/begin MEASUREMENT UDS_u8MtocNvm[15] "UDS_u8MtocNvm[15]" UBYTE F_1_p0_4 1 2 0 255 ECU_ADDRESS 0x0 /end MEASUREMENT
/begin MEASUREMENT UDS_u8MtocNvm[16] "UDS_u8MtocNvm[16]" UBYTE F_1_p0_4 1 2 0 255 ECU_ADDRESS 0x0 /end MEASUREMENT
/begin MEASUREMENT UDS_u8MtocNvm[1] "UDS_u8MtocNvm[1]" UBYTE F_1_p0_4 1 2 0 255 ECU_ADDRESS 0x0 /end MEASUREMENT
/begin MEASUREMENT UDS_u8MtocNvm[2] "UDS_u8MtocNvm[2]" UBYTE F_1_p0_4 1 2 0 255 ECU_ADDRESS 0x0 /end MEASUREMENT
/begin MEASUREMENT UDS_u8MtocNvm[3] "UDS_u8MtocNvm[3]" UBYTE F_1_p0_4 1 2 0 255 ECU_ADDRESS 0x0 /end MEASUREMENT
/begin MEASUREMENT UDS_u8MtocNvm[4] "UDS_u8MtocNvm[4]" UBYTE F_1_p0_4 1 2 0 255 ECU_ADDRESS 0x0 /end MEASUREMENT
/begin MEASUREMENT UDS_u8MtocNvm[5] "UDS_u8MtocNvm[5]" UBYTE F_1_p0_4 1 2 0 255 ECU_ADDRESS 0x0 /end MEASUREMENT
/begin MEASUREMENT UDS_u8MtocNvm[6] "UDS_u8MtocNvm[6]" UBYTE F_1_p0_4 1 2 0 255 ECU_ADDRESS 0x0 /end MEASUREMENT
/begin MEASUREMENT UDS_u8MtocNvm[7] "UDS_u8MtocNvm[7]" UBYTE F_1_p0_4 1 2 0 255 ECU_ADDRESS 0x0 /end MEASUREMENT
/begin MEASUREMENT UDS_u8MtocNvm[8] "UDS_u8MtocNvm[8]" UBYTE F_1_p0_4 1 2 0 255 ECU_ADDRESS 0x0 /end MEASUREMENT
/begin MEASUREMENT UDS_u8MtocNvm[9] "UDS_u8MtocNvm[9]" UBYTE F_1_p0_4 1 2 0 255 ECU_ADDRESS 0x0 /end MEASUREMENT
/begin MEASUREMENT UDS_u8MtocNvm_def "DID F102 -> MTOC" UBYTE F_1_p0_4 1 2 0 255 MATRIX_DIM 17 1 1 ECU_ADDRESS 0x0 /end MEASUREMENT
/begin MEASUREMENT UDS_u8MtocNvm_def[0] "UDS_u8MtocNvm_def[0]" UBYTE F_1_p0_4 1 2 0 255 ECU_ADDRESS 0x0 /end MEASUREMENT
/begin MEASUREMENT UDS_u8MtocNvm_def[10] "UDS_u8MtocNvm_def[10]" UBYTE F_1_p0_4 1 2 0 255 ECU_ADDRESS 0x0 /end MEASUREMENT
/begin MEASUREMENT UDS_u8MtocNvm_def[11] "UDS_u8MtocNvm_def[11]" UBYTE F_1_p0_4 1 2 0 255 ECU_ADDRESS 0x0 /end MEASUREMENT
/begin MEASUREMENT UDS_u8MtocNvm_def[12] "UDS_u8MtocNvm_def[12]" UBYTE F_1_p0_4 1 2 0 255 ECU_ADDRESS 0x0 /end MEASUREMENT
/begin MEASUREMENT UDS_u8MtocNvm_def[13] "UDS_u8MtocNvm_def[13]" UBYTE F_1_p0_4 1 2 0 255 ECU_ADDRESS 0x0 /end MEASUREMENT
/begin MEASUREMENT UDS_u8MtocNvm_def[14] "UDS_u8MtocNvm_def[14]" UBYTE F_1_p0_4 1 2 0 255 ECU_ADDRESS 0x0 /end MEASUREMENT
/begin MEASUREMENT UDS_u8MtocNvm_def[15] "UDS_u8MtocNvm_def[15]" UBYTE F_1_p0_4 1 2 0 255 ECU_ADDRESS 0x0 /end MEASUREMENT
/begin MEASUREMENT UDS_u8MtocNvm_def[16] "UDS_u8MtocNvm_def[16]" UBYTE F_1_p0_4 1 2 0 255 ECU_ADDRESS 0x0 /end MEASUREMENT
/begin MEASUREMENT UDS_u8MtocNvm_def[1] "UDS_u8MtocNvm_def[1]" UBYTE F_1_p0_4 1 2 0 255 ECU_ADDRESS 0x0 /end MEASUREMENT
/begin MEASUREMENT UDS_u8MtocNvm_def[2] "UDS_u8MtocNvm_def[2]" UBYTE F_1_p0_4 1 2 0 255 ECU_ADDRESS 0x0 /end MEASUREMENT
/begin MEASUREMENT UDS_u8MtocNvm_def[3] "UDS_u8MtocNvm_def[3]" UBYTE F_1_p0_4 1 2 0 255 ECU_ADDRESS 0x0 /end MEASUREMENT
/begin MEASUREMENT UDS_u8MtocNvm_def[4] "UDS_u8MtocNvm_def[4]" UBYTE F_1_p0_4 1 2 0 255 ECU_ADDRESS 0x0 /end MEASUREMENT
/begin MEASUREMENT UDS_u8MtocNvm_def[5] "UDS_u8MtocNvm_def[5]" UBYTE F_1_p0_4 1 2 0 255 ECU_ADDRESS 0x0 /end MEASUREMENT
/begin MEASUREMENT UDS_u8MtocNvm_def[6] "UDS_u8MtocNvm_def[6]" UBYTE F_1_p0_4 1 2 0 255 ECU_ADDRESS 0x0 /end MEASUREMENT
/begin MEASUREMENT UDS_u8MtocNvm_def[7] "UDS_u8MtocNvm_def[7]" UBYTE F_1_p0_4 1 2 0 255 ECU_ADDRESS 0x0 /end MEASUREMENT
/begin MEASUREMENT UDS_u8MtocNvm_def[8] "UDS_u8MtocNvm_def[8]" UBYTE F_1_p0_4 1 2 0 255 ECU_ADDRESS 0x0 /end MEASUREMENT
/begin MEASUREMENT UDS_u8MtocNvm_def[9] "UDS_u8MtocNvm_def[9]" UBYTE F_1_p0_4 1 2 0 255 ECU_ADDRESS 0x0 /end MEASUREMENT
/begin MEASUREMENT UDS_u8ResetRequestedMode "Type of reset requested to be able to done the associated reset after sending the response frame" UBYTE F_1_p0_4 1 2 0 255 ECU_ADDRESS 0x0 /end MEASUREMENT
/begin MEASUREMENT VSI_bSoftOvCurrPhsUFlg "..." UBYTE Bool_ON_OFF 1 2 0 1 BIT_MASK 0x01 ECU_ADDRESS 0x0 /end MEASUREMENT
/begin MEASUREMENT VSI_bSoftOvCurrPhsVFlg "..." UBYTE Bool_ON_OFF 1 2 0 1 BIT_MASK 0x01 ECU_ADDRESS 0x0 /end MEASUREMENT
/begin MEASUREMENT VSI_bSoftOvCurrPhsWFlg "..." UBYTE Bool_ON_OFF 1 2 0 1 BIT_MASK 0x01 ECU_ADDRESS 0x0 /end MEASUREMENT
/begin MEASUREMENT VSI_u8IdTx "VSI_u8IdTx" UBYTE I_1 1 2 0 255 ECU_ADDRESS 0x0 /end MEASUREMENT
/begin COMPU_METHOD I_1 "" RAT_FUNC "%9.2" "-" COEFFS 0 1 0 0 0 1 /end COMPU_METHOD
/begin COMPU_METHOD I_3 "" RAT_FUNC "%9.2" "" COEFFS 0 1 0 0 0 1 /end COMPU_METHOD
/begin COMPU_METHOD F_1_p0_4 "" RAT_FUNC "%9.2" "-" COEFFS 0 1 0 0 0 1 /end COMPU_METHOD
/begin COMPU_METHOD F_0v0012210012_p0_10 "" RAT_FUNC "%9.3" "V" COEFFS 0 1 0 0 0 0.001221 /end COMPU_METHOD
/begin COMPU_METHOD I_23 "" RAT_FUNC "%9.2" "uint8" COEFFS 0 1 0 0 0 1 /end COMPU_METHOD
/begin COMPU_METHOD F_5_p0_30 "" RAT_FUNC "%9.2" "ms" COEFFS 0 1 0 0 0 5 /end COMPU_METHOD
/begin COMPU_METHOD F_0v1_p0_70 "" RAT_FUNC "%9.2" "µs" COEFFS 0 1 0 0 0 0.1 /end COMPU_METHOD
/begin COMPU_METHOD I_74 "" RAT_FUNC "%9.2" "uint16" COEFFS 0 1 0 0 0 1 /end COMPU_METHOD
/begin COMPU_METHOD F_0v4694835681_m284v9765258216_75 "" RAT_FUNC "%9.2" "°C" COEFFS 0 1 284.977 0 0 0.469484 /end COMPU_METHOD
/begin COMPU_METHOD F_0v0012218964_p0_80 "" RAT_FUNC "%9.3" "V" COEFFS 0 1 0 0 0 0.0012219 /end COMPU_METHOD
/begin COMPU_METHOD F_0v025_p0_81 "" RAT_FUNC "%9.2" "µs" COEFFS 0 1 0 0 0 0.025 /end COMPU_METHOD
/begin COMPU_METHOD D_2_0v00005_p0_82 "" RAT_FUNC "%9.2" "KHz" COEFFS 0 0 1 0 5e-005 0 /end COMPU_METHOD
/begin COMPU_METHOD F_25_p0_83 "" RAT_FUNC "%9.2" "ns" COEFFS 0 1 0 0 0 25 /end COMPU_METHOD
/begin COMPU_METHOD F_0v5_p0v5_84 "" RAT_FUNC "%9.2" "µs" COEFFS 0 1 -0.5 0 0 0.5 /end COMPU_METHOD
/begin COMPU_METHOD Id_0x00 "" RAT_FUNC "%9.2" "." COEFFS 0 1 0 0 0 1 /end COMPU_METHOD
/begin COMPU_METHOD Bool_ON_OFF "" TAB_VERB "%8.4" "." COMPU_TAB_REF Bool_ON_OFF_table /end COMPU_METHOD
/begin COMPU_VTAB Bool_ON_OFF_table "" TAB_VERB 2 0 "OFF" 1 "ON" /end COMPU_VTAB
/begin FUNCTION SBC ""
 /begin OUT_MEASUREMENT SBC_au16ConfigRegs SBC_au16ConfigRegs[0] SBC_au16ConfigRegs[10] SBC_au16ConfigRegs[11] SBC_au16ConfigRegs[1] SBC_au16ConfigRegs[2] SBC_au16ConfigRegs[3] SBC_au16ConfigRegs[4] SBC_au16ConfigRegs[5] SBC_au16ConfigRegs[6] SBC_au16ConfigRegs[7] SBC_au16ConfigRegs[8] SBC_au16ConfigRegs[9] SBC_au16SpiRxStsData SBC_au16SpiRxStsData[0] SBC_au16SpiRxStsData[10] SBC_au16SpiRxStsData[11] SBC_au16SpiRxStsData[12] SBC_au16SpiRxStsData[13] SBC_au16SpiRxStsData[14] SBC_au16SpiRxStsData[15] SBC_au16SpiRxStsData[16] SBC_au16SpiRxStsData[17] SBC_au16SpiRxStsData[18] SBC_au16SpiRxStsData[19] SBC_au16SpiRxStsData[1] SBC_au16SpiRxStsData[20] SBC_au16SpiRxStsData[21] SBC_au16SpiRxStsData[22] SBC_au16SpiRxStsData[23] SBC_au16SpiRxStsData[24] SBC_au16SpiRxStsData[25] SBC_au16SpiRxStsData[26] SBC_au16SpiRxStsData[27] SBC_au16SpiRxStsData[28] SBC_au16SpiRxStsData[29] SBC_au16SpiRxStsData[2] SBC_au16SpiRxStsData[3] SBC_au16SpiRxStsData[4] SBC_au16SpiRxStsData[5] SBC_au16SpiRxStsData[6] SBC_au16SpiRxStsData[7] SBC_au16SpiRxStsData[8] SBC_au16SpiRxStsData[9] SBC_au16SpiTxAddr SBC_au16SpiTxAddr[0] SBC_au16SpiTxAddr[10] SBC_au16SpiTxAddr[11] SBC_au16SpiTxAddr[12] SBC_au16SpiTxAddr[13] SBC_au16SpiTxAddr[14] SBC_au16SpiTxAddr[15] SBC_au16SpiTxAddr[16] SBC_au16SpiTxAddr[17] SBC_au16SpiTxAddr[18] SBC_au16SpiTxAddr[19] SBC_au16SpiTxAddr[1] SBC_au16SpiTxAddr[20] SBC_au16SpiTxAddr[21] SBC_au16SpiTxAddr[22] SBC_au16SpiTxAddr[23] SBC_au16SpiTxAddr[24] SBC_au16SpiTxAddr[25] SBC_au16SpiTxAddr[26] SBC_au16SpiTxAddr[27] SBC_au16SpiTxAddr[28] SBC_au16SpiTxAddr[29] SBC_au16SpiTxAddr[2] SBC_au16SpiTxAddr[3] SBC_au16SpiTxAddr[4] SBC_au16SpiTxAddr[5] SBC_au16SpiTxAddr[6] SBC_au16SpiTxAddr[7] SBC_au16SpiTxAddr[8] SBC_au16SpiTxAddr[9] SBC_au16SpiTxData SBC_au16SpiTxData[0] SBC_au16SpiTxData[10] SBC_au16SpiTxData[11] SBC_au16SpiTxData[12] SBC_au16SpiTxData[13] SBC_au16SpiTxData[14] SBC_au16SpiTxData[15] SBC_au16SpiTxData[16] SBC_au16SpiTxData[17] SBC_au16SpiTxData[18] SBC_au16SpiTxData[19] SBC_au16SpiTxData[1] SBC_au16SpiTxData[20] SBC_au16SpiTxData[21] SBC_au16SpiTxData[22] SBC_au16SpiTxData[23] SBC_au16SpiTxData[24] SBC_au16SpiTxData[25] SBC_au16SpiTxData[26] SBC_au16SpiTxData[27] SBC_au16SpiTxData[28] SBC_au16SpiTxData[29] SBC_au16SpiTxData[2] SBC_au16SpiTxData[3] SBC_au16SpiTxData[4] SBC_au16SpiTxData[5] SBC_au16SpiTxData[6] SBC_au16SpiTxData[7] SBC_au16SpiTxData[8] SBC_au16SpiTxData[9] SBC_au16StatusRegs SBC_au16StatusRegs[0] SBC_au16StatusRegs[10] SBC_au16StatusRegs[11] SBC_au16StatusRegs[12] SBC_au16StatusRegs[13] SBC_au16StatusRegs[14] SBC_au16StatusRegs[15] SBC_au16StatusRegs[16] SBC_au16StatusRegs[17] SBC_au16StatusRegs[1] SBC_au16StatusRegs[2] SBC_au16StatusRegs[3] SBC_au16StatusRegs[4] SBC_au16StatusRegs[5] SBC_au16StatusRegs[6] SBC_au16StatusRegs[7] SBC_au16StatusRegs[8] SBC_au16StatusRegs[9] SBC_au16StatusRegsNvm SBC_au16StatusRegsNvm[0] SBC_au16StatusRegsNvm[10] SBC_au16StatusRegsNvm[11] SBC_au16StatusRegsNvm[12] SBC_au16StatusRegsNvm[13] SBC_au16StatusRegsNvm[14] SBC_au16StatusRegsNvm[15] SBC_au16StatusRegsNvm[16] SBC_au16StatusRegsNvm[17] SBC_au16StatusRegsNvm[1] SBC_au16StatusRegsNvm[2] SBC_au16StatusRegsNvm[3] SBC_au16StatusRegsNvm[4] SBC_au16StatusRegsNvm[5] SBC_au16StatusRegsNvm[6] SBC_au16StatusRegsNvm[7] SBC_au16StatusRegsNvm[8] SBC_au16StatusRegsNvm[9] SBC_bClrStsRegs SBC_bDeintWdgCmd SBC_bFaultSts SBC_bFaultStsCom SBC_bFaultStsInit SBC_bFaultStsTemp SBC_bFaultStsVolt SBC_bPwOnFltClred SBC_bPwrOnFaultCleared SBC_bStdbyStsFlag SBC_f32BatteryVoltage SBC_f32BkpVoltage SBC_u8ReadingRegObj SBC_u8SpiWriteNum SBC_u8State /end OUT_MEASUREMENT
/end FUNCTION
/begin FUNCTION SCU "" /begin DEF_CHARACTERISTIC SCU_ku16MaxDieTempThrd SCU_ku16MinDieTempThrd /end DEF_CHARACTERISTIC /begin OUT_MEASUREMENT SCU_u16DieTemp /end OUT_MEASUREMENT /end FUNCTION
/begin FUNCTION SPY ""
 /begin OUT_MEASUREMENT SPY_bBufFull SPY_u16DaqListFirstElmIdx SPY_u16NrOfElmsToTx SPY_u16PreTrigSmplIdx SPY_u16RmngSmplIdx SPY_u16SmplIdx SPY_u16TrigSmplIdx /end OUT_MEASUREMENT
/end FUNCTION
/begin FUNCTION STFSRV ""
 /begin DEF_CHARACTERISTIC ESM_bPowerOffModeInhC ESM_ku16AfterrunToutCntC GESM_bPowerOffModeInhC GESM_ku16AfterrunToutCntC /end DEF_CHARACTERISTIC
 /begin OUT_MEASUREMENT ESM_bAfterrunFin ESM_bAfterrunReq ESM_bCallAppliOn ESM_bMcuEnaReq ESM_bPwrDnReadyFlg ESM_bPwrLNfClrFltFinsh ESM_ESM_MODE_FT ESM_ESM_MODE_NF ESM_EsmMode ESM_OpFtState ESM_OpNfState ESM_PwrLFtState ESM_PwrLNfState ESM_StpIIFtState ESM_StpIINfState ESM_StpIState ESM_u16AfterrunCnt ESM_u16CmdReq ESM_u16CmdReqNm1 ESM_u16CmdRes ESM_u8AllowPwrDnDelay ESM_u8PwrLNfStep ESM_u8PwrOffTim ESM_u8RestartDelayCnt GESM_bAfterrunFin GESM_bAfterrunReq GESM_bCallAppliOn GESM_bMcuEnaReq GESM_bPwrDnReadyFlg GESM_bPwrLNfClrFltFinsh GESM_ESM_MODE_FT GESM_ESM_MODE_NF GESM_EsmMode GESM_OpFtState GESM_OpNfState GESM_PwrLFtState GESM_PwrLNfState GESM_StpIIFtState GESM_StpIINfState GESM_StpIState GESM_u16AfterrunCnt GESM_u16CmdReq GESM_u16CmdReqNm1 GESM_u16CmdRes GESM_u8AllowPwrDnDelay GESM_u8PwrLNfStep GESM_u8PwrOffTim GESM_u8RestartDelayCnt /end OUT_MEASUREMENT
/end FUNCTION
/begin FUNCTION SWFAIL ""
 /begin OUT_MEASUREMENT SWFAIL_audtSaveContext SWFAIL_audtSaveContext[0] SWFAIL_audtSaveContext[10] SWFAIL_audtSaveContext[11] SWFAIL_audtSaveContext[12] SWFAIL_audtSaveContext[13] SWFAIL_audtSaveContext[14] SWFAIL_audtSaveContext[15] SWFAIL_audtSaveContext[16] SWFAIL_audtSaveContext[17] SWFAIL_audtSaveContext[18] SWFAIL_audtSaveContext[19] SWFAIL_audtSaveContext[1] SWFAIL_audtSaveContext[20] SWFAIL_audtSaveContext[21] SWFAIL_audtSaveContext[22] SWFAIL_audtSaveContext[23] SWFAIL_audtSaveContext[24] SWFAIL_audtSaveContext[25] SWFAIL_audtSaveContext[26] SWFAIL_audtSaveContext[27] SWFAIL_audtSaveContext[28] SWFAIL_audtSaveContext[29] SWFAIL_audtSaveContext[2] SWFAIL_audtSaveContext[30] SWFAIL_audtSaveContext[31] SWFAIL_audtSaveContext[3] SWFAIL_audtSaveContext[4] SWFAIL_audtSaveContext[5] SWFAIL_audtSaveContext[6] SWFAIL_audtSaveContext[7] SWFAIL_audtSaveContext[8] SWFAIL_audtSaveContext[9] SWFAIL_bfErrorType SWFAIL_bfTrapType SWFAIL_pfErrorAddress SWFAIL_pfu32IllegalInstruction SWFAIL_pfu32ProgramReturnError SWFAIL_u16ExceptionErrorCounter SWFAIL_u16SoftwareErrorCounter SWFAIL_u16StackErrorCounter SWFAIL_u32StatusRegisterError SWFAIL_u8CoreIdx SWFAIL_udtStackIdx /end OUT_MEASUREMENT
/end FUNCTION
/begin FUNCTION TJA1145 ""
 /begin OUT_MEASUREMENT TJA1145_au16SpiReadFrame TJA1145_au16SpiReadFrame[0] TJA1145_au16SpiReadFrame[10] TJA1145_au16SpiReadFrame[11] TJA1145_au16SpiReadFrame[12] TJA1145_au16SpiReadFrame[13] TJA1145_au16SpiReadFrame[14] TJA1145_au16SpiReadFrame[15] TJA1145_au16SpiReadFrame[16] TJA1145_au16SpiReadFrame[17] TJA1145_au16SpiReadFrame[18] TJA1145_au16SpiReadFrame[19] TJA1145_au16SpiReadFrame[1] TJA1145_au16SpiReadFrame[20] TJA1145_au16SpiReadFrame[21] TJA1145_au16SpiReadFrame[22] TJA1145_au16SpiReadFrame[23] TJA1145_au16SpiReadFrame[24] TJA1145_au16SpiReadFrame[25] TJA1145_au16SpiReadFrame[26] TJA1145_au16SpiReadFrame[27] TJA1145_au16SpiReadFrame[28] TJA1145_au16SpiReadFrame[29] TJA1145_au16SpiReadFrame[2] TJA1145_au16SpiReadFrame[3] TJA1145_au16SpiReadFrame[4] TJA1145_au16SpiReadFrame[5] TJA1145_au16SpiReadFrame[6] TJA1145_au16SpiReadFrame[7] TJA1145_au16SpiReadFrame[8] TJA1145_au16SpiReadFrame[9] TJA1145_au16SpiWriteFrame TJA1145_au16SpiWriteFrame[0] TJA1145_au16SpiWriteFrame[10] TJA1145_au16SpiWriteFrame[11] TJA1145_au16SpiWriteFrame[12] TJA1145_au16SpiWriteFrame[13] TJA1145_au16SpiWriteFrame[14] TJA1145_au16SpiWriteFrame[15] TJA1145_au16SpiWriteFrame[16] TJA1145_au16SpiWriteFrame[17] TJA1145_au16SpiWriteFrame[18] TJA1145_au16SpiWriteFrame[19] TJA1145_au16SpiWriteFrame[1] TJA1145_au16SpiWriteFrame[20] TJA1145_au16SpiWriteFrame[21] TJA1145_au16SpiWriteFrame[22] TJA1145_au16SpiWriteFrame[23] TJA1145_au16SpiWriteFrame[24] TJA1145_au16SpiWriteFrame[25] TJA1145_au16SpiWriteFrame[26] TJA1145_au16SpiWriteFrame[27] TJA1145_au16SpiWriteFrame[28] TJA1145_au16SpiWriteFrame[29] TJA1145_au16SpiWriteFrame[2] TJA1145_au16SpiWriteFrame[3] TJA1145_au16SpiWriteFrame[4] TJA1145_au16SpiWriteFrame[5] TJA1145_au16SpiWriteFrame[6] TJA1145_au16SpiWriteFrame[7] TJA1145_au16SpiWriteFrame[8] TJA1145_au16SpiWriteFrame[9] TJA1145_bEnableTest TJA1145_bFrameErrOverFlow TJA1145_bFrameFinish TJA1145_bNormSlpFinsh TJA1145_bSpiComError TJA1145_u8Add2Read TJA1145_u8ChipTesting TJA1145_u8ChipUsed TJA1145_u8DONE TJA1145_u8ErrorFrameCnt TJA1145_u8IndexFrame TJA1145_u8SpiTxFrameMaxNb TJA1145_u8WakeupSrc /end OUT_MEASUREMENT
/end FUNCTION
/begin FUNCTION TLE9180 ""
 /begin DEF_CHARACTERISTIC TLE9180_bDrvOverCurrentTestOnC TLE9180_bDrvOverTempTestOnC TLE9180_bDrvOverVoltageTestOnC TLE9180_bDrvUnderVoltageTestOnC TLE9180_bManualReadRegC TLE9180_bPhasePerfTestOnC TLE9180_bPhaseShortHighTestOnC TLE9180_bPhaseShortLowTestOnC TLE9180_bPhsOverVoltTestOnC TLE9180_kf32PhsTempFaultC TLE9180_kf32PhsTempFltRecoverC TLE9180_ku16EnaResetTimeC TLE9180_ku16ErrPinChkTimC TLE9180_ku8EnaResetCntC TLE9180_ku8ErrRecvMaxNumC /end DEF_CHARACTERISTIC
 /begin OUT_MEASUREMENT TLE9180_af32ReadPhsTempPhys TLE9180_af32ReadPhsTempPhys[0] TLE9180_af32ReadPhsTempPhys[1] TLE9180_af32ReadPhsTempPhys[2] TLE9180_af32ReadPhsTempPhys[3] TLE9180_af32ReadPhsTempPhys[4] TLE9180_af32ReadPhsTempPhys[5] TLE9180_au32SpiReadFrame TLE9180_au32SpiReadFrame[0] TLE9180_au32SpiReadFrame[10] TLE9180_au32SpiReadFrame[11] TLE9180_au32SpiReadFrame[12] TLE9180_au32SpiReadFrame[13] TLE9180_au32SpiReadFrame[14] TLE9180_au32SpiReadFrame[15] TLE9180_au32SpiReadFrame[16] TLE9180_au32SpiReadFrame[17] TLE9180_au32SpiReadFrame[18] TLE9180_au32SpiReadFrame[19] TLE9180_au32SpiReadFrame[1] TLE9180_au32SpiReadFrame[20] TLE9180_au32SpiReadFrame[21] TLE9180_au32SpiReadFrame[22] TLE9180_au32SpiReadFrame[23] TLE9180_au32SpiReadFrame[24] TLE9180_au32SpiReadFrame[25] TLE9180_au32SpiReadFrame[26] TLE9180_au32SpiReadFrame[27] TLE9180_au32SpiReadFrame[28] TLE9180_au32SpiReadFrame[29] TLE9180_au32SpiReadFrame[2] TLE9180_au32SpiReadFrame[3] TLE9180_au32SpiReadFrame[4] TLE9180_au32SpiReadFrame[5] TLE9180_au32SpiReadFrame[6] TLE9180_au32SpiReadFrame[7] TLE9180_au32SpiReadFrame[8] TLE9180_au32SpiReadFrame[9] TLE9180_au32SpiWriteFrame TLE9180_au32SpiWriteFrame[0] TLE9180_au32SpiWriteFrame[10] TLE9180_au32SpiWriteFrame[11] TLE9180_au32SpiWriteFrame[12] TLE9180_au32SpiWriteFrame[13] TLE9180_au32SpiWriteFrame[14] TLE9180_au32SpiWriteFrame[15] TLE9180_au32SpiWriteFrame[16] TLE9180_au32SpiWriteFrame[17] TLE9180_au32SpiWriteFrame[18] TLE9180_au32SpiWriteFrame[19] TLE9180_au32SpiWriteFrame[1] TLE9180_au32SpiWriteFrame[20] TLE9180_au32SpiWriteFrame[21] TLE9180_au32SpiWriteFrame[22] TLE9180_au32SpiWriteFrame[23] TLE9180_au32SpiWriteFrame[24] TLE9180_au32SpiWriteFrame[25] TLE9180_au32SpiWriteFrame[26] TLE9180_au32SpiWriteFrame[27] TLE9180_au32SpiWriteFrame[28] TLE9180_au32SpiWriteFrame[29] TLE9180_au32SpiWriteFrame[2] TLE9180_au32SpiWriteFrame[3] TLE9180_au32SpiWriteFrame[4] TLE9180_au32SpiWriteFrame[5] TLE9180_au32SpiWriteFrame[6] TLE9180_au32SpiWriteFrame[7] TLE9180_au32SpiWriteFrame[8] TLE9180_au32SpiWriteFrame[9] TLE9180_au8CfgRegister TLE9180_au8CfgRegister[0] TLE9180_au8CfgRegister[10] TLE9180_au8CfgRegister[11] TLE9180_au8CfgRegister[12] TLE9180_au8CfgRegister[13] TLE9180_au8CfgRegister[14] TLE9180_au8CfgRegister[15] TLE9180_au8CfgRegister[16] TLE9180_au8CfgRegister[17] TLE9180_au8CfgRegister[18] TLE9180_au8CfgRegister[19] TLE9180_au8CfgRegister[1] TLE9180_au8CfgRegister[20] TLE9180_au8CfgRegister[21] TLE9180_au8CfgRegister[22] TLE9180_au8CfgRegister[23] TLE9180_au8CfgRegister[24] TLE9180_au8CfgRegister[25] TLE9180_au8CfgRegister[26] TLE9180_au8CfgRegister[27] TLE9180_au8CfgRegister[28] TLE9180_au8CfgRegister[29] TLE9180_au8CfgRegister[2] TLE9180_au8CfgRegister[3] TLE9180_au8CfgRegister[4] TLE9180_au8CfgRegister[5] TLE9180_au8CfgRegister[6] TLE9180_au8CfgRegister[7] TLE9180_au8CfgRegister[8] TLE9180_au8CfgRegister[9] TLE9180_au8CfgRegReadBk TLE9180_au8CfgRegReadBk[0] TLE9180_au8CfgRegReadBk[10] TLE9180_au8CfgRegReadBk[11] TLE9180_au8CfgRegReadBk[12] TLE9180_au8CfgRegReadBk[13] TLE9180_au8CfgRegReadBk[14] TLE9180_au8CfgRegReadBk[15] TLE9180_au8CfgRegReadBk[16] TLE9180_au8CfgRegReadBk[17] TLE9180_au8CfgRegReadBk[18] TLE9180_au8CfgRegReadBk[19] TLE9180_au8CfgRegReadBk[1] TLE9180_au8CfgRegReadBk[20] TLE9180_au8CfgRegReadBk[21] TLE9180_au8CfgRegReadBk[22] TLE9180_au8CfgRegReadBk[23] TLE9180_au8CfgRegReadBk[24] TLE9180_au8CfgRegReadBk[25] TLE9180_au8CfgRegReadBk[26] TLE9180_au8CfgRegReadBk[27] TLE9180_au8CfgRegReadBk[28] TLE9180_au8CfgRegReadBk[29] TLE9180_au8CfgRegReadBk[2] TLE9180_au8CfgRegReadBk[3] TLE9180_au8CfgRegReadBk[4] TLE9180_au8CfgRegReadBk[5] TLE9180_au8CfgRegReadBk[6] TLE9180_au8CfgRegReadBk[7] TLE9180_au8CfgRegReadBk[8] TLE9180_au8CfgRegReadBk[9] TLE9180_au8ReadPhsTemp TLE9180_au8ReadPhsTemp[0] TLE9180_au8ReadPhsTemp[1] TLE9180_au8ReadPhsTemp[2] TLE9180_au8ReadPhsTemp[3] TLE9180_au8ReadPhsTemp[4] TLE9180_au8ReadPhsTemp[5] TLE9180_au8ReadRegs TLE9180_au8ReadRegs[0] TLE9180_au8ReadRegs[10] TLE9180_au8ReadRegs[11] TLE9180_au8ReadRegs[12] TLE9180_au8ReadRegs[13] TLE9180_au8ReadRegs[14] TLE9180_au8ReadRegs[15] TLE9180_au8ReadRegs[16] TLE9180_au8ReadRegs[17] TLE9180_au8ReadRegs[18] TLE9180_au8ReadRegs[19] TLE9180_au8ReadRegs[1] TLE9180_au8ReadRegs[20] TLE9180_au8ReadRegs[21] TLE9180_au8ReadRegs[22] TLE9180_au8ReadRegs[23] TLE9180_au8ReadRegs[24] TLE9180_au8ReadRegs[25] TLE9180_au8ReadRegs[26] TLE9180_au8ReadRegs[27] TLE9180_au8ReadRegs[28] TLE9180_au8ReadRegs[29] TLE9180_au8ReadRegs[2] TLE9180_au8ReadRegs[3] TLE9180_au8ReadRegs[4] TLE9180_au8ReadRegs[5] TLE9180_au8ReadRegs[6] TLE9180_au8ReadRegs[7] TLE9180_au8ReadRegs[8] TLE9180_au8ReadRegs[9] TLE9180_bDataTransferDone TLE9180_bDrvOverCurrent TLE9180_bDrvOverTemp TLE9180_bDrvOverVoltage TLE9180_bDrvUnderVoltage TLE9180_bErrorFlag TLE9180_bErrorPinLevel TLE9180_bHALOverVolt TLE9180_bHALUnderVolt TLE9180_bInitFailFlg TLE9180_bPhasePerf TLE9180_bPhaseShortHigh TLE9180_bPhaseShortLow TLE9180_bPhsOverVolt TLE9180_bReadErrInfoFlg TLE9180_bTempWarning TLE9180_bTestReadErrRegs TLE9180_bTestReadReg TLE9180_bTestWriteReg TLE9180_f32MaxPhsTempPhys TLE9180_u16EnaResetTime TLE9180_u16ErrPinChkCnt TLE9180_u16HallSupVolt TLE9180_u8CurOperMode TLE9180_u8EnaResetCnt TLE9180_u8ErrorFrameCnt TLE9180_u8ErrRecoverCnt TLE9180_u8FeedBackAddr TLE9180_u8FeedBackData TLE9180_u8FeedBackStatus TLE9180_u8HallSupVolt TLE9180_u8IndexFrame TLE9180_u8Mode TLE9180_u8RdRegTimCnt TLE9180_u8ReadRegAddr TLE9180_u8SelfTestStep TLE9180_u8SelfTstModChk TLE9180_u8SpiTxFrameMaxNb TLE9180_u8TestMode TLE9180_u8WriteData TLE9180_u8WriteRegAddr /end OUT_MEASUREMENT
/end FUNCTION
/begin FUNCTION UDS "" /begin DEF_CHARACTERISTIC UDS_SecurAccessBenchOnC /end DEF_CHARACTERISTIC
 /begin OUT_MEASUREMENT UDS_au8CalibSoftId UDS_au8CalibSoftId[0] UDS_au8CalibSoftId[10] UDS_au8CalibSoftId[11] UDS_au8CalibSoftId[12] UDS_au8CalibSoftId[13] UDS_au8CalibSoftId[14] UDS_au8CalibSoftId[15] UDS_au8CalibSoftId[1] UDS_au8CalibSoftId[2] UDS_au8CalibSoftId[3] UDS_au8CalibSoftId[4] UDS_au8CalibSoftId[5] UDS_au8CalibSoftId[6] UDS_au8CalibSoftId[7] UDS_au8CalibSoftId[8] UDS_au8CalibSoftId[9] UDS_au8DiagVers UDS_au8DiagVers[0] UDS_au8DiagVers[1] UDS_au8DiagVers[2] UDS_au8DiagVers[3] UDS_au8ECUInstallDateNvm UDS_au8ECUInstallDateNvm[0] UDS_au8ECUInstallDateNvm[1] UDS_au8ECUInstallDateNvm[2] UDS_au8ECUInstallDateNvm[3] UDS_au8ESKWriteNvm UDS_au8ESKWriteNvm[0] UDS_au8ESKWriteNvm[10] UDS_au8ESKWriteNvm[11] UDS_au8ESKWriteNvm[12] UDS_au8ESKWriteNvm[13] UDS_au8ESKWriteNvm[14] UDS_au8ESKWriteNvm[15] UDS_au8ESKWriteNvm[1] UDS_au8ESKWriteNvm[2] UDS_au8ESKWriteNvm[3] UDS_au8ESKWriteNvm[4] UDS_au8ESKWriteNvm[5] UDS_au8ESKWriteNvm[6] UDS_au8ESKWriteNvm[7] UDS_au8ESKWriteNvm[8] UDS_au8ESKWriteNvm[9] UDS_au8FaultDiagVers UDS_au8FaultDiagVers[0] UDS_au8FaultDiagVers[1] UDS_au8FaultDiagVers[2] UDS_au8FaultDiagVers[3] UDS_au8VehManufEcuSwVersNvm UDS_au8VehManufEcuSwVersNvm[0] UDS_au8VehManufEcuSwVersNvm[10] UDS_au8VehManufEcuSwVersNvm[11] UDS_au8VehManufEcuSwVersNvm[12] UDS_au8VehManufEcuSwVersNvm[13] UDS_au8VehManufEcuSwVersNvm[14] UDS_au8VehManufEcuSwVersNvm[15] UDS_au8VehManufEcuSwVersNvm[1] UDS_au8VehManufEcuSwVersNvm[2] UDS_au8VehManufEcuSwVersNvm[3] UDS_au8VehManufEcuSwVersNvm[4] UDS_au8VehManufEcuSwVersNvm[5] UDS_au8VehManufEcuSwVersNvm[6] UDS_au8VehManufEcuSwVersNvm[7] UDS_au8VehManufEcuSwVersNvm[8] UDS_au8VehManufEcuSwVersNvm[9] UDS_au8VehNetConfigNvm UDS_au8VehNetConfigNvm[0] UDS_au8VehNetConfigNvm[1] UDS_au8VehNetConfigNvm[2] UDS_au8VehNetConfigNvm[3] UDS_au8VehNetConfigNvm[4] UDS_au8VehNetConfigNvm[5] UDS_au8VehNetConfigNvm[6] UDS_au8VehNetConfigNvm[7] UDS_bDisableComFlg UDS_bDisableDtcSettingFlg UDS_bDisaNmComFlg UDS_bKeyOffOnResetActivated UDS_bResetAndBootCondition UDS_kau8ESKWriteNvm_def UDS_kau8ESKWriteNvm_def[0] UDS_kau8ESKWriteNvm_def[10] UDS_kau8ESKWriteNvm_def[11] UDS_kau8ESKWriteNvm_def[12] UDS_kau8ESKWriteNvm_def[13] UDS_kau8ESKWriteNvm_def[14] UDS_kau8ESKWriteNvm_def[15] UDS_kau8ESKWriteNvm_def[1] UDS_kau8ESKWriteNvm_def[2] UDS_kau8ESKWriteNvm_def[3] UDS_kau8ESKWriteNvm_def[4] UDS_kau8ESKWriteNvm_def[5] UDS_kau8ESKWriteNvm_def[6] UDS_kau8ESKWriteNvm_def[7] UDS_kau8ESKWriteNvm_def[8] UDS_kau8ESKWriteNvm_def[9] UDS_u16Autophs UDS_u16AutophsCrc UDS_u16EngineRPM UDS_u16ISGCurrTorq UDS_u16IvtrSysTqReq UDS_u16ReprogAttemptCntNvm UDS_u16ReprogAttemptCntNvm_def UDS_u16ReprogCntNvm UDS_u16ReprogCntNvm_def UDS_u16RmsCurU UDS_u16RmsCurV UDS_u16RmsCurW UDS_u16SupplyVolt UDS_u16VCU_TMPwrLimMax UDS_u16VCU_TMPwrLimMin UDS_u32Jump2PreBotCode UDS_u32SecurKeyVal UDS_u8ComCtrlType UDS_u8DCDCTemp UDS_u8DtcSettingControlNvm UDS_u8DtcSettingControlNvm[0] UDS_u8DtcSettingControlNvm[10] UDS_u8DtcSettingControlNvm[11] UDS_u8DtcSettingControlNvm[1] UDS_u8DtcSettingControlNvm[2] UDS_u8DtcSettingControlNvm[3] UDS_u8DtcSettingControlNvm[4] UDS_u8DtcSettingControlNvm[5] UDS_u8DtcSettingControlNvm[6] UDS_u8DtcSettingControlNvm[7] UDS_u8DtcSettingControlNvm[8] UDS_u8DtcSettingControlNvm[9] UDS_u8DtcSettingControlNvm_def UDS_u8DtcSettingControlNvm_def[0] UDS_u8DtcSettingControlNvm_def[10] UDS_u8DtcSettingControlNvm_def[11] UDS_u8DtcSettingControlNvm_def[1] UDS_u8DtcSettingControlNvm_def[2] UDS_u8DtcSettingControlNvm_def[3] UDS_u8DtcSettingControlNvm_def[4] UDS_u8DtcSettingControlNvm_def[5] UDS_u8DtcSettingControlNvm_def[6] UDS_u8DtcSettingControlNvm_def[7] UDS_u8DtcSettingControlNvm_def[8] UDS_u8DtcSettingControlNvm_def[9] UDS_u8ESKWriteStatus UDS_u8IPUMode UDS_u8ManufactoryModeNvm UDS_u8ManufactoryModeNvm_def UDS_u8MotTempSnsr1 UDS_u8MotTempSnsr2 UDS_u8MtocNvm UDS_u8MtocNvm[0] UDS_u8MtocNvm[10] UDS_u8MtocNvm[11] UDS_u8MtocNvm[12] UDS_u8MtocNvm[13] UDS_u8MtocNvm[14] UDS_u8MtocNvm[15] UDS_u8MtocNvm[16] UDS_u8MtocNvm[1] UDS_u8MtocNvm[2] UDS_u8MtocNvm[3] UDS_u8MtocNvm[4] UDS_u8MtocNvm[5] UDS_u8MtocNvm[6] UDS_u8MtocNvm[7] UDS_u8MtocNvm[8] UDS_u8MtocNvm[9] UDS_u8MtocNvm_def UDS_u8MtocNvm_def[0] UDS_u8MtocNvm_def[10] UDS_u8MtocNvm_def[11] UDS_u8MtocNvm_def[12] UDS_u8MtocNvm_def[13] UDS_u8MtocNvm_def[14] UDS_u8MtocNvm_def[15] UDS_u8MtocNvm_def[16] UDS_u8MtocNvm_def[1] UDS_u8MtocNvm_def[2] UDS_u8MtocNvm_def[3] UDS_u8MtocNvm_def[4] UDS_u8MtocNvm_def[5] UDS_u8MtocNvm_def[6] UDS_u8MtocNvm_def[7] UDS_u8MtocNvm_def[8] UDS_u8MtocNvm_def[9] UDS_u8ResetRequestedMode /end OUT_MEASUREMENT
/end FUNCTION
/begin FUNCTION VADC ""
 /begin DEF_CHARACTERISTIC VADC_aku16MaxThrdGrp VADC_aku16MinThrdGrp VADC_ku16MaxThrdGlobal VADC_ku16MinThrdGlobal /end DEF_CHARACTERISTIC
/end FUNCTION
/begin FUNCTION VSI ""
 /begin DEF_CHARACTERISTIC VSI_bBenchFrameRxChkOffC VSI_u16Cal1OverCurThBatC VSI_u16Cal1OverCurThMotC VSI_u16Cal1OverVoltVbatThC VSI_u16Cal1PwmDeadtimeC VSI_u16Cal1PwmFreqC VSI_u16Cal1PwmInitValUlC VSI_u16Cal1PwmInitValUrC VSI_u16Cal1PwmInitValVlC VSI_u16Cal1PwmInitValVrC VSI_u16Cal1PwmInitValWlC VSI_u16Cal1PwmInitValWrC VSI_u16Cal1SynchroDelayC VSI_u32SafeTreatDelayC VSI_u32TimeoutCsC VSI_u32TimeoutEmailC VSI_u32TimeoutSafeTcalcC VSI_u32TimeoutSyncPosC VSI_u32TimeoutTcalcC /end DEF_CHARACTERISTIC
 /begin OUT_MEASUREMENT VSI_bSoftOvCurrPhsUFlg VSI_bSoftOvCurrPhsVFlg VSI_bSoftOvCurrPhsWFlg VSI_u8IdTx /end OUT_MEASUREMENT
/end FUNCTION
/begin GROUP Acquisitions "Acquisitions_GROUP" ROOT /begin FUNCTION_LIST HARD MAIN /end FUNCTION_LIST /end GROUP
/begin GROUP Application "Application_GROUP" ROOT /begin FUNCTION_LIST ESM HARD MAIN SCU VADC /end FUNCTION_LIST /end GROUP
/begin GROUP AutoMSG_Rx10_GW_ESC2 "AutoMSG_Rx10_GW_ESC2_GROUP" ROOT /begin FUNCTION_LIST MAIN /end FUNCTION_LIST /end GROUP
/begin GROUP AutoMSG_Rx11_GW_ESC_WheelSpd "AutoMSG_Rx11_GW_ESC_WheelSpd_GROUP" ROOT /begin FUNCTION_LIST MAIN /end FUNCTION_LIST /end GROUP
/begin GROUP AutoMSG_Rx12_TBOX_OTAInfo "AutoMSG_Rx12_TBOX_OTAInfo_GROUP" ROOT /begin FUNCTION_LIST MAIN /end FUNCTION_LIST /end GROUP
/begin GROUP AutoMSG_Rx13_GW_IVI "AutoMSG_Rx13_GW_IVI_GROUP" ROOT /begin FUNCTION_LIST MAIN /end FUNCTION_LIST /end GROUP
/begin GROUP AutoMSG_Rx14_AC1 "AutoMSG_Rx14_AC1_GROUP" ROOT /begin FUNCTION_LIST MAIN /end FUNCTION_LIST /end GROUP
/begin GROUP AutoMSG_Rx15_GW_TBOX_Time "AutoMSG_Rx15_GW_TBOX_Time_GROUP" ROOT /begin FUNCTION_LIST MAIN /end FUNCTION_LIST /end GROUP
/begin GROUP AutoMSG_Rx16_BMS1 "AutoMSG_Rx16_BMS1_GROUP" ROOT /begin FUNCTION_LIST MAIN /end FUNCTION_LIST /end GROUP
/begin GROUP AutoMSG_Rx17_BMS4 "AutoMSG_Rx17_BMS4_GROUP" ROOT /begin FUNCTION_LIST MAIN /end FUNCTION_LIST /end GROUP
/begin GROUP AutoMSG_Rx18_BMS3 "AutoMSG_Rx18_BMS3_GROUP" ROOT /begin FUNCTION_LIST MAIN /end FUNCTION_LIST /end GROUP
/begin GROUP AutoMSG_Rx19_BMS7 "AutoMSG_Rx19_BMS7_GROUP" ROOT /begin FUNCTION_LIST MAIN /end FUNCTION_LIST /end GROUP
/begin GROUP AutoMSG_Rx1_EMS0 "AutoMSG_Rx1_EMS0_GROUP" ROOT /begin FUNCTION_LIST MAIN /end FUNCTION_LIST /end GROUP
/begin GROUP AutoMSG_Rx20_OPC1 "AutoMSG_Rx20_OPC1_GROUP" ROOT /begin FUNCTION_LIST MAIN /end FUNCTION_LIST /end GROUP
/begin GROUP AutoMSG_Rx21_VCU_AccPedal "AutoMSG_Rx21_VCU_AccPedal_GROUP" ROOT /begin FUNCTION_LIST MAIN /end FUNCTION_LIST /end GROUP
/begin GROUP AutoMSG_Rx22_VCU2 "AutoMSG_Rx22_VCU2_GROUP" ROOT /begin FUNCTION_LIST MAIN /end FUNCTION_LIST /end GROUP
/begin GROUP AutoMSG_Rx23_VCU_MTCU "AutoMSG_Rx23_VCU_MTCU_GROUP" ROOT /begin FUNCTION_LIST MAIN /end FUNCTION_LIST /end GROUP
/begin GROUP AutoMSG_Rx24_VCUtoDisplay "AutoMSG_Rx24_VCUtoDisplay_GROUP" ROOT /begin FUNCTION_LIST MAIN /end FUNCTION_LIST /end GROUP
/begin GROUP AutoMSG_Rx25_VCUCtrlMotor "AutoMSG_Rx25_VCUCtrlMotor_GROUP" ROOT /begin FUNCTION_LIST MAIN /end FUNCTION_LIST /end GROUP
/begin GROUP AutoMSG_Rx26_VCUCtrlDCDC "AutoMSG_Rx26_VCUCtrlDCDC_GROUP" ROOT /begin FUNCTION_LIST MAIN /end FUNCTION_LIST /end GROUP
/begin GROUP AutoMSG_Rx27 "AutoMSG_Rx27_GROUP" ROOT /begin FUNCTION_LIST MAIN /end FUNCTION_LIST /end GROUP
/begin GROUP AutoMSG_Rx2_EMS1 "AutoMSG_Rx2_EMS1_GROUP" ROOT /begin FUNCTION_LIST MAIN /end FUNCTION_LIST /end GROUP
/begin GROUP AutoMSG_Rx3_EMS2 "AutoMSG_Rx3_EMS2_GROUP" ROOT /begin FUNCTION_LIST MAIN /end FUNCTION_LIST /end GROUP
/begin GROUP AutoMSG_Rx4_EMS7 "AutoMSG_Rx4_EMS7_GROUP" ROOT /begin FUNCTION_LIST MAIN /end FUNCTION_LIST /end GROUP
/begin GROUP AutoMSG_Rx5_EMS8 "AutoMSG_Rx5_EMS8_GROUP" ROOT /begin FUNCTION_LIST MAIN /end FUNCTION_LIST /end GROUP
/begin GROUP AutoMSG_Rx6_EMS_P3 "AutoMSG_Rx6_EMS_P3_GROUP" ROOT /begin FUNCTION_LIST MAIN /end FUNCTION_LIST /end GROUP
/begin GROUP AutoMSG_Rx7_IBCM3 "AutoMSG_Rx7_IBCM3_GROUP" ROOT /begin FUNCTION_LIST MAIN /end FUNCTION_LIST /end GROUP
/begin GROUP AutoMSG_Rx8_IBCM6 "AutoMSG_Rx8_IBCM6_GROUP" ROOT /begin FUNCTION_LIST MAIN /end FUNCTION_LIST /end GROUP
/begin GROUP AutoMSG_Rx9_IBCM_IMMO "AutoMSG_Rx9_IBCM_IMMO_GROUP" ROOT /begin FUNCTION_LIST MAIN /end FUNCTION_LIST /end GROUP
/begin GROUP AutoMSG_Tx10_MCU1 "AutoMSG_Tx10_MCU1_GROUP" ROOT /begin FUNCTION_LIST MAIN /end FUNCTION_LIST /end GROUP
/begin GROUP AutoMSG_Tx11_MCU2 "AutoMSG_Tx11_MCU2_GROUP" ROOT /begin FUNCTION_LIST MAIN /end FUNCTION_LIST /end GROUP
/begin GROUP AutoMSG_Tx12_MCU3 "AutoMSG_Tx12_MCU3_GROUP" ROOT /begin FUNCTION_LIST MAIN /end FUNCTION_LIST /end GROUP
/begin GROUP AutoMSG_Tx13_MCU4 "AutoMSG_Tx13_MCU4_GROUP" ROOT /begin FUNCTION_LIST MAIN /end FUNCTION_LIST /end GROUP
/begin GROUP AutoMSG_Tx14_MTCU_HTCU1 "AutoMSG_Tx14_MTCU_HTCU1_GROUP" ROOT /begin FUNCTION_LIST MAIN /end FUNCTION_LIST /end GROUP
/begin GROUP AutoMSG_Tx15_HTCU2 "AutoMSG_Tx15_HTCU2_GROUP" ROOT /begin FUNCTION_LIST MAIN /end FUNCTION_LIST /end GROUP
/begin GROUP AutoMSG_Tx16_MTCU_DevelopFrame "AutoMSG_Tx16_MTCU_DevelopFrame_GROUP" ROOT /begin FUNCTION_LIST MAIN /end FUNCTION_LIST /end GROUP
/begin GROUP AutoMSG_Tx17_GCU2 "AutoMSG_Tx17_GCU2_GROUP" ROOT /begin FUNCTION_LIST MAIN /end FUNCTION_LIST /end GROUP
/begin GROUP AutoMSG_Tx18_MTCU_OPC_test6 "AutoMSG_Tx18_MTCU_OPC_test6_GROUP" ROOT /begin FUNCTION_LIST MAIN /end FUNCTION_LIST /end GROUP
/begin GROUP AutoMSG_Tx1_MTCU_IMMO "AutoMSG_Tx1_MTCU_IMMO_GROUP" ROOT /begin FUNCTION_LIST MAIN /end FUNCTION_LIST /end GROUP
/begin GROUP AutoMSG_Tx2_MTCU_EngineAuthResul "AutoMSG_Tx2_MTCU_EngineAuthResul_GROUP" ROOT /begin FUNCTION_LIST MAIN /end FUNCTION_LIST /end GROUP
/begin GROUP AutoMSG_Tx3_GCU1 "AutoMSG_Tx3_GCU1_GROUP" ROOT /begin FUNCTION_LIST MAIN /end FUNCTION_LIST /end GROUP
/begin GROUP AutoMSG_Tx4_GCU3 "AutoMSG_Tx4_GCU3_GROUP" ROOT /begin FUNCTION_LIST MAIN /end FUNCTION_LIST /end GROUP
/begin GROUP AutoMSG_Tx5_GCU4 "AutoMSG_Tx5_GCU4_GROUP" ROOT /begin FUNCTION_LIST MAIN /end FUNCTION_LIST /end GROUP
/begin GROUP AutoMSG_Tx6_MCU_Fault "AutoMSG_Tx6_MCU_Fault_GROUP" ROOT /begin FUNCTION_LIST MAIN /end FUNCTION_LIST /end GROUP
/begin GROUP AutoMSG_Tx7_GCU_Fault "AutoMSG_Tx7_GCU_Fault_GROUP" ROOT /begin FUNCTION_LIST MAIN /end FUNCTION_LIST /end GROUP
/begin GROUP AutoMSG_Tx8_MTCUGCU "AutoMSG_Tx8_MTCUGCU_GROUP" ROOT /begin FUNCTION_LIST MAIN /end FUNCTION_LIST /end GROUP
/begin GROUP AutoMSG_Tx9_MTCUMCU "AutoMSG_Tx9_MTCUMCU_GROUP" ROOT /begin FUNCTION_LIST MAIN /end FUNCTION_LIST /end GROUP
/begin GROUP BLDC "BLDC_GROUP" ROOT /begin FUNCTION_LIST BLDC /end FUNCTION_LIST /end GROUP
/begin GROUP BSW "BSW_GROUP" ROOT /begin FUNCTION_LIST BSW FAIL UDS /end FUNCTION_LIST /end GROUP
/begin GROUP CALUSR "CALUSR_GROUP" ROOT /begin FUNCTION_LIST CALUSR /end FUNCTION_LIST /end GROUP
/begin GROUP CCU6 "CCU6_GROUP" ROOT /begin FUNCTION_LIST CCU6 /end FUNCTION_LIST /end GROUP
/begin GROUP COMMUSR "COMMUSR_GROUP" ROOT /begin FUNCTION_LIST COMMUSR /end FUNCTION_LIST /end GROUP
/begin GROUP Calibration "Calibration_GROUP" /begin SUB_GROUP DEV /end SUB_GROUP /end GROUP
/begin GROUP Com "Com_GROUP" ROOT /begin FUNCTION_LIST MAIN /end FUNCTION_LIST /end GROUP
/begin GROUP Communication "Communication_GROUP" /begin FUNCTION_LIST BLDC CCU6 RTE /end FUNCTION_LIST /end GROUP
/begin GROUP DCU_1 "DCU_1_GROUP" /begin SUB_GROUP Communication /end SUB_GROUP /end GROUP
/begin GROUP DEV "DEV_GROUP" /begin FUNCTION_LIST MAIN /end FUNCTION_LIST /end GROUP
/begin GROUP DFLASH "DFLASH_GROUP" ROOT /begin FUNCTION_LIST DFLASH /end FUNCTION_LIST /end GROUP
/begin GROUP DSM "DSM_GROUP" /begin FUNCTION_LIST FAULT_FF /end FUNCTION_LIST /end GROUP
/begin GROUP Develop "Develop_GROUP" /begin FUNCTION_LIST MAIN /end FUNCTION_LIST /end GROUP
/begin GROUP Development_z "Development_z_GROUP" ROOT /begin FUNCTION_LIST DEVHAL SPY /end FUNCTION_LIST /end GROUP
/begin GROUP Developpement "Developpement_GROUP" ROOT /begin FUNCTION_LIST BSW HARD UDS VSI /end FUNCTION_LIST /end GROUP
/begin GROUP Diagnostic "Diagnostic_GROUP" ROOT /begin FUNCTION_LIST BSW DSM FAULT GDSM MAIN /end FUNCTION_LIST /end GROUP
/begin GROUP Divers "Divers_GROUP" ROOT /begin FUNCTION_LIST MAIN SWFAIL /end FUNCTION_LIST /end GROUP
/begin GROUP Driver "Driver_GROUP" ROOT /begin FUNCTION_LIST BLDC COMMUSR MAIN RES SBC STFSRV VSI /end FUNCTION_LIST /end GROUP
/begin GROUP EAS "EAS_GROUP" ROOT /begin FUNCTION_LIST EAS TJA1145 /end FUNCTION_LIST /end GROUP
/begin GROUP FAIL "FAIL_GROUP" ROOT /begin FUNCTION_LIST FAIL /end FUNCTION_LIST /end GROUP
/begin GROUP FAULT_FF "FAULT_FF_GROUP" ROOT /begin SUB_GROUP DSM /end SUB_GROUP /end GROUP
/begin GROUP FRecord "FRecord_GROUP" ROOT /begin FUNCTION_LIST FRecord /end FUNCTION_LIST /end GROUP
/begin GROUP G2M_3 "G2M_3_GROUP" /begin SUB_GROUP MAIN /end SUB_GROUP /end GROUP
/begin GROUP GCCU6 "GCCU6_GROUP" ROOT /begin FUNCTION_LIST GCCU6 /end FUNCTION_LIST /end GROUP
/begin GROUP MAIN "MAIN_GROUP" /begin FUNCTION_LIST MAIN /end FUNCTION_LIST /end GROUP
/begin GROUP Main "Main_GROUP" ROOT /begin FUNCTION_LIST BSW MAIN SPY /end FUNCTION_LIST /end GROUP
/begin GROUP Miscellaneous "Miscellaneous_GROUP" ROOT /begin FUNCTION_LIST RTMCLD /end FUNCTION_LIST /end GROUP
/begin GROUP Noyau "Noyau_GROUP" ROOT /begin FUNCTION_LIST RTMTSK /end FUNCTION_LIST /end GROUP
/begin GROUP NvM "NvM_GROUP" ROOT /begin FUNCTION_LIST BSW /end FUNCTION_LIST /end GROUP
/begin GROUP OBD "OBD_GROUP" ROOT /begin FUNCTION_LIST OBD /end FUNCTION_LIST /end GROUP
/begin GROUP Physical "Physical_GROUP" ROOT /begin SUB_GROUP DCU_1 /end SUB_GROUP /end GROUP
/begin GROUP RSTSRV "RSTSRV_GROUP" ROOT /begin FUNCTION_LIST RSTSRV /end FUNCTION_LIST /end GROUP
/begin GROUP RTE "RTE_GROUP" ROOT /begin FUNCTION_LIST RTE /end FUNCTION_LIST /end GROUP
/begin GROUP Raw "Raw_GROUP" ROOT /begin SUB_GROUP Calibration G2M_3 /end SUB_GROUP /end GROUP
/begin GROUP RxChecksum "RxChecksum_GROUP" ROOT /begin FUNCTION_LIST BSW /end FUNCTION_LIST /end GROUP
/begin GROUP TJA1145 "TJA1145_GROUP" ROOT /begin FUNCTION_LIST TJA1145 /end FUNCTION_LIST /end GROUP
/begin GROUP TLE9180 "TLE9180_GROUP" ROOT /begin FUNCTION_LIST TLE9180 /end FUNCTION_LIST /end GROUP
/begin GROUP TOutFlag "TOutFlag_GROUP" ROOT /begin FUNCTION_LIST BSW /end FUNCTION_LIST /end GROUP
/begin GROUP TST "TST_GROUP" ROOT /begin FUNCTION_LIST HARD /end FUNCTION_LIST /end GROUP
/begin GROUP Tsk "Tsk_GROUP" ROOT /begin SUB_GROUP Develop /end SUB_GROUP /end GROUP
/begin GROUP UDS "UDS_GROUP" ROOT /begin FUNCTION_LIST UDS /end FUNCTION_LIST /end GROUP
/begin GROUP miscellaneous "miscellaneous_GROUP" ROOT /begin FUNCTION_LIST DET /end FUNCTION_LIST /end GROUP
/begin GROUP miscellenious "miscellenious_GROUP" ROOT /begin FUNCTION_LIST DET /end FUNCTION_LIST /end GROUP
/begin COMPU_METHOD ESM_EsmMode_conv "" TAB_VERB "%8.4" "." COMPU_TAB_REF ESM_EsmMode_table /end COMPU_METHOD
/begin COMPU_VTAB ESM_EsmMode_table "" TAB_VERB 2 1 "ESM_ESM_MODE_NF" 4 "ESM_ESM_MODE_FT" /end COMPU_VTAB
/begin COMPU_METHOD GESM_EsmMode_conv "" TAB_VERB "%8.4" "." COMPU_TAB_REF GESM_EsmMode_table /end COMPU_METHOD
/begin COMPU_VTAB GESM_EsmMode_table "" TAB_VERB 2 1 "GESM_ESM_MODE_NF" 4 "GESM_ESM_MODE_FT" /end COMPU_VTAB
/end MODULE
/end PROJECT
