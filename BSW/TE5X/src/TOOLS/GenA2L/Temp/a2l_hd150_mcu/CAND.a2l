/******************************************************************************
* ASAP2 file: CAND.a2l
* Code generation for model "CAND.mdl".
* Model version : 1.17
* Simulink Coder version : 8.1 (R2011b) 08-Jul-2011
* C source code generated on : Thu Mar 02 11:07:16 2023
* Target selection: autosar_servicePort.tlc
* Embedded hardware selection: Freescale->32-bit PowerPC
* Code generation objectives: Unspecified
* Validation result: Not run
* (add additional file header information here)
******************************************************************************/ ASAP2_VERSION 1 31
/* Version 1.31 */
/begin PROJECT ProjectName "Project Comment Goes Here"
/begin HEADER "Header Comments go here" /end HEADER
/begin MODULE ModuleName "Module Comment Goes Here"
/begin MOD_PAR "MOD PAR Comment Goes Here" /end MOD_PAR
/begin MOD_COMMON "Mod Common Comment Here" BYTE_ORDER MSB_FIRST /end MOD_COMMON
/begin RECORD_LAYOUT Scalar_BOOLEAN FNC_VALUES 1 UBYTE COLUMN_DIR DIRECT /end RECORD_LAYOUT
/begin RECORD_LAYOUT Scalar_UBYTE FNC_VALUES 1 UBYTE COLUMN_DIR DIRECT /end RECORD_LAYOUT
/begin RECORD_LAYOUT Scalar_BYTE FNC_VALUES 1 SBYTE COLUMN_DIR DIRECT /end RECORD_LAYOUT
/begin RECORD_LAYOUT Scalar_UWORD FNC_VALUES 1 UWORD COLUMN_DIR DIRECT /end RECORD_LAYOUT
/begin RECORD_LAYOUT Scalar_SWORD FNC_VALUES 1 SWORD COLUMN_DIR DIRECT /end RECORD_LAYOUT
/begin RECORD_LAYOUT Scalar_ULONG FNC_VALUES 1 ULONG COLUMN_DIR DIRECT /end RECORD_LAYOUT
/begin RECORD_LAYOUT Scalar_LONG FNC_VALUES 1 SLONG COLUMN_DIR DIRECT /end RECORD_LAYOUT
/begin RECORD_LAYOUT Scalar_FLOAT32_IEEE FNC_VALUES 1 FLOAT32_IEEE COLUMN_DIR DIRECT /end RECORD_LAYOUT
/begin RECORD_LAYOUT Scalar_FLOAT64_IEEE FNC_VALUES 1 FLOAT64_IEEE COLUMN_DIR DIRECT /end RECORD_LAYOUT
/begin RECORD_LAYOUT Lookup1D_BYTE FNC_VALUES 1 SBYTE COLUMN_DIR DIRECT /end RECORD_LAYOUT
/begin RECORD_LAYOUT Lookup1D_X_BYTE AXIS_PTS_X 1 SBYTE INDEX_INCR DIRECT /end RECORD_LAYOUT
/begin RECORD_LAYOUT Lookup1D_UBYTE FNC_VALUES 1 UBYTE COLUMN_DIR DIRECT /end RECORD_LAYOUT
/begin RECORD_LAYOUT Lookup1D_X_UBYTE AXIS_PTS_X 1 UBYTE INDEX_INCR DIRECT /end RECORD_LAYOUT
/begin RECORD_LAYOUT Lookup1D_UWORD FNC_VALUES 1 UWORD COLUMN_DIR DIRECT /end RECORD_LAYOUT
/begin RECORD_LAYOUT Lookup1D_X_UWORD AXIS_PTS_X 1 UWORD INDEX_INCR DIRECT /end RECORD_LAYOUT
/begin RECORD_LAYOUT Lookup1D_WORD FNC_VALUES 1 SWORD COLUMN_DIR DIRECT /end RECORD_LAYOUT
/begin RECORD_LAYOUT Lookup1D_X_WORD AXIS_PTS_X 1 SWORD INDEX_INCR DIRECT /end RECORD_LAYOUT
/begin RECORD_LAYOUT Lookup1D_ULONG FNC_VALUES 1 ULONG COLUMN_DIR DIRECT /end RECORD_LAYOUT
/begin RECORD_LAYOUT Lookup1D_X_ULONG AXIS_PTS_X 1 ULONG INDEX_INCR DIRECT /end RECORD_LAYOUT
/begin RECORD_LAYOUT Lookup1D_SLONG FNC_VALUES 1 SLONG COLUMN_DIR DIRECT /end RECORD_LAYOUT
/begin RECORD_LAYOUT Lookup1D_X_LONG AXIS_PTS_X 1 SLONG INDEX_INCR DIRECT /end RECORD_LAYOUT
/begin RECORD_LAYOUT Lookup1D_FLOAT32_IEEE FNC_VALUES 1 FLOAT32_IEEE COLUMN_DIR DIRECT /end RECORD_LAYOUT
/begin RECORD_LAYOUT Lookup1D_X_FLOAT32_IEEE AXIS_PTS_X 1 FLOAT32_IEEE INDEX_INCR DIRECT /end RECORD_LAYOUT
/begin RECORD_LAYOUT Lookup1D_FLOAT64_IEEE FNC_VALUES 1 FLOAT64_IEEE COLUMN_DIR DIRECT /end RECORD_LAYOUT
/begin RECORD_LAYOUT Lookup1D_X_FLOAT64_IEEE AXIS_PTS_X 1 FLOAT64_IEEE INDEX_INCR DIRECT /end RECORD_LAYOUT
/begin RECORD_LAYOUT Lookup2D_UBYTE FNC_VALUES 1 UBYTE COLUMN_DIR DIRECT /end RECORD_LAYOUT
/begin RECORD_LAYOUT Lookup2D_X_UBYTE AXIS_PTS_X 1 UBYTE INDEX_INCR DIRECT /end RECORD_LAYOUT
/begin RECORD_LAYOUT Lookup2D_BYTE FNC_VALUES 1 SBYTE COLUMN_DIR DIRECT /end RECORD_LAYOUT
/begin RECORD_LAYOUT Lookup2D_X_BYTE AXIS_PTS_X 1 SBYTE INDEX_INCR DIRECT /end RECORD_LAYOUT
/begin RECORD_LAYOUT Lookup2D_UWORD FNC_VALUES 1 UWORD COLUMN_DIR DIRECT /end RECORD_LAYOUT
/begin RECORD_LAYOUT Lookup2D_X_UWORD AXIS_PTS_X 1 UWORD INDEX_INCR DIRECT /end RECORD_LAYOUT
/begin RECORD_LAYOUT Lookup2D_WORD FNC_VALUES 1 SWORD COLUMN_DIR DIRECT /end RECORD_LAYOUT
/begin RECORD_LAYOUT Lookup2D_X_WORD AXIS_PTS_X 1 SWORD INDEX_INCR DIRECT /end RECORD_LAYOUT
/begin RECORD_LAYOUT Lookup2D_ULONG FNC_VALUES 1 ULONG COLUMN_DIR DIRECT /end RECORD_LAYOUT
/begin RECORD_LAYOUT Lookup2D_X_ULONG AXIS_PTS_X 1 ULONG INDEX_INCR DIRECT /end RECORD_LAYOUT
/begin RECORD_LAYOUT Lookup2D_LONG FNC_VALUES 1 SLONG COLUMN_DIR DIRECT /end RECORD_LAYOUT
/begin RECORD_LAYOUT Lookup2D_X_LONG AXIS_PTS_X 1 SLONG INDEX_INCR DIRECT /end RECORD_LAYOUT
/begin RECORD_LAYOUT Lookup2D_FLOAT32_IEEE FNC_VALUES 1 FLOAT32_IEEE COLUMN_DIR DIRECT /end RECORD_LAYOUT
/begin RECORD_LAYOUT Lookup2D_X_FLOAT32_IEEE AXIS_PTS_X 1 FLOAT32_IEEE INDEX_INCR DIRECT /end RECORD_LAYOUT
/begin RECORD_LAYOUT Lookup2D_FLOAT64_IEEE FNC_VALUES 1 FLOAT64_IEEE COLUMN_DIR DIRECT /end RECORD_LAYOUT
/begin RECORD_LAYOUT Lookup2D_X_FLOAT64_IEEE AXIS_PTS_X 1 FLOAT64_IEEE INDEX_INCR DIRECT /end RECORD_LAYOUT
/begin CHARACTERISTIC CANDke_Cnt_ID_VCU_DiagCounts "Number of diagnostic cycles before reporting PASS to DEM." VALUE 0x0000 /* @ECU_Address@CANDke_Cnt_ID_VCU_DiagCounts@ */ Scalar_UWORD 0 CM_T_Cnt_Num_1_1_u16 0.0 65535.0 /end CHARACTERISTIC
/begin CHARACTERISTIC CANDke_Cnt_VCUFAULT_DiagCounts "Diagagnostic evaluations before PASS" VALUE 0x0000 /* @ECU_Address@CANDke_Cnt_VCUFAULT_DiagCounts@ */ Scalar_UWORD 0 CM_T_Cnt_Num_1_1_u16 0.0 65535.0 /end CHARACTERISTIC
/begin CHARACTERISTIC CANDke_r_ID_VCU_RatioToFail "Number of failed cycles before reporting FAIL to DEM. As a ratio of CANDke_Cnt_ID_VCU_DiagCounts." VALUE 0x0000 /* @ECU_Address@CANDke_r_ID_VCU_RatioToFail@ */ Scalar_UWORD 0 CM_T_r_NA_256_1_u16 0.0 1.0 EXTENDED_LIMITS 0.0 255.99609375 /end CHARACTERISTIC
/begin CHARACTERISTIC CANDke_r_VCUFAULT_RatioToFail "Number of failed diagnostic evaluations before FAIL. As a ratio to CANDke_Cnt_VCUFAULT_DiagCounts." VALUE 0x0000 /* @ECU_Address@CANDke_r_VCUFAULT_RatioToFail@ */ Scalar_UWORD 0 CM_T_r_NA_256_1_u16 0.0 1.0 EXTENDED_LIMITS 0.0 255.99609375 /end CHARACTERISTIC
/begin CHARACTERISTIC CANDie_y_HTCU_Fault_OV "Override value for the HTCU_Fault signal." VALUE 0x0000 /* @ECU_Address@CANDie_y_HTCU_Fault_OV@ */ Scalar_UBYTE 0 CM_T_y_BitField8 0.0 255.0 /end CHARACTERISTIC
/begin CHARACTERISTIC CANDie_y_HTCU_State_OV "Override value for the HTCU_State signal." VALUE 0x0000 /* @ECU_Address@CANDie_y_HTCU_State_OV@ */ Scalar_UBYTE 0 CM_T_y_BitField8 0.0 1.0 EXTENDED_LIMITS 0.0 255.0 /end CHARACTERISTIC
/begin CHARACTERISTIC CANDke_Cnt_CtrlMon_10ms_Index "This is the index reported to the control flow function. It should be unique and in the correct order of execution according to the scheduler." VALUE 0x0000 /* @ECU_Address@CANDke_Cnt_CtrlMon_10ms_Index@ */ Scalar_UBYTE 0 CM_T_Cnt_Num_1_1_u8 0.0 255.0 /end CHARACTERISTIC
/begin CHARACTERISTIC CANDke_Cnt_ID_ClutchCmdMaxLim "Maximum allowed value for the clutch command data." VALUE 0x0000 /* @ECU_Address@CANDke_Cnt_ID_ClutchCmdMaxLim@ */ Scalar_UBYTE 0 CM_T_Cnt_Num_1_1_u8 0.0 255.0 /end CHARACTERISTIC
/begin CHARACTERISTIC CANDke_Cnt_ID_ClutchCmdMinLim "Minimum allowed value for the clutch command data." VALUE 0x0000 /* @ECU_Address@CANDke_Cnt_ID_ClutchCmdMinLim@ */ Scalar_UBYTE 0 CM_T_Cnt_Num_1_1_u8 0.0 255.0 /end CHARACTERISTIC
/begin CHARACTERISTIC CANDke_Cnt_VCUFAULT_FaultLim "If bit 6-7 typecast into a number is greater or equal to this value a fault shall be detected." VALUE 0x0000 /* @ECU_Address@CANDke_Cnt_VCUFAULT_FaultLim@ */ Scalar_UBYTE 0 CM_T_Cnt_Num_1_1_u8 0.0 255.0 /end CHARACTERISTIC
/begin CHARACTERISTIC CANDke_y_BitPat_CCPClear "Bit pattern for ForceOilLubricationToSafeLubricationMode" VALUE 0x0000 /* @ECU_Address@CANDke_y_BitPat_CCPClear@ */ Scalar_UBYTE 0 CM_T_y_BitField8 0.0 255.0 /end CHARACTERISTIC
/begin CHARACTERISTIC CANDke_y_BitPat_CutFuel "bitpattern" VALUE 0x0000 /* @ECU_Address@CANDke_y_BitPat_CutFuel@ */ Scalar_UBYTE 0 CM_T_y_BitField8 0 255 /end CHARACTERISTIC
/begin CHARACTERISTIC CANDke_y_BitPat_EngStop "bitpattern" VALUE 0x0000 /* @ECU_Address@CANDke_y_BitPat_EngStop@ */ Scalar_UBYTE 0 CM_T_y_BitField8 0 255 /end CHARACTERISTIC
/begin CHARACTERISTIC CANDke_y_BitPat_FCNGear "bitpattern" VALUE 0x0000 /* @ECU_Address@CANDke_y_BitPat_FCNGear@ */ Scalar_UBYTE 0 CM_T_y_BitField8 0 255 /end CHARACTERISTIC
/begin CHARACTERISTIC CANDke_y_BitPat_FCOO "Bitpattern for ForceClutchOddOpen" VALUE 0x0000 /* @ECU_Address@CANDke_y_BitPat_FCOO@ */ Scalar_UBYTE 0 CM_T_y_BitField8 0.0 255.0 /end CHARACTERISTIC
/begin CHARACTERISTIC CANDke_y_BitPat_FCOOnorecover "bitpattern" VALUE 0x0000 /* @ECU_Address@CANDke_y_BitPat_FCOOnorecover@ */ Scalar_UBYTE 0 CM_T_y_BitField8 0 255 /end CHARACTERISTIC
/begin CHARACTERISTIC CANDke_y_BitPat_FICTO "Bitpattern for ForceIOCControlToOff" VALUE 0x0000 /* @ECU_Address@CANDke_y_BitPat_FICTO@ */ Scalar_UBYTE 0 CM_T_y_BitField8 0.0 255.0 /end CHARACTERISTIC
/begin CHARACTERISTIC CANDke_y_BitPat_FOCTSCM "Bit pattern for ForceOilCoolingToSafeCoolingMode" VALUE 0x0000 /* @ECU_Address@CANDke_y_BitPat_FOCTSCM@ */ Scalar_UBYTE 0 CM_T_y_BitField8 0.0 255.0 /end CHARACTERISTIC
/begin CHARACTERISTIC CANDke_y_BitPat_HTCU_State "Value for HTCU_State when any of the inputs are TRUE." VALUE 0x0000 /* @ECU_Address@CANDke_y_BitPat_HTCU_State@ */ Scalar_UBYTE 0 CM_T_y_BitField8 0.0 255.0 /end CHARACTERISTIC
/begin CHARACTERISTIC CANDke_y_BitPat_LimitCapability "bitpattern" VALUE 0x0000 /* @ECU_Address@CANDke_y_BitPat_LimitCapability@ */ Scalar_UBYTE 0 CM_T_y_BitField8 0 255 /end CHARACTERISTIC
/begin CHARACTERISTIC CANDke_y_BitPat_LimitSpeed "bitpattern" VALUE 0x0000 /* @ECU_Address@CANDke_y_BitPat_LimitSpeed@ */ Scalar_UBYTE 0 CM_T_y_BitField8 0 255 /end CHARACTERISTIC
/begin CHARACTERISTIC CANDke_y_BitPat_OilTempCrit "Bit pattern for high oil temperature critical signal." VALUE 0x0000 /* @ECU_Address@CANDke_y_BitPat_OilTempCrit@ */ Scalar_UBYTE 0 CM_T_y_BitField8 0.0 255.0 /end CHARACTERISTIC
/begin CHARACTERISTIC CANDke_y_BitPat_OilTempWarn "Bit pattern for high oil temperature warning signal." VALUE 0x0000 /* @ECU_Address@CANDke_y_BitPat_OilTempWarn@ */ Scalar_UBYTE 0 CM_T_y_BitField8 0.0 255.0 /end CHARACTERISTIC
/begin CHARACTERISTIC CANDie_b_ATFailure_OB "Override boolean for ATFaliure" VALUE 0x0000 /* @ECU_Address@CANDie_b_ATFailure_OB@ */ Scalar_BOOLEAN 0 CM_T_BOOLEAN 0.0 1.0 /end CHARACTERISTIC
/begin CHARACTERISTIC CANDie_b_ATFailure_OV "Override value for ATFaliure" VALUE 0x0000 /* @ECU_Address@CANDie_b_ATFailure_OV@ */ Scalar_BOOLEAN 0 CM_T_BOOLEAN 0.0 1.0 /end CHARACTERISTIC
/begin CHARACTERISTIC CANDie_b_CtrlMon_10ms_BlockReport "This override blocks the report of the execution to the monitoring system.
      Should be used during testing to verify correct behaviour of the monitoring system.
      " VALUE 0x0000 /* @ECU_Address@CANDie_b_CtrlMon_10ms_BlockReport@ */ Scalar_BOOLEAN 0 CM_T_BOOLEAN 0.0 1.0 /end CHARACTERISTIC
/begin CHARACTERISTIC CANDie_b_HTCU_Fault_OB "Override boolean for the HTCU_Fault signal." VALUE 0x0000 /* @ECU_Address@CANDie_b_HTCU_Fault_OB@ */ Scalar_BOOLEAN 0 CM_T_BOOLEAN 0.0 1.0 /end CHARACTERISTIC
/begin CHARACTERISTIC CANDie_b_HTCU_State_OB "Override boolean for the HTCU_State signal." VALUE 0x0000 /* @ECU_Address@CANDie_b_HTCU_State_OB@ */ Scalar_BOOLEAN 0 CM_T_BOOLEAN 0.0 1.0 /end CHARACTERISTIC
/begin CHARACTERISTIC CANDke_b_VCUFAULT_DiagEnbl "Enable boolean for the VCU internal fault diagnosis." VALUE 0x0000 /* @ECU_Address@CANDke_b_VCUFAULT_DiagEnbl@ */ Scalar_BOOLEAN 0 CM_T_BOOLEAN 0.0 1.0 /end CHARACTERISTIC
/begin CHARACTERISTIC CANDke_b_VCU_ID_DiagEnbl "Enable boolean for the invalid data diagnosis." VALUE 0x0000 /* @ECU_Address@CANDke_b_VCU_ID_DiagEnbl@ */ Scalar_BOOLEAN 0 CM_T_BOOLEAN 0.0 1.0 /end CHARACTERISTIC
/begin MEASUREMENT CANDve_Cnt_VCUFAULT_FailLim "Fail limit" UWORD CM_T_Cnt_Num_1_1_u16 0 0 0 65535 ECU_ADDRESS 0x0000 /* @ECU_Address@CANDve_Cnt_VCUFAULT_FailLim@ */ /end MEASUREMENT
/begin MEASUREMENT CANDve_Cnt_ID_FailLim "Fail limit for the invalid data diagnosis." UWORD CM_T_Cnt_Num_1_1_u16 0 0 0 65535 ECU_ADDRESS 0x0000 /* @ECU_Address@CANDve_Cnt_ID_FailLim@ */ /end MEASUREMENT
/begin MEASUREMENT CANDve_y_ResetByBSW "ResetByBSW event status" UBYTE CM_T_y_BitField8 0 0 0 255 ECU_ADDRESS 0x0000 /* @ECU_Address@CANDve_y_ResetByBSW@ */ /end MEASUREMENT
/begin MEASUREMENT CANDve_y_ResetByASW "ResetByASW event status" UBYTE CM_T_y_BitField8 0 0 0 255 ECU_ADDRESS 0x0000 /* @ECU_Address@CANDve_y_ResetByASW@ */ /end MEASUREMENT
/begin MEASUREMENT CANDve_y_ResetByHW "ResetByHW event status" UBYTE CM_T_y_BitField8 0 0 0 255 ECU_ADDRESS 0x0000 /* @ECU_Address@CANDve_y_ResetByHW@ */ /end MEASUREMENT
/begin MEASUREMENT CANDve_y_XCPBusOff "XCPBusOFF event status" UBYTE CM_T_y_BitField8 0 0 0 255 ECU_ADDRESS 0x0000 /* @ECU_Address@CANDve_y_XCPBusOff@ */ /end MEASUREMENT
/begin MEASUREMENT CANDve_b_VCUFAULT_FaultFound "A fault has been detected on the VCU" UBYTE CM_T_BOOLEAN 0 0 0 1 ECU_ADDRESS 0x0000 /* @ECU_Address@CANDve_b_VCUFAULT_FaultFound@ */ /end MEASUREMENT
/begin MEASUREMENT CANDve_b_ID_NotEqual "TRUE if the CAN signal and SWIN conversion does not match." UBYTE CM_T_BOOLEAN 0 0 0 1 ECU_ADDRESS 0x0000 /* @ECU_Address@CANDve_b_ID_NotEqual@ */ /end MEASUREMENT
/begin MEASUREMENT CANDve_b_ID_SWINsigOutOfRange "TRUE if the SWIN signal is outside accepted range." UBYTE CM_T_BOOLEAN 0 0 0 1 ECU_ADDRESS 0x0000 /* @ECU_Address@CANDve_b_ID_SWINsigOutOfRange@ */ /end MEASUREMENT
/begin MEASUREMENT CANDve_b_ID_CANsigOutOfRange "TRUE if the CAN signal is outside accepted range." UBYTE CM_T_BOOLEAN 0 0 0 1 ECU_ADDRESS 0x0000 /* @ECU_Address@CANDve_b_ID_CANsigOutOfRange@ */ /end MEASUREMENT
/begin MEASUREMENT CANDve_b_ID_FaultFound "TRUE if an invalid data fault has been found." UBYTE CM_T_BOOLEAN 0 0 0 1 ECU_ADDRESS 0x0000 /* @ECU_Address@CANDve_b_ID_FaultFound@ */ /end MEASUREMENT
/begin MEASUREMENT CANDve_Cnt_DiagCounts "Diagnostic counter for the invalid data diagnosis." UWORD CM_T_Cnt_Num_1_1_u16 0 0 0 65535 ECU_ADDRESS 0x0000 /* @ECU_Address@CANDve_Cnt_DiagCounts@ */ /end MEASUREMENT
/begin MEASUREMENT CANDve_Cnt_DiagFails "Fail counter for the invalid data diagnosis." UWORD CM_T_Cnt_Num_1_1_u16 0 0 0 65535 ECU_ADDRESS 0x0000 /* @ECU_Address@CANDve_Cnt_DiagFails@ */ /end MEASUREMENT
/begin MEASUREMENT CANDve_y_VCUFAULT_DiagCounts "counts" UWORD CM_T_Cnt_Num_1_1_u16 0 0 0 65535 ECU_ADDRESS 0x0000 /* @ECU_Address@CANDve_y_VCUFAULT_DiagCounts@ */ /end MEASUREMENT
/begin MEASUREMENT CANDve_y_VCUFAULT_DiagFails "fails" UWORD CM_T_Cnt_Num_1_1_u16 0 0 0 65535 ECU_ADDRESS 0x0000 /* @ECU_Address@CANDve_y_VCUFAULT_DiagFails@ */ /end MEASUREMENT
/begin MEASUREMENT CANDve_y_ID_Status "Status of the invalid data diagnosis." UBYTE CM_T_y_BitFieldDiagStatus 0 0 0 255 ECU_ADDRESS 0x0000 /* @ECU_Address@CANDve_y_ID_Status@ */ /end MEASUREMENT
/begin MEASUREMENT CANDve_y_Progress "Progress of the invalid data diagnosis." UBYTE CM_T_y_BitFieldDiagProgress 0 0 0 255 ECU_ADDRESS 0x0000 /* @ECU_Address@CANDve_y_Progress@ */ /end MEASUREMENT
/begin MEASUREMENT CANDve_y_VCUFAULT_Progress "progress" UBYTE CM_T_y_BitFieldDiagProgress 0 0 0 255 ECU_ADDRESS 0x0000 /* @ECU_Address@CANDve_y_VCUFAULT_Progress@ */ /end MEASUREMENT
/begin MEASUREMENT CANDve_y_VCUFAULT_Status "Status" UBYTE CM_T_y_BitFieldDiagStatus 0 0 0 255 ECU_ADDRESS 0x0000 /* @ECU_Address@CANDve_y_VCUFAULT_Status@ */ /end MEASUREMENT
/begin COMPU_METHOD CM_T_Cnt_Num_1_1_u16 "Q = V" RAT_FUNC "%5.0" "Num (counts)" COEFFS 0 1 0 0 0 1 /end COMPU_METHOD
/begin COMPU_METHOD CM_T_r_NA_256_1_u16 "Q = V*256.000000" RAT_FUNC "%11.8" "NA (none)" COEFFS 0 256 0 0 0 1 /end COMPU_METHOD
/begin COMPU_METHOD CM_T_y_BitField8 "Q = V" RAT_FUNC "%3.0" "BitField" COEFFS 0 1 0 0 0 1 /end COMPU_METHOD
/begin COMPU_METHOD CM_T_Cnt_Num_1_1_u8 "Q = V" RAT_FUNC "%3.0" "Num (counts)" COEFFS 0 1 0 0 0 1 /end COMPU_METHOD
/begin COMPU_METHOD CM_T_BOOLEAN "Q = V" RAT_FUNC "%1.0" "Bool" COEFFS 0 1 0 0 0 1 /end COMPU_METHOD
/begin COMPU_METHOD CM_T_y_BitFieldDiagStatus "Q = V" RAT_FUNC "%3.0" "BitField" COEFFS 0 1 0 0 0 1 /end COMPU_METHOD
/begin COMPU_METHOD CM_T_y_BitFieldDiagProgress "Q = V" RAT_FUNC "%3.0" "BitField" COEFFS 0 1 0 0 0 1 /end COMPU_METHOD
/end MODULE
/end PROJECT
/* (add any file trailer comments here) */
/* EOF CAND.a2l */
