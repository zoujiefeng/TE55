ASAP2_VERSION 1 3
/begin PROJECT P_TC375_PLATFORM_0_0 "P_TC375_PLATFORM_0_0"
/begin HEADER "" VERSION "5210.00" PROJECT_NO D0 /end HEADER
/begin MODULE P_TC375_PLATFORM_0_0 "Invt"
/begin MOD_COMMON "" DEPOSIT ABSOLUTE ALIGNMENT_BYTE 1 ALIGNMENT_WORD 2 ALIGNMENT_LONG 4 ALIGNMENT_FLOAT32_IEEE 4 ALIGNMENT_FLOAT64_IEEE 8 BYTE_ORDER MSB_LAST /end MOD_COMMON
/begin RECORD_LAYOUT DATA_RECORD_UBYTE FNC_VALUES 1 UBYTE ROW_DIR DIRECT /end RECORD_LAYOUT
/begin RECORD_LAYOUT DATA_RECORD_UWORD FNC_VALUES 1 UWORD ROW_DIR DIRECT /end RECORD_LAYOUT
/begin RECORD_LAYOUT DATA_RECORD_ULONG FNC_VALUES 1 ULONG ROW_DIR DIRECT /end RECORD_LAYOUT
/begin RECORD_LAYOUT DATA_RECORD_FLOAT32_IEEE FNC_VALUES 1 FLOAT32_IEEE ROW_DIR DIRECT /end RECORD_LAYOUT
/begin RECORD_LAYOUT AXIS_PTS_X_UWORD_VEMS AXIS_PTS_X 1 UWORD INDEX_INCR DIRECT /end RECORD_LAYOUT
/begin RECORD_LAYOUT AXIS_PTS_X_SWORD_VEMS AXIS_PTS_X 1 SWORD INDEX_INCR DIRECT /end RECORD_LAYOUT
/begin RECORD_LAYOUT AXIS_PTS_X_ULONG_VEMS AXIS_PTS_X 1 ULONG INDEX_INCR DIRECT /end RECORD_LAYOUT
/begin RECORD_LAYOUT AXIS_PTS_X_SLONG_VEMS AXIS_PTS_X 1 SLONG INDEX_INCR DIRECT /end RECORD_LAYOUT
/begin RECORD_LAYOUT AXIS_PTS_X_FLOAT32_IEEE_VEMS AXIS_PTS_X 1 FLOAT32_IEEE INDEX_INCR DIRECT /end RECORD_LAYOUT
/begin RECORD_LAYOUT AXIS_PTS_X_FLOAT64_IEEE_VEMS AXIS_PTS_X 1 FLOAT64_IEEE INDEX_INCR DIRECT /end RECORD_LAYOUT
/begin RECORD_LAYOUT AXIS_PTS_X_UBYTE NO_AXIS_PTS_X 1 UBYTE AXIS_PTS_X 2 UBYTE INDEX_INCR DIRECT /end RECORD_LAYOUT
/begin RECORD_LAYOUT AXIS_PTS_X_SBYTE NO_AXIS_PTS_X 1 SBYTE AXIS_PTS_X 2 SBYTE INDEX_INCR DIRECT /end RECORD_LAYOUT
/begin RECORD_LAYOUT AXIS_PTS_X_UWORD NO_AXIS_PTS_X 1 UWORD AXIS_PTS_X 2 UWORD INDEX_INCR DIRECT /end RECORD_LAYOUT
/begin RECORD_LAYOUT AXIS_PTS_X_SWORD NO_AXIS_PTS_X 1 SWORD AXIS_PTS_X 2 SWORD INDEX_INCR DIRECT /end RECORD_LAYOUT
/begin RECORD_LAYOUT AXIS_PTS_X_ULONG NO_AXIS_PTS_X 1 ULONG AXIS_PTS_X 2 ULONG INDEX_INCR DIRECT /end RECORD_LAYOUT
/begin RECORD_LAYOUT AXIS_PTS_X_SLONG NO_AXIS_PTS_X 1 SLONG AXIS_PTS_X 2 SLONG INDEX_INCR DIRECT /end RECORD_LAYOUT
/begin RECORD_LAYOUT AXIS_PTS_X_FLOAT32_IEEE NO_AXIS_PTS_X 1 FLOAT32_IEEE AXIS_PTS_X 2 FLOAT32_IEEE INDEX_INCR DIRECT /end RECORD_LAYOUT
/begin RECORD_LAYOUT AXIS_PTS_X_FLOAT64_IEEE NO_AXIS_PTS_X 1 FLOAT64_IEEE AXIS_PTS_X 2 FLOAT64_IEEE INDEX_INCR DIRECT /end RECORD_LAYOUT
/begin CHARACTERISTIC FTDDLMP_I0LimitMinC "The minimum current of I0 limit value in limp control mode." VALUE 0x8005CF00 DATA_RECORD_FLOAT32_IEEE 2000 F_1_p0_2 -1000 1000 /end CHARACTERISTIC
/begin CHARACTERISTIC FTDDLMP_IdLimitMaxC "The maximum current of Id limit value in limp control mode." VALUE 0x8005CEFC DATA_RECORD_FLOAT32_IEEE 2000 F_1_p0_2 -1000 1000 /end CHARACTERISTIC
/begin CHARACTERISTIC FTDDLMP_IdLimitMinC "The minimum current of Id limit value in limp control mode." VALUE 0x8005CEF8 DATA_RECORD_FLOAT32_IEEE 2000 F_1_p0_2 -1000 1000 /end CHARACTERISTIC
/begin CHARACTERISTIC FTDDLMP_IqLimitMaxC "The maximum current of Iq limit value in limp control mode." VALUE 0x8005CEF4 DATA_RECORD_FLOAT32_IEEE 2000 F_1_p0_2 -1000 1000 /end CHARACTERISTIC
/begin CHARACTERISTIC FTDDLMP_IqLimitMinC "The minimum current of Iq limit value in limp control mode." VALUE 0x8005CEF0 DATA_RECORD_FLOAT32_IEEE 2000 F_1_p0_2 -1000 1000 /end CHARACTERISTIC
/begin CHARACTERISTIC FTDDLMP_PowerLimC "FTDDLMP_PowerLimC" VALUE 0x8005CEEC DATA_RECORD_FLOAT32_IEEE 3.402823466E+038 F_1_p0_2 -3.402823466E+038 3.402823466E+038 /end CHARACTERISTIC
/begin CHARACTERISTIC FTDDLMP_SpeedLimitMaxC "The maximum speed limit value in limp control mode." VALUE 0x8005CEE8 DATA_RECORD_FLOAT32_IEEE 40000 F_1_p0_2 -20000 20000 /end CHARACTERISTIC
/begin CHARACTERISTIC FTDDLMP_SpeedLimitMinC "The minimum speed limit value in limp control mode." VALUE 0x8005CEE4 DATA_RECORD_FLOAT32_IEEE 40000 F_1_p0_2 -20000 20000 /end CHARACTERISTIC
/begin CHARACTERISTIC FTDDLMP_TorqLimitMaxC "The maximum torque limit value in limp control mode." VALUE 0x8005CEE0 DATA_RECORD_FLOAT32_IEEE 6000 F_1_p0_2 -3000 3000 /end CHARACTERISTIC
/begin CHARACTERISTIC FTDDLMP_TorqLimitMinC "The minimum torque limit value in limp control mode." VALUE 0x8005CEDC DATA_RECORD_FLOAT32_IEEE 6000 F_1_p0_2 -3000 3000 /end CHARACTERISTIC
/begin CHARACTERISTIC FTEVEIT_CommutDataCoeffC "Data for commutation losses estimation : ( floor(ModuleFunctionCallPeriod / SwitchingPeriod) * floor(CommutationNberPerSwtchT / 2) ) / ModuleFunctionCallPeriod." VALUE 0x8005D5B4 DATA_RECORD_FLOAT32_IEEE 1000000 F_1_p0_2 0 1000000 /end CHARACTERISTIC
/begin CHARACTERISTIC FTEVEIT_EoffICurrentsC "IGBT Eoff = f(Current) cartography input vector." CURVE 0x8005D590 DATA_RECORD_FLOAT32_IEEE 1000000 F_1_p0_2 0 1000000
 /begin AXIS_DESCR FIX_AXIS NO_INPUT_QUANTITY Id_0x00 9 0 8 MAX_GRAD 100.0 FIX_AXIS_PAR_DIST 0 1 9 /end AXIS_DESCR
/end CHARACTERISTIC
/begin CHARACTERISTIC FTEVEIT_EoffIEnergiesC "IGBT Eoff = f(Current) cartography output vector." CURVE 0x8005D56C DATA_RECORD_FLOAT32_IEEE 1000000 F_1_p0_2 0 1000000
 /begin AXIS_DESCR FIX_AXIS NO_INPUT_QUANTITY Id_0x00 9 0 8 MAX_GRAD 100.0 FIX_AXIS_PAR_DIST 0 1 9 /end AXIS_DESCR
/end CHARACTERISTIC
/begin CHARACTERISTIC FTEVEIT_EonICurrentsC "IGBT Eon = f(Current) cartography input vector." CURVE 0x8005D548 DATA_RECORD_FLOAT32_IEEE 1000000 F_1_p0_2 0 1000000
 /begin AXIS_DESCR FIX_AXIS NO_INPUT_QUANTITY Id_0x00 9 0 8 MAX_GRAD 100.0 FIX_AXIS_PAR_DIST 0 1 9 /end AXIS_DESCR
/end CHARACTERISTIC
/begin CHARACTERISTIC FTEVEIT_EonIEnergiesC "IGBT Eon = f(Current) cartography output vector." CURVE 0x8005D524 DATA_RECORD_FLOAT32_IEEE 1000000 F_1_p0_2 0 1000000
 /begin AXIS_DESCR FIX_AXIS NO_INPUT_QUANTITY Id_0x00 9 0 8 MAX_GRAD 100.0 FIX_AXIS_PAR_DIST 0 1 9 /end AXIS_DESCR
/end CHARACTERISTIC
/begin CHARACTERISTIC FTEVEIT_ErecICurrentsC "Diode Erec = f(Current) cartography input vector." CURVE 0x8005D500 DATA_RECORD_FLOAT32_IEEE 1000000 F_1_p0_2 0 1000000
 /begin AXIS_DESCR FIX_AXIS NO_INPUT_QUANTITY Id_0x00 9 0 8 MAX_GRAD 100.0 FIX_AXIS_PAR_DIST 0 1 9 /end AXIS_DESCR
/end CHARACTERISTIC
/begin CHARACTERISTIC FTEVEIT_ErecIEnergiesC "Diode Erec = f(Current) cartography output vector." CURVE 0x8005D4DC DATA_RECORD_FLOAT32_IEEE 1000000 F_1_p0_2 0 1000000
 /begin AXIS_DESCR FIX_AXIS NO_INPUT_QUANTITY Id_0x00 9 0 8 MAX_GRAD 100.0 FIX_AXIS_PAR_DIST 0 1 9 /end AXIS_DESCR
/end CHARACTERISTIC
/begin CHARACTERISTIC FTEVEIT_KoffUdcCoeffsC "IGBT Koff = f(Udc) table output vector." CURVE 0x8005D498 DATA_RECORD_FLOAT32_IEEE 100 F_1_p0_2 0 100
 /begin AXIS_DESCR FIX_AXIS NO_INPUT_QUANTITY Id_0x00 17 0 16 MAX_GRAD 100.0 FIX_AXIS_PAR_DIST 0 1 17 /end AXIS_DESCR
/end CHARACTERISTIC
/begin CHARACTERISTIC FTEVEIT_KoffUdcVoltagesC "IGBT Koff = f(Udc) cartography input vector." CURVE 0x8005D454 DATA_RECORD_FLOAT32_IEEE 2000 F_1_p0_2 0 2000
 /begin AXIS_DESCR FIX_AXIS NO_INPUT_QUANTITY Id_0x00 17 0 16 MAX_GRAD 100.0 FIX_AXIS_PAR_DIST 0 1 17 /end AXIS_DESCR
/end CHARACTERISTIC
/begin CHARACTERISTIC FTEVEIT_KonUdcCoeffsC "IGBT Kon = f(Udc) table output vector." CURVE 0x8005D410 DATA_RECORD_FLOAT32_IEEE 100 F_1_p0_2 0 100
 /begin AXIS_DESCR FIX_AXIS NO_INPUT_QUANTITY Id_0x00 17 0 16 MAX_GRAD 100.0 FIX_AXIS_PAR_DIST 0 1 17 /end AXIS_DESCR
/end CHARACTERISTIC
/begin CHARACTERISTIC FTEVEIT_KonUdcVoltagesC "IGBT Kon = f(Udc) cartography input vector." CURVE 0x8005D3CC DATA_RECORD_FLOAT32_IEEE 2000 F_1_p0_2 0 2000
 /begin AXIS_DESCR FIX_AXIS NO_INPUT_QUANTITY Id_0x00 17 0 16 MAX_GRAD 100.0 FIX_AXIS_PAR_DIST 0 1 17 /end AXIS_DESCR
/end CHARACTERISTIC
/begin CHARACTERISTIC FTEVEIT_KrecUdcCoeffsC "Diode Krec = f(Udc) table output vector." CURVE 0x8005D388 DATA_RECORD_FLOAT32_IEEE 100 F_1_p0_2 0 100
 /begin AXIS_DESCR FIX_AXIS NO_INPUT_QUANTITY Id_0x00 17 0 16 MAX_GRAD 100.0 FIX_AXIS_PAR_DIST 0 1 17 /end AXIS_DESCR
/end CHARACTERISTIC
/begin CHARACTERISTIC FTEVEIT_KrecUdcVoltagesC "Diode Krec = f(Udc) cartography input vector." CURVE 0x8005D344 DATA_RECORD_FLOAT32_IEEE 2000 F_1_p0_2 0 2000
 /begin AXIS_DESCR FIX_AXIS NO_INPUT_QUANTITY Id_0x00 17 0 16 MAX_GRAD 100.0 FIX_AXIS_PAR_DIST 0 1 17 /end AXIS_DESCR
/end CHARACTERISTIC
/begin CHARACTERISTIC FTEVEIT_MaxMechaSpdHysteresisC "Hysteresis maximal temperature for estimation enable." VALUE 0x8005D340 DATA_RECORD_FLOAT32_IEEE 16000 F_1_p0_2 0 16000 /end CHARACTERISTIC
/begin CHARACTERISTIC FTEVEIT_MaxTempC "Chips maximal allowed temperature." VALUE 0x8005D33C DATA_RECORD_FLOAT32_IEEE 240 F_1_p0_2 -40 200 /end CHARACTERISTIC
/begin CHARACTERISTIC FTEVEIT_MinMechaSpdHysteresisC "Hysteresis minimal temperature for estimation enable." VALUE 0x8005D338 DATA_RECORD_FLOAT32_IEEE 16000 F_1_p0_2 0 16000 /end CHARACTERISTIC
/begin CHARACTERISTIC FTEVEIT_OverTempThresC "Maximal temperature value for the IGBTs and Diodes maximal estimated temperatures." VALUE 0x8005D334 DATA_RECORD_FLOAT32_IEEE 240 F_1_p0_2 -40 200 /end CHARACTERISTIC
/begin CHARACTERISTIC FTEVEIT_PdiodeTdiodeAlphaS1C "Thermal model : Transfert function from diode power losses to diode junction temperature : subsystem 1 pole." VALUE 0x8005D330 DATA_RECORD_FLOAT32_IEEE 1 F_1_p0_2 0 1 /end CHARACTERISTIC
/begin CHARACTERISTIC FTEVEIT_PdiodeTdiodeAlphaS2C "Thermal model : Transfert function from diode power losses to diode junction temperature : subsystem 2 pole." VALUE 0x8005D32C DATA_RECORD_FLOAT32_IEEE 1 F_1_p0_2 0 1 /end CHARACTERISTIC
/begin CHARACTERISTIC FTEVEIT_PdiodeTdiodeAlphaS3C "Thermal model : Transfert function from diode power losses to diode junction temperature : subsystem 3 pole." VALUE 0x8005D328 DATA_RECORD_FLOAT32_IEEE 1 F_1_p0_2 0 1 /end CHARACTERISTIC
/begin CHARACTERISTIC FTEVEIT_PdiodeTdiodeAlphaS4C "Thermal model : Transfert function from diode power losses to diode junction temperature : subsystem 4 pole." VALUE 0x8005D324 DATA_RECORD_FLOAT32_IEEE 1 F_1_p0_2 0 1 /end CHARACTERISTIC
/begin CHARACTERISTIC FTEVEIT_PdiodeTdiodeAlphaS5C "Thermal model : Transfert function from diode power losses to diode junction temperature : subsystem 5 pole." VALUE 0x8005D320 DATA_RECORD_FLOAT32_IEEE 1 F_1_p0_2 0 1 /end CHARACTERISTIC
/begin CHARACTERISTIC FTEVEIT_PdiodeTdiodeNumS1C "Thermal model : Transfert function from diode power losses to diode junction temperature : subsystem 1 numerator gain." VALUE 0x8005D31C DATA_RECORD_FLOAT32_IEEE 1000000 F_1_p0_2 0 1000000 /end CHARACTERISTIC
/begin CHARACTERISTIC FTEVEIT_PdiodeTdiodeNumS2C "Thermal model : Transfert function from diode power losses to diode junction temperature : subsystem 2 numerator gain." VALUE 0x8005D318 DATA_RECORD_FLOAT32_IEEE 1000000 F_1_p0_2 0 1000000 /end CHARACTERISTIC
/begin CHARACTERISTIC FTEVEIT_PdiodeTdiodeNumS3C "Thermal model : Transfert function from diode power losses to diode junction temperature : subsystem 3 numerator gain." VALUE 0x8005D314 DATA_RECORD_FLOAT32_IEEE 1000000 F_1_p0_2 0 1000000 /end CHARACTERISTIC
/begin CHARACTERISTIC FTEVEIT_PdiodeTdiodeNumS4C "Thermal model : Transfert function from diode power losses to diode junction temperature : subsystem 4 numerator gain." VALUE 0x8005D310 DATA_RECORD_FLOAT32_IEEE 1000000 F_1_p0_2 0 1000000 /end CHARACTERISTIC
/begin CHARACTERISTIC FTEVEIT_PdiodeTdiodeNumS5C "Thermal model : Transfert function from diode power losses to diode junction temperature : subsystem 5 numerator gain." VALUE 0x8005D30C DATA_RECORD_FLOAT32_IEEE 1000000 F_1_p0_2 0 1000000 /end CHARACTERISTIC
/begin CHARACTERISTIC FTEVEIT_PdiodeTigbtAlphaC "Thermal model : Transfert function from diode power losses to IGBT junction temperature : pole." VALUE 0x8005D308 DATA_RECORD_FLOAT32_IEEE 1 F_1_p0_2 0 1 /end CHARACTERISTIC
/begin CHARACTERISTIC FTEVEIT_PdiodeTigbtNumC "Thermal model : Transfert function from diode power losses to IGBT junction temperature : numerator gain." VALUE 0x8005D304 DATA_RECORD_FLOAT32_IEEE 1000000 F_1_p0_2 0 1000000 /end CHARACTERISTIC
/begin CHARACTERISTIC FTEVEIT_PigbtTdiodeAlphaC "Thermal model : Transfert function from IGBT power losses to diode junction temperature : pole." VALUE 0x8005D300 DATA_RECORD_FLOAT32_IEEE 1 F_1_p0_2 0 1 /end CHARACTERISTIC
/begin CHARACTERISTIC FTEVEIT_PigbtTdiodeNumC "Thermal model : Transfert function from IGBT power losses to diode junction temperature : numerator gain." VALUE 0x8005D2FC DATA_RECORD_FLOAT32_IEEE 1000000 F_1_p0_2 0 1000000 /end CHARACTERISTIC
/begin CHARACTERISTIC FTEVEIT_PigbtTigbtAlphaS1C "Thermal model : Transfert function from IGBT power losses to IGBT junction temperature : subsystem 1 pole." VALUE 0x8005D2F8 DATA_RECORD_FLOAT32_IEEE 1 F_1_p0_2 0 1 /end CHARACTERISTIC
/begin CHARACTERISTIC FTEVEIT_PigbtTigbtAlphaS2C "Thermal model : Transfert function from IGBT power losses to IGBT junction temperature : subsystem 2 pole." VALUE 0x8005D2F4 DATA_RECORD_FLOAT32_IEEE 1 F_1_p0_2 0 1 /end CHARACTERISTIC
/begin CHARACTERISTIC FTEVEIT_PigbtTigbtAlphaS3C "Thermal model : Transfert function from IGBT power losses to IGBT junction temperature : subsystem 3 pole." VALUE 0x8005D2F0 DATA_RECORD_FLOAT32_IEEE 1 F_1_p0_2 0 1 /end CHARACTERISTIC
/begin CHARACTERISTIC FTEVEIT_PigbtTigbtAlphaS4C "Thermal model : Transfert function from IGBT power losses to IGBT junction temperature : subsystem 4 pole." VALUE 0x8005D2EC DATA_RECORD_FLOAT32_IEEE 1 F_1_p0_2 0 1 /end CHARACTERISTIC
/begin CHARACTERISTIC FTEVEIT_PigbtTigbtAlphaS5C "Thermal model : Transfert function from IGBT power losses to IGBT junction temperature : subsystem 5 pole." VALUE 0x8005D2E8 DATA_RECORD_FLOAT32_IEEE 1 F_1_p0_2 0 1 /end CHARACTERISTIC
/begin CHARACTERISTIC FTEVEIT_PigbtTigbtNumS1C "Thermal model : Transfert function from IGBT power losses to IGBT junction temperature : subsystem 1 numerator gain." VALUE 0x8005D2E4 DATA_RECORD_FLOAT32_IEEE 1000000 F_1_p0_2 0 1000000 /end CHARACTERISTIC
/begin CHARACTERISTIC FTEVEIT_PigbtTigbtNumS2C "Thermal model : Transfert function from IGBT power losses to IGBT junction temperature : subsystem 2 numerator gain." VALUE 0x8005D2E0 DATA_RECORD_FLOAT32_IEEE 1000000 F_1_p0_2 0 1000000 /end CHARACTERISTIC
/begin CHARACTERISTIC FTEVEIT_PigbtTigbtNumS3C "Thermal model : Transfert function from IGBT power losses to IGBT junction temperature : subsystem 3 numerator gain." VALUE 0x8005D2DC DATA_RECORD_FLOAT32_IEEE 1000000 F_1_p0_2 0 1000000 /end CHARACTERISTIC
/begin CHARACTERISTIC FTEVEIT_PigbtTigbtNumS4C "Thermal model : Transfert function from IGBT power losses to IGBT junction temperature : subsystem 4 numerator gain." VALUE 0x8005D2D8 DATA_RECORD_FLOAT32_IEEE 1000000 F_1_p0_2 0 1000000 /end CHARACTERISTIC
/begin CHARACTERISTIC FTEVEIT_PigbtTigbtNumS5C "Thermal model : Transfert function from IGBT power losses to IGBT junction temperature : subsystem 5 numerator gain." VALUE 0x8005D2D4 DATA_RECORD_FLOAT32_IEEE 1000000 F_1_p0_2 0 1000000 /end CHARACTERISTIC
/begin CHARACTERISTIC FTEVEIT_TcoolBenchC "Bench mode : demanded cooling temperature asked by the experimenter." VALUE 0x8005D2D0 DATA_RECORD_FLOAT32_IEEE 400 F_1_p0_2 -200 200 /end CHARACTERISTIC
/begin CHARACTERISTIC FTEVEIT_TcoolChoosePMWC "Set this boolean to 1 to estimate the cooling temperature by using the power module W temperature." VALUE 0x8005D2CC DATA_RECORD_UBYTE 1 Bool_ON_OFF 0 1 BIT_MASK 0x01 /end CHARACTERISTIC
/begin CHARACTERISTIC FTEVEIT_TcoolScalingAlphaC "Scaling on the estimated cooling temperature : y = Alpha * x + Beta." VALUE 0x8005D2C8 DATA_RECORD_FLOAT32_IEEE 2000000 F_1_p0_2 -1000000 1000000 /end CHARACTERISTIC
/begin CHARACTERISTIC FTEVEIT_TcoolScalingBetaC "Scaling on the estimated cooling temperature : y = Alpha * x + Beta." VALUE 0x8005D2C4 DATA_RECORD_FLOAT32_IEEE 2000000 F_1_p0_2 -1000000 1000000 /end CHARACTERISTIC
/begin CHARACTERISTIC FTEVEIT_TempFirstFildTrC "Time response at 95 Percent for the IGBTs and Diodes temperatures estimation first filter." VALUE 0x8005D2C0 DATA_RECORD_FLOAT32_IEEE 100 F_1_p0_2 0 100 /end CHARACTERISTIC
/begin CHARACTERISTIC FTEVEIT_TempSecFildTrC "Time response at 95 Percent for the IGBTs and Diodes temperatures estimation second filter." VALUE 0x8005D2BC DATA_RECORD_FLOAT32_IEEE 100 F_1_p0_2 0 100 /end CHARACTERISTIC
/begin CHARACTERISTIC FTEVEIT_TempVectFildTrC "Time response at 95 Percent for the IGBTs and Diodes temperatures estimation vector filter." VALUE 0x8005D2B8 DATA_RECORD_FLOAT32_IEEE 100 F_1_p0_2 0 100 /end CHARACTERISTIC
/begin CHARACTERISTIC FTEVEIT_UdICurrentsC "Diode Voltage = f(Current) cartography input vector." CURVE 0x8005D274 DATA_RECORD_FLOAT32_IEEE 1000000 F_1_p0_2 0 1000000
 /begin AXIS_DESCR FIX_AXIS NO_INPUT_QUANTITY Id_0x00 17 0 16 MAX_GRAD 100.0 FIX_AXIS_PAR_DIST 0 1 17 /end AXIS_DESCR
/end CHARACTERISTIC
/begin CHARACTERISTIC FTEVEIT_UdIVoltagesC "Diode Voltage = f(Current) cartography output vector." CURVE 0x8005D230 DATA_RECORD_FLOAT32_IEEE 1000000 F_1_p0_2 0 1000000
 /begin AXIS_DESCR FIX_AXIS NO_INPUT_QUANTITY Id_0x00 17 0 16 MAX_GRAD 100.0 FIX_AXIS_PAR_DIST 0 1 17 /end AXIS_DESCR
/end CHARACTERISTIC
/begin CHARACTERISTIC FTEVEIT_UtICurrentsC "IGBT Voltage = f(Current) cartography input vector." CURVE 0x8005D1EC DATA_RECORD_FLOAT32_IEEE 1000000 F_1_p0_2 0 1000000
 /begin AXIS_DESCR FIX_AXIS NO_INPUT_QUANTITY Id_0x00 17 0 16 MAX_GRAD 100.0 FIX_AXIS_PAR_DIST 0 1 17 /end AXIS_DESCR
/end CHARACTERISTIC
/begin CHARACTERISTIC FTEVEIT_UtIVoltagesC "IGBT Voltage = f(Current) cartography output vector." CURVE 0x8005D1A8 DATA_RECORD_FLOAT32_IEEE 1000000 F_1_p0_2 0 1000000
 /begin AXIS_DESCR FIX_AXIS NO_INPUT_QUANTITY Id_0x00 17 0 16 MAX_GRAD 100.0 FIX_AXIS_PAR_DIST 0 1 17 /end AXIS_DESCR
/end CHARACTERISTIC
/begin CHARACTERISTIC FTMTLCS_A2DGainIsuLC "gain used to correct a sensor linearity error" VALUE 0x8005D6D0 DATA_RECORD_FLOAT32_IEEE 3.402823466E+038 F_1_p0_2 -3.402823466E+038 3.402823466E+038 /end CHARACTERISTIC
/begin CHARACTERISTIC FTMTLCS_A2DGainIsvLC "gain used to correct a sensor linearity error" VALUE 0x8005D6CC DATA_RECORD_FLOAT32_IEEE 3.402823466E+038 F_1_p0_2 -3.402823466E+038 3.402823466E+038 /end CHARACTERISTIC
/begin CHARACTERISTIC FTMTLCS_A2DGainIswLC "gain used to correct a sensor linearity error" VALUE 0x8005D6C8 DATA_RECORD_FLOAT32_IEEE 3.402823466E+038 F_1_p0_2 -3.402823466E+038 3.402823466E+038 /end CHARACTERISTIC
/begin CHARACTERISTIC FTMTLCS_A2DHighThresholdC "FTMTLCS_A2DHighThresholdC" VALUE 0x8005D6C4 DATA_RECORD_UWORD 4095 F_1_p0_2 0 4095 /end CHARACTERISTIC
/begin CHARACTERISTIC FTMTLCS_A2DLowThresholdC "FTMTLCS_A2DLowThresholdC" VALUE 0x8005D6C0 DATA_RECORD_UWORD 4095 F_1_p0_2 0 4095 /end CHARACTERISTIC
/begin CHARACTERISTIC FTMTLCS_CounterInitC "FTMTLCS_CounterInitC" VALUE 0x8005D6BC DATA_RECORD_ULONG 4294967295 F_1_p0_2 0 4294967295 /end CHARACTERISTIC
/begin CHARACTERISTIC FTMTLCS_CurrentCalEnableC "FTMTLCS_CurrentCalEnableC" VALUE 0x8005D6B8 DATA_RECORD_UBYTE 1 Bool_ON_OFF 0 1 BIT_MASK 0x01 /end CHARACTERISTIC
/begin CHARACTERISTIC FTMTLCS_CurrentOffsetInitC "FTMTLCS_CurrentOffsetInitC" VALUE 0x8005D6B4 DATA_RECORD_FLOAT32_IEEE 3.402823466E+038 F_1_p0_2 -3.402823466E+038 3.402823466E+038 /end CHARACTERISTIC
/begin CHARACTERISTIC FTMTLCS_CurrentRmsCounterC "FTMTLCS_CurrentRmsCounterC" VALUE 0x8005D6B0 DATA_RECORD_ULONG 4294967295 F_1_p0_2 0 4294967295 /end CHARACTERISTIC
/begin CHARACTERISTIC FTMTLCS_CurrentRmsCounterZC "FTMTLCS_CurrentRmsCounterZC" VALUE 0x8005D6AC DATA_RECORD_FLOAT32_IEEE 3.402823466E+038 F_1_p0_2 -3.402823466E+038 3.402823466E+038 /end CHARACTERISTIC
/begin CHARACTERISTIC FTMTLCS_CurrentRmsFTEnC "FTMTLCS_CurrentRmsFTEnC" VALUE 0x8005D6A8 DATA_RECORD_UBYTE 1 Bool_ON_OFF 0 1 BIT_MASK 0x01 /end CHARACTERISTIC
/begin CHARACTERISTIC FTMTLCS_CurrentRmsSumInitC "FTMTLCS_CurrentRmsSumInitC" VALUE 0x8005D6A4 DATA_RECORD_FLOAT32_IEEE 3.402823466E+038 F_1_p0_2 -3.402823466E+038 3.402823466E+038 /end CHARACTERISTIC
/begin CHARACTERISTIC FTMTLCS_ExtCurrentGainEnaC "FTMTLCS_ExtCurrentGainEnaC" VALUE 0x8005D6A0 DATA_RECORD_UBYTE 1 Bool_ON_OFF 0 1 BIT_MASK 0x01 /end CHARACTERISTIC
/begin CHARACTERISTIC FTMTLCS_ExtCurrentGainMaxC "FTMTLCS_ExtCurrentGainMaxC" VALUE 0x8005D69C DATA_RECORD_FLOAT32_IEEE 3.402823466E+038 F_1_p0_2 -3.402823466E+038 3.402823466E+038 /end CHARACTERISTIC
/begin CHARACTERISTIC FTMTLCS_ExtCurrentGainMinC "FTMTLCS_ExtCurrentGainMinC" VALUE 0x8005D698 DATA_RECORD_FLOAT32_IEEE 3.402823466E+038 F_1_p0_2 -3.402823466E+038 3.402823466E+038 /end CHARACTERISTIC
/begin CHARACTERISTIC FTMTLCS_Init2DurationC "duration of init 2" VALUE 0x8005D694 DATA_RECORD_FLOAT32_IEEE 3.402823466E+038 F_1_p0_2 -3.402823466E+038 3.402823466E+038 /end CHARACTERISTIC
/begin CHARACTERISTIC FTMTLCS_InitIuvw3C "FTMTLCS_InitIuvw3C" CURVE 0x8005D688 DATA_RECORD_FLOAT32_IEEE 3.402823466E+038 F_1_p0_2 -3.402823466E+038 3.402823466E+038
 /begin AXIS_DESCR FIX_AXIS NO_INPUT_QUANTITY Id_0x00 3 0 2 MAX_GRAD 100.0 FIX_AXIS_PAR_DIST 0 1 3 /end AXIS_DESCR
/end CHARACTERISTIC
/begin CHARACTERISTIC FTMTLCS_IuGainC "FTMTLCS_IuGainC" VALUE 0x8005D684 DATA_RECORD_FLOAT32_IEEE 3.402823466E+038 F_1_p0_2 -3.402823466E+038 3.402823466E+038 /end CHARACTERISTIC
/begin CHARACTERISTIC FTMTLCS_IvGainC "FTMTLCS_IvGainC" VALUE 0x8005D680 DATA_RECORD_FLOAT32_IEEE 3.402823466E+038 F_1_p0_2 -3.402823466E+038 3.402823466E+038 /end CHARACTERISTIC
/begin CHARACTERISTIC FTMTLCS_IwGainC "FTMTLCS_IwGainC" VALUE 0x8005D67C DATA_RECORD_FLOAT32_IEEE 3.402823466E+038 F_1_p0_2 -3.402823466E+038 3.402823466E+038 /end CHARACTERISTIC
/begin CHARACTERISTIC FTMTLCS_LostPhaseDelayCntC "FTMTLCS_LostPhaseDelayCntC" VALUE 0x8005D678 DATA_RECORD_UWORD 65535 F_1_p0_2 0 65535 /end CHARACTERISTIC
/begin CHARACTERISTIC FTMTLCS_LostPhaseEnaEleSpdRdsC "FTMTLCS_LostPhaseEnaEleSpdRdsC" VALUE 0x8005D674 DATA_RECORD_FLOAT32_IEEE 3.402823466E+038 F_1_p0_2 -3.402823466E+038 3.402823466E+038 /end CHARACTERISTIC
/begin CHARACTERISTIC FTMTLCS_LostPhaseMaxRateC "FTMTLCS_LostPhaseMaxRateC" VALUE 0x8005D670 DATA_RECORD_FLOAT32_IEEE 3.402823466E+038 F_1_p0_2 -3.402823466E+038 3.402823466E+038 /end CHARACTERISTIC
/begin CHARACTERISTIC FTMTLCS_LostPhaseMinIRmsC "FTMTLCS_LostPhaseMinIRmsC" VALUE 0x8005D66C DATA_RECORD_FLOAT32_IEEE 3.402823466E+038 F_1_p0_2 -3.402823466E+038 3.402823466E+038 /end CHARACTERISTIC
/begin CHARACTERISTIC FTMTLCS_LutInPhaseCurrUC "FTMTLCS_LutInPhaseCurrUC" CURVE 0x8005D650 DATA_RECORD_FLOAT32_IEEE 3.402823466E+038 F_1_p0_2 -3.402823466E+038 3.402823466E+038
 /begin AXIS_DESCR FIX_AXIS NO_INPUT_QUANTITY Id_0x00 7 0 6 MAX_GRAD 100.0 FIX_AXIS_PAR_DIST 0 1 7 /end AXIS_DESCR
/end CHARACTERISTIC
/begin CHARACTERISTIC FTMTLCS_LutInPhaseCurrVC "FTMTLCS_LutInPhaseCurrVC" CURVE 0x8005D634 DATA_RECORD_FLOAT32_IEEE 3.402823466E+038 F_1_p0_2 -3.402823466E+038 3.402823466E+038
 /begin AXIS_DESCR FIX_AXIS NO_INPUT_QUANTITY Id_0x00 7 0 6 MAX_GRAD 100.0 FIX_AXIS_PAR_DIST 0 1 7 /end AXIS_DESCR
/end CHARACTERISTIC
/begin CHARACTERISTIC FTMTLCS_LutInPhaseCurrWC "FTMTLCS_LutInPhaseCurrWC" CURVE 0x8005D618 DATA_RECORD_FLOAT32_IEEE 3.402823466E+038 F_1_p0_2 -3.402823466E+038 3.402823466E+038
 /begin AXIS_DESCR FIX_AXIS NO_INPUT_QUANTITY Id_0x00 7 0 6 MAX_GRAD 100.0 FIX_AXIS_PAR_DIST 0 1 7 /end AXIS_DESCR
/end CHARACTERISTIC
/begin CHARACTERISTIC FTMTLCS_LutOutPhaseCurrUC "FTMTLCS_LutOutPhaseCurrUC" CURVE 0x8005D5FC DATA_RECORD_FLOAT32_IEEE 3.402823466E+038 F_1_p0_2 -3.402823466E+038 3.402823466E+038
 /begin AXIS_DESCR FIX_AXIS NO_INPUT_QUANTITY Id_0x00 7 0 6 MAX_GRAD 100.0 FIX_AXIS_PAR_DIST 0 1 7 /end AXIS_DESCR
/end CHARACTERISTIC
/begin CHARACTERISTIC FTMTLCS_LutOutPhaseCurrVC "FTMTLCS_LutOutPhaseCurrVC" CURVE 0x8005D5E0 DATA_RECORD_FLOAT32_IEEE 3.402823466E+038 F_1_p0_2 -3.402823466E+038 3.402823466E+038
 /begin AXIS_DESCR FIX_AXIS NO_INPUT_QUANTITY Id_0x00 7 0 6 MAX_GRAD 100.0 FIX_AXIS_PAR_DIST 0 1 7 /end AXIS_DESCR
/end CHARACTERISTIC
/begin CHARACTERISTIC FTMTLCS_LutOutPhaseCurrWC "FTMTLCS_LutOutPhaseCurrWC" CURVE 0x8005D5C4 DATA_RECORD_FLOAT32_IEEE 3.402823466E+038 F_1_p0_2 -3.402823466E+038 3.402823466E+038
 /begin AXIS_DESCR FIX_AXIS NO_INPUT_QUANTITY Id_0x00 7 0 6 MAX_GRAD 100.0 FIX_AXIS_PAR_DIST 0 1 7 /end AXIS_DESCR
/end CHARACTERISTIC
/begin CHARACTERISTIC FTMTLCS_SpdCutOffFrequencyC "FTMTLCS_SpdCutOffFrequencyC" VALUE 0x8005D5C0 DATA_RECORD_FLOAT32_IEEE 3.402823466E+038 F_1_p0_2 -3.402823466E+038 3.402823466E+038 /end CHARACTERISTIC
/begin CHARACTERISTIC FTMTLCS_SumErrorNegThrC "FTMTLCS_SumErrorNegThrC" VALUE 0x8005D5BC DATA_RECORD_FLOAT32_IEEE 200 F_1_p0_2 -200 0 /end CHARACTERISTIC
/begin CHARACTERISTIC FTMTLCS_SumErrorPosThrC "FTMTLCS_SumErrorPosThrC" VALUE 0x8005D5B8 DATA_RECORD_FLOAT32_IEEE 200 F_1_p0_2 0 200 /end CHARACTERISTIC
/begin CHARACTERISTIC FTMTSEP_ErrorThetaFactorC "FTMTSEP_ErrorThetaFactorC" VALUE 0x8005D6D8 DATA_RECORD_FLOAT32_IEEE 3.402823466E+038 F_1_p0_2 -3.402823466E+038 3.402823466E+038 /end CHARACTERISTIC
/begin CHARACTERISTIC FTMTSEP_TimeAdvanceFactC "FTMTSEP_TimeAdvanceFactC" VALUE 0x8005D6D4 DATA_RECORD_FLOAT32_IEEE 3.402823466E+038 F_1_p0_2 -3.402823466E+038 3.402823466E+038 /end CHARACTERISTIC
/begin CHARACTERISTIC FTSMACS_AclSpeedThdC "FTSMACS_AclSpeedThdC" VALUE 0x8005CF20 DATA_RECORD_FLOAT32_IEEE 65535 F_1_p0_2 0 65535 /end CHARACTERISTIC
/begin CHARACTERISTIC FTSMACS_BenchModeC "FTSMACS_BenchModeC" VALUE 0x8005CF1C DATA_RECORD_UBYTE 1 Bool_ON_OFF 0 1 BIT_MASK 0x01 /end CHARACTERISTIC
/begin CHARACTERISTIC FTSMACS_PwmOffSpeedThdC "FTSMACS_PwmOffSpeedThdC" VALUE 0x8005CF18 DATA_RECORD_FLOAT32_IEEE 3.402823466E+038 F_1_p0_2 -3.402823466E+038 3.402823466E+038 /end CHARACTERISTIC
/begin CHARACTERISTIC FTSMACS_ReinitFaultC "reinit all fault" VALUE 0x8005CF14 DATA_RECORD_UBYTE 1 Bool_ON_OFF 0 1 BIT_MASK 0x01 /end CHARACTERISTIC
/begin CHARACTERISTIC FTSMACS_TestFaultC "reinit all fault" VALUE 0x8005CF10 DATA_RECORD_UBYTE 1 Bool_ON_OFF 0 1 BIT_MASK 0x01 /end CHARACTERISTIC
/begin CHARACTERISTIC FTSMACS_UbatHVMinC "FTSMACS_UbatHVMinC" VALUE 0x8005CF0C DATA_RECORD_FLOAT32_IEEE 65535 F_1_p0_2 0 65535 /end CHARACTERISTIC
/begin CHARACTERISTIC FTSMACS_VsiTimerFreqRatioRefC "0 =&gt; VSI switching frequency = SPI freq and 1 =&gt; VSI switching frequency = SPI freq / 2" VALUE 0x8005CF08 DATA_RECORD_UWORD 65535 F_1_p0_2 0 65535 /end CHARACTERISTIC
/begin CHARACTERISTIC FTSMMAM_AclStateBypassOnOffC "FTSMMAM_AclStateBypassOnOffC" VALUE 0x8005CF54 DATA_RECORD_UBYTE 1 Bool_ON_OFF 0 1 BIT_MASK 0x01 /end CHARACTERISTIC
/begin CHARACTERISTIC FTSMMAM_AclStateBypassValueC "FTSMMAM_AclStateBypassValueC" VALUE 0x8005CF50 DATA_RECORD_UWORD 65535 F_1_p0_2 0 65535 /end CHARACTERISTIC
/begin CHARACTERISTIC FTSMMAM_CMCCS_M0ConOnoffC "FTSMMAM_CMCCS_M0ConOnoffC" VALUE 0x8005CF4C DATA_RECORD_UBYTE 1 Bool_ON_OFF 0 1 BIT_MASK 0x01 /end CHARACTERISTIC
/begin CHARACTERISTIC FTSMMAM_EVEIT_MainEnableC "FTSMMAM_EVEIT_MainEnableC" VALUE 0x8005CF48 DATA_RECORD_UBYTE 1 Bool_ON_OFF 0 1 BIT_MASK 0x01 /end CHARACTERISTIC
/begin CHARACTERISTIC FTSMMAM_FTCIVDC_StateC "FTSMMAM_FTCIVDC_StateC" VALUE 0x8005CF44 DATA_RECORD_UWORD 65535 F_1_p0_2 0 65535 /end CHARACTERISTIC
/begin CHARACTERISTIC FTSMMAM_FTCMCCS_StateC "FTSMMAM_FTCMCCS_StateC" VALUE 0x8005CF40 DATA_RECORD_UWORD 65535 F_1_p0_2 0 65535 /end CHARACTERISTIC
/begin CHARACTERISTIC FTSMMAM_FTCMSCS_StateC "FTSMMAM_FTCMSCS_StateC" VALUE 0x8005CF3C DATA_RECORD_UWORD 65535 F_1_p0_2 0 65535 /end CHARACTERISTIC
/begin CHARACTERISTIC FTSMMAM_FTCMTCS_StateC "FTSMMAM_FTCMTCS_StateC" VALUE 0x8005CF38 DATA_RECORD_UWORD 65535 F_1_p0_2 0 65535 /end CHARACTERISTIC
/begin CHARACTERISTIC FTSMMAM_FtModeReqBypassOnOffC "FTSMMAM_FtModeReqBypassOnOffC" VALUE 0x8005CF34 DATA_RECORD_UBYTE 1 Bool_ON_OFF 0 1 BIT_MASK 0x01 /end CHARACTERISTIC
/begin CHARACTERISTIC FTSMMAM_FtModeReqBypassValueC "FTSMMAM_FtModeReqBypassValueC" VALUE 0x8005CF30 DATA_RECORD_UWORD 65535 F_1_p0_2 0 65535 /end CHARACTERISTIC
/begin CHARACTERISTIC FTSMMAM_MTLCS_StateC "FTSMMAM_MTLCS_StateC" VALUE 0x8005CF2C DATA_RECORD_UWORD 65535 F_1_p0_2 0 65535 /end CHARACTERISTIC
/begin CHARACTERISTIC FTSMMAM_MTMEP_MainEnableC "FTSMMAM_MTMEP_MainEnableC" VALUE 0x8005CF28 DATA_RECORD_UBYTE 1 Bool_ON_OFF 0 1 BIT_MASK 0x01 /end CHARACTERISTIC
/begin CHARACTERISTIC FTSMMAM_MTMEP_StateC "FTSMMAM_MTMEP_StateC" VALUE 0x8005CF24 DATA_RECORD_UWORD 65535 F_1_p0_2 0 65535 /end CHARACTERISTIC
/begin CHARACTERISTIC FTSMREF_AutoPhasingOutputNumC "FTSMREF_AutoPhasingOutputNumC" VALUE 0x8005D1A4 DATA_RECORD_UWORD 65535 F_1_p0_2 0 65535 /end CHARACTERISTIC
/begin CHARACTERISTIC FTSMREF_CalEnableTimeC "FTSMREF_CalEnableTimeC" VALUE 0x8005D1A0 DATA_RECORD_FLOAT32_IEEE 3.402823466E+038 F_1_p0_2 -3.402823466E+038 3.402823466E+038 /end CHARACTERISTIC
/begin CHARACTERISTIC FTSMREF_CalFinishTimeC "FTSMREF_CalFinishTimeC" VALUE 0x8005D19C DATA_RECORD_FLOAT32_IEEE 3.402823466E+038 F_1_p0_2 -3.402823466E+038 3.402823466E+038 /end CHARACTERISTIC
/begin CHARACTERISTIC FTSMREF_CalStartTimeMaxC "FTSMREF_CalStartTimeMaxC" VALUE 0x8005D198 DATA_RECORD_FLOAT32_IEEE 3.402823466E+038 F_1_p0_2 -3.402823466E+038 3.402823466E+038 /end CHARACTERISTIC
/begin CHARACTERISTIC FTSMREF_CyclefinishNumC "FTSMREF_CyclefinishNumC" VALUE 0x8005D194 DATA_RECORD_UWORD 65535 F_1_p0_2 0 65535 /end CHARACTERISTIC
/begin CHARACTERISTIC FTSMREF_IdrefC "FTSMREF_IdrefC" CURVE 0x8005D080 DATA_RECORD_FLOAT32_IEEE 3.402823466E+038 F_1_p0_2 -3.402823466E+038 3.402823466E+038
 /begin AXIS_DESCR FIX_AXIS NO_INPUT_QUANTITY Id_0x00 69 0 68 MAX_GRAD 100.0 FIX_AXIS_PAR_DIST 0 1 69 /end AXIS_DESCR
/end CHARACTERISTIC
/begin CHARACTERISTIC FTSMREF_IdrefGainC "FTSMREF_IdrefGainC" VALUE 0x8005D07C DATA_RECORD_FLOAT32_IEEE 3.402823466E+038 F_1_p0_2 -3.402823466E+038 3.402823466E+038 /end CHARACTERISTIC
/begin CHARACTERISTIC FTSMREF_LutOutAngleC "FTSMREF_LutOutAngleC" CURVE 0x8005CF68 DATA_RECORD_FLOAT32_IEEE 3.402823466E+038 F_1_p0_2 -3.402823466E+038 3.402823466E+038
 /begin AXIS_DESCR FIX_AXIS NO_INPUT_QUANTITY Id_0x00 69 0 68 MAX_GRAD 100.0 FIX_AXIS_PAR_DIST 0 1 69 /end AXIS_DESCR
/end CHARACTERISTIC
/begin CHARACTERISTIC FTSMREF_Neg0TimerThdHighC "FTSMREF_Neg0TimerThdHighC" VALUE 0x8005CF64 DATA_RECORD_UWORD 65535 F_1_p0_2 0 65535 /end CHARACTERISTIC
/begin CHARACTERISTIC FTSMREF_Neg0TimerThdLowC "FTSMREF_Neg0TimerThdLowC" VALUE 0x8005CF60 DATA_RECORD_UWORD 65535 F_1_p0_2 0 65535 /end CHARACTERISTIC
/begin CHARACTERISTIC FTSMREF_Pos0TimerThdHighC "FTSMREF_Pos0TimerThdHighC" VALUE 0x8005CF5C DATA_RECORD_UWORD 65535 F_1_p0_2 0 65535 /end CHARACTERISTIC
/begin CHARACTERISTIC FTSMREF_Pos0TimerThdLowC "FTSMREF_Pos0TimerThdLowC" VALUE 0x8005CF58 DATA_RECORD_UWORD 65535 F_1_p0_2 0 65535 /end CHARACTERISTIC
/begin CHARACTERISTIC SDMTLCS_CounterInitC "SDMTLCS_CounterInitC" VALUE 0x8005D6EC DATA_RECORD_ULONG 4294967295 F_1_p0_2 0 4294967295 /end CHARACTERISTIC
/begin CHARACTERISTIC SDMTLCS_CurrentRmsCounterC "SDMTLCS_CurrentRmsCounterC" VALUE 0x8005D6E8 DATA_RECORD_ULONG 4294967295 F_1_p0_2 0 4294967295 /end CHARACTERISTIC
/begin CHARACTERISTIC SDMTLCS_CurrentRmsCounterZC "SDMTLCS_CurrentRmsCounterZC" VALUE 0x8005D6E4 DATA_RECORD_FLOAT32_IEEE 3.402823466E+038 F_1_p0_2 -3.402823466E+038 3.402823466E+038 /end CHARACTERISTIC
/begin CHARACTERISTIC SDMTLCS_CurrentRmsSDEnC "SDMTLCS_CurrentRmsSDEnC" VALUE 0x8005D6E0 DATA_RECORD_UBYTE 1 Bool_ON_OFF 0 1 BIT_MASK 0x01 /end CHARACTERISTIC
/begin CHARACTERISTIC SDMTLCS_CurrentRmsSumInitC "SDMTLCS_CurrentRmsSumInitC" VALUE 0x8005D6DC DATA_RECORD_FLOAT32_IEEE 3.402823466E+038 F_1_p0_2 -3.402823466E+038 3.402823466E+038 /end CHARACTERISTIC
/begin CHARACTERISTIC SDMTMEP_A2DShortCircuitGndC "SDMTMEP_A2DShortCircuitGndC" VALUE 0x8005D81C DATA_RECORD_UWORD 65535 F_1_p0_2 0 65535 /end CHARACTERISTIC
/begin CHARACTERISTIC SDMTMEP_A2DShortCircuitVccC "SDMTMEP_A2DShortCircuitVccC" VALUE 0x8005D818 DATA_RECORD_UWORD 65535 F_1_p0_2 0 65535 /end CHARACTERISTIC
/begin CHARACTERISTIC SDMTMEP_AutoPhasingAngOnOffC "SDMTMEP_AutoPhasingAngOnOffC" VALUE 0x8005D814 DATA_RECORD_UBYTE 1 Bool_ON_OFF 0 1 BIT_MASK 0x01 /end CHARACTERISTIC
/begin CHARACTERISTIC SDMTMEP_AutoPhasingAngleC "parameter used to adjust the resolver position to the motor position" VALUE 0x8005D810 DATA_RECORD_FLOAT32_IEEE 2 F_1_p0_2 -1 1 /end CHARACTERISTIC
/begin CHARACTERISTIC SDMTMEP_AutophasingThdHighC "SDMTMEP_AutophasingThdHighC" VALUE 0x8005D80C DATA_RECORD_FLOAT32_IEEE 3.402823466E+038 F_1_p0_2 -3.402823466E+038 3.402823466E+038 /end CHARACTERISTIC
/begin CHARACTERISTIC SDMTMEP_AutophasingThdLowC "SDMTMEP_AutophasingThdLowC" VALUE 0x8005D808 DATA_RECORD_FLOAT32_IEEE 3.402823466E+038 F_1_p0_2 -3.402823466E+038 3.402823466E+038 /end CHARACTERISTIC
/begin CHARACTERISTIC SDMTMEP_AvarageGainC "SDMTMEP_AvarageGainC" VALUE 0x8005D804 DATA_RECORD_FLOAT32_IEEE 3.402823466E+038 F_1_p0_2 -3.402823466E+038 3.402823466E+038 /end CHARACTERISTIC
/begin CHARACTERISTIC SDMTMEP_BenchModeValueC "0 = observer / 1 = manual speed" VALUE 0x8005D800 DATA_RECORD_UBYTE 1 Bool_ON_OFF 0 1 BIT_MASK 0x01 /end CHARACTERISTIC
/begin CHARACTERISTIC SDMTMEP_Filter_NumZC "filter parameter" VALUE 0x8005D7FC DATA_RECORD_FLOAT32_IEEE 3.402823466E+038 F_1_p0_2 -3.402823466E+038 3.402823466E+038 /end CHARACTERISTIC
/begin CHARACTERISTIC SDMTMEP_Flg2BSWTimeMaxC "SDMTMEP_Flg2BSWTimeMaxC" VALUE 0x8005D7F8 DATA_RECORD_FLOAT32_IEEE 3.402823466E+038 F_1_p0_2 -3.402823466E+038 3.402823466E+038 /end CHARACTERISTIC
/begin CHARACTERISTIC SDMTMEP_GainCosSignAutoEnC "SDMTMEP_GainCosSignAutoEnC" VALUE 0x8005D7F4 DATA_RECORD_UBYTE 1 Bool_ON_OFF 0 1 BIT_MASK 0x01 /end CHARACTERISTIC
/begin CHARACTERISTIC SDMTMEP_GainCosSignC "SDMTMEP_GainCosSignC" VALUE 0x8005D7F0 DATA_RECORD_FLOAT32_IEEE 3.402823466E+038 F_1_p0_2 -3.402823466E+038 3.402823466E+038 /end CHARACTERISTIC
/begin CHARACTERISTIC SDMTMEP_GainCosThdHighC "SDMTMEP_GainCosThdHighC" VALUE 0x8005D7EC DATA_RECORD_FLOAT32_IEEE 3.402823466E+038 F_1_p0_2 -3.402823466E+038 3.402823466E+038 /end CHARACTERISTIC
/begin CHARACTERISTIC SDMTMEP_GainCosThdLowC "SDMTMEP_GainCosThdLowC" VALUE 0x8005D7E8 DATA_RECORD_FLOAT32_IEEE 3.402823466E+038 F_1_p0_2 -3.402823466E+038 3.402823466E+038 /end CHARACTERISTIC
/begin CHARACTERISTIC SDMTMEP_GainCosTrimC "gain used to correct a sensor linearity error" VALUE 0x8005D7E4 DATA_RECORD_FLOAT32_IEEE 3.402823466E+038 F_1_p0_2 -3.402823466E+038 3.402823466E+038 /end CHARACTERISTIC
/begin CHARACTERISTIC SDMTMEP_GainSinHighC "SDMTMEP_GainSinHighC" VALUE 0x8005D7E0 DATA_RECORD_FLOAT32_IEEE 3.402823466E+038 F_1_p0_2 -3.402823466E+038 3.402823466E+038 /end CHARACTERISTIC
/begin CHARACTERISTIC SDMTMEP_GainSinSignC "SDMTMEP_GainSinSignC" VALUE 0x8005D7DC DATA_RECORD_FLOAT32_IEEE 3.402823466E+038 F_1_p0_2 -3.402823466E+038 3.402823466E+038 /end CHARACTERISTIC
/begin CHARACTERISTIC SDMTMEP_GainSinThdLowC "SDMTMEP_GainSinThdLowC" VALUE 0x8005D7D8 DATA_RECORD_FLOAT32_IEEE 3.402823466E+038 F_1_p0_2 -3.402823466E+038 3.402823466E+038 /end CHARACTERISTIC
/begin CHARACTERISTIC SDMTMEP_GainSinTrimC "gain used to correct a sensor linearity error" VALUE 0x8005D7D4 DATA_RECORD_FLOAT32_IEEE 3.402823466E+038 F_1_p0_2 -3.402823466E+038 3.402823466E+038 /end CHARACTERISTIC
/begin CHARACTERISTIC SDMTMEP_ImpoedThetaStepC "SDMTMEP_ImpoedThetaStepC" VALUE 0x8005D7D0 DATA_RECORD_FLOAT32_IEEE 3.402823466E+038 F_1_p0_2 -3.402823466E+038 3.402823466E+038 /end CHARACTERISTIC
/begin CHARACTERISTIC SDMTMEP_ImpoedThetaStepMaxC "SDMTMEP_ImpoedThetaStepMaxC" VALUE 0x8005D7CC DATA_RECORD_FLOAT32_IEEE 3.402823466E+038 F_1_p0_2 -3.402823466E+038 3.402823466E+038 /end CHARACTERISTIC
/begin CHARACTERISTIC SDMTMEP_K1ParameterC "observer parameter (see V03 NT 09 00262)" VALUE 0x8005D7C8 DATA_RECORD_FLOAT32_IEEE 3.402823466E+038 F_1_p0_2 -3.402823466E+038 3.402823466E+038 /end CHARACTERISTIC
/begin CHARACTERISTIC SDMTMEP_K2ParameterC "observer parameter (see V03 NT 09 00262)" VALUE 0x8005D7C4 DATA_RECORD_FLOAT32_IEEE 3.402823466E+038 F_1_p0_2 -3.402823466E+038 3.402823466E+038 /end CHARACTERISTIC
/begin CHARACTERISTIC SDMTMEP_LutInMecaSpeedRpmC "SDMTMEP_LutInMecaSpeedRpmC" CURVE 0x8005D7A0 DATA_RECORD_FLOAT32_IEEE 3.402823466E+038 F_1_p0_2 -3.402823466E+038 3.402823466E+038
 /begin AXIS_DESCR FIX_AXIS NO_INPUT_QUANTITY Id_0x00 9 0 8 MAX_GRAD 100.0 FIX_AXIS_PAR_DIST 0 1 9 /end AXIS_DESCR
/end CHARACTERISTIC
/begin CHARACTERISTIC SDMTMEP_LutOutAutoPhaseAngleC "SDMTMEP_LutOutAutoPhaseAngleC" CURVE 0x8005D77C DATA_RECORD_FLOAT32_IEEE 3.402823466E+038 F_1_p0_2 -3.402823466E+038 3.402823466E+038
 /begin AXIS_DESCR FIX_AXIS NO_INPUT_QUANTITY Id_0x00 9 0 8 MAX_GRAD 100.0 FIX_AXIS_PAR_DIST 0 1 9 /end AXIS_DESCR
/end CHARACTERISTIC
/begin CHARACTERISTIC SDMTMEP_LutSinC "LUT IN resolver sinus theta" CURVE 0x8005D768 DATA_RECORD_FLOAT32_IEEE 3.402823466E+038 F_1_p0_2 -3.402823466E+038 3.402823466E+038
 /begin AXIS_DESCR FIX_AXIS NO_INPUT_QUANTITY Id_0x00 5 0 4 MAX_GRAD 100.0 FIX_AXIS_PAR_DIST 0 1 5 /end AXIS_DESCR
/end CHARACTERISTIC
/begin CHARACTERISTIC SDMTMEP_LutThetaRdSurPiC "LUT OUT resolver angle" CURVE 0x8005D754 DATA_RECORD_FLOAT32_IEEE 3.402823466E+038 F_1_p0_2 -3.402823466E+038 3.402823466E+038
 /begin AXIS_DESCR FIX_AXIS NO_INPUT_QUANTITY Id_0x00 5 0 4 MAX_GRAD 100.0 FIX_AXIS_PAR_DIST 0 1 5 /end AXIS_DESCR
/end CHARACTERISTIC
/begin CHARACTERISTIC SDMTMEP_MecaRpmToElecRdsC "SDMTMEP_MecaRpmToElecRdsC" VALUE 0x8005D750 DATA_RECORD_FLOAT32_IEEE 3.402823466E+038 F_1_p0_2 -3.402823466E+038 3.402823466E+038 /end CHARACTERISTIC
/begin CHARACTERISTIC SDMTMEP_MecaSpeedRpmC "Value of mechanical speed when SDMTMEP_ManualSpeedActivationC = 1" VALUE 0x8005D74C DATA_RECORD_FLOAT32_IEEE 3.402823466E+038 F_1_p0_2 -3.402823466E+038 3.402823466E+038 /end CHARACTERISTIC
/begin CHARACTERISTIC SDMTMEP_OcGainCosTrimC "SDMTMEP_OcGainCosTrimC" VALUE 0x8005D748 DATA_RECORD_FLOAT32_IEEE 3.402823466E+038 F_1_p0_2 -3.402823466E+038 3.402823466E+038 /end CHARACTERISTIC
/begin CHARACTERISTIC SDMTMEP_OcGainSinTrimC "SDMTMEP_OcGainSinTrimC" VALUE 0x8005D744 DATA_RECORD_FLOAT32_IEEE 3.402823466E+038 F_1_p0_2 -3.402823466E+038 3.402823466E+038 /end CHARACTERISTIC
/begin CHARACTERISTIC SDMTMEP_OcOffsetCosTrimC "SDMTMEP_OcOffsetCosTrimC" VALUE 0x8005D740 DATA_RECORD_FLOAT32_IEEE 3.402823466E+038 F_1_p0_2 -3.402823466E+038 3.402823466E+038 /end CHARACTERISTIC
/begin CHARACTERISTIC SDMTMEP_OcOffsetSinTrimC "SDMTMEP_OcOffsetSinTrimC" VALUE 0x8005D73C DATA_RECORD_FLOAT32_IEEE 3.402823466E+038 F_1_p0_2 -3.402823466E+038 3.402823466E+038 /end CHARACTERISTIC
/begin CHARACTERISTIC SDMTMEP_OcRotoringNormalSumC "SDMTMEP_OcSumRangeResThetaC * 2 * 5" VALUE 0x8005D738 DATA_RECORD_FLOAT32_IEEE 3.402823466E+038 F_1_p0_2 -3.402823466E+038 3.402823466E+038 /end CHARACTERISTIC
/begin CHARACTERISTIC SDMTMEP_OcSinCosAdcFilterNumZC "SDMTMEP_OcSinCosAdcFilterNumZC" VALUE 0x8005D734 DATA_RECORD_FLOAT32_IEEE 3.402823466E+038 F_1_p0_2 -3.402823466E+038 3.402823466E+038 /end CHARACTERISTIC
/begin CHARACTERISTIC SDMTMEP_OcSumRangeResThetaC "SDMTMEP_OcSumRangeResThetaC" VALUE 0x8005D730 DATA_RECORD_FLOAT32_IEEE 3.402823466E+038 F_1_p0_2 -3.402823466E+038 3.402823466E+038 /end CHARACTERISTIC
/begin CHARACTERISTIC SDMTMEP_OffsetCosThdHighC "SDMTMEP_OffsetCosThdHighC" VALUE 0x8005D72C DATA_RECORD_FLOAT32_IEEE 3.402823466E+038 F_1_p0_2 -3.402823466E+038 3.402823466E+038 /end CHARACTERISTIC
/begin CHARACTERISTIC SDMTMEP_OffsetCosThdLowC "SDMTMEP_OffsetCosThdLowC" VALUE 0x8005D728 DATA_RECORD_FLOAT32_IEEE 3.402823466E+038 F_1_p0_2 -3.402823466E+038 3.402823466E+038 /end CHARACTERISTIC
/begin CHARACTERISTIC SDMTMEP_OffsetCosTrimC "parameter used to correct the sensor offset error" VALUE 0x8005D724 DATA_RECORD_FLOAT32_IEEE 3.402823466E+038 F_1_p0_2 -3.402823466E+038 3.402823466E+038 /end CHARACTERISTIC
/begin CHARACTERISTIC SDMTMEP_OffsetSinThdHighC "SDMTMEP_OffsetSinThdHighC" VALUE 0x8005D720 DATA_RECORD_FLOAT32_IEEE 3.402823466E+038 F_1_p0_2 -3.402823466E+038 3.402823466E+038 /end CHARACTERISTIC
/begin CHARACTERISTIC SDMTMEP_OffsetSinThdLowC "SDMTMEP_OffsetSinThdLowC" VALUE 0x8005D71C DATA_RECORD_FLOAT32_IEEE 3.402823466E+038 F_1_p0_2 -3.402823466E+038 3.402823466E+038 /end CHARACTERISTIC
/begin CHARACTERISTIC SDMTMEP_OffsetSinTrimC "parameter used to correct the sensor offset error" VALUE 0x8005D718 DATA_RECORD_FLOAT32_IEEE 3.402823466E+038 F_1_p0_2 -3.402823466E+038 3.402823466E+038 /end CHARACTERISTIC
/begin CHARACTERISTIC SDMTMEP_OverSpeedThdC "parameter used to correct the sensor offset error" VALUE 0x8005D714 DATA_RECORD_FLOAT32_IEEE 3.402823466E+038 F_1_p0_2 -3.402823466E+038 3.402823466E+038 /end CHARACTERISTIC
/begin CHARACTERISTIC SDMTMEP_OverSpeedThdOcC "parameter used to correct the sensor offset error" VALUE 0x8005D710 DATA_RECORD_FLOAT32_IEEE 3.402823466E+038 F_1_p0_2 -3.402823466E+038 3.402823466E+038 /end CHARACTERISTIC
/begin CHARACTERISTIC SDMTMEP_PositionMarginC "SDMTMEP_PositionMarginC" VALUE 0x8005D70C DATA_RECORD_FLOAT32_IEEE 1 F_1_p0_2 0 1 /end CHARACTERISTIC
/begin CHARACTERISTIC SDMTMEP_RecoverTimeC "SDMTMEP_RecoverTimeC" VALUE 0x8005D708 DATA_RECORD_FLOAT32_IEEE 3.402823466E+038 F_1_p0_2 -3.402823466E+038 3.402823466E+038 /end CHARACTERISTIC
/begin CHARACTERISTIC SDMTMEP_ResolverParamStoreEnC "SDMTMEP_ResolverParamStoreEnC" VALUE 0x8005D704 DATA_RECORD_UBYTE 1 Bool_ON_OFF 0 1 BIT_MASK 0x01 /end CHARACTERISTIC
/begin CHARACTERISTIC SDMTMEP_RotoringPerdCountC "sample time of the function" VALUE 0x8005D700 DATA_RECORD_UWORD 65535 F_1_p0_2 0 65535 /end CHARACTERISTIC
/begin CHARACTERISTIC SDMTMEP_SpdCompEnableC "SDMTMEP_SpdCompEnableC" VALUE 0x8005D6FC DATA_RECORD_UBYTE 1 Bool_ON_OFF 0 1 BIT_MASK 0x01 /end CHARACTERISTIC
/begin CHARACTERISTIC SDMTMEP_SpeedMarginC "SDMTMEP_SpeedMarginC" VALUE 0x8005D6F8 DATA_RECORD_FLOAT32_IEEE 500 F_1_p0_2 0 500 /end CHARACTERISTIC
/begin CHARACTERISTIC SDMTMEP_UnderSpeedThdC "parameter used to correct the sensor offset error" VALUE 0x8005D6F4 DATA_RECORD_FLOAT32_IEEE 3.402823466E+038 F_1_p0_2 -3.402823466E+038 3.402823466E+038 /end CHARACTERISTIC
/begin CHARACTERISTIC SDMTMEP_UnderSpeedThdOcC "parameter used to correct the sensor offset error" VALUE 0x8005D6F0 DATA_RECORD_FLOAT32_IEEE 3.402823466E+038 F_1_p0_2 -3.402823466E+038 3.402823466E+038 /end CHARACTERISTIC
/begin MEASUREMENT CurrentSession "CurrentSession" UBYTE I_1 1 2 0 255 ECU_ADDRESS 0x7002B55E /end MEASUREMENT
/begin COMPU_METHOD I_1 "" RAT_FUNC "%9.2" "-" COEFFS 0 1 0 0 0 1 /end COMPU_METHOD
/begin COMPU_METHOD F_1_p0_2 "" RAT_FUNC "%9.2" "" COEFFS 0 1 0 0 0 1 /end COMPU_METHOD
/begin COMPU_METHOD Id_0x00 "" RAT_FUNC "%9.2" "." COEFFS 0 1 0 0 0 1 /end COMPU_METHOD
/begin COMPU_METHOD Bool_ON_OFF "" TAB_VERB "%8.4" "." COMPU_TAB_REF Bool_ON_OFF_table /end COMPU_METHOD
/begin COMPU_VTAB Bool_ON_OFF_table "" TAB_VERB 2 0 "OFF" 1 "ON" /end COMPU_VTAB
/begin FUNCTION SWC_FT ""
 /begin DEF_CHARACTERISTIC FTDDLMP_I0LimitMinC FTDDLMP_IdLimitMaxC FTDDLMP_IdLimitMinC FTDDLMP_IqLimitMaxC FTDDLMP_IqLimitMinC FTDDLMP_PowerLimC FTDDLMP_SpeedLimitMaxC FTDDLMP_SpeedLimitMinC FTDDLMP_TorqLimitMaxC FTDDLMP_TorqLimitMinC FTEVEIT_CommutDataCoeffC FTEVEIT_EoffICurrentsC FTEVEIT_EoffIEnergiesC FTEVEIT_EonICurrentsC FTEVEIT_EonIEnergiesC FTEVEIT_ErecICurrentsC FTEVEIT_ErecIEnergiesC FTEVEIT_KoffUdcCoeffsC FTEVEIT_KoffUdcVoltagesC FTEVEIT_KonUdcCoeffsC FTEVEIT_KonUdcVoltagesC FTEVEIT_KrecUdcCoeffsC FTEVEIT_KrecUdcVoltagesC FTEVEIT_MaxMechaSpdHysteresisC FTEVEIT_MaxTempC FTEVEIT_MinMechaSpdHysteresisC FTEVEIT_OverTempThresC FTEVEIT_PdiodeTdiodeAlphaS1C FTEVEIT_PdiodeTdiodeAlphaS2C FTEVEIT_PdiodeTdiodeAlphaS3C FTEVEIT_PdiodeTdiodeAlphaS4C FTEVEIT_PdiodeTdiodeAlphaS5C FTEVEIT_PdiodeTdiodeNumS1C FTEVEIT_PdiodeTdiodeNumS2C FTEVEIT_PdiodeTdiodeNumS3C FTEVEIT_PdiodeTdiodeNumS4C FTEVEIT_PdiodeTdiodeNumS5C FTEVEIT_PdiodeTigbtAlphaC FTEVEIT_PdiodeTigbtNumC FTEVEIT_PigbtTdiodeAlphaC FTEVEIT_PigbtTdiodeNumC FTEVEIT_PigbtTigbtAlphaS1C FTEVEIT_PigbtTigbtAlphaS2C FTEVEIT_PigbtTigbtAlphaS3C FTEVEIT_PigbtTigbtAlphaS4C FTEVEIT_PigbtTigbtAlphaS5C FTEVEIT_PigbtTigbtNumS1C FTEVEIT_PigbtTigbtNumS2C FTEVEIT_PigbtTigbtNumS3C FTEVEIT_PigbtTigbtNumS4C FTEVEIT_PigbtTigbtNumS5C FTEVEIT_TcoolBenchC FTEVEIT_TcoolChoosePMWC FTEVEIT_TcoolScalingAlphaC FTEVEIT_TcoolScalingBetaC FTEVEIT_TempFirstFildTrC FTEVEIT_TempSecFildTrC FTEVEIT_TempVectFildTrC FTEVEIT_UdICurrentsC FTEVEIT_UdIVoltagesC FTEVEIT_UtICurrentsC FTEVEIT_UtIVoltagesC FTMTLCS_A2DGainIsuLC FTMTLCS_A2DGainIsvLC FTMTLCS_A2DGainIswLC FTMTLCS_A2DHighThresholdC FTMTLCS_A2DLowThresholdC FTMTLCS_CounterInitC FTMTLCS_CurrentCalEnableC FTMTLCS_CurrentOffsetInitC FTMTLCS_CurrentRmsCounterC FTMTLCS_CurrentRmsCounterZC FTMTLCS_CurrentRmsFTEnC FTMTLCS_CurrentRmsSumInitC FTMTLCS_ExtCurrentGainEnaC FTMTLCS_ExtCurrentGainMaxC FTMTLCS_ExtCurrentGainMinC FTMTLCS_Init2DurationC FTMTLCS_InitIuvw3C FTMTLCS_IuGainC FTMTLCS_IvGainC FTMTLCS_IwGainC FTMTLCS_LostPhaseDelayCntC FTMTLCS_LostPhaseEnaEleSpdRdsC FTMTLCS_LostPhaseMaxRateC FTMTLCS_LostPhaseMinIRmsC FTMTLCS_LutInPhaseCurrUC FTMTLCS_LutInPhaseCurrVC FTMTLCS_LutInPhaseCurrWC FTMTLCS_LutOutPhaseCurrUC FTMTLCS_LutOutPhaseCurrVC FTMTLCS_LutOutPhaseCurrWC FTMTLCS_SpdCutOffFrequencyC FTMTLCS_SumErrorNegThrC FTMTLCS_SumErrorPosThrC FTMTSEP_ErrorThetaFactorC FTMTSEP_TimeAdvanceFactC FTSMACS_AclSpeedThdC FTSMACS_BenchModeC FTSMACS_PwmOffSpeedThdC FTSMACS_ReinitFaultC FTSMACS_TestFaultC FTSMACS_UbatHVMinC FTSMACS_VsiTimerFreqRatioRefC FTSMMAM_AclStateBypassOnOffC FTSMMAM_AclStateBypassValueC FTSMMAM_CMCCS_M0ConOnoffC FTSMMAM_EVEIT_MainEnableC FTSMMAM_FTCIVDC_StateC FTSMMAM_FTCMCCS_StateC FTSMMAM_FTCMSCS_StateC FTSMMAM_FTCMTCS_StateC FTSMMAM_FtModeReqBypassOnOffC FTSMMAM_FtModeReqBypassValueC FTSMMAM_MTLCS_StateC FTSMMAM_MTMEP_MainEnableC FTSMMAM_MTMEP_StateC FTSMREF_AutoPhasingOutputNumC FTSMREF_CalEnableTimeC FTSMREF_CalFinishTimeC FTSMREF_CalStartTimeMaxC FTSMREF_CyclefinishNumC FTSMREF_IdrefC FTSMREF_IdrefGainC FTSMREF_LutOutAngleC FTSMREF_Neg0TimerThdHighC FTSMREF_Neg0TimerThdLowC FTSMREF_Pos0TimerThdHighC FTSMREF_Pos0TimerThdLowC SDMTLCS_CounterInitC SDMTLCS_CurrentRmsCounterC SDMTLCS_CurrentRmsCounterZC SDMTLCS_CurrentRmsSDEnC SDMTLCS_CurrentRmsSumInitC SDMTMEP_A2DShortCircuitGndC SDMTMEP_A2DShortCircuitVccC SDMTMEP_AutoPhasingAngleC SDMTMEP_AutoPhasingAngOnOffC SDMTMEP_AutophasingThdHighC SDMTMEP_AutophasingThdLowC SDMTMEP_AvarageGainC SDMTMEP_BenchModeValueC SDMTMEP_Filter_NumZC SDMTMEP_Flg2BSWTimeMaxC SDMTMEP_GainCosSignAutoEnC SDMTMEP_GainCosSignC SDMTMEP_GainCosThdHighC SDMTMEP_GainCosThdLowC SDMTMEP_GainCosTrimC SDMTMEP_GainSinHighC SDMTMEP_GainSinSignC SDMTMEP_GainSinThdLowC SDMTMEP_GainSinTrimC SDMTMEP_ImpoedThetaStepC SDMTMEP_ImpoedThetaStepMaxC SDMTMEP_K1ParameterC SDMTMEP_K2ParameterC SDMTMEP_LutInMecaSpeedRpmC SDMTMEP_LutOutAutoPhaseAngleC SDMTMEP_LutSinC SDMTMEP_LutThetaRdSurPiC SDMTMEP_MecaRpmToElecRdsC SDMTMEP_MecaSpeedRpmC SDMTMEP_OcGainCosTrimC SDMTMEP_OcGainSinTrimC SDMTMEP_OcOffsetCosTrimC SDMTMEP_OcOffsetSinTrimC SDMTMEP_OcRotoringNormalSumC SDMTMEP_OcSinCosAdcFilterNumZC SDMTMEP_OcSumRangeResThetaC SDMTMEP_OffsetCosThdHighC SDMTMEP_OffsetCosThdLowC SDMTMEP_OffsetCosTrimC SDMTMEP_OffsetSinThdHighC SDMTMEP_OffsetSinThdLowC SDMTMEP_OffsetSinTrimC SDMTMEP_OverSpeedThdC SDMTMEP_OverSpeedThdOcC SDMTMEP_PositionMarginC SDMTMEP_RecoverTimeC SDMTMEP_ResolverParamStoreEnC SDMTMEP_RotoringPerdCountC SDMTMEP_SpdCompEnableC SDMTMEP_SpeedMarginC SDMTMEP_UnderSpeedThdC SDMTMEP_UnderSpeedThdOcC /end DEF_CHARACTERISTIC
/end FUNCTION
/begin FUNCTION UDS "" /begin OUT_MEASUREMENT CurrentSession /end OUT_MEASUREMENT /end FUNCTION
/begin GROUP AMAIN "AMAIN_GROUP" ROOT /begin FUNCTION_LIST MAIN /end FUNCTION_LIST /end GROUP
/begin GROUP Acquisitions "Acquisitions_GROUP" ROOT /begin FUNCTION_LIST HARD MAIN /end FUNCTION_LIST /end GROUP
/begin GROUP Application "Application_GROUP" ROOT /begin FUNCTION_LIST ESM HARD MAIN /end FUNCTION_LIST /end GROUP
/begin GROUP AutoMSG_Rx10_TBOX_1 "AutoMSG_Rx10_TBOX_1_GROUP" ROOT /begin FUNCTION_LIST MAIN /end FUNCTION_LIST /end GROUP
/begin GROUP AutoMSG_Rx11_TBOX_4 "AutoMSG_Rx11_TBOX_4_GROUP" ROOT /begin FUNCTION_LIST MAIN /end FUNCTION_LIST /end GROUP
/begin GROUP AutoMSG_Rx12_PEPS_1 "AutoMSG_Rx12_PEPS_1_GROUP" ROOT /begin FUNCTION_LIST MAIN /end FUNCTION_LIST /end GROUP
/begin GROUP AutoMSG_Rx13_BMS_8 "AutoMSG_Rx13_BMS_8_GROUP" ROOT /begin FUNCTION_LIST MAIN /end FUNCTION_LIST /end GROUP
/begin GROUP AutoMSG_Rx1_VCU_1 "AutoMSG_Rx1_VCU_1_GROUP" ROOT /begin FUNCTION_LIST MAIN /end FUNCTION_LIST /end GROUP
/begin GROUP AutoMSG_Rx2_VCU_2 "AutoMSG_Rx2_VCU_2_GROUP" ROOT /begin FUNCTION_LIST MAIN /end FUNCTION_LIST /end GROUP
/begin GROUP AutoMSG_Rx3_VCU_7 "AutoMSG_Rx3_VCU_7_GROUP" ROOT /begin FUNCTION_LIST MAIN /end FUNCTION_LIST /end GROUP
/begin GROUP AutoMSG_Rx4_BMS_6 "AutoMSG_Rx4_BMS_6_GROUP" ROOT /begin FUNCTION_LIST MAIN /end FUNCTION_LIST /end GROUP
/begin GROUP AutoMSG_Rx5_TBOX_2 "AutoMSG_Rx5_TBOX_2_GROUP" ROOT /begin FUNCTION_LIST MAIN /end FUNCTION_LIST /end GROUP
/begin GROUP AutoMSG_Rx6_ACP_2 "AutoMSG_Rx6_ACP_2_GROUP" ROOT /begin FUNCTION_LIST MAIN /end FUNCTION_LIST /end GROUP
/begin GROUP AutoMSG_Rx7_TMS_4 "AutoMSG_Rx7_TMS_4_GROUP" ROOT /begin FUNCTION_LIST MAIN /end FUNCTION_LIST /end GROUP
/begin GROUP AutoMSG_Rx8_VCU_5 "AutoMSG_Rx8_VCU_5_GROUP" ROOT /begin FUNCTION_LIST MAIN /end FUNCTION_LIST /end GROUP
/begin GROUP AutoMSG_Rx9_VCU_3 "AutoMSG_Rx9_VCU_3_GROUP" ROOT /begin FUNCTION_LIST MAIN /end FUNCTION_LIST /end GROUP
/begin GROUP AutoMSG_Tx1_MCU_1 "AutoMSG_Tx1_MCU_1_GROUP" ROOT /begin FUNCTION_LIST MAIN /end FUNCTION_LIST /end GROUP
/begin GROUP AutoMSG_Tx2_MCU_2 "AutoMSG_Tx2_MCU_2_GROUP" ROOT /begin FUNCTION_LIST MAIN /end FUNCTION_LIST /end GROUP
/begin GROUP AutoMSG_Tx3_MCU_3 "AutoMSG_Tx3_MCU_3_GROUP" ROOT /begin FUNCTION_LIST MAIN /end FUNCTION_LIST /end GROUP
/begin GROUP AutoMSG_Tx4_MCU_4 "AutoMSG_Tx4_MCU_4_GROUP" ROOT /begin FUNCTION_LIST MAIN /end FUNCTION_LIST /end GROUP
/begin GROUP AutoMSG_Tx5_PDU_1 "AutoMSG_Tx5_PDU_1_GROUP" ROOT /begin FUNCTION_LIST MAIN /end FUNCTION_LIST /end GROUP
/begin GROUP AutoMSG_Tx6_DCAC_1 "AutoMSG_Tx6_DCAC_1_GROUP" ROOT /begin FUNCTION_LIST MAIN /end FUNCTION_LIST /end GROUP
/begin GROUP AutoMSG_Tx7_DCAC_2 "AutoMSG_Tx7_DCAC_2_GROUP" ROOT /begin FUNCTION_LIST MAIN /end FUNCTION_LIST /end GROUP
/begin GROUP BLDC "BLDC_GROUP" ROOT /end GROUP
/begin GROUP BSW "BSW_GROUP" ROOT /begin FUNCTION_LIST BSW FAIL /end FUNCTION_LIST /end GROUP
/begin GROUP CALUSR "CALUSR_GROUP" ROOT /begin FUNCTION_LIST CALUSR /end FUNCTION_LIST /end GROUP
/begin GROUP CCU6 "CCU6_GROUP" ROOT /begin FUNCTION_LIST CCU6 /end FUNCTION_LIST /end GROUP
/begin GROUP COMMUSR "COMMUSR_GROUP" ROOT /end GROUP
/begin GROUP Calibration "Calibration_GROUP" /begin SUB_GROUP DEV /end SUB_GROUP /end GROUP
/begin GROUP Com "Com_GROUP" ROOT /begin FUNCTION_LIST MAIN /end FUNCTION_LIST /end GROUP
/begin GROUP Communication "Communication_GROUP" /begin FUNCTION_LIST CCU6 /end FUNCTION_LIST /end GROUP
/begin GROUP DCU_1 "DCU_1_GROUP" /begin SUB_GROUP Communication /end SUB_GROUP /end GROUP
/begin GROUP DEV "DEV_GROUP" /begin FUNCTION_LIST MAIN /end FUNCTION_LIST /end GROUP
/begin GROUP DFLASH "DFLASH_GROUP" ROOT /end GROUP
/begin GROUP DSM "DSM_GROUP" /begin FUNCTION_LIST FAULT_FF /end FUNCTION_LIST /end GROUP
/begin GROUP Develop "Develop_GROUP" /begin FUNCTION_LIST MAIN /end FUNCTION_LIST /end GROUP
/begin GROUP Development_z "Development_z_GROUP" ROOT /begin FUNCTION_LIST DEVHAL SPY /end FUNCTION_LIST /end GROUP
/begin GROUP Developpement "Developpement_GROUP" ROOT /begin FUNCTION_LIST BSW HARD /end FUNCTION_LIST /end GROUP
/begin GROUP Diagnostic "Diagnostic_GROUP" ROOT /begin FUNCTION_LIST BSW DSM FAULT MAIN /end FUNCTION_LIST /end GROUP
/begin GROUP Divers "Divers_GROUP" ROOT /begin FUNCTION_LIST MAIN /end FUNCTION_LIST /end GROUP
/begin GROUP Driver "Driver_GROUP" ROOT /begin FUNCTION_LIST COMMUSR MAIN RES STFSRV /end FUNCTION_LIST /end GROUP
/begin GROUP EAS "EAS_GROUP" ROOT /end GROUP
/begin GROUP FAIL "FAIL_GROUP" ROOT /begin FUNCTION_LIST FAIL /end FUNCTION_LIST /end GROUP
/begin GROUP FAULT_FF "FAULT_FF_GROUP" ROOT /begin SUB_GROUP DSM /end SUB_GROUP /end GROUP
/begin GROUP FRecord "FRecord_GROUP" ROOT /begin FUNCTION_LIST FRecord /end FUNCTION_LIST /end GROUP
/begin GROUP G2M_3 "G2M_3_GROUP" /begin SUB_GROUP MAIN /end SUB_GROUP /end GROUP
/begin GROUP GCCU6 "GCCU6_GROUP" ROOT /begin FUNCTION_LIST GCCU6 /end FUNCTION_LIST /end GROUP
/begin GROUP Hard_Pwm "Hard_Pwm_GROUP" ROOT /begin FUNCTION_LIST HARD /end FUNCTION_LIST /end GROUP
/begin GROUP IOHAL "IOHAL_GROUP" ROOT /begin FUNCTION_LIST IOHAL /end FUNCTION_LIST /end GROUP
/begin GROUP MAIN "MAIN_GROUP" /begin FUNCTION_LIST MAIN /end FUNCTION_LIST /end GROUP
/begin GROUP Main "Main_GROUP" ROOT /begin FUNCTION_LIST BSW MAIN SPY /end FUNCTION_LIST /end GROUP
/begin GROUP Miscellaneous "Miscellaneous_GROUP" ROOT /end GROUP
/begin GROUP Noyau "Noyau_GROUP" ROOT /end GROUP
/begin GROUP NvM "NvM_GROUP" ROOT /begin FUNCTION_LIST BSW /end FUNCTION_LIST /end GROUP
/begin GROUP OBD "OBD_GROUP" ROOT /end GROUP
/begin GROUP Physical "Physical_GROUP" ROOT /begin SUB_GROUP DCU_1 /end SUB_GROUP /end GROUP
/begin GROUP RSTSRV "RSTSRV_GROUP" ROOT /end GROUP
/begin GROUP RTE "RTE_GROUP" ROOT /begin FUNCTION_LIST RTE /end FUNCTION_LIST /end GROUP
/begin GROUP Raw "Raw_GROUP" ROOT /begin SUB_GROUP Calibration G2M_3 /end SUB_GROUP /end GROUP
/begin GROUP RxChecksum "RxChecksum_GROUP" ROOT /begin FUNCTION_LIST BSW /end FUNCTION_LIST /end GROUP
/begin GROUP SWC_FS "SWC_FS_GROUP" ROOT /begin FUNCTION_LIST SWC_FS /end FUNCTION_LIST /end GROUP
/begin GROUP SWC_FT "SWC_FT_GROUP" ROOT /begin FUNCTION_LIST SWC_FT /end FUNCTION_LIST /end GROUP
/begin GROUP TJA1145 "TJA1145_GROUP" ROOT /end GROUP
/begin GROUP TOutFlag "TOutFlag_GROUP" ROOT /begin FUNCTION_LIST BSW /end FUNCTION_LIST /end GROUP
/begin GROUP TST "TST_GROUP" ROOT /begin FUNCTION_LIST HARD /end FUNCTION_LIST /end GROUP
/begin GROUP Tsk "Tsk_GROUP" ROOT /begin SUB_GROUP Develop /end SUB_GROUP /end GROUP
/begin GROUP UDS "UDS_GROUP" ROOT /begin FUNCTION_LIST UDS /end FUNCTION_LIST /end GROUP
/begin GROUP miscellaneous "miscellaneous_GROUP" ROOT /end GROUP
/begin GROUP miscellenious "miscellenious_GROUP" ROOT /end GROUP
/end MODULE
/end PROJECT
