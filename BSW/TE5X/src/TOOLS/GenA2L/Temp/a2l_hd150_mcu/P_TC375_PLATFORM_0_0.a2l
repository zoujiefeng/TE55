ASAP2_VERSION 1 3
/begin PROJECT P_TC375_PLATFORM_0_0 "P_TC375_PLATFORM_0_0"
/begin HEADER "" VERSION "5210.00" PROJECT_NO D0 /end HEADER
/begin MODULE P_TC375_PLATFORM_0_0 "Invt"
/begin MOD_COMMON "" DEPOSIT ABSOLUTE ALIGNMENT_BYTE 1 ALIGNMENT_WORD 2 ALIGNMENT_LONG 4 ALIGNMENT_FLOAT32_IEEE 4 ALIGNMENT_FLOAT64_IEEE 8 BYTE_ORDER MSB_LAST /end MOD_COMMON
/begin RECORD_LAYOUT DATA_RECORD_UBYTE FNC_VALUES 1 UBYTE ROW_DIR DIRECT /end RECORD_LAYOUT
/begin RECORD_LAYOUT DATA_RECORD_SBYTE FNC_VALUES 1 SBYTE ROW_DIR DIRECT /end RECORD_LAYOUT
/begin RECORD_LAYOUT DATA_RECORD_UWORD FNC_VALUES 1 UWORD ROW_DIR DIRECT /end RECORD_LAYOUT
/begin RECORD_LAYOUT DATA_RECORD_FLOAT32_IEEE FNC_VALUES 1 FLOAT32_IEEE ROW_DIR DIRECT /end RECORD_LAYOUT
/begin CHARACTERISTIC AFSEVBHV_A2DOffsetVoltageC "Parameter used to correct an sensor offset error." VALUE 0x80058DCC DATA_RECORD_FLOAT32_IEEE 8190 F_1_p0_2 -4095 4095 /end CHARACTERISTIC
/begin CHARACTERISTIC AFSEVBHV_A2dMaxValueC "Maximal value of the ADC." VALUE 0x80058DC8 DATA_RECORD_FLOAT32_IEEE 4095 F_1_p0_2 0 4095 /end CHARACTERISTIC
/begin CHARACTERISTIC AFSEVBHV_A2dMinValueC "Minimal value of the ADC." VALUE 0x80058DC4 DATA_RECORD_FLOAT32_IEEE 4095 F_1_p0_2 0 4095 /end CHARACTERISTIC
/begin CHARACTERISTIC AFSEVBHV_BackVoltageThrdC "AFSEVBHV_BackVoltageThrdC" VALUE 0x80058DC0 DATA_RECORD_FLOAT32_IEEE 3.402823466E+038 F_1_p0_2 -3.402823466E+038 3.402823466E+038 /end CHARACTERISTIC
/begin CHARACTERISTIC AFSEVBHV_CutOffFrequencyC "Filter parameter." VALUE 0x80058DBC DATA_RECORD_FLOAT32_IEEE 2000000 F_1_p0_2 -1000000 1000000 /end CHARACTERISTIC
/begin CHARACTERISTIC AFSEVBHV_ExtUbatGainEnC "AFSEVBHV_ExtUbatGainEnC" VALUE 0x80058DB8 DATA_RECORD_UBYTE 1 Bool_ON_OFF 0 1 BIT_MASK 0x01 /end CHARACTERISTIC
/begin CHARACTERISTIC AFSEVBHV_ExtUbatGainMaxC "AFSEVBHV_ExtUbatGainMaxC" VALUE 0x80058DB4 DATA_RECORD_UWORD 65535 F_1_p0_2 0 65535 /end CHARACTERISTIC
/begin CHARACTERISTIC AFSEVBHV_ExtUbatGainMinC "AFSEVBHV_ExtUbatGainMinC" VALUE 0x80058DB0 DATA_RECORD_UWORD 65535 F_1_p0_2 0 65535 /end CHARACTERISTIC
/begin CHARACTERISTIC AFSEVBHV_GainCorrnC "Gain used to correct a sensor linearity error." VALUE 0x80058DAC DATA_RECORD_FLOAT32_IEEE 2000000 F_1_p0_2 -1000000 1000000 /end CHARACTERISTIC
/begin CHARACTERISTIC AFSEVBHV_GainCorrnPwmC "Gain used to correct a sensor linearity error." VALUE 0x80058DA8 DATA_RECORD_FLOAT32_IEEE 2000000 F_1_p0_2 -1000000 1000000 /end CHARACTERISTIC
/begin CHARACTERISTIC AFSEVBHV_GainScalingC "Gain used to convert ADC result into real battery voltage." VALUE 0x80058DA4 DATA_RECORD_FLOAT32_IEEE 2000000 F_1_p0_2 -1000000 1000000 /end CHARACTERISTIC
/begin CHARACTERISTIC AFSEVBHV_HighVoltRdyThrC "AFSEVBHV_HighVoltRdyThrC" VALUE 0x80058DA0 DATA_RECORD_FLOAT32_IEEE 3.402823466E+038 F_1_p0_2 -3.402823466E+038 3.402823466E+038 /end CHARACTERISTIC
/begin CHARACTERISTIC AFSEVBHV_HighVoltageThrC "Maximal acceptable value of the battery voltage." VALUE 0x80058D9C DATA_RECORD_FLOAT32_IEEE 4095 F_1_p0_2 0 4095 /end CHARACTERISTIC
/begin CHARACTERISTIC AFSEVBHV_LowVoltageThrC "Maximal acceptable value of the battery voltage." VALUE 0x80058D98 DATA_RECORD_FLOAT32_IEEE 4095 F_1_p0_2 0 4095 /end CHARACTERISTIC
/begin CHARACTERISTIC AFSEVBHV_VisuAdUbatC "AFSEVBHV_VisuAdUbatC" VALUE 0x80058D94 DATA_RECORD_FLOAT32_IEEE 3.402823466E+038 F_1_p0_2 -3.402823466E+038 3.402823466E+038 /end CHARACTERISTIC
/begin CHARACTERISTIC AFSEVBHV_VisuAdUbatEnC "AFSEVBHV_VisuAdUbatEnC" VALUE 0x80058D90 DATA_RECORD_UBYTE 1 Bool_ON_OFF 0 1 BIT_MASK 0x01 /end CHARACTERISTIC
/begin CHARACTERISTIC AFSEVBHV_VolNotRationalEnC "AFSEVBHV_VolNotRationalEnC" VALUE 0x80058D8C DATA_RECORD_UBYTE 1 Bool_ON_OFF 0 1 BIT_MASK 0x01 /end CHARACTERISTIC
/begin CHARACTERISTIC AFSEVBHV_VolNotRationalNumC "AFSEVBHV_VolNotRationalNumC" VALUE 0x80058D88 DATA_RECORD_FLOAT32_IEEE 3.402823466E+038 F_1_p0_2 -3.402823466E+038 3.402823466E+038 /end CHARACTERISTIC
/begin CHARACTERISTIC AFSEVBLV_A2DOffsetVoltageC "Parameter used to correct an sensor offset error." VALUE 0x80058DF8 DATA_RECORD_FLOAT32_IEEE 8190 F_1_p0_2 -4095 4095 /end CHARACTERISTIC
/begin CHARACTERISTIC AFSEVBLV_A2dMaxValueC "Maximal value of the ADC." VALUE 0x80058DF4 DATA_RECORD_FLOAT32_IEEE 4095 F_1_p0_2 0 4095 /end CHARACTERISTIC
/begin CHARACTERISTIC AFSEVBLV_A2dMinValueC "Minimal value of the ADC." VALUE 0x80058DF0 DATA_RECORD_FLOAT32_IEEE 4095 F_1_p0_2 0 4095 /end CHARACTERISTIC
/begin CHARACTERISTIC AFSEVBLV_CutOffFrequencyC "Filter parameter." VALUE 0x80058DEC DATA_RECORD_FLOAT32_IEEE 2000000 F_1_p0_2 -1000000 1000000 /end CHARACTERISTIC
/begin CHARACTERISTIC AFSEVBLV_GainCorrnC "Gain used to correct a sensor linearity error." VALUE 0x80058DE8 DATA_RECORD_FLOAT32_IEEE 2000000 F_1_p0_2 -1000000 1000000 /end CHARACTERISTIC
/begin CHARACTERISTIC AFSEVBLV_GainScalingC "Gain used to convert ADC result into real battery voltage." VALUE 0x80058DE4 DATA_RECORD_FLOAT32_IEEE 2000000 F_1_p0_2 -1000000 1000000 /end CHARACTERISTIC
/begin CHARACTERISTIC AFSEVBLV_HighVoltageThrC "Maximal acceptable value of the battery voltage." VALUE 0x80058DE0 DATA_RECORD_FLOAT32_IEEE 4095 F_1_p0_2 0 4095 /end CHARACTERISTIC
/begin CHARACTERISTIC AFSEVBLV_LowVoltageThrC "Maximal acceptable value of the battery voltage." VALUE 0x80058DDC DATA_RECORD_FLOAT32_IEEE 4095 F_1_p0_2 0 4095 /end CHARACTERISTIC
/begin CHARACTERISTIC AFSEVBLV_P5VAD2VoltC "Maximal acceptable value of the battery voltage." VALUE 0x80058DD8 DATA_RECORD_FLOAT32_IEEE 4095 F_1_p0_2 0 4095 /end CHARACTERISTIC
/begin CHARACTERISTIC AFSEVBLV_P5VRefC "Maximal acceptable value of the battery voltage." VALUE 0x80058DD4 DATA_RECORD_FLOAT32_IEEE 4095 F_1_p0_2 0 4095 /end CHARACTERISTIC
/begin CHARACTERISTIC AFSEVBLV_P5VRefErrBurstC "Maximal acceptable value of the battery voltage." VALUE 0x80058DD0 DATA_RECORD_FLOAT32_IEEE 4095 F_1_p0_2 0 4095 /end CHARACTERISTIC
/begin CHARACTERISTIC AFSEVETA_A2dMaxValueC "AFSEVETA_A2dMaxValueC" VALUE 0x8005961C DATA_RECORD_FLOAT32_IEEE 3.402823466E+038 F_1_p0_2 -3.402823466E+038 3.402823466E+038 /end CHARACTERISTIC
/begin CHARACTERISTIC AFSEVETA_A2dMinValueC "AFSEVETA_A2dMinValueC" VALUE 0x80059618 DATA_RECORD_FLOAT32_IEEE 3.402823466E+038 F_1_p0_2 -3.402823466E+038 3.402823466E+038 /end CHARACTERISTIC
/begin CHARACTERISTIC AFSEVETA_CoolShortCircuitGndC "AFSEVETA_CoolShortCircuitGndC" VALUE 0x80059614 DATA_RECORD_UWORD 65535 F_1_p0_2 0 65535 /end CHARACTERISTIC
/begin CHARACTERISTIC AFSEVETA_CoolShortCircuitVccC "AFSEVETA_CoolShortCircuitVccC" VALUE 0x80059610 DATA_RECORD_UWORD 65535 F_1_p0_2 0 65535 /end CHARACTERISTIC
/begin CHARACTERISTIC AFSEVETA_CutOffFrequencyC "AFSEVETA_CutOffFrequencyC" VALUE 0x8005960C DATA_RECORD_FLOAT32_IEEE 10 F_1_p0_2 0 10 /end CHARACTERISTIC
/begin CHARACTERISTIC AFSEVETA_FaultPeriodCounterC "AFSEVETA_FaultPeriodCounterC" VALUE 0x80059608 DATA_RECORD_UWORD 65535 F_1_p0_2 0 65535 /end CHARACTERISTIC
/begin CHARACTERISTIC AFSEVETA_GainTempCoolingC "AFSEVETA_GainTempCoolingC" VALUE 0x80059604 DATA_RECORD_FLOAT32_IEEE 2000 F_1_p0_2 -1000 1000 /end CHARACTERISTIC
/begin CHARACTERISTIC AFSEVETA_GainTempDrvBoardLeftC "AFSEVETA_GainTempDrvBoardLeftC" VALUE 0x80059600 DATA_RECORD_FLOAT32_IEEE 2000 F_1_p0_2 -1000 1000 /end CHARACTERISTIC
/begin CHARACTERISTIC AFSEVETA_GainTempIgbtLeftC "AFSEVETA_GainTempIgbtLeftC" VALUE 0x800595FC DATA_RECORD_FLOAT32_IEEE 2000 F_1_p0_2 -1000 1000 /end CHARACTERISTIC
/begin CHARACTERISTIC AFSEVETA_GainTempLVCmdBoardC "AFSEVETA_GainTempLVCmdBoardC" VALUE 0x800595F8 DATA_RECORD_FLOAT32_IEEE 1 F_1_p0_2 0 1 /end CHARACTERISTIC
/begin CHARACTERISTIC AFSEVETA_HighTempCmdBoard2ThdC "AFSEVETA_HighTempCmdBoard2ThdC" VALUE 0x800595F4 DATA_RECORD_FLOAT32_IEEE 3.402823466E+038 F_1_p0_2 -3.402823466E+038 3.402823466E+038 /end CHARACTERISTIC
/begin CHARACTERISTIC AFSEVETA_HighTempCmdBoardThdC "AFSEVETA_HighTempCmdBoardThdC" VALUE 0x800595F0 DATA_RECORD_FLOAT32_IEEE 3.402823466E+038 F_1_p0_2 -3.402823466E+038 3.402823466E+038 /end CHARACTERISTIC
/begin CHARACTERISTIC AFSEVETA_HighTempCoolingThdC "AFSEVETA_HighTempCoolingThdC" VALUE 0x800595EC DATA_RECORD_FLOAT32_IEEE 3.402823466E+038 F_1_p0_2 -3.402823466E+038 3.402823466E+038 /end CHARACTERISTIC
/begin CHARACTERISTIC AFSEVETA_HighTempDrvLeftThdC "AFSEVETA_HighTempDrvLeftThdC" VALUE 0x800595E8 DATA_RECORD_FLOAT32_IEEE 3.402823466E+038 F_1_p0_2 -3.402823466E+038 3.402823466E+038 /end CHARACTERISTIC
/begin CHARACTERISTIC AFSEVETA_HighTempIgbtLeftThdC "AFSEVETA_HighTempIgbtLeftThdC" VALUE 0x800595E4 DATA_RECORD_FLOAT32_IEEE 3.402823466E+038 F_1_p0_2 -3.402823466E+038 3.402823466E+038 /end CHARACTERISTIC
/begin CHARACTERISTIC AFSEVETA_IOFilterC "AFSEVETA_IOFilterC" VALUE 0x800595E0 DATA_RECORD_UWORD 65535 F_1_p0_2 0 65535 /end CHARACTERISTIC
/begin CHARACTERISTIC AFSEVETA_IgbtRationalThdC "AFSEVETA_IgbtRationalThdC" VALUE 0x800595DC DATA_RECORD_FLOAT32_IEEE 100 F_1_p0_2 0 100 /end CHARACTERISTIC
/begin CHARACTERISTIC AFSEVETA_IgbtTempSlopDetnEnC "AFSEVETA_IgbtTempSlopDetnEnC" VALUE 0x800595D8 DATA_RECORD_UBYTE 1 Bool_ON_OFF 0 1 BIT_MASK 0x01 /end CHARACTERISTIC
/begin CHARACTERISTIC AFSEVETA_IgbtTempSlopMaxC "AFSEVETA_IgbtTempSlopMaxC" VALUE 0x800595D4 DATA_RECORD_FLOAT32_IEEE 3.402823466E+038 F_1_p0_2 -3.402823466E+038 3.402823466E+038 /end CHARACTERISTIC
/begin CHARACTERISTIC AFSEVETA_LowTempCmdBoard2ThdC "AFSEVETA_LowTempCmdBoard2ThdC" VALUE 0x800595D0 DATA_RECORD_FLOAT32_IEEE 3.402823466E+038 F_1_p0_2 -3.402823466E+038 3.402823466E+038 /end CHARACTERISTIC
/begin CHARACTERISTIC AFSEVETA_LowTempCmdBoardThdC "AFSEVETA_LowTempCmdBoardThdC" VALUE 0x800595CC DATA_RECORD_FLOAT32_IEEE 3.402823466E+038 F_1_p0_2 -3.402823466E+038 3.402823466E+038 /end CHARACTERISTIC
/begin CHARACTERISTIC AFSEVETA_LowTempDrvLeftThdC "AFSEVETA_LowTempDrvLeftThdC" VALUE 0x800595C8 DATA_RECORD_FLOAT32_IEEE 3.402823466E+038 F_1_p0_2 -3.402823466E+038 3.402823466E+038 /end CHARACTERISTIC
/begin CHARACTERISTIC AFSEVETA_LutInTempCmdBoardC "AFSEVETA_LutInTempCmdBoardC" CURVE 0x80059520 DATA_RECORD_FLOAT32_IEEE 3.402823466E+038 F_1_p0_2 -3.402823466E+038 3.402823466E+038
 /begin AXIS_DESCR FIX_AXIS NO_INPUT_QUANTITY Id_0x00 42 0 41 MAX_GRAD 100.0 FIX_AXIS_PAR_DIST 0 1 42 /end AXIS_DESCR
/end CHARACTERISTIC
/begin CHARACTERISTIC AFSEVETA_LutInTempDrvBoardC "AFSEVETA_LutInTempDrvBoardC" CURVE 0x80059478 DATA_RECORD_FLOAT32_IEEE 3.402823466E+038 F_1_p0_2 -3.402823466E+038 3.402823466E+038
 /begin AXIS_DESCR FIX_AXIS NO_INPUT_QUANTITY Id_0x00 42 0 41 MAX_GRAD 100.0 FIX_AXIS_PAR_DIST 0 1 42 /end AXIS_DESCR
/end CHARACTERISTIC
/begin CHARACTERISTIC AFSEVETA_LutInTempIgbtCU "AFSEVETA_LutInTempIgbtCU" CURVE 0x800593DC DATA_RECORD_FLOAT32_IEEE 3.402823466E+038 F_1_p0_2 -3.402823466E+038 3.402823466E+038
 /begin AXIS_DESCR FIX_AXIS NO_INPUT_QUANTITY Id_0x00 39 0 38 MAX_GRAD 100.0 FIX_AXIS_PAR_DIST 0 1 39 /end AXIS_DESCR
/end CHARACTERISTIC
/begin CHARACTERISTIC AFSEVETA_LutInTempIgbtCV "AFSEVETA_LutInTempIgbtCV" CURVE 0x80059340 DATA_RECORD_FLOAT32_IEEE 3.402823466E+038 F_1_p0_2 -3.402823466E+038 3.402823466E+038
 /begin AXIS_DESCR FIX_AXIS NO_INPUT_QUANTITY Id_0x00 39 0 38 MAX_GRAD 100.0 FIX_AXIS_PAR_DIST 0 1 39 /end AXIS_DESCR
/end CHARACTERISTIC
/begin CHARACTERISTIC AFSEVETA_LutInTempIgbtCW "AFSEVETA_LutInTempIgbtCW" CURVE 0x800592A4 DATA_RECORD_FLOAT32_IEEE 3.402823466E+038 F_1_p0_2 -3.402823466E+038 3.402823466E+038
 /begin AXIS_DESCR FIX_AXIS NO_INPUT_QUANTITY Id_0x00 39 0 38 MAX_GRAD 100.0 FIX_AXIS_PAR_DIST 0 1 39 /end AXIS_DESCR
/end CHARACTERISTIC
/begin CHARACTERISTIC AFSEVETA_LutInTempPt100C "AFSEVETA_LutInTempPt100C" CURVE 0x800591F8 DATA_RECORD_FLOAT32_IEEE 3.402823466E+038 F_1_p0_2 -3.402823466E+038 3.402823466E+038
 /begin AXIS_DESCR FIX_AXIS NO_INPUT_QUANTITY Id_0x00 43 0 42 MAX_GRAD 100.0 FIX_AXIS_PAR_DIST 0 1 43 /end AXIS_DESCR
/end CHARACTERISTIC
/begin CHARACTERISTIC AFSEVETA_LutOutTempCmdBoardC "AFSEVETA_LutOutTempCmdBoardC" CURVE 0x80059150 DATA_RECORD_FLOAT32_IEEE 3.402823466E+038 F_1_p0_2 -3.402823466E+038 3.402823466E+038
 /begin AXIS_DESCR FIX_AXIS NO_INPUT_QUANTITY Id_0x00 42 0 41 MAX_GRAD 100.0 FIX_AXIS_PAR_DIST 0 1 42 /end AXIS_DESCR
/end CHARACTERISTIC
/begin CHARACTERISTIC AFSEVETA_LutOutTempDrvBoardC "AFSEVETA_LutOutTempDrvBoardC" CURVE 0x800590A8 DATA_RECORD_FLOAT32_IEEE 3.402823466E+038 F_1_p0_2 -3.402823466E+038 3.402823466E+038
 /begin AXIS_DESCR FIX_AXIS NO_INPUT_QUANTITY Id_0x00 42 0 41 MAX_GRAD 100.0 FIX_AXIS_PAR_DIST 0 1 42 /end AXIS_DESCR
/end CHARACTERISTIC
/begin CHARACTERISTIC AFSEVETA_LutOutTempIgbtCU "AFSEVETA_LutOutTempIgbtCU" CURVE 0x8005900C DATA_RECORD_FLOAT32_IEEE 3.402823466E+038 F_1_p0_2 -3.402823466E+038 3.402823466E+038
 /begin AXIS_DESCR FIX_AXIS NO_INPUT_QUANTITY Id_0x00 39 0 38 MAX_GRAD 100.0 FIX_AXIS_PAR_DIST 0 1 39 /end AXIS_DESCR
/end CHARACTERISTIC
/begin CHARACTERISTIC AFSEVETA_LutOutTempIgbtCV "AFSEVETA_LutOutTempIgbtCV" CURVE 0x80058F70 DATA_RECORD_FLOAT32_IEEE 3.402823466E+038 F_1_p0_2 -3.402823466E+038 3.402823466E+038
 /begin AXIS_DESCR FIX_AXIS NO_INPUT_QUANTITY Id_0x00 39 0 38 MAX_GRAD 100.0 FIX_AXIS_PAR_DIST 0 1 39 /end AXIS_DESCR
/end CHARACTERISTIC
/begin CHARACTERISTIC AFSEVETA_LutOutTempIgbtCW "AFSEVETA_LutOutTempIgbtCW" CURVE 0x80058ED4 DATA_RECORD_FLOAT32_IEEE 3.402823466E+038 F_1_p0_2 -3.402823466E+038 3.402823466E+038
 /begin AXIS_DESCR FIX_AXIS NO_INPUT_QUANTITY Id_0x00 39 0 38 MAX_GRAD 100.0 FIX_AXIS_PAR_DIST 0 1 39 /end AXIS_DESCR
/end CHARACTERISTIC
/begin CHARACTERISTIC AFSEVETA_LutOutTempPt100C "AFSEVETA_LutOutTempPt100C" CURVE 0x80058E28 DATA_RECORD_FLOAT32_IEEE 3.402823466E+038 F_1_p0_2 -3.402823466E+038 3.402823466E+038
 /begin AXIS_DESCR FIX_AXIS NO_INPUT_QUANTITY Id_0x00 43 0 42 MAX_GRAD 100.0 FIX_AXIS_PAR_DIST 0 1 43 /end AXIS_DESCR
/end CHARACTERISTIC
/begin CHARACTERISTIC AFSEVETA_MotorSpeedC "AFSEVETA_MotorSpeedC" VALUE 0x80058E24 DATA_RECORD_FLOAT32_IEEE 13000 F_1_p0_2 0 13000 /end CHARACTERISTIC
/begin CHARACTERISTIC AFSEVETA_OffsetTempCoolingC "AFSEVETA_OffsetTempCoolingC" VALUE 0x80058E20 DATA_RECORD_FLOAT32_IEEE 3.402823466E+038 F_1_p0_2 -3.402823466E+038 3.402823466E+038 /end CHARACTERISTIC
/begin CHARACTERISTIC AFSEVETA_OffsetTempDrvBoardLeftC "AFSEVETA_OffsetTempDrvBoardLeftC" VALUE 0x80058E1C DATA_RECORD_FLOAT32_IEEE 3.402823466E+038 F_1_p0_2 -3.402823466E+038 3.402823466E+038 /end CHARACTERISTIC
/begin CHARACTERISTIC AFSEVETA_OffsetTempIgbtLeftC "AFSEVETA_OffsetTempIgbtLeftC" VALUE 0x80058E18 DATA_RECORD_FLOAT32_IEEE 3.402823466E+038 F_1_p0_2 -3.402823466E+038 3.402823466E+038 /end CHARACTERISTIC
/begin CHARACTERISTIC AFSEVETA_OffsetTempLVCmdBoardC "AFSEVETA_OffsetTempLVCmdBoardC" VALUE 0x80058E14 DATA_RECORD_FLOAT32_IEEE 3.402823466E+038 F_1_p0_2 -3.402823466E+038 3.402823466E+038 /end CHARACTERISTIC
/begin CHARACTERISTIC AFSEVETA_OperationalC "AFSEVETA_OperationalC" VALUE 0x80058E10 DATA_RECORD_FLOAT32_IEEE 100 F_1_p0_2 0 100 /end CHARACTERISTIC
/begin CHARACTERISTIC AFSEVETA_ShortCircuitGndC "AFSEVETA_ShortCircuitGndC" VALUE 0x80058E0C DATA_RECORD_FLOAT32_IEEE 3.402823466E+038 F_1_p0_2 -3.402823466E+038 3.402823466E+038 /end CHARACTERISTIC
/begin CHARACTERISTIC AFSEVETA_ShortCircuitVccC "AFSEVETA_ShortCircuitVccC" VALUE 0x80058E08 DATA_RECORD_FLOAT32_IEEE 3.402823466E+038 F_1_p0_2 -3.402823466E+038 3.402823466E+038 /end CHARACTERISTIC
/begin CHARACTERISTIC AFSEVETA_TempIgbtGndC "AFSEVETA_TempIgbtGndC" VALUE 0x80058E04 DATA_RECORD_FLOAT32_IEEE 3.402823466E+038 F_1_p0_2 -3.402823466E+038 3.402823466E+038 /end CHARACTERISTIC
/begin CHARACTERISTIC AFSEVETA_TempIgbtGndStopOvTEnC "AFSEVETA_TempIgbtGndStopOvTEnC" VALUE 0x80058E00 DATA_RECORD_UBYTE 1 Bool_ON_OFF 0 1 BIT_MASK 0x01 /end CHARACTERISTIC
/begin CHARACTERISTIC AFSEVETA_TempRationalEnC "AFSEVETA_TempRationalEnC" VALUE 0x80058DFC DATA_RECORD_FLOAT32_IEEE 10 F_1_p0_2 0 10 /end CHARACTERISTIC
/begin CHARACTERISTIC AFSEVIBT_IbatRmsGainC "AFSEVIBT_IbatRmsGainC" VALUE 0x80059624 DATA_RECORD_FLOAT32_IEEE 3.402823466E+038 F_1_p0_2 -3.402823466E+038 3.402823466E+038 /end CHARACTERISTIC
/begin CHARACTERISTIC AFSEVIBT_LowPassFiltNumC "AFSEVIBT_LowPassFiltNumC" VALUE 0x80059620 DATA_RECORD_FLOAT32_IEEE 3.402823466E+038 F_1_p0_2 -3.402823466E+038 3.402823466E+038 /end CHARACTERISTIC
/begin CHARACTERISTIC AFSEXCTX_DrtGainC "AFSEXCTX_DrtGainC" VALUE 0x80059628 DATA_RECORD_FLOAT32_IEEE 1 F_1_p0_2 0 1 /end CHARACTERISTIC
/begin CHARACTERISTIC AFSMTMTA_A2dMaxValueC "AFSMTMTA_A2dMaxValueC" VALUE 0x800597D0 DATA_RECORD_FLOAT32_IEEE 3.402823466E+038 F_1_p0_2 -3.402823466E+038 3.402823466E+038 /end CHARACTERISTIC
/begin CHARACTERISTIC AFSMTMTA_A2dMinValueC "AFSMTMTA_A2dMinValueC" VALUE 0x800597CC DATA_RECORD_FLOAT32_IEEE 3.402823466E+038 F_1_p0_2 -3.402823466E+038 3.402823466E+038 /end CHARACTERISTIC
/begin CHARACTERISTIC AFSMTMTA_CutOffFrequencyC "AFSMTMTA_CutOffFrequencyC" VALUE 0x800597C8 DATA_RECORD_FLOAT32_IEEE 3.402823466E+038 F_1_p0_2 -3.402823466E+038 3.402823466E+038 /end CHARACTERISTIC
/begin CHARACTERISTIC AFSMTMTA_GainTempWindingHead1C "AFSMTMTA_GainTempWindingHead1C" VALUE 0x800597C4 DATA_RECORD_FLOAT32_IEEE 3.402823466E+038 F_1_p0_2 -3.402823466E+038 3.402823466E+038 /end CHARACTERISTIC
/begin CHARACTERISTIC AFSMTMTA_HighTempWdgHead1ThdC "AFSMTMTA_HighTempWdgHead1ThdC" VALUE 0x800597C0 DATA_RECORD_FLOAT32_IEEE 3.402823466E+038 F_1_p0_2 -3.402823466E+038 3.402823466E+038 /end CHARACTERISTIC
/begin CHARACTERISTIC AFSMTMTA_LutInTempMotorC "AFSMTMTA_LutInTempMotorC" CURVE 0x800596FC DATA_RECORD_FLOAT32_IEEE 3.402823466E+038 F_1_p0_2 -3.402823466E+038 3.402823466E+038
 /begin AXIS_DESCR FIX_AXIS NO_INPUT_QUANTITY Id_0x00 49 0 48 MAX_GRAD 100.0 FIX_AXIS_PAR_DIST 0 1 49 /end AXIS_DESCR
/end CHARACTERISTIC
/begin CHARACTERISTIC AFSMTMTA_LutOutTempMotorC "AFSMTMTA_LutOutTempMotorC" CURVE 0x80059638 DATA_RECORD_FLOAT32_IEEE 3.402823466E+038 F_1_p0_2 -3.402823466E+038 3.402823466E+038
 /begin AXIS_DESCR FIX_AXIS NO_INPUT_QUANTITY Id_0x00 49 0 48 MAX_GRAD 100.0 FIX_AXIS_PAR_DIST 0 1 49 /end AXIS_DESCR
/end CHARACTERISTIC
/begin CHARACTERISTIC AFSMTMTA_OffsetTempWindingHead1C "AFSMTMTA_OffsetTempWindingHead1C" VALUE 0x80059634 DATA_RECORD_FLOAT32_IEEE 3.402823466E+038 F_1_p0_2 -3.402823466E+038 3.402823466E+038 /end CHARACTERISTIC
/begin CHARACTERISTIC AFSMTMTA_ShortCircuitGndC "AFSMTMTA_ShortCircuitGndC" VALUE 0x80059630 DATA_RECORD_UWORD 65535 F_1_p0_2 0 65535 /end CHARACTERISTIC
/begin CHARACTERISTIC AFSMTMTA_ShortCircuitVccC "AFSMTMTA_ShortCircuitVccC" VALUE 0x8005962C DATA_RECORD_UWORD 65535 F_1_p0_2 0 65535 /end CHARACTERISTIC
/begin CHARACTERISTIC AFSSMACS_AbsMecaSpeedTrC "AFSSMACS_AbsMecaSpeedTrC" VALUE 0x80058C78 DATA_RECORD_FLOAT32_IEEE 3.402823466E+038 F_1_p0_2 -3.402823466E+038 3.402823466E+038 /end CHARACTERISTIC
/begin CHARACTERISTIC AFSSMACS_AkdEnterSpdThrdC "AFSSMACS_AkdEnterSpdThrdC" VALUE 0x80058C74 DATA_RECORD_FLOAT32_IEEE 3.402823466E+038 F_1_p0_2 -3.402823466E+038 3.402823466E+038 /end CHARACTERISTIC
/begin CHARACTERISTIC AFSSMACS_AkdExitSpdThrdC "AFSSMACS_AkdExitSpdThrdC" VALUE 0x80058C70 DATA_RECORD_FLOAT32_IEEE 3.402823466E+038 F_1_p0_2 -3.402823466E+038 3.402823466E+038 /end CHARACTERISTIC
/begin CHARACTERISTIC AFSSMACS_AkdStopVoltageC "AFSSMACS_AkdStopVoltageC" VALUE 0x80058C6C DATA_RECORD_FLOAT32_IEEE 1000 F_1_p0_2 0 1000 /end CHARACTERISTIC
/begin CHARACTERISTIC AFSSMACS_AkdTimeoutCntC "AFSSMACS_AkdTimeoutCntC" VALUE 0x80058C68 DATA_RECORD_UWORD 65535 F_1_p0_2 0 65535 /end CHARACTERISTIC
/begin CHARACTERISTIC AFSSMACS_AllowStartSpeedRpmC "AFSSMACS_AllowStartSpeedRpmC" VALUE 0x80058C64 DATA_RECORD_FLOAT32_IEEE 3.402823466E+038 F_1_p0_2 -3.402823466E+038 3.402823466E+038 /end CHARACTERISTIC
/begin CHARACTERISTIC AFSSMACS_AuxDischgeEnC "AFSSMACS_AuxDischgeEnC" VALUE 0x80058C60 DATA_RECORD_UBYTE 1 Bool_ON_OFF 0 1 BIT_MASK 0x01 /end CHARACTERISTIC
/begin CHARACTERISTIC AFSSMACS_BenchKL15EnaC "AFSSMACS_BenchKL15EnaC" VALUE 0x80058C5C DATA_RECORD_UBYTE 1 Bool_ON_OFF 0 1 BIT_MASK 0x01 /end CHARACTERISTIC
/begin CHARACTERISTIC AFSSMACS_DeaultSpdModeC "AFSSMACS_DeaultSpdModeC" VALUE 0x80058C58 DATA_RECORD_UBYTE 255 F_1_p0_2 0 255 /end CHARACTERISTIC
/begin CHARACTERISTIC AFSSMACS_HiPwrRdyVoltC "220v is the low level to enter the ready, traction mode" VALUE 0x80058C54 DATA_RECORD_FLOAT32_IEEE 3.402823466E+038 F_1_p0_2 -3.402823466E+038 3.402823466E+038 /end CHARACTERISTIC
/begin CHARACTERISTIC AFSSMACS_HiPwrStbVoltC "AFSSMACS_HiPwrStbVoltC" VALUE 0x80058C50 DATA_RECORD_FLOAT32_IEEE 3.402823466E+038 F_1_p0_2 -3.402823466E+038 3.402823466E+038 /end CHARACTERISTIC
/begin CHARACTERISTIC AFSSMACS_KL15FilterC "AFSSMACS_KL15FilterC" VALUE 0x80058C4C DATA_RECORD_UWORD 65535 F_1_p0_2 0 65535 /end CHARACTERISTIC
/begin CHARACTERISTIC AFSSMACS_ManualModeReqC "AFSSMACS_ManualModeReqC" VALUE 0x80058C48 DATA_RECORD_UBYTE 255 F_1_p0_2 0 255 /end CHARACTERISTIC
/begin CHARACTERISTIC AFSSMACS_PreCharFinVoltC "AFSSMACS_PreCharFinVoltC" VALUE 0x80058C44 DATA_RECORD_FLOAT32_IEEE 3.402823466E+038 F_1_p0_2 -3.402823466E+038 3.402823466E+038 /end CHARACTERISTIC
/begin CHARACTERISTIC AFSSMACS_ReverseKL15EnaC "AFSSMACS_ReverseKL15EnaC" VALUE 0x80058C40 DATA_RECORD_UBYTE 1 Bool_ON_OFF 0 1 BIT_MASK 0x01 /end CHARACTERISTIC
/begin CHARACTERISTIC AFSSMACS_SpeedReadyFilterC "AFSSMACS_SpeedReadyFilterC" VALUE 0x80058C3C DATA_RECORD_UWORD 65535 F_1_p0_2 0 65535 /end CHARACTERISTIC
/begin CHARACTERISTIC AFSSMACS_SpeedReadyThresholdC "AFSSMACS_SpeedReadyThresholdC" VALUE 0x80058C38 DATA_RECORD_FLOAT32_IEEE 3.402823466E+038 F_1_p0_2 -3.402823466E+038 3.402823466E+038 /end CHARACTERISTIC
/begin CHARACTERISTIC AFSSMACS_TorqueEnterSpdThrdC "AFSSMACS_TorqueEnterSpdThrdC" VALUE 0x80058C34 DATA_RECORD_FLOAT32_IEEE 3.402823466E+038 F_1_p0_2 -3.402823466E+038 3.402823466E+038 /end CHARACTERISTIC
/begin CHARACTERISTIC AFSSMACS_TorqueExitSpdThrdC "AFSSMACS_TorqueExitSpdThrdC" VALUE 0x80058C30 DATA_RECORD_FLOAT32_IEEE 3.402823466E+038 F_1_p0_2 -3.402823466E+038 3.402823466E+038 /end CHARACTERISTIC
/begin CHARACTERISTIC AFSSMACS_ZeroTorqCounterC "AFSSMACS_ZeroTorqCounterC" VALUE 0x80058C2C DATA_RECORD_UWORD 65535 F_1_p0_2 0 65535 /end CHARACTERISTIC
/begin CHARACTERISTIC AFSSMMAM_AclStateBypassOnOffC "bypass activation boolean" VALUE 0x80058C80 DATA_RECORD_UBYTE 1 Bool_ON_OFF 0 1 BIT_MASK 0x01 /end CHARACTERISTIC
/begin CHARACTERISTIC AFSSMMAM_AclStateBypassValueC "Mcu State value when bypass is activated" VALUE 0x80058C7C DATA_RECORD_UWORD 65535 F_1_p0_2 0 65535 /end CHARACTERISTIC
/begin CHARACTERISTIC AFSTCGTC_CanSpeedTgtEnC "AFSTCGTC_CanSpeedTgtEnC" VALUE 0x80058D84 DATA_RECORD_UBYTE 1 Bool_ON_OFF 0 1 BIT_MASK 0x01 /end CHARACTERISTIC
/begin CHARACTERISTIC AFSTCGTC_I0dqTgtC "[i0, id, iq]" CURVE 0x80058D78 DATA_RECORD_FLOAT32_IEEE 3.402823466E+038 F_1_p0_2 -3.402823466E+038 3.402823466E+038
 /begin AXIS_DESCR FIX_AXIS NO_INPUT_QUANTITY Id_0x00 3 0 2 MAX_GRAD 100.0 FIX_AXIS_PAR_DIST 0 1 3 /end AXIS_DESCR
/end CHARACTERISTIC
/begin CHARACTERISTIC AFSTCGTC_MecaSpeedRpmTgtC "AFSTCGTC_MecaSpeedRpmTgtC" VALUE 0x80058D74 DATA_RECORD_FLOAT32_IEEE 3.402823466E+038 F_1_p0_2 -3.402823466E+038 3.402823466E+038 /end CHARACTERISTIC
/begin CHARACTERISTIC AFSTCGTC_MecaSpeedRpmTgtDiffC "AFSTCGTC_MecaSpeedRpmTgtDiffC" VALUE 0x80058D70 DATA_RECORD_FLOAT32_IEEE 3.402823466E+038 F_1_p0_2 -3.402823466E+038 3.402823466E+038 /end CHARACTERISTIC
/begin CHARACTERISTIC AFSTCGTC_MecaSpeedRpmTgtDutyC "AFSTCGTC_MecaSpeedRpmTgtDutyC" VALUE 0x80058D6C DATA_RECORD_FLOAT32_IEEE 3.402823466E+038 F_1_p0_2 -3.402823466E+038 3.402823466E+038 /end CHARACTERISTIC
/begin CHARACTERISTIC AFSTCGTC_MecaSpeedRpmTgtEnC "AFSTCGTC_MecaSpeedRpmTgtEnC" VALUE 0x80058D68 DATA_RECORD_UBYTE 1 Bool_ON_OFF 0 1 BIT_MASK 0x01 /end CHARACTERISTIC
/begin CHARACTERISTIC AFSTCGTC_MecaSpeedRpmTgtFrecC "AFSTCGTC_MecaSpeedRpmTgtFrecC" VALUE 0x80058D64 DATA_RECORD_FLOAT32_IEEE 3.402823466E+038 F_1_p0_2 -3.402823466E+038 3.402823466E+038 /end CHARACTERISTIC
/begin CHARACTERISTIC AFSTCGTC_MecaSpeedRpmTgtMinC "AFSTCGTC_MecaSpeedRpmTgtMinC" VALUE 0x80058D60 DATA_RECORD_FLOAT32_IEEE 3.402823466E+038 F_1_p0_2 -3.402823466E+038 3.402823466E+038 /end CHARACTERISTIC
/begin CHARACTERISTIC AFSTCGTC_MecaSpeedRpmTgtModeC "AFSTCGTC_MecaSpeedRpmTgtModeC" VALUE 0x80058D5C DATA_RECORD_UBYTE 255 F_1_p0_2 0 255 /end CHARACTERISTIC
/begin CHARACTERISTIC AFSTCGTC_SinLutC "AFSTCGTC_SinLutC" CURVE 0x80058C90 DATA_RECORD_FLOAT32_IEEE 3.402823466E+038 F_1_p0_2 -3.402823466E+038 3.402823466E+038
 /begin AXIS_DESCR FIX_AXIS NO_INPUT_QUANTITY Id_0x00 51 0 50 MAX_GRAD 100.0 FIX_AXIS_PAR_DIST 0 1 51 /end AXIS_DESCR
/end CHARACTERISTIC
/begin CHARACTERISTIC AFSTCGTC_U0dqTgtC "AFSTCGTC_U0dqTgtC" CURVE 0x80058C84 DATA_RECORD_FLOAT32_IEEE 3.402823466E+038 F_1_p0_2 -3.402823466E+038 3.402823466E+038
 /begin AXIS_DESCR FIX_AXIS NO_INPUT_QUANTITY Id_0x00 3 0 2 MAX_GRAD 100.0 FIX_AXIS_PAR_DIST 0 1 3 /end AXIS_DESCR
/end CHARACTERISTIC
/begin CHARACTERISTIC ESM_bPowerOffModeInhC "ESM POWER_OFF_MODE state inhibition" VALUE 0x800AE63D DATA_RECORD_UBYTE 1 Bool_ON_OFF 0 1 BIT_MASK 0x01 /end CHARACTERISTIC
/begin CHARACTERISTIC ESM_ku16AfterrunToutCntC "ESM_ku16AfterrunToutCntC" VALUE 0x80058ACE DATA_RECORD_UWORD 327675 F_5_p0_26 0 327675 /end CHARACTERISTIC
/begin CHARACTERISTIC FSEVBHV_A2DOffsetVoltageC "Parameter used to correct an sensor offset error." VALUE 0x80059980 DATA_RECORD_FLOAT32_IEEE 8190 F_1_p0_2 -4095 4095 /end CHARACTERISTIC
/begin CHARACTERISTIC FSEVBHV_A2dMaxValueC "Maximal value of the ADC." VALUE 0x8005997C DATA_RECORD_FLOAT32_IEEE 4095 F_1_p0_2 0 4095 /end CHARACTERISTIC
/begin CHARACTERISTIC FSEVBHV_A2dMinValueC "Minimal value of the ADC." VALUE 0x80059978 DATA_RECORD_FLOAT32_IEEE 4095 F_1_p0_2 0 4095 /end CHARACTERISTIC
/begin CHARACTERISTIC FSEVBHV_BackVoltageThrdC "FSEVBHV_BackVoltageThrdC" VALUE 0x80059974 DATA_RECORD_FLOAT32_IEEE 3.402823466E+038 F_1_p0_2 -3.402823466E+038 3.402823466E+038 /end CHARACTERISTIC
/begin CHARACTERISTIC FSEVBHV_CutOffFrequencyC "Filter parameter." VALUE 0x80059970 DATA_RECORD_FLOAT32_IEEE 2000000 F_1_p0_2 -1000000 1000000 /end CHARACTERISTIC
/begin CHARACTERISTIC FSEVBHV_ExtUbatGainMaxC "FSEVBHV_ExtUbatGainMaxC" VALUE 0x8005996C DATA_RECORD_UWORD 65535 F_1_p0_2 0 65535 /end CHARACTERISTIC
/begin CHARACTERISTIC FSEVBHV_ExtUbatGainMinC "FSEVBHV_ExtUbatGainMinC" VALUE 0x80059968 DATA_RECORD_UWORD 65535 F_1_p0_2 0 65535 /end CHARACTERISTIC
/begin CHARACTERISTIC FSEVBHV_GainCorrnC "Gain used to correct a sensor linearity error." VALUE 0x80059964 DATA_RECORD_FLOAT32_IEEE 2000000 F_1_p0_2 -1000000 1000000 /end CHARACTERISTIC
/begin CHARACTERISTIC FSEVBHV_GainScalingC "Gain used to convert ADC result into real battery voltage." VALUE 0x80059960 DATA_RECORD_FLOAT32_IEEE 2000000 F_1_p0_2 -1000000 1000000 /end CHARACTERISTIC
/begin CHARACTERISTIC FSEVBHV_HighVoltageThrC "Maximal acceptable value of the battery voltage." VALUE 0x8005995C DATA_RECORD_FLOAT32_IEEE 4095 F_1_p0_2 0 4095 /end CHARACTERISTIC
/begin CHARACTERISTIC FSEVBHV_LowVoltageThrC "Maximal acceptable value of the battery voltage." VALUE 0x80059958 DATA_RECORD_FLOAT32_IEEE 4095 F_1_p0_2 0 4095 /end CHARACTERISTIC
/begin CHARACTERISTIC FSEVBHV_VisuAdUbat2C "FSEVBHV_VisuAdUbat2C" VALUE 0x80059954 DATA_RECORD_FLOAT32_IEEE 3.402823466E+038 F_1_p0_2 -3.402823466E+038 3.402823466E+038 /end CHARACTERISTIC
/begin CHARACTERISTIC FSEVBHV_VisuAdUbat2EnC "FSEVBHV_VisuAdUbat2EnC" VALUE 0x80059950 DATA_RECORD_UBYTE 1 Bool_ON_OFF 0 1 BIT_MASK 0x01 /end CHARACTERISTIC
/begin CHARACTERISTIC FSEVBHV_VisuAdUbatC "FSEVBHV_VisuAdUbatC" VALUE 0x8005994C DATA_RECORD_FLOAT32_IEEE 3.402823466E+038 F_1_p0_2 -3.402823466E+038 3.402823466E+038 /end CHARACTERISTIC
/begin CHARACTERISTIC FSEVBHV_VisuAdUbatEnC "FSEVBHV_VisuAdUbatEnC" VALUE 0x80059948 DATA_RECORD_UBYTE 1 Bool_ON_OFF 0 1 BIT_MASK 0x01 /end CHARACTERISTIC
/begin CHARACTERISTIC FSEVBLV_A2DOffsetVoltageC "Parameter used to correct an sensor offset error." VALUE 0x800599CC DATA_RECORD_FLOAT32_IEEE 8190 F_1_p0_2 -4095 4095 /end CHARACTERISTIC
/begin CHARACTERISTIC FSEVBLV_A2dMaxValueC "Maximal value of the ADC." VALUE 0x800599C8 DATA_RECORD_FLOAT32_IEEE 4095 F_1_p0_2 0 4095 /end CHARACTERISTIC
/begin CHARACTERISTIC FSEVBLV_A2dMinValueC "Minimal value of the ADC." VALUE 0x800599C4 DATA_RECORD_FLOAT32_IEEE 4095 F_1_p0_2 0 4095 /end CHARACTERISTIC
/begin CHARACTERISTIC FSEVBLV_CutOffFrequencyC "Filter parameter." VALUE 0x800599C0 DATA_RECORD_FLOAT32_IEEE 2000000 F_1_p0_2 -1000000 1000000 /end CHARACTERISTIC
/begin CHARACTERISTIC FSEVBLV_GainCorrnC "Gain used to correct a sensor linearity error." VALUE 0x800599BC DATA_RECORD_FLOAT32_IEEE 2000000 F_1_p0_2 -1000000 1000000 /end CHARACTERISTIC
/begin CHARACTERISTIC FSEVBLV_GainScalingC "Gain used to convert ADC result into real battery voltage." VALUE 0x800599B8 DATA_RECORD_FLOAT32_IEEE 2000000 F_1_p0_2 -1000000 1000000 /end CHARACTERISTIC
/begin CHARACTERISTIC FSEVBLV_HighVoltageThrC "Maximal acceptable value of the battery voltage." VALUE 0x800599B4 DATA_RECORD_FLOAT32_IEEE 4095 F_1_p0_2 0 4095 /end CHARACTERISTIC
/begin CHARACTERISTIC FSEVBLV_LowHysteresisRangeC "FSEVBLV_LowHysteresisRangeC" VALUE 0x800599B0 DATA_RECORD_FLOAT32_IEEE 3.402823466E+038 F_1_p0_2 -3.402823466E+038 3.402823466E+038 /end CHARACTERISTIC
/begin CHARACTERISTIC FSEVBLV_LowVoltageThrC "Maximal acceptable value of the battery voltage." VALUE 0x800599AC DATA_RECORD_FLOAT32_IEEE 4095 F_1_p0_2 0 4095 /end CHARACTERISTIC
/begin CHARACTERISTIC FSEVBLV_LowVoltageWarnThrC "FSEVBLV_LowVoltageWarnThrC" VALUE 0x800599A8 DATA_RECORD_FLOAT32_IEEE 3.402823466E+038 F_1_p0_2 -3.402823466E+038 3.402823466E+038 /end CHARACTERISTIC
/begin CHARACTERISTIC FSEVBLV_P5VAD2VoltC "Maximal acceptable value of the battery voltage." VALUE 0x800599A4 DATA_RECORD_FLOAT32_IEEE 4095 F_1_p0_2 0 4095 /end CHARACTERISTIC
/begin CHARACTERISTIC FSEVBLV_P5VHSRefAdC "FSEVBLV_P5VHSRefAdC" VALUE 0x800599A0 DATA_RECORD_UWORD 65535 F_1_p0_2 0 65535 /end CHARACTERISTIC
/begin CHARACTERISTIC FSEVBLV_P5VHSRefCompEnC "FSEVBLV_P5VHSRefCompEnC" VALUE 0x8005999C DATA_RECORD_UBYTE 1 Bool_ON_OFF 0 1 BIT_MASK 0x01 /end CHARACTERISTIC
/begin CHARACTERISTIC FSEVBLV_P5VRefC "Maximal acceptable value of the battery voltage." VALUE 0x80059998 DATA_RECORD_FLOAT32_IEEE 4095 F_1_p0_2 0 4095 /end CHARACTERISTIC
/begin CHARACTERISTIC FSEVBLV_P5VRefErrBurstC "Maximal acceptable value of the battery voltage." VALUE 0x80059994 DATA_RECORD_FLOAT32_IEEE 4095 F_1_p0_2 0 4095 /end CHARACTERISTIC
/begin CHARACTERISTIC FSEVBLV_SensCompGainMaxC "FSEVBLV_SensCompGainMaxC" VALUE 0x80059990 DATA_RECORD_FLOAT32_IEEE 3.402823466E+038 F_1_p0_2 -3.402823466E+038 3.402823466E+038 /end CHARACTERISTIC
/begin CHARACTERISTIC FSEVBLV_SensCompGainMinC "FSEVBLV_SensCompGainMinC" VALUE 0x8005998C DATA_RECORD_FLOAT32_IEEE 3.402823466E+038 F_1_p0_2 -3.402823466E+038 3.402823466E+038 /end CHARACTERISTIC
/begin CHARACTERISTIC FSEVBLV_ShortCircuitGndC "FSEVBLV_ShortCircuitGndC" VALUE 0x80059988 DATA_RECORD_UWORD 65535 F_1_p0_2 0 65535 /end CHARACTERISTIC
/begin CHARACTERISTIC FSEVBLV_ShortCircuitVccC "FSEVBLV_ShortCircuitVccC" VALUE 0x80059984 DATA_RECORD_UWORD 65535 F_1_p0_2 0 65535 /end CHARACTERISTIC
/begin CHARACTERISTIC FSEVETA_A2dMaxValueC "FSEVETA_A2dMaxValueC" VALUE 0x80059CA8 DATA_RECORD_FLOAT32_IEEE 3.402823466E+038 F_1_p0_2 -3.402823466E+038 3.402823466E+038 /end CHARACTERISTIC
/begin CHARACTERISTIC FSEVETA_A2dMinValueC "FSEVETA_A2dMinValueC" VALUE 0x80059CA4 DATA_RECORD_FLOAT32_IEEE 3.402823466E+038 F_1_p0_2 -3.402823466E+038 3.402823466E+038 /end CHARACTERISTIC
/begin CHARACTERISTIC FSEVETA_CmdBoardRationalThdC "FSEVETA_CmdBoardRationalThdC" VALUE 0x80059CA0 DATA_RECORD_FLOAT32_IEEE 100 F_1_p0_2 0 100 /end CHARACTERISTIC
/begin CHARACTERISTIC FSEVETA_CmdShortCircuitGndC "FSEVETA_CmdShortCircuitGndC" VALUE 0x80059C9C DATA_RECORD_UWORD 65535 F_1_p0_2 0 65535 /end CHARACTERISTIC
/begin CHARACTERISTIC FSEVETA_CmdShortCircuitVccC "FSEVETA_CmdShortCircuitVccC" VALUE 0x80059C98 DATA_RECORD_UWORD 65535 F_1_p0_2 0 65535 /end CHARACTERISTIC
/begin CHARACTERISTIC FSEVETA_CoolShortCircuitGndC "FSEVETA_CoolShortCircuitGndC" VALUE 0x80059C94 DATA_RECORD_UWORD 65535 F_1_p0_2 0 65535 /end CHARACTERISTIC
/begin CHARACTERISTIC FSEVETA_CoolShortCircuitVccC "FSEVETA_CoolShortCircuitVccC" VALUE 0x80059C90 DATA_RECORD_UWORD 65535 F_1_p0_2 0 65535 /end CHARACTERISTIC
/begin CHARACTERISTIC FSEVETA_CoolingRationalThdC "FSEVETA_CoolingRationalThdC" VALUE 0x80059C8C DATA_RECORD_FLOAT32_IEEE 100 F_1_p0_2 0 100 /end CHARACTERISTIC
/begin CHARACTERISTIC FSEVETA_CutOffFrequencyC "FSEVETA_CutOffFrequencyC" VALUE 0x80059C88 DATA_RECORD_FLOAT32_IEEE 10 F_1_p0_2 0 10 /end CHARACTERISTIC
/begin CHARACTERISTIC FSEVETA_DrvBoardRationalThdC "FSEVETA_DrvBoardRationalThdC" VALUE 0x80059C84 DATA_RECORD_FLOAT32_IEEE 100 F_1_p0_2 0 100 /end CHARACTERISTIC
/begin CHARACTERISTIC FSEVETA_FaultPeriodCounterC "FSEVETA_FaultPeriodCounterC" VALUE 0x80059C80 DATA_RECORD_UWORD 65535 F_1_p0_2 0 65535 /end CHARACTERISTIC
/begin CHARACTERISTIC FSEVETA_GainTempCoolingC "FSEVETA_GainTempCoolingC" VALUE 0x80059C7C DATA_RECORD_FLOAT32_IEEE 2000 F_1_p0_2 -1000 1000 /end CHARACTERISTIC
/begin CHARACTERISTIC FSEVETA_GainTempDrvBoardLeftC "FSEVETA_GainTempDrvBoardLeftC" VALUE 0x80059C78 DATA_RECORD_FLOAT32_IEEE 2000 F_1_p0_2 -1000 1000 /end CHARACTERISTIC
/begin CHARACTERISTIC FSEVETA_GainTempIgbtLeftC "FSEVETA_GainTempIgbtLeftC" VALUE 0x80059C74 DATA_RECORD_FLOAT32_IEEE 2000 F_1_p0_2 -1000 1000 /end CHARACTERISTIC
/begin CHARACTERISTIC FSEVETA_GainTempLVCmdBoardC "FSEVETA_GainTempLVCmdBoardC" VALUE 0x80059C70 DATA_RECORD_FLOAT32_IEEE 1 F_1_p0_2 0 1 /end CHARACTERISTIC
/begin CHARACTERISTIC FSEVETA_HighTempCmdBoard2ThdC "FSEVETA_HighTempCmdBoard2ThdC" VALUE 0x80059C6C DATA_RECORD_FLOAT32_IEEE 3.402823466E+038 F_1_p0_2 -3.402823466E+038 3.402823466E+038 /end CHARACTERISTIC
/begin CHARACTERISTIC FSEVETA_HighTempCmdBoardThdC "FSEVETA_HighTempCmdBoardThdC" VALUE 0x80059C68 DATA_RECORD_FLOAT32_IEEE 3.402823466E+038 F_1_p0_2 -3.402823466E+038 3.402823466E+038 /end CHARACTERISTIC
/begin CHARACTERISTIC FSEVETA_HighTempCoolingThdC "FSEVETA_HighTempCoolingThdC" VALUE 0x80059C64 DATA_RECORD_FLOAT32_IEEE 3.402823466E+038 F_1_p0_2 -3.402823466E+038 3.402823466E+038 /end CHARACTERISTIC
/begin CHARACTERISTIC FSEVETA_HighTempIgbtLeftThdC "FSEVETA_HighTempIgbtLeftThdC" VALUE 0x80059C60 DATA_RECORD_FLOAT32_IEEE 3.402823466E+038 F_1_p0_2 -3.402823466E+038 3.402823466E+038 /end CHARACTERISTIC
/begin CHARACTERISTIC FSEVETA_IgbtRationalThdC "FSEVETA_IgbtRationalThdC" VALUE 0x80059C5C DATA_RECORD_FLOAT32_IEEE 100 F_1_p0_2 0 100 /end CHARACTERISTIC
/begin CHARACTERISTIC FSEVETA_IgbtTempSlopDetnEnC "FSEVETA_IgbtTempSlopDetnEnC" VALUE 0x80059C58 DATA_RECORD_UBYTE 1 Bool_ON_OFF 0 1 BIT_MASK 0x01 /end CHARACTERISTIC
/begin CHARACTERISTIC FSEVETA_IgbtTempSlopMaxC "FSEVETA_IgbtTempSlopMaxC" VALUE 0x80059C54 DATA_RECORD_FLOAT32_IEEE 3.402823466E+038 F_1_p0_2 -3.402823466E+038 3.402823466E+038 /end CHARACTERISTIC
/begin CHARACTERISTIC FSEVETA_InterShortCircuitGndC "FSEVETA_InterShortCircuitGndC" VALUE 0x80059C50 DATA_RECORD_UWORD 65535 F_1_p0_2 0 65535 /end CHARACTERISTIC
/begin CHARACTERISTIC FSEVETA_InterShortCircuitVccC "FSEVETA_InterShortCircuitVccC" VALUE 0x80059C4C DATA_RECORD_UWORD 65535 F_1_p0_2 0 65535 /end CHARACTERISTIC
/begin CHARACTERISTIC FSEVETA_LowTempCmdBoard2ThdC "FSEVETA_LowTempCmdBoard2ThdC" VALUE 0x80059C48 DATA_RECORD_FLOAT32_IEEE 3.402823466E+038 F_1_p0_2 -3.402823466E+038 3.402823466E+038 /end CHARACTERISTIC
/begin CHARACTERISTIC FSEVETA_LowTempCmdBoardThdC "FSEVETA_LowTempCmdBoardThdC" VALUE 0x80059C44 DATA_RECORD_FLOAT32_IEEE 3.402823466E+038 F_1_p0_2 -3.402823466E+038 3.402823466E+038 /end CHARACTERISTIC
/begin CHARACTERISTIC FSEVETA_LowTempCoolingThdC "FSEVETA_LowTempCoolingThdC" VALUE 0x80059C40 DATA_RECORD_FLOAT32_IEEE 3.402823466E+038 F_1_p0_2 -3.402823466E+038 3.402823466E+038 /end CHARACTERISTIC
/begin CHARACTERISTIC FSEVETA_LowTempIgbtLeftThdC "FSEVETA_LowTempIgbtLeftThdC" VALUE 0x80059C3C DATA_RECORD_FLOAT32_IEEE 3.402823466E+038 F_1_p0_2 -3.402823466E+038 3.402823466E+038 /end CHARACTERISTIC
/begin CHARACTERISTIC FSEVETA_LutInTempCmdBoardC "FSEVETA_LutInTempCmdBoardC" CURVE 0x80059BB8 DATA_RECORD_FLOAT32_IEEE 3.402823466E+038 F_1_p0_2 -3.402823466E+038 3.402823466E+038
 /begin AXIS_DESCR FIX_AXIS NO_INPUT_QUANTITY Id_0x00 33 0 32 MAX_GRAD 100.0 FIX_AXIS_PAR_DIST 0 1 33 /end AXIS_DESCR
/end CHARACTERISTIC
/begin CHARACTERISTIC FSEVETA_LutInTempDrvBoardC "FSEVETA_LutInTempDrvBoardC" CURVE 0x80059B18 DATA_RECORD_FLOAT32_IEEE 3.402823466E+038 F_1_p0_2 -3.402823466E+038 3.402823466E+038
 /begin AXIS_DESCR FIX_AXIS NO_INPUT_QUANTITY Id_0x00 40 0 39 MAX_GRAD 100.0 FIX_AXIS_PAR_DIST 0 1 40 /end AXIS_DESCR
/end CHARACTERISTIC
/begin CHARACTERISTIC FSEVETA_LutInTempIgbtCU "FSEVETA_LutInTempIgbtCU" CURVE 0x8009A35C DATA_RECORD_FLOAT32_IEEE 3.402823466E+038 F_1_p0_2 -3.402823466E+038 3.402823466E+038
 /begin AXIS_DESCR FIX_AXIS NO_INPUT_QUANTITY Id_0x00 62 0 61 MAX_GRAD 100.0 FIX_AXIS_PAR_DIST 0 1 62 /end AXIS_DESCR
/end CHARACTERISTIC
/begin CHARACTERISTIC FSEVETA_LutInTempIgbtCV "FSEVETA_LutInTempIgbtCV" CURVE 0x8009A264 DATA_RECORD_FLOAT32_IEEE 3.402823466E+038 F_1_p0_2 -3.402823466E+038 3.402823466E+038
 /begin AXIS_DESCR FIX_AXIS NO_INPUT_QUANTITY Id_0x00 62 0 61 MAX_GRAD 100.0 FIX_AXIS_PAR_DIST 0 1 62 /end AXIS_DESCR
/end CHARACTERISTIC
/begin CHARACTERISTIC FSEVETA_LutInTempIgbtCW "FSEVETA_LutInTempIgbtCW" CURVE 0x8009A16C DATA_RECORD_FLOAT32_IEEE 3.402823466E+038 F_1_p0_2 -3.402823466E+038 3.402823466E+038
 /begin AXIS_DESCR FIX_AXIS NO_INPUT_QUANTITY Id_0x00 62 0 61 MAX_GRAD 100.0 FIX_AXIS_PAR_DIST 0 1 62 /end AXIS_DESCR
/end CHARACTERISTIC
/begin CHARACTERISTIC FSEVETA_LutInTempPt100C "FSEVETA_LutInTempPt100C" CURVE 0x8009A0C0 DATA_RECORD_FLOAT32_IEEE 3.402823466E+038 F_1_p0_2 -3.402823466E+038 3.402823466E+038
 /begin AXIS_DESCR FIX_AXIS NO_INPUT_QUANTITY Id_0x00 43 0 42 MAX_GRAD 100.0 FIX_AXIS_PAR_DIST 0 1 43 /end AXIS_DESCR
/end CHARACTERISTIC
/begin CHARACTERISTIC FSEVETA_LutOutTempCmdBoardC "FSEVETA_LutOutTempCmdBoardC" CURVE 0x80059A94 DATA_RECORD_FLOAT32_IEEE 3.402823466E+038 F_1_p0_2 -3.402823466E+038 3.402823466E+038
 /begin AXIS_DESCR FIX_AXIS NO_INPUT_QUANTITY Id_0x00 33 0 32 MAX_GRAD 100.0 FIX_AXIS_PAR_DIST 0 1 33 /end AXIS_DESCR
/end CHARACTERISTIC
/begin CHARACTERISTIC FSEVETA_LutOutTempDrvBoardC "FSEVETA_LutOutTempDrvBoardC" CURVE 0x800599F4 DATA_RECORD_FLOAT32_IEEE 3.402823466E+038 F_1_p0_2 -3.402823466E+038 3.402823466E+038
 /begin AXIS_DESCR FIX_AXIS NO_INPUT_QUANTITY Id_0x00 40 0 39 MAX_GRAD 100.0 FIX_AXIS_PAR_DIST 0 1 40 /end AXIS_DESCR
/end CHARACTERISTIC
/begin CHARACTERISTIC FSEVETA_LutOutTempIgbtCU "FSEVETA_LutOutTempIgbtCU" CURVE 0x80099FC8 DATA_RECORD_FLOAT32_IEEE 3.402823466E+038 F_1_p0_2 -3.402823466E+038 3.402823466E+038
 /begin AXIS_DESCR FIX_AXIS NO_INPUT_QUANTITY Id_0x00 62 0 61 MAX_GRAD 100.0 FIX_AXIS_PAR_DIST 0 1 62 /end AXIS_DESCR
/end CHARACTERISTIC
/begin CHARACTERISTIC FSEVETA_LutOutTempIgbtCV "FSEVETA_LutOutTempIgbtCV" CURVE 0x80099ED0 DATA_RECORD_FLOAT32_IEEE 3.402823466E+038 F_1_p0_2 -3.402823466E+038 3.402823466E+038
 /begin AXIS_DESCR FIX_AXIS NO_INPUT_QUANTITY Id_0x00 62 0 61 MAX_GRAD 100.0 FIX_AXIS_PAR_DIST 0 1 62 /end AXIS_DESCR
/end CHARACTERISTIC
/begin CHARACTERISTIC FSEVETA_LutOutTempIgbtCW "FSEVETA_LutOutTempIgbtCW" CURVE 0x80099DD8 DATA_RECORD_FLOAT32_IEEE 3.402823466E+038 F_1_p0_2 -3.402823466E+038 3.402823466E+038
 /begin AXIS_DESCR FIX_AXIS NO_INPUT_QUANTITY Id_0x00 62 0 61 MAX_GRAD 100.0 FIX_AXIS_PAR_DIST 0 1 62 /end AXIS_DESCR
/end CHARACTERISTIC
/begin CHARACTERISTIC FSEVETA_LutOutTempPt100C "FSEVETA_LutOutTempPt100C" CURVE 0x80099D2C DATA_RECORD_FLOAT32_IEEE 3.402823466E+038 F_1_p0_2 -3.402823466E+038 3.402823466E+038
 /begin AXIS_DESCR FIX_AXIS NO_INPUT_QUANTITY Id_0x00 43 0 42 MAX_GRAD 100.0 FIX_AXIS_PAR_DIST 0 1 43 /end AXIS_DESCR
/end CHARACTERISTIC
/begin CHARACTERISTIC FSEVETA_MotorSpeedC "FSEVETA_MotorSpeedC" VALUE 0x800599F0 DATA_RECORD_FLOAT32_IEEE 13000 F_1_p0_2 0 13000 /end CHARACTERISTIC
/begin CHARACTERISTIC FSEVETA_OffsetTempCoolingC "FSEVETA_OffsetTempCoolingC" VALUE 0x800599EC DATA_RECORD_FLOAT32_IEEE 3.402823466E+038 F_1_p0_2 -3.402823466E+038 3.402823466E+038 /end CHARACTERISTIC
/begin CHARACTERISTIC FSEVETA_OffsetTempDrvBoardLeftC "FSEVETA_OffsetTempDrvBoardLeftC" VALUE 0x800599E8 DATA_RECORD_FLOAT32_IEEE 3.402823466E+038 F_1_p0_2 -3.402823466E+038 3.402823466E+038 /end CHARACTERISTIC
/begin CHARACTERISTIC FSEVETA_OffsetTempIgbtLeftC "FSEVETA_OffsetTempIgbtLeftC" VALUE 0x800599E4 DATA_RECORD_FLOAT32_IEEE 3.402823466E+038 F_1_p0_2 -3.402823466E+038 3.402823466E+038 /end CHARACTERISTIC
/begin CHARACTERISTIC FSEVETA_OffsetTempLVCmdBoardC "FSEVETA_OffsetTempLVCmdBoardC" VALUE 0x800599E0 DATA_RECORD_FLOAT32_IEEE 3.402823466E+038 F_1_p0_2 -3.402823466E+038 3.402823466E+038 /end CHARACTERISTIC
/begin CHARACTERISTIC FSEVETA_OperationalC "FSEVETA_OperationalC" VALUE 0x800599DC DATA_RECORD_FLOAT32_IEEE 100 F_1_p0_2 0 100 /end CHARACTERISTIC
/begin CHARACTERISTIC FSEVETA_ShortCircuitGndC "FSEVETA_ShortCircuitGndC" VALUE 0x800599D8 DATA_RECORD_UWORD 65535 F_1_p0_2 0 65535 /end CHARACTERISTIC
/begin CHARACTERISTIC FSEVETA_ShortCircuitVccC "FSEVETA_ShortCircuitVccC" VALUE 0x800599D4 DATA_RECORD_UWORD 65535 F_1_p0_2 0 65535 /end CHARACTERISTIC
/begin CHARACTERISTIC FSEVETA_TempRationalEnC "FSEVETA_TempRationalEnC" VALUE 0x800599D0 DATA_RECORD_FLOAT32_IEEE 10 F_1_p0_2 0 10 /end CHARACTERISTIC
/begin CHARACTERISTIC FSEVIBT_IbatRmsGainC "FSEVIBT_IbatRmsGainC" VALUE 0x80059CB0 DATA_RECORD_FLOAT32_IEEE 3.402823466E+038 F_1_p0_2 -3.402823466E+038 3.402823466E+038 /end CHARACTERISTIC
/begin CHARACTERISTIC FSEVIBT_LowPassFiltNumC "FSEVIBT_LowPassFiltNumC" VALUE 0x80059CAC DATA_RECORD_FLOAT32_IEEE 3.402823466E+038 F_1_p0_2 -3.402823466E+038 3.402823466E+038 /end CHARACTERISTIC
/begin CHARACTERISTIC FSEXCTX_DrtGainC "FSEXCTX_DrtGainC" VALUE 0x80059CC0 DATA_RECORD_FLOAT32_IEEE 1 F_1_p0_2 0 1 /end CHARACTERISTIC
/begin CHARACTERISTIC FSEXCTX_SpeedFirstFildTrC "FSEXCTX_SpeedFirstFildTrC" VALUE 0x80059CBC DATA_RECORD_FLOAT32_IEEE 3.402823466E+038 F_1_p0_2 -3.402823466E+038 3.402823466E+038 /end CHARACTERISTIC
/begin CHARACTERISTIC FSEXCTX_TorqueCanFild2TrC "FSEXCTX_TorqueCanFild2TrC" VALUE 0x80059CB8 DATA_RECORD_FLOAT32_IEEE 3.402823466E+038 F_1_p0_2 -3.402823466E+038 3.402823466E+038 /end CHARACTERISTIC
/begin CHARACTERISTIC FSEXCTX_TorqueCanFildTrC "FSEXCTX_TorqueCanFildTrC" VALUE 0x80059CB4 DATA_RECORD_FLOAT32_IEEE 3.402823466E+038 F_1_p0_2 -3.402823466E+038 3.402823466E+038 /end CHARACTERISTIC
/begin CHARACTERISTIC FSMTMTA_A2dMaxValueC "FSMTMTA_A2dMaxValueC" VALUE 0x80059E7C DATA_RECORD_FLOAT32_IEEE 3.402823466E+038 F_1_p0_2 -3.402823466E+038 3.402823466E+038 /end CHARACTERISTIC
/begin CHARACTERISTIC FSMTMTA_A2dMinValueC "FSMTMTA_A2dMinValueC" VALUE 0x80059E78 DATA_RECORD_FLOAT32_IEEE 3.402823466E+038 F_1_p0_2 -3.402823466E+038 3.402823466E+038 /end CHARACTERISTIC
/begin CHARACTERISTIC FSMTMTA_CutOffFrequencyC "FSMTMTA_CutOffFrequencyC" VALUE 0x80059E74 DATA_RECORD_FLOAT32_IEEE 3.402823466E+038 F_1_p0_2 -3.402823466E+038 3.402823466E+038 /end CHARACTERISTIC
/begin CHARACTERISTIC FSMTMTA_GainTempWindingHead1C "FSMTMTA_GainTempWindingHead1C" VALUE 0x80059E70 DATA_RECORD_FLOAT32_IEEE 3.402823466E+038 F_1_p0_2 -3.402823466E+038 3.402823466E+038 /end CHARACTERISTIC
/begin CHARACTERISTIC FSMTMTA_GainTempWindingHead2C "FSMTMTA_GainTempWindingHead2C" VALUE 0x80059E6C DATA_RECORD_FLOAT32_IEEE 3.402823466E+038 F_1_p0_2 -3.402823466E+038 3.402823466E+038 /end CHARACTERISTIC
/begin CHARACTERISTIC FSMTMTA_HighTempWdgHead1ThdC "FSMTMTA_HighTempWdgHead1ThdC" VALUE 0x80059E68 DATA_RECORD_FLOAT32_IEEE 3.402823466E+038 F_1_p0_2 -3.402823466E+038 3.402823466E+038 /end CHARACTERISTIC
/begin CHARACTERISTIC FSMTMTA_HighTempWdgHead2ThdC "FSMTMTA_HighTempWdgHead2ThdC" VALUE 0x80059E64 DATA_RECORD_FLOAT32_IEEE 3.402823466E+038 F_1_p0_2 -3.402823466E+038 3.402823466E+038 /end CHARACTERISTIC
/begin CHARACTERISTIC FSMTMTA_LowTempWindingHead1ThdC "FSMTMTA_LowTempWindingHead1ThdC" VALUE 0x80059E60 DATA_RECORD_FLOAT32_IEEE 3.402823466E+038 F_1_p0_2 -3.402823466E+038 3.402823466E+038 /end CHARACTERISTIC
/begin CHARACTERISTIC FSMTMTA_LowTempWindingHead2ThdC "FSMTMTA_LowTempWindingHead2ThdC" VALUE 0x80059E5C DATA_RECORD_FLOAT32_IEEE 3.402823466E+038 F_1_p0_2 -3.402823466E+038 3.402823466E+038 /end CHARACTERISTIC
/begin CHARACTERISTIC FSMTMTA_LutInTempMotorC "FSMTMTA_LutInTempMotorC" CURVE 0x80059D98 DATA_RECORD_FLOAT32_IEEE 3.402823466E+038 F_1_p0_2 -3.402823466E+038 3.402823466E+038
 /begin AXIS_DESCR FIX_AXIS NO_INPUT_QUANTITY Id_0x00 49 0 48 MAX_GRAD 100.0 FIX_AXIS_PAR_DIST 0 1 49 /end AXIS_DESCR
/end CHARACTERISTIC
/begin CHARACTERISTIC FSMTMTA_LutOutTempMotorC "FSMTMTA_LutOutTempMotorC" CURVE 0x80059CD4 DATA_RECORD_FLOAT32_IEEE 3.402823466E+038 F_1_p0_2 -3.402823466E+038 3.402823466E+038
 /begin AXIS_DESCR FIX_AXIS NO_INPUT_QUANTITY Id_0x00 49 0 48 MAX_GRAD 100.0 FIX_AXIS_PAR_DIST 0 1 49 /end AXIS_DESCR
/end CHARACTERISTIC
/begin CHARACTERISTIC FSMTMTA_OffsetTempWindingHead1C "FSMTMTA_OffsetTempWindingHead1C" VALUE 0x80059CD0 DATA_RECORD_FLOAT32_IEEE 3.402823466E+038 F_1_p0_2 -3.402823466E+038 3.402823466E+038 /end CHARACTERISTIC
/begin CHARACTERISTIC FSMTMTA_OffsetTempWindingHead2C "FSMTMTA_OffsetTempWindingHead2C" VALUE 0x80059CCC DATA_RECORD_FLOAT32_IEEE 3.402823466E+038 F_1_p0_2 -3.402823466E+038 3.402823466E+038 /end CHARACTERISTIC
/begin CHARACTERISTIC FSMTMTA_ShortCircuitGndC "FSMTMTA_ShortCircuitGndC" VALUE 0x80059CC8 DATA_RECORD_UWORD 65535 F_1_p0_2 0 65535 /end CHARACTERISTIC
/begin CHARACTERISTIC FSMTMTA_ShortCircuitVccC "FSMTMTA_ShortCircuitVccC" VALUE 0x80059CC4 DATA_RECORD_UWORD 65535 F_1_p0_2 0 65535 /end CHARACTERISTIC
/begin CHARACTERISTIC FSMTRDG_A2DOffsetCosHC "FSMTRDG_A2DOffsetCosHC" VALUE 0x80059EC8 DATA_RECORD_UWORD 65535 F_1_p0_2 0 65535 /end CHARACTERISTIC
/begin CHARACTERISTIC FSMTRDG_A2DOffsetCosLC "FSMTRDG_A2DOffsetCosLC" VALUE 0x80059EC4 DATA_RECORD_UWORD 65535 F_1_p0_2 0 65535 /end CHARACTERISTIC
/begin CHARACTERISTIC FSMTRDG_A2DOffsetExtationC "FSMTRDG_A2DOffsetExtationC" VALUE 0x80059EC0 DATA_RECORD_UWORD 65535 F_1_p0_2 0 65535 /end CHARACTERISTIC
/begin CHARACTERISTIC FSMTRDG_A2DOffsetSinHC "FSMTRDG_A2DOffsetSinHC" VALUE 0x80059EBC DATA_RECORD_UWORD 65535 F_1_p0_2 0 65535 /end CHARACTERISTIC
/begin CHARACTERISTIC FSMTRDG_A2DOffsetSinLC "FSMTRDG_A2DOffsetSinLC" VALUE 0x80059EB8 DATA_RECORD_UWORD 65535 F_1_p0_2 0 65535 /end CHARACTERISTIC
/begin CHARACTERISTIC FSMTRDG_A2dMaxValueC "Maximal value of the ADC." VALUE 0x80059EB4 DATA_RECORD_FLOAT32_IEEE 4095 F_1_p0_2 0 4095 /end CHARACTERISTIC
/begin CHARACTERISTIC FSMTRDG_A2dMinValueC "Minimal value of the ADC." VALUE 0x80059EB0 DATA_RECORD_FLOAT32_IEEE 4095 F_1_p0_2 0 4095 /end CHARACTERISTIC
/begin CHARACTERISTIC FSMTRDG_CosHScalingC "FSMTRDG_CosHScalingC" VALUE 0x80059EAC DATA_RECORD_FLOAT32_IEEE 3.402823466E+038 F_1_p0_2 -3.402823466E+038 3.402823466E+038 /end CHARACTERISTIC
/begin CHARACTERISTIC FSMTRDG_CosLScalingC "FSMTRDG_CosLScalingC" VALUE 0x80059EA8 DATA_RECORD_FLOAT32_IEEE 3.402823466E+038 F_1_p0_2 -3.402823466E+038 3.402823466E+038 /end CHARACTERISTIC
/begin CHARACTERISTIC FSMTRDG_CutOffFrequencyC "Filter parameter." VALUE 0x80059EA4 DATA_RECORD_FLOAT32_IEEE 2000000 F_1_p0_2 -1000000 1000000 /end CHARACTERISTIC
/begin CHARACTERISTIC FSMTRDG_ExitationScalingC "FSMTRDG_ExitationScalingC" VALUE 0x80059EA0 DATA_RECORD_FLOAT32_IEEE 3.402823466E+038 F_1_p0_2 -3.402823466E+038 3.402823466E+038 /end CHARACTERISTIC
/begin CHARACTERISTIC FSMTRDG_GainCosHC "FSMTRDG_GainCosHC" VALUE 0x80059E9C DATA_RECORD_FLOAT32_IEEE 3.402823466E+038 F_1_p0_2 -3.402823466E+038 3.402823466E+038 /end CHARACTERISTIC
/begin CHARACTERISTIC FSMTRDG_GainCosLC "FSMTRDG_GainCosLC" VALUE 0x80059E98 DATA_RECORD_FLOAT32_IEEE 3.402823466E+038 F_1_p0_2 -3.402823466E+038 3.402823466E+038 /end CHARACTERISTIC
/begin CHARACTERISTIC FSMTRDG_GainExitationVoltC "FSMTRDG_GainExitationVoltC" VALUE 0x80059E94 DATA_RECORD_FLOAT32_IEEE 3.402823466E+038 F_1_p0_2 -3.402823466E+038 3.402823466E+038 /end CHARACTERISTIC
/begin CHARACTERISTIC FSMTRDG_GainSinHC "FSMTRDG_GainSinHC" VALUE 0x80059E90 DATA_RECORD_FLOAT32_IEEE 3.402823466E+038 F_1_p0_2 -3.402823466E+038 3.402823466E+038 /end CHARACTERISTIC
/begin CHARACTERISTIC FSMTRDG_GainSinLC "FSMTRDG_GainSinLC" VALUE 0x80059E8C DATA_RECORD_FLOAT32_IEEE 3.402823466E+038 F_1_p0_2 -3.402823466E+038 3.402823466E+038 /end CHARACTERISTIC
/begin CHARACTERISTIC FSMTRDG_IOFilterC "FSMTRDG_IOFilterC" VALUE 0x80059E88 DATA_RECORD_UWORD 65535 F_1_p0_2 0 65535 /end CHARACTERISTIC
/begin CHARACTERISTIC FSMTRDG_SinHScalingC "FSMTRDG_SinHScalingC" VALUE 0x80059E84 DATA_RECORD_FLOAT32_IEEE 3.402823466E+038 F_1_p0_2 -3.402823466E+038 3.402823466E+038 /end CHARACTERISTIC
/begin CHARACTERISTIC FSMTRDG_SinLScalingC "FSMTRDG_SinLScalingC" VALUE 0x80059E80 DATA_RECORD_FLOAT32_IEEE 3.402823466E+038 F_1_p0_2 -3.402823466E+038 3.402823466E+038 /end CHARACTERISTIC
/begin CHARACTERISTIC FSSMACS_AbsMecaSpeedTrC "FSSMACS_AbsMecaSpeedTrC" VALUE 0x80059840 DATA_RECORD_FLOAT32_IEEE 3.402823466E+038 F_1_p0_2 -3.402823466E+038 3.402823466E+038 /end CHARACTERISTIC
/begin CHARACTERISTIC FSSMACS_AkdEnterSpdThrdC "FSSMACS_AkdEnterSpdThrdC" VALUE 0x8005983C DATA_RECORD_FLOAT32_IEEE 3.402823466E+038 F_1_p0_2 -3.402823466E+038 3.402823466E+038 /end CHARACTERISTIC
/begin CHARACTERISTIC FSSMACS_AkdExitSpdThrdC "FSSMACS_AkdExitSpdThrdC" VALUE 0x80059838 DATA_RECORD_FLOAT32_IEEE 3.402823466E+038 F_1_p0_2 -3.402823466E+038 3.402823466E+038 /end CHARACTERISTIC
/begin CHARACTERISTIC FSSMACS_AkdStopVoltageC "FSSMACS_AkdStopVoltageC" VALUE 0x80059834 DATA_RECORD_FLOAT32_IEEE 1000 F_1_p0_2 0 1000 /end CHARACTERISTIC
/begin CHARACTERISTIC FSSMACS_AkdTimeoutCntC "FSSMACS_AkdTimeoutCntC" VALUE 0x80059830 DATA_RECORD_UWORD 65535 F_1_p0_2 0 65535 /end CHARACTERISTIC
/begin CHARACTERISTIC FSSMACS_AllowShutdownTrqRateC "FSSMACS_AllowShutdownTrqRateC" VALUE 0x8005982C DATA_RECORD_FLOAT32_IEEE 0.999 F_1_p0_2 0.001 1 /end CHARACTERISTIC
/begin CHARACTERISTIC FSSMACS_AllowStartSpeedRpmC "FSSMACS_AllowStartSpeedRpmC" VALUE 0x80059828 DATA_RECORD_FLOAT32_IEEE 3.402823466E+038 F_1_p0_2 -3.402823466E+038 3.402823466E+038 /end CHARACTERISTIC
/begin CHARACTERISTIC FSSMACS_BenchKL15EnaC "FSSMACS_BenchKL15EnaC" VALUE 0x80059824 DATA_RECORD_UBYTE 1 Bool_ON_OFF 0 1 BIT_MASK 0x01 /end CHARACTERISTIC
/begin CHARACTERISTIC FSSMACS_HiPwrRdyVoltC "220v is the low level to enter the ready, traction mode" VALUE 0x80059820 DATA_RECORD_FLOAT32_IEEE 3.402823466E+038 F_1_p0_2 -3.402823466E+038 3.402823466E+038 /end CHARACTERISTIC
/begin CHARACTERISTIC FSSMACS_HiPwrStbVoltC "FSSMACS_HiPwrStbVoltC" VALUE 0x8005981C DATA_RECORD_FLOAT32_IEEE 3.402823466E+038 F_1_p0_2 -3.402823466E+038 3.402823466E+038 /end CHARACTERISTIC
/begin CHARACTERISTIC FSSMACS_KL15FilterC "FSSMACS_KL15FilterC" VALUE 0x80059818 DATA_RECORD_UWORD 65535 F_1_p0_2 0 65535 /end CHARACTERISTIC
/begin CHARACTERISTIC FSSMACS_ManualModeReqC "FSSMACS_ManualModeReqC" VALUE 0x80059814 DATA_RECORD_UBYTE 255 F_1_p0_2 0 255 /end CHARACTERISTIC
/begin CHARACTERISTIC FSSMACS_OcCntMaxValueC "FSSMACS_OcCntMaxValueC" VALUE 0x80059810 DATA_RECORD_UWORD 65535 F_1_p0_2 0 65535 /end CHARACTERISTIC
/begin CHARACTERISTIC FSSMACS_OcLowVolMaxC "FSSMACS_OcLowVolMaxC" VALUE 0x8005980C DATA_RECORD_FLOAT32_IEEE 3.402823466E+038 F_1_p0_2 -3.402823466E+038 3.402823466E+038 /end CHARACTERISTIC
/begin CHARACTERISTIC FSSMACS_OcLowVolMinC "FSSMACS_OcLowVolMinC" VALUE 0x80059808 DATA_RECORD_FLOAT32_IEEE 3.402823466E+038 F_1_p0_2 -3.402823466E+038 3.402823466E+038 /end CHARACTERISTIC
/begin CHARACTERISTIC FSSMACS_PreCharFinVoltC "FSSMACS_PreCharFinVoltC" VALUE 0x80059804 DATA_RECORD_FLOAT32_IEEE 3.402823466E+038 F_1_p0_2 -3.402823466E+038 3.402823466E+038 /end CHARACTERISTIC
/begin CHARACTERISTIC FSSMACS_ReverseKL15EnaC "FSSMACS_ReverseKL15EnaC" VALUE 0x80059800 DATA_RECORD_UBYTE 1 Bool_ON_OFF 0 1 BIT_MASK 0x01 /end CHARACTERISTIC
/begin CHARACTERISTIC FSSMACS_RuningShutDelayComfCntC "FSSMACS_RuningShutDelayComfCntC" VALUE 0x800597FC DATA_RECORD_UWORD 65535 F_1_p0_2 0 65535 /end CHARACTERISTIC
/begin CHARACTERISTIC FSSMACS_SpeedReadyFilterC "FSSMACS_SpeedReadyFilterC" VALUE 0x800597F8 DATA_RECORD_UWORD 65535 F_1_p0_2 0 65535 /end CHARACTERISTIC
/begin CHARACTERISTIC FSSMACS_SpeedReadyThresholdC "FSSMACS_SpeedReadyThresholdC" VALUE 0x800597F4 DATA_RECORD_FLOAT32_IEEE 3.402823466E+038 F_1_p0_2 -3.402823466E+038 3.402823466E+038 /end CHARACTERISTIC
/begin CHARACTERISTIC FSSMACS_TorqueEnterSpdThrdC "FSSMACS_TorqueEnterSpdThrdC" VALUE 0x800597F0 DATA_RECORD_FLOAT32_IEEE 3.402823466E+038 F_1_p0_2 -3.402823466E+038 3.402823466E+038 /end CHARACTERISTIC
/begin CHARACTERISTIC FSSMACS_TorqueExitSpdThrdC "FSSMACS_TorqueExitSpdThrdC" VALUE 0x800597EC DATA_RECORD_FLOAT32_IEEE 3.402823466E+038 F_1_p0_2 -3.402823466E+038 3.402823466E+038 /end CHARACTERISTIC
/begin CHARACTERISTIC FSSMACS_UdsOCBenchModeOnOffC "FSSMACS_UdsOCBenchModeOnOffC" VALUE 0x800597E8 DATA_RECORD_UBYTE 1 Bool_ON_OFF 0 1 BIT_MASK 0x01 /end CHARACTERISTIC
/begin CHARACTERISTIC FSSMACS_UdsOcEnableC "FSSMACS_UdsOcEnableC" VALUE 0x800597E4 DATA_RECORD_UBYTE 1 Bool_ON_OFF 0 1 BIT_MASK 0x01 /end CHARACTERISTIC
/begin CHARACTERISTIC FSSMACS_UdsOcRdResFlagC "FSSMACS_UdsOcRdResFlagC" VALUE 0x800597E0 DATA_RECORD_UBYTE 1 Bool_ON_OFF 0 1 BIT_MASK 0x01 /end CHARACTERISTIC
/begin CHARACTERISTIC FSSMACS_UdsOcStartReqC "FSSMACS_UdsOcStartReqC" VALUE 0x800597DC DATA_RECORD_UBYTE 1 Bool_ON_OFF 0 1 BIT_MASK 0x01 /end CHARACTERISTIC
/begin CHARACTERISTIC FSSMACS_Volt2BmsDiffC "FSSMACS_Volt2BmsDiffC" VALUE 0x800597D8 DATA_RECORD_FLOAT32_IEEE 1000 F_1_p0_2 0 1000 /end CHARACTERISTIC
/begin CHARACTERISTIC FSSMACS_ZeroTorqCounterC "FSSMACS_ZeroTorqCounterC" VALUE 0x800597D4 DATA_RECORD_UWORD 65535 F_1_p0_2 0 65535 /end CHARACTERISTIC
/begin CHARACTERISTIC FSSMMAM_AclStateBypassOnOffC "bypass activation boolean" VALUE 0x80059848 DATA_RECORD_UBYTE 1 Bool_ON_OFF 0 1 BIT_MASK 0x01 /end CHARACTERISTIC
/begin CHARACTERISTIC FSSMMAM_AclStateBypassValueC "Mcu State value when bypass is activated" VALUE 0x80059844 DATA_RECORD_UWORD 65535 F_1_p0_2 0 65535 /end CHARACTERISTIC
/begin CHARACTERISTIC FSTCGTC_AccCheckCntThrdC "FSTCGTC_AccCheckCntThrdC" VALUE 0x80059944 DATA_RECORD_UWORD 65535 F_1_p0_2 0 65535 /end CHARACTERISTIC
/begin CHARACTERISTIC FSTCGTC_AccPedThdC "FSTCGTC_AccPedThdC" VALUE 0x80059940 DATA_RECORD_FLOAT32_IEEE 3.402823466E+038 F_1_p0_2 -3.402823466E+038 3.402823466E+038 /end CHARACTERISTIC
/begin CHARACTERISTIC FSTCGTC_ActiveSpdLmtEnC "FSTCGTC_ActiveSpdLmtEnC" VALUE 0x8005993C DATA_RECORD_UBYTE 1 Bool_ON_OFF 0 1 BIT_MASK 0x01 /end CHARACTERISTIC
/begin CHARACTERISTIC FSTCGTC_BrakeCheckCntThrdC "FSTCGTC_BrakeCheckCntThrdC" VALUE 0x80059938 DATA_RECORD_UWORD 65535 F_1_p0_2 0 65535 /end CHARACTERISTIC
/begin CHARACTERISTIC FSTCGTC_BrakePedPosSlopThrdC "FSTCGTC_BrakePedPosSlopThrdC" VALUE 0x80059934 DATA_RECORD_FLOAT32_IEEE 3.402823466E+038 F_1_p0_2 -3.402823466E+038 3.402823466E+038 /end CHARACTERISTIC
/begin CHARACTERISTIC FSTCGTC_CanTrqTgtRelatedGearEnC "If the VCU does not send an anti-slipping sign" VALUE 0x80059930 DATA_RECORD_UBYTE 1 Bool_ON_OFF 0 1 BIT_MASK 0x01 /end CHARACTERISTIC
/begin CHARACTERISTIC FSTCGTC_CtrlTrLutInSpdC "FSTCGTC_CtrlTrLutInSpdC" CURVE 0x80059924 DATA_RECORD_FLOAT32_IEEE 3.402823466E+038 F_1_p0_2 -3.402823466E+038 3.402823466E+038
 /begin AXIS_DESCR FIX_AXIS NO_INPUT_QUANTITY Id_0x00 3 0 2 MAX_GRAD 100.0 FIX_AXIS_PAR_DIST 0 1 3 /end AXIS_DESCR
/end CHARACTERISTIC
/begin CHARACTERISTIC FSTCGTC_CtrlTrLutOutC "FSTCGTC_CtrlTrLutOutC" CURVE 0x80059918 DATA_RECORD_FLOAT32_IEEE 3.402823466E+038 F_1_p0_2 -3.402823466E+038 3.402823466E+038
 /begin AXIS_DESCR FIX_AXIS NO_INPUT_QUANTITY Id_0x00 3 0 2 MAX_GRAD 100.0 FIX_AXIS_PAR_DIST 0 1 3 /end AXIS_DESCR
/end CHARACTERISTIC
/begin CHARACTERISTIC FSTCGTC_HacDisableTrasCntC "FSTCGTC_HacDisableTrasCntC" VALUE 0x80059914 DATA_RECORD_UWORD 65535 F_1_p0_2 0 65535 /end CHARACTERISTIC
/begin CHARACTERISTIC FSTCGTC_HacEnSpeedMaxC "FSTCGTC_HacEnSpeedMaxC" VALUE 0x80059910 DATA_RECORD_FLOAT32_IEEE 3.402823466E+038 F_1_p0_2 -3.402823466E+038 3.402823466E+038 /end CHARACTERISTIC
/begin CHARACTERISTIC FSTCGTC_HacEnSpeedThrdC "FSTCGTC_HacEnSpeedThrdC" VALUE 0x8005990C DATA_RECORD_FLOAT32_IEEE 3.402823466E+038 F_1_p0_2 -3.402823466E+038 3.402823466E+038 /end CHARACTERISTIC
/begin CHARACTERISTIC FSTCGTC_HacEnableCntMaxC "FSTCGTC_HacEnableCntMaxC" VALUE 0x80059908 DATA_RECORD_UWORD 65535 F_1_p0_2 0 65535 /end CHARACTERISTIC
/begin CHARACTERISTIC FSTCGTC_HacEnableNumberMaxC "FSTCGTC_HacEnableNumberMaxC" VALUE 0x80059904 DATA_RECORD_UBYTE 255 F_1_p0_2 0 255 /end CHARACTERISTIC
/begin CHARACTERISTIC FSTCGTC_HacTempOutCntC "FSTCGTC_HacTempOutCntC" VALUE 0x80059900 DATA_RECORD_UWORD 65535 F_1_p0_2 0 65535 /end CHARACTERISTIC
/begin CHARACTERISTIC FSTCGTC_HandBrakeCheckCntC "FSTCGTC_HandBrakeCheckCntC" VALUE 0x800598FC DATA_RECORD_UWORD 65535 F_1_p0_2 0 65535 /end CHARACTERISTIC
/begin CHARACTERISTIC FSTCGTC_HandBrakeCheckThrdC "FSTCGTC_HandBrakeCheckThrdC" VALUE 0x800598F8 DATA_RECORD_UWORD 65535 F_1_p0_2 0 65535 /end CHARACTERISTIC
/begin CHARACTERISTIC FSTCGTC_I0dqTgtC "[i0, id, iq]" CURVE 0x800598EC DATA_RECORD_FLOAT32_IEEE 3.402823466E+038 F_1_p0_2 -3.402823466E+038 3.402823466E+038
 /begin AXIS_DESCR FIX_AXIS NO_INPUT_QUANTITY Id_0x00 3 0 2 MAX_GRAD 100.0 FIX_AXIS_PAR_DIST 0 1 3 /end AXIS_DESCR
/end CHARACTERISTIC
/begin CHARACTERISTIC FSTCGTC_LmtSpdChgPwrMinC "FSTCGTC_LmtSpdChgPwrMinC" VALUE 0x800598E8 DATA_RECORD_FLOAT32_IEEE 3.402823466E+038 F_1_p0_2 -3.402823466E+038 3.402823466E+038 /end CHARACTERISTIC
/begin CHARACTERISTIC FSTCGTC_LmtSpdChgPwrModeC "FSTCGTC_LmtSpdChgPwrModeC" VALUE 0x800598E4 DATA_RECORD_UBYTE 1 Bool_ON_OFF 0 1 BIT_MASK 0x01 /end CHARACTERISTIC
/begin CHARACTERISTIC FSTCGTC_LmtSpdMotorGenEffC "First filter response time at 95 pct." VALUE 0x800598E0 DATA_RECORD_FLOAT32_IEEE 0.8 F_1_p0_2 0.2 1 /end CHARACTERISTIC
/begin CHARACTERISTIC FSTCGTC_LmtSpdTrqSatThrdC "FSTCGTC_LmtSpdTrqSatThrdC" VALUE 0x800598DC DATA_RECORD_FLOAT32_IEEE 3.402823466E+038 F_1_p0_2 -3.402823466E+038 3.402823466E+038 /end CHARACTERISTIC
/begin CHARACTERISTIC FSTCGTC_LutInTrqCompSpdC "FSTCGTC_LutInTrqCompSpdC" CURVE 0x800598C8 DATA_RECORD_FLOAT32_IEEE 3.402823466E+038 F_1_p0_2 -3.402823466E+038 3.402823466E+038
 /begin AXIS_DESCR FIX_AXIS NO_INPUT_QUANTITY Id_0x00 5 0 4 MAX_GRAD 100.0 FIX_AXIS_PAR_DIST 0 1 5 /end AXIS_DESCR
/end CHARACTERISTIC
/begin CHARACTERISTIC FSTCGTC_LutOutTrqCompTorqC "FSTCGTC_LutOutTrqCompTorqC" CURVE 0x800598B4 DATA_RECORD_FLOAT32_IEEE 3.402823466E+038 F_1_p0_2 -3.402823466E+038 3.402823466E+038
 /begin AXIS_DESCR FIX_AXIS NO_INPUT_QUANTITY Id_0x00 5 0 4 MAX_GRAD 100.0 FIX_AXIS_PAR_DIST 0 1 5 /end AXIS_DESCR
/end CHARACTERISTIC
/begin CHARACTERISTIC FSTCGTC_MecaSpdOffsetC "FSTCGTC_MecaSpdOffsetC" VALUE 0x800598B0 DATA_RECORD_FLOAT32_IEEE 20 F_1_p0_2 -10 10 /end CHARACTERISTIC
/begin CHARACTERISTIC FSTCGTC_MecaSpeedRpmTgtC "FSTCGTC_MecaSpeedRpmTgtC" VALUE 0x800598AC DATA_RECORD_FLOAT32_IEEE 3.402823466E+038 F_1_p0_2 -3.402823466E+038 3.402823466E+038 /end CHARACTERISTIC
/begin CHARACTERISTIC FSTCGTC_MecaSpeedTgtModeC "FSTCGTC_MecaSpeedTgtModeC" VALUE 0x800598A8 DATA_RECORD_UBYTE 1 Bool_ON_OFF 0 1 BIT_MASK 0x01 /end CHARACTERISTIC
/begin CHARACTERISTIC FSTCGTC_MotorDirRevEnableC "Set to 1 when the positive direction of the motor is opposite to the direction of the vehicle" VALUE 0x800598A4 DATA_RECORD_UBYTE 1 Bool_ON_OFF 0 1 BIT_MASK 0x01 /end CHARACTERISTIC
/begin CHARACTERISTIC FSTCGTC_MotorMaxSpeedC "FSTCGTC_MotorMaxSpeedC" VALUE 0x800598A0 DATA_RECORD_FLOAT32_IEEE 10 F_1_p0_2 0 10 /end CHARACTERISTIC
/begin CHARACTERISTIC FSTCGTC_MotorMinSpeedC "FSTCGTC_MotorMinSpeedC" VALUE 0x8005989C DATA_RECORD_FLOAT32_IEEE 10 F_1_p0_2 -10 0 /end CHARACTERISTIC
/begin CHARACTERISTIC FSTCGTC_OpenLoopLutEnCntC "FSTCGTC_OpenLoopLutEnCntC" VALUE 0x80059898 DATA_RECORD_UWORD 65535 F_1_p0_2 0 65535 /end CHARACTERISTIC
/begin CHARACTERISTIC FSTCGTC_RunSpeedThrdC "FSTCGTC_RunSpeedThrdC" VALUE 0x80059894 DATA_RECORD_FLOAT32_IEEE 3.402823466E+038 F_1_p0_2 -3.402823466E+038 3.402823466E+038 /end CHARACTERISTIC
/begin CHARACTERISTIC FSTCGTC_SlopSlipEnableC "If the VCU does not send an anti-slipping sign" VALUE 0x80059890 DATA_RECORD_UBYTE 1 Bool_ON_OFF 0 1 BIT_MASK 0x01 /end CHARACTERISTIC
/begin CHARACTERISTIC FSTCGTC_StopCheckCntThrdC "FSTCGTC_StopCheckCntThrdC" VALUE 0x8005988C DATA_RECORD_UWORD 65535 F_1_p0_2 0 65535 /end CHARACTERISTIC
/begin CHARACTERISTIC FSTCGTC_StopSpeedThrdC "FSTCGTC_StopSpeedThrdC" VALUE 0x80059888 DATA_RECORD_FLOAT32_IEEE 3.402823466E+038 F_1_p0_2 -3.402823466E+038 3.402823466E+038 /end CHARACTERISTIC
/begin CHARACTERISTIC FSTCGTC_ToVcuTrqCheckCntC "FSTCGTC_ToVcuTrqCheckCntC" VALUE 0x80059884 DATA_RECORD_UWORD 65535 F_1_p0_2 0 65535 /end CHARACTERISTIC
/begin CHARACTERISTIC FSTCGTC_ToVcuTrqMaxRateC "FSTCGTC_ToVcuTrqMaxRateC" VALUE 0x80059880 DATA_RECORD_FLOAT32_IEEE 0.5 F_1_p0_2 0.5 1 /end CHARACTERISTIC
/begin CHARACTERISTIC FSTCGTC_TorqSlewRateC "FSTCGTC_TorqSlewRateC" VALUE 0x8005987C DATA_RECORD_FLOAT32_IEEE 3.402823466E+038 F_1_p0_2 -3.402823466E+038 3.402823466E+038 /end CHARACTERISTIC
/begin CHARACTERISTIC FSTCGTC_TorquePreFildTrC "FSTCGTC_TorquePreFildTrC" VALUE 0x80059878 DATA_RECORD_FLOAT32_IEEE 3.402823466E+038 F_1_p0_2 -3.402823466E+038 3.402823466E+038 /end CHARACTERISTIC
/begin CHARACTERISTIC FSTCGTC_TorqueTgtC "FSTCGTC_TorqueTgtC" VALUE 0x80059874 DATA_RECORD_FLOAT32_IEEE 3.402823466E+038 F_1_p0_2 -3.402823466E+038 3.402823466E+038 /end CHARACTERISTIC
/begin CHARACTERISTIC FSTCGTC_TorqueTgtDirectionC "FSTCGTC_TorqueTgtDirectionC" VALUE 0x80059870 DATA_RECORD_SBYTE 200 F_1_p0_2 -100 100 /end CHARACTERISTIC
/begin CHARACTERISTIC FSTCGTC_TorqueTgtModeC "FSTCGTC_TorqueTgtModeC" VALUE 0x8005986C DATA_RECORD_UBYTE 1 Bool_ON_OFF 0 1 BIT_MASK 0x01 /end CHARACTERISTIC
/begin CHARACTERISTIC FSTCGTC_U0dqTgtC "FSTCGTC_U0dqTgtC" CURVE 0x80059860 DATA_RECORD_FLOAT32_IEEE 3.402823466E+038 F_1_p0_2 -3.402823466E+038 3.402823466E+038
 /begin AXIS_DESCR FIX_AXIS NO_INPUT_QUANTITY Id_0x00 3 0 2 MAX_GRAD 100.0 FIX_AXIS_PAR_DIST 0 1 3 /end AXIS_DESCR
/end CHARACTERISTIC
/begin CHARACTERISTIC FSTCGTC_ZeroToqueLowSpeedThrdC "FSTCGTC_ZeroToqueLowSpeedThrdC" VALUE 0x8005985C DATA_RECORD_FLOAT32_IEEE 2000 F_1_p0_2 -1000 1000 /end CHARACTERISTIC
/begin CHARACTERISTIC FSTCGTC_ZeroTorqueCompTgtC "torque compensation allowed when zero torque set" VALUE 0x80059858 DATA_RECORD_FLOAT32_IEEE 3.402823466E+038 F_1_p0_2 -3.402823466E+038 3.402823466E+038 /end CHARACTERISTIC
/begin CHARACTERISTIC FSTCGTC_ZeroTorqueOffsetEnableC "FSTCGTC_ZeroTorqueOffsetEnableC" VALUE 0x80059854 DATA_RECORD_UBYTE 1 Bool_ON_OFF 0 1 BIT_MASK 0x01 /end CHARACTERISTIC
/begin CHARACTERISTIC FSTCGTC_fC "FSTCGTC_fC" VALUE 0x80059850 DATA_RECORD_FLOAT32_IEEE 3.402823466E+038 F_1_p0_2 -3.402823466E+038 3.402823466E+038 /end CHARACTERISTIC
/begin CHARACTERISTIC FSTCGTC_jC "FSTCGTC_jC" VALUE 0x8005984C DATA_RECORD_FLOAT32_IEEE 3.402823466E+038 F_1_p0_2 -3.402823466E+038 3.402823466E+038 /end CHARACTERISTIC
/begin CHARACTERISTIC GESM_bPowerOffModeInhC "ESM POWER_OFF_MODE state inhibition" VALUE 0x800A3708 DATA_RECORD_UBYTE 1 Bool_ON_OFF 0 1 BIT_MASK 0x01 /end CHARACTERISTIC
/begin CHARACTERISTIC GESM_ku16AfterrunToutCntC "GESM_ku16AfterrunToutCntC" VALUE 0x800580AA DATA_RECORD_UWORD 327675 F_5_p0_26 0 327675 /end CHARACTERISTIC
/begin CHARACTERISTIC RCEVHCM_A2DOffsetVoltageC "Parameter used to correct an sensor offset error." VALUE 0x80059EE4 DATA_RECORD_FLOAT32_IEEE 8190 F_1_p0_2 -4095 4095 /end CHARACTERISTIC
/begin CHARACTERISTIC RCEVHCM_A2dMaxValueC "Maximal value of the ADC." VALUE 0x80059EE0 DATA_RECORD_FLOAT32_IEEE 4095 F_1_p0_2 0 4095 /end CHARACTERISTIC
/begin CHARACTERISTIC RCEVHCM_A2dMinValueC "Minimal value of the ADC." VALUE 0x80059EDC DATA_RECORD_FLOAT32_IEEE 4095 F_1_p0_2 0 4095 /end CHARACTERISTIC
/begin CHARACTERISTIC RCEVHCM_CutOffFrequencyC "Filter parameter." VALUE 0x80059ED8 DATA_RECORD_FLOAT32_IEEE 2000000 F_1_p0_2 -1000000 1000000 /end CHARACTERISTIC
/begin CHARACTERISTIC RCEVHCM_GainCorrnC "Gain used to correct a sensor linearity error." VALUE 0x80059ED4 DATA_RECORD_FLOAT32_IEEE 2000000 F_1_p0_2 -1000000 1000000 /end CHARACTERISTIC
/begin CHARACTERISTIC RCEVHCM_GainScalingC "Gain used to convert ADC result into real battery voltage." VALUE 0x80059ED0 DATA_RECORD_FLOAT32_IEEE 2000000 F_1_p0_2 -1000000 1000000 /end CHARACTERISTIC
/begin CHARACTERISTIC RCEVHCM_HighVoltRdyThrC "Gain used to convert ADC result into real battery voltage." VALUE 0x80059ECC DATA_RECORD_FLOAT32_IEEE 2000000 F_1_p0_2 -1000000 1000000 /end CHARACTERISTIC
/begin MEASUREMENT AFSEVBHV_A2DBackResCorrdVoltage "Corrected ADC value of the battery voltage." FLOAT32_IEEE F_1_p0_2 1 2 0 4095 ECU_ADDRESS 0x700025B8 /end MEASUREMENT
/begin MEASUREMENT AFSEVBHV_A2DResCorrdVoltage "Corrected ADC value of the battery voltage." FLOAT32_IEEE F_1_p0_2 1 2 0 4095 ECU_ADDRESS 0x700025B4 /end MEASUREMENT
/begin MEASUREMENT AFSEVBHV_ActVoltage "AFSEVBHV_ActVoltage" FLOAT32_IEEE F_1_p0_2 1 2 0 605 ECU_ADDRESS 0x700025B0 /end MEASUREMENT
/begin MEASUREMENT AFSEVBHV_BackupVoltage "Current value of the HV battery scaled voltage." FLOAT32_IEEE F_1_p0_2 1 2 0 605 ECU_ADDRESS 0x700025AC /end MEASUREMENT
/begin MEASUREMENT AFSEVBHV_BackupVoltageFild "Filtered value of the battery voltage with 1 time delay." FLOAT32_IEEE F_1_p0_2 1 2 0 605 ECU_ADDRESS 0x700025A8 /end MEASUREMENT
/begin MEASUREMENT AFSEVBHV_BackupVoltageFildZ "Filtered value of the battery voltage with 1 time delay." FLOAT32_IEEE F_1_p0_2 1 2 0 605 ECU_ADDRESS 0x700025A4 /end MEASUREMENT
/begin MEASUREMENT AFSEVBHV_ExtUbatGain "AFSEVBHV_ExtUbatGain" FLOAT32_IEEE F_1_p0_2 1 2 -3.402823466E+038 3.402823466E+038 ECU_ADDRESS 0x700025A0 /end MEASUREMENT
/begin MEASUREMENT AFSEVBHV_HighVoltReady "AFSEVBHV_HighVoltReady" UBYTE Bool_ON_OFF 1 2 0 1 BIT_MASK 0x01 ECU_ADDRESS 0x7000259E /end MEASUREMENT
/begin MEASUREMENT AFSEVBHV_VolNotRationalDetn "Fault on the battery voltage measure detection." UBYTE Bool_ON_OFF 1 2 0 1 BIT_MASK 0x01 ECU_ADDRESS 0x7000259D /end MEASUREMENT
/begin MEASUREMENT AFSEVBHV_VolNotRationalErr "Fault on the battery voltage measure detection." UBYTE Bool_ON_OFF 1 2 0 1 BIT_MASK 0x01 ECU_ADDRESS 0x7000259C /end MEASUREMENT
/begin MEASUREMENT AFSEVBHV_Voltage "Current value of the HV battery scaled voltage." FLOAT32_IEEE F_1_p0_2 1 2 0 605 ECU_ADDRESS 0x70002598 /end MEASUREMENT
/begin MEASUREMENT AFSEVBHV_Voltage1Fild "Filtered value of the battery voltage." FLOAT32_IEEE F_1_p0_2 1 2 0 605 ECU_ADDRESS 0x70002594 /end MEASUREMENT
/begin MEASUREMENT AFSEVBHV_Voltage1FildZ "Filtered value of the battery voltage." FLOAT32_IEEE F_1_p0_2 1 2 0 605 ECU_ADDRESS 0x70002590 /end MEASUREMENT
/begin MEASUREMENT AFSEVBHV_VoltageFild "Filtered value of the battery voltage." FLOAT32_IEEE F_1_p0_2 1 2 0 605 ECU_ADDRESS 0x7000258C /end MEASUREMENT
/begin MEASUREMENT AFSEVBHV_VoltageFildZ "Filtered value of the battery voltage with 1 time delay." FLOAT32_IEEE F_1_p0_2 1 2 0 605 ECU_ADDRESS 0x70002588 /end MEASUREMENT
/begin MEASUREMENT AFSEVBHV_VoltageGndDetn "AFSEVBHV_VoltageGndDetn" UBYTE Bool_ON_OFF 1 2 0 1 BIT_MASK 0x01 ECU_ADDRESS 0x70002587 /end MEASUREMENT
/begin MEASUREMENT AFSEVBHV_VoltageVccDetn "AFSEVBHV_VoltageVccDetn" UBYTE Bool_ON_OFF 1 2 0 1 BIT_MASK 0x01 ECU_ADDRESS 0x70002586 /end MEASUREMENT
/begin MEASUREMENT AFSEVBLV_A2DResCorrdVoltage "Corrected ADC value of the battery voltage." FLOAT32_IEEE F_1_p0_2 1 2 0 4095 ECU_ADDRESS 0x700025C8 /end MEASUREMENT
/begin MEASUREMENT AFSEVBLV_Voltage "Current value of the HV battery scaled voltage." FLOAT32_IEEE F_1_p0_2 1 2 0 605 ECU_ADDRESS 0x700025C4 /end MEASUREMENT
/begin MEASUREMENT AFSEVBLV_VoltageFild "Filtered value of the battery voltage." FLOAT32_IEEE F_1_p0_2 1 2 0 605 ECU_ADDRESS 0x700025C0 /end MEASUREMENT
/begin MEASUREMENT AFSEVBLV_VoltageFildZ "Filtered value of the battery voltage with 1 time delay." FLOAT32_IEEE F_1_p0_2 1 2 0 605 ECU_ADDRESS 0x700025BC /end MEASUREMENT
/begin MEASUREMENT AFSEVETA_CorrdTempCooling "AFSEVETA_CorrdTempCooling" FLOAT32_IEEE F_1_p0_2 1 2 -1000 1000 ECU_ADDRESS 0x70002664 /end MEASUREMENT
/begin MEASUREMENT AFSEVETA_CorrdTempDrvBoardLeft "AFSEVETA_CorrdTempDrvBoardLeft" FLOAT32_IEEE F_1_p0_2 1 2 -1000 1000 ECU_ADDRESS 0x70002660 /end MEASUREMENT
/begin MEASUREMENT AFSEVETA_CorrdTempIgbtLeftU "AFSEVETA_CorrdTempIgbtLeftU" FLOAT32_IEEE F_1_p0_2 1 2 -1000 1000 ECU_ADDRESS 0x7000265C /end MEASUREMENT
/begin MEASUREMENT AFSEVETA_CorrdTempIgbtLeftV "AFSEVETA_CorrdTempIgbtLeftV" FLOAT32_IEEE F_1_p0_2 1 2 -1000 1000 ECU_ADDRESS 0x70002658 /end MEASUREMENT
/begin MEASUREMENT AFSEVETA_CorrdTempIgbtLeftW "AFSEVETA_CorrdTempIgbtLeftW" FLOAT32_IEEE F_1_p0_2 1 2 -1000 1000 ECU_ADDRESS 0x70002654 /end MEASUREMENT
/begin MEASUREMENT AFSEVETA_CorrdTempLVCmdBoard "AFSEVETA_CorrdTempLVCmdBoard" FLOAT32_IEEE F_1_p0_2 1 2 -3.402823466E+038 3.402823466E+038 ECU_ADDRESS 0x70002650 /end MEASUREMENT
/begin MEASUREMENT AFSEVETA_CorrdTempLVCmdBoard2 "AFSEVETA_CorrdTempLVCmdBoard2" FLOAT32_IEEE F_1_p0_2 1 2 -3.402823466E+038 3.402823466E+038 ECU_ADDRESS 0x7000264C /end MEASUREMENT
/begin MEASUREMENT AFSEVETA_CounterNumberZ "AFSEVETA_CounterNumberZ" UWORD F_1_p0_2 1 2 0 65535 ECU_ADDRESS 0x7000264A /end MEASUREMENT
/begin MEASUREMENT AFSEVETA_IOCoolingFlowDetection "AFSEVETA_IOCoolingFlowDetection" UBYTE Bool_ON_OFF 1 2 0 1 BIT_MASK 0x01 ECU_ADDRESS 0x70002648 /end MEASUREMENT
/begin MEASUREMENT AFSEVETA_IOcounterZ "AFSEVETA_IOcounterZ" UWORD F_1_p0_2 1 2 0 65535 ECU_ADDRESS 0x70002646 /end MEASUREMENT
/begin MEASUREMENT AFSEVETA_IOinZ "AFSEVETA_IOinZ" UBYTE Bool_ON_OFF 1 2 0 1 BIT_MASK 0x01 ECU_ADDRESS 0x70002644 /end MEASUREMENT
/begin MEASUREMENT AFSEVETA_IOoutZ "AFSEVETA_IOoutZ" UBYTE Bool_ON_OFF 1 2 0 1 BIT_MASK 0x01 ECU_ADDRESS 0x70002643 /end MEASUREMENT
/begin MEASUREMENT AFSEVETA_IgbtTempRationa "AFSEVETA_IgbtTempRationa" UBYTE Bool_ON_OFF 1 2 0 1 BIT_MASK 0x01 ECU_ADDRESS 0x70002642 /end MEASUREMENT
/begin MEASUREMENT AFSEVETA_IgbtTempRationalDetn "AFSEVETA_IgbtTempRationalDetn" UBYTE Bool_ON_OFF 1 2 0 1 BIT_MASK 0x01 ECU_ADDRESS 0x70002641 /end MEASUREMENT
/begin MEASUREMENT AFSEVETA_IgbtTempSlopOver "AFSEVETA_IgbtTempSlopOver" UBYTE Bool_ON_OFF 1 2 0 1 BIT_MASK 0x01 ECU_ADDRESS 0x70002640 /end MEASUREMENT
/begin MEASUREMENT AFSEVETA_IgbtTempZ "AFSEVETA_IgbtTempZ" FLOAT32_IEEE F_1_p0_2 1 2 -3.402823466E+038 3.402823466E+038 ECU_ADDRESS 0x7000263C /end MEASUREMENT
/begin MEASUREMENT AFSEVETA_OverTempCoolingDetn "AFSEVETA_OverTempCoolingDetn" UBYTE Bool_ON_OFF 1 2 0 1 BIT_MASK 0x01 ECU_ADDRESS 0x7000263A /end MEASUREMENT
/begin MEASUREMENT AFSEVETA_OverTempDrvLeftDetn "AFSEVETA_OverTempDrvLeftDetn" UBYTE Bool_ON_OFF 1 2 0 1 BIT_MASK 0x01 ECU_ADDRESS 0x70002639 /end MEASUREMENT
/begin MEASUREMENT AFSEVETA_OverTempNTC2CmdBoardDetn "AFSEVETA_OverTempNTC2CmdBoardDetn" UBYTE Bool_ON_OFF 1 2 0 1 BIT_MASK 0x01 ECU_ADDRESS 0x70002638 /end MEASUREMENT
/begin MEASUREMENT AFSEVETA_TempCmdBoard "AFSEVETA_TempCmdBoard" FLOAT32_IEEE F_1_p0_2 1 2 -3.402823466E+038 3.402823466E+038 ECU_ADDRESS 0x70002634 /end MEASUREMENT
/begin MEASUREMENT AFSEVETA_TempCooling "AFSEVETA_TempCooling" FLOAT32_IEEE F_1_p0_2 1 2 -1000 1000 ECU_ADDRESS 0x70002630 /end MEASUREMENT
/begin MEASUREMENT AFSEVETA_TempCoolingFild "AFSEVETA_TempCoolingFild" FLOAT32_IEEE F_1_p0_2 1 2 -1000 1000 ECU_ADDRESS 0x7000262C /end MEASUREMENT
/begin MEASUREMENT AFSEVETA_TempCoolingFildZ "AFSEVETA_TempCoolingFildZ" FLOAT32_IEEE F_1_p0_2 1 2 -1000 1000 ECU_ADDRESS 0x70002628 /end MEASUREMENT
/begin MEASUREMENT AFSEVETA_TempCoolingGndDetn "AFSEVETA_TempCoolingGndDetn" UBYTE Bool_ON_OFF 1 2 0 1 BIT_MASK 0x01 ECU_ADDRESS 0x70002625 /end MEASUREMENT
/begin MEASUREMENT AFSEVETA_TempCoolingVccDetn "AFSEVETA_TempCoolingVccDetn" UBYTE Bool_ON_OFF 1 2 0 1 BIT_MASK 0x01 ECU_ADDRESS 0x70002624 /end MEASUREMENT
/begin MEASUREMENT AFSEVETA_TempDrvBoard "AFSEVETA_TempDrvBoard" FLOAT32_IEEE F_1_p0_2 1 2 -1000 1000 ECU_ADDRESS 0x70002620 /end MEASUREMENT
/begin MEASUREMENT AFSEVETA_TempDrvBoardLeft "AFSEVETA_TempDrvBoardLeft" FLOAT32_IEEE F_1_p0_2 1 2 -1000 1000 ECU_ADDRESS 0x7000261C /end MEASUREMENT
/begin MEASUREMENT AFSEVETA_TempDrvBoardLeftFild "AFSEVETA_TempDrvBoardLeftFild" FLOAT32_IEEE F_1_p0_2 1 2 -1000 1000 ECU_ADDRESS 0x70002618 /end MEASUREMENT
/begin MEASUREMENT AFSEVETA_TempDrvBoardLeftFildZ "AFSEVETA_TempDrvBoardLeftFildZ" FLOAT32_IEEE F_1_p0_2 1 2 -1000 1000 ECU_ADDRESS 0x70002614 /end MEASUREMENT
/begin MEASUREMENT AFSEVETA_TempIgbt "AFSEVETA_TempIgbt" FLOAT32_IEEE F_1_p0_2 1 2 -1000 1000 ECU_ADDRESS 0x70002610 /end MEASUREMENT
/begin MEASUREMENT AFSEVETA_TempIgbtLeftFild "AFSEVETA_TempIgbtLeftFild" FLOAT32_IEEE F_1_p0_2 1 2 -1000 1000 ECU_ADDRESS 0x7000260C /end MEASUREMENT
/begin MEASUREMENT AFSEVETA_TempIgbtLeftFildU "AFSEVETA_TempIgbtLeftFildU" FLOAT32_IEEE F_1_p0_2 1 2 -1000 1000 ECU_ADDRESS 0x70002608 /end MEASUREMENT
/begin MEASUREMENT AFSEVETA_TempIgbtLeftFildV "AFSEVETA_TempIgbtLeftFildV" FLOAT32_IEEE F_1_p0_2 1 2 -1000 1000 ECU_ADDRESS 0x70002604 /end MEASUREMENT
/begin MEASUREMENT AFSEVETA_TempIgbtLeftFildW "AFSEVETA_TempIgbtLeftFildW" FLOAT32_IEEE F_1_p0_2 1 2 -1000 1000 ECU_ADDRESS 0x70002600 /end MEASUREMENT
/begin MEASUREMENT AFSEVETA_TempIgbtLeftFildZU "AFSEVETA_TempIgbtLeftFildZU" FLOAT32_IEEE F_1_p0_2 1 2 -1000 1000 ECU_ADDRESS 0x700025FC /end MEASUREMENT
/begin MEASUREMENT AFSEVETA_TempIgbtLeftFildZV "AFSEVETA_TempIgbtLeftFildZV" FLOAT32_IEEE F_1_p0_2 1 2 -1000 1000 ECU_ADDRESS 0x700025F8 /end MEASUREMENT
/begin MEASUREMENT AFSEVETA_TempIgbtLeftFildZW "AFSEVETA_TempIgbtLeftFildZW" FLOAT32_IEEE F_1_p0_2 1 2 -1000 1000 ECU_ADDRESS 0x700025F4 /end MEASUREMENT
/begin MEASUREMENT AFSEVETA_TempIgbtLeftU "AFSEVETA_TempIgbtLeftU" FLOAT32_IEEE F_1_p0_2 1 2 -1000 1000 ECU_ADDRESS 0x700025F0 /end MEASUREMENT
/begin MEASUREMENT AFSEVETA_TempIgbtLeftV "AFSEVETA_TempIgbtLeftV" FLOAT32_IEEE F_1_p0_2 1 2 -1000 1000 ECU_ADDRESS 0x700025EC /end MEASUREMENT
/begin MEASUREMENT AFSEVETA_TempIgbtLeftW "AFSEVETA_TempIgbtLeftW" FLOAT32_IEEE F_1_p0_2 1 2 -1000 1000 ECU_ADDRESS 0x700025E8 /end MEASUREMENT
/begin MEASUREMENT AFSEVETA_TempLVCmdBoard "AFSEVETA_TempLVCmdBoard" FLOAT32_IEEE F_1_p0_2 1 2 -3.402823466E+038 3.402823466E+038 ECU_ADDRESS 0x700025E4 /end MEASUREMENT
/begin MEASUREMENT AFSEVETA_TempLVCmdBoard2 "AFSEVETA_TempLVCmdBoard2" FLOAT32_IEEE F_1_p0_2 1 2 -3.402823466E+038 3.402823466E+038 ECU_ADDRESS 0x700025E0 /end MEASUREMENT
/begin MEASUREMENT AFSEVETA_TempLVCmdBoard2Fild "AFSEVETA_TempLVCmdBoard2Fild" FLOAT32_IEEE F_1_p0_2 1 2 -100 500 ECU_ADDRESS 0x700025DC /end MEASUREMENT
/begin MEASUREMENT AFSEVETA_TempLVCmdBoard2FildZ "AFSEVETA_TempLVCmdBoard2FildZ" FLOAT32_IEEE F_1_p0_2 1 2 -3.402823466E+038 3.402823466E+038 ECU_ADDRESS 0x700025D8 /end MEASUREMENT
/begin MEASUREMENT AFSEVETA_TempLVCmdBoardFild "AFSEVETA_TempLVCmdBoardFild" FLOAT32_IEEE F_1_p0_2 1 2 -100 500 ECU_ADDRESS 0x700025D4 /end MEASUREMENT
/begin MEASUREMENT AFSEVETA_TempLVCmdBoardFildZ "AFSEVETA_TempLVCmdBoardFildZ" FLOAT32_IEEE F_1_p0_2 1 2 -3.402823466E+038 3.402823466E+038 ECU_ADDRESS 0x700025D0 /end MEASUREMENT
/begin MEASUREMENT AFSEVETA_UnderTempDrvLeftDetn "AFSEVETA_UnderTempDrvLeftDetn" UBYTE Bool_ON_OFF 1 2 0 1 BIT_MASK 0x01 ECU_ADDRESS 0x700025CE /end MEASUREMENT
/begin MEASUREMENT AFSEVETA_UnderTempNTC1CmdBoardDetn "AFSEVETA_UnderTempNTC1CmdBoardDetn" UBYTE Bool_ON_OFF 1 2 0 1 BIT_MASK 0x01 ECU_ADDRESS 0x700025CD /end MEASUREMENT
/begin MEASUREMENT AFSEVETA_UnderTempNTC2CmdBoardDetn "AFSEVETA_UnderTempNTC2CmdBoardDetn" UBYTE Bool_ON_OFF 1 2 0 1 BIT_MASK 0x01 ECU_ADDRESS 0x700025CC /end MEASUREMENT
/begin MEASUREMENT AFSEVIBT_EstiIbatHv "AFSEVIBT_EstiIbatHv" FLOAT32_IEEE F_1_p0_2 1 2 -3.402823466E+038 3.402823466E+038 ECU_ADDRESS 0x70002670 /end MEASUREMENT
/begin MEASUREMENT AFSEVIBT_IbatHVFild "AFSEVIBT_IbatHVFild" FLOAT32_IEEE F_1_p0_2 1 2 -1000 1000 ECU_ADDRESS 0x7000266C /end MEASUREMENT
/begin MEASUREMENT AFSEVIBT_IbatHVFildZ "AFSEVIBT_IbatHVFildZ" FLOAT32_IEEE F_1_p0_2 1 2 -1000 1000 ECU_ADDRESS 0x70002668 /end MEASUREMENT
/begin MEASUREMENT AFSEXCTX_DCcurrentActual "AFSEXCTX_DCcurrentActual" FLOAT32_IEEE F_1_p0_2 1 2 -1000 1000 ECU_ADDRESS 0x700026A8 /end MEASUREMENT
/begin MEASUREMENT AFSEXCTX_DCvoltActual "AFSEXCTX_DCvoltActual" FLOAT32_IEEE F_1_p0_2 1 2 -3.402823466E+038 3.402823466E+038 ECU_ADDRESS 0x700026A4 /end MEASUREMENT
/begin MEASUREMENT AFSEXCTX_DeratingStatus "AFSEXCTX_DeratingStatus" UWORD F_1_p0_2 1 2 0 65535 ECU_ADDRESS 0x700026A2 /end MEASUREMENT
/begin MEASUREMENT AFSEXCTX_HVReadyStatus "AFSEXCTX_HVReadyStatus" UBYTE Bool_ON_OFF 1 2 0 1 BIT_MASK 0x01 ECU_ADDRESS 0x700026A0 /end MEASUREMENT
/begin MEASUREMENT AFSEXCTX_Idirect "AFSEXCTX_Idirect" FLOAT32_IEEE F_1_p0_2 1 2 -1000 1000 ECU_ADDRESS 0x7000269C /end MEASUREMENT
/begin MEASUREMENT AFSEXCTX_InverterTemp "AFSEXCTX_InverterTemp" FLOAT32_IEEE F_1_p0_2 1 2 -1000 1000 ECU_ADDRESS 0x70002698 /end MEASUREMENT
/begin MEASUREMENT AFSEXCTX_Iquadra "AFSEXCTX_Iquadra" FLOAT32_IEEE F_1_p0_2 1 2 -1000 1000 ECU_ADDRESS 0x70002694 /end MEASUREMENT
/begin MEASUREMENT AFSEXCTX_MotorAppliedTorque "Current value of applied torque." FLOAT32_IEEE F_1_p0_2 1 2 -500 500 ECU_ADDRESS 0x70002690 /end MEASUREMENT
/begin MEASUREMENT AFSEXCTX_MotorSpeed "Current value of  motor speed." FLOAT32_IEEE F_1_p0_2 1 2 -1000000 1000000 ECU_ADDRESS 0x7000268C /end MEASUREMENT
/begin MEASUREMENT AFSEXCTX_MotorState "Current value of motor state" UWORD F_1_p0_2 1 2 0 65535 ECU_ADDRESS 0x70002688 /end MEASUREMENT
/begin MEASUREMENT AFSEXCTX_MotorTemp "AFSEXCTX_MotorTemp" FLOAT32_IEEE F_1_p0_2 1 2 -1000 1000 ECU_ADDRESS 0x70002684 /end MEASUREMENT
/begin MEASUREMENT AFSEXCTX_RotorTemp "AFSEXCTX_RotorTemp" FLOAT32_IEEE F_1_p0_2 1 2 -1000 1000 ECU_ADDRESS 0x70002680 /end MEASUREMENT
/begin MEASUREMENT AFSEXCTX_SwVerNum1 "AFSEXCTX_SwVerNum1" UWORD F_1_p0_2 1 2 0 31 ECU_ADDRESS 0x7000267C /end MEASUREMENT
/begin MEASUREMENT AFSEXCTX_SwVerNum2 "AFSEXCTX_SwVerNum2" UWORD F_1_p0_2 1 2 0 31 ECU_ADDRESS 0x7000267A /end MEASUREMENT
/begin MEASUREMENT AFSEXCTX_SwVerNum3 "AFSEXCTX_SwVerNum3" UWORD F_1_p0_2 1 2 0 31 ECU_ADDRESS 0x70002678 /end MEASUREMENT
/begin MEASUREMENT AFSEXCTX_SwVerNum4 "AFSEXCTX_SwVerNum4" UWORD F_1_p0_2 1 2 0 31 ECU_ADDRESS 0x70002676 /end MEASUREMENT
/begin MEASUREMENT AFSEXCTX_SysTempOvrInd "AFSEXCTX_SysTempOvrInd" UBYTE Bool_ON_OFF 1 2 0 1 BIT_MASK 0x01 ECU_ADDRESS 0x70002674 /end MEASUREMENT
/begin MEASUREMENT AFSMTMTA_CorrdTempWindingHead1 "AFSMTMTA_CorrdTempWindingHead1" FLOAT32_IEEE F_1_p0_2 1 2 -3.402823466E+038 3.402823466E+038 ECU_ADDRESS 0x700026C4 /end MEASUREMENT
/begin MEASUREMENT AFSMTMTA_TempWindingHead1 "AFSMTMTA_TempWindingHead1" FLOAT32_IEEE F_1_p0_2 1 2 -3.402823466E+038 3.402823466E+038 ECU_ADDRESS 0x700026B8 /end MEASUREMENT
/begin MEASUREMENT AFSMTMTA_TempWindingHead1Fild "AFSMTMTA_TempWindingHead1Fild" FLOAT32_IEEE F_1_p0_2 1 2 -3.402823466E+038 3.402823466E+038 ECU_ADDRESS 0x700026B4 /end MEASUREMENT
/begin MEASUREMENT AFSMTMTA_TempWindingHead1FildZ "AFSMTMTA_TempWindingHead1FildZ" FLOAT32_IEEE F_1_p0_2 1 2 -3.402823466E+038 3.402823466E+038 ECU_ADDRESS 0x700026B0 /end MEASUREMENT
/begin MEASUREMENT AFSMTMTA_TempWindingMax "AFSMTMTA_TempWindingMax" FLOAT32_IEEE F_1_p0_2 1 2 -3.402823466E+038 3.402823466E+038 ECU_ADDRESS 0x700026AC /end MEASUREMENT
/begin MEASUREMENT AFSMTMTA_TempWinding[0] "AFSMTMTA_TempWinding" FLOAT32_IEEE F_1_p0_2 1 2 -3.402823466E+038 3.402823466E+038 ECU_ADDRESS 0x700026BC /end MEASUREMENT
/begin MEASUREMENT AFSMTMTA_TempWinding[1] "AFSMTMTA_TempWinding" FLOAT32_IEEE F_1_p0_2 1 2 -3.402823466E+038 3.402823466E+038 ECU_ADDRESS 0x700026C0 /end MEASUREMENT
/begin MEASUREMENT AFSSMACS_AbsMecaSpeedRpmFild "AFSSMACS_AbsMecaSpeedRpmFild" FLOAT32_IEEE F_1_p0_2 1 2 -3.402823466E+038 3.402823466E+038 ECU_ADDRESS 0x700024C0 /end MEASUREMENT
/begin MEASUREMENT AFSSMACS_AbsMecaSpeedRpmFildZ "AFSSMACS_AbsMecaSpeedRpmFildZ" FLOAT32_IEEE F_1_p0_2 1 2 -3.402823466E+038 3.402823466E+038 ECU_ADDRESS 0x700024BC /end MEASUREMENT
/begin MEASUREMENT AFSSMACS_AclState "AFSSMACS_AclState" UWORD F_1_p0_2 1 2 0 65535 ECU_ADDRESS 0x700024B8 /end MEASUREMENT
/begin MEASUREMENT AFSSMACS_CmdFtShutDownReq "AFSSMACS_CmdFtShutDownReq" UBYTE Bool_ON_OFF 1 2 0 1 BIT_MASK 0x01 ECU_ADDRESS 0x700024B6 /end MEASUREMENT
/begin MEASUREMENT AFSSMACS_CmdFtStartReq "AFSSMACS_CmdFtStartReq" UBYTE Bool_ON_OFF 1 2 0 1 BIT_MASK 0x01 ECU_ADDRESS 0x700024B5 /end MEASUREMENT
/begin MEASUREMENT AFSSMACS_CmdSwShutDownReq "AFSSMACS_CmdSwShutDownReq" UBYTE Bool_ON_OFF 1 2 0 1 BIT_MASK 0x01 ECU_ADDRESS 0x700024B4 /end MEASUREMENT
/begin MEASUREMENT AFSSMACS_FTModeReq "AFSSMACS_FTModeReq" UWORD F_1_p0_2 1 2 0 65535 ECU_ADDRESS 0x700024B2 /end MEASUREMENT
/begin MEASUREMENT AFSSMACS_KL15 "AFSSMACS_KL15" UBYTE Bool_ON_OFF 1 2 0 1 BIT_MASK 0x01 ECU_ADDRESS 0x700024B0 /end MEASUREMENT
/begin MEASUREMENT AFSSMACS_KL15counterZ "AFSSMACS_KL15counterZ" UWORD F_1_p0_2 1 2 0 65535 ECU_ADDRESS 0x700024AE /end MEASUREMENT
/begin MEASUREMENT AFSSMACS_KL15in "AFSSMACS_KL15in" UBYTE Bool_ON_OFF 1 2 0 1 BIT_MASK 0x01 ECU_ADDRESS 0x700024AC /end MEASUREMENT
/begin MEASUREMENT AFSSMACS_KL15inZ "AFSSMACS_KL15inZ" UBYTE Bool_ON_OFF 1 2 0 1 BIT_MASK 0x01 ECU_ADDRESS 0x700024AB /end MEASUREMENT
/begin MEASUREMENT AFSSMACS_KL15outZ "AFSSMACS_KL15outZ" UBYTE Bool_ON_OFF 1 2 0 1 BIT_MASK 0x01 ECU_ADDRESS 0x700024AA /end MEASUREMENT
/begin MEASUREMENT AFSSMACS_NormalStartFtFlg "AFSSMACS_NormalStartFtFlg" UBYTE Bool_ON_OFF 1 2 0 1 BIT_MASK 0x01 ECU_ADDRESS 0x700024A9 /end MEASUREMENT
/begin MEASUREMENT AFSSMACS_SCSpeedReady "AFSSMACS_SCSpeedReady" UBYTE Bool_ON_OFF 1 2 0 1 BIT_MASK 0x01 ECU_ADDRESS 0x700024A8 /end MEASUREMENT
/begin MEASUREMENT AFSSMACS_SCSpeedReadyinZ "AFSSMACS_SCSpeedReadyinZ" UBYTE Bool_ON_OFF 1 2 0 1 BIT_MASK 0x01 ECU_ADDRESS 0x700024A7 /end MEASUREMENT
/begin MEASUREMENT AFSSMACS_SCSpeedReadyoutZ "AFSSMACS_SCSpeedReadyoutZ" UBYTE Bool_ON_OFF 1 2 0 1 BIT_MASK 0x01 ECU_ADDRESS 0x700024A6 /end MEASUREMENT
/begin MEASUREMENT AFSSMACS_SpeedReadycounterZ "AFSSMACS_SpeedReadycounterZ" UWORD F_1_p0_2 1 2 0 65535 ECU_ADDRESS 0x700024A4 /end MEASUREMENT
/begin MEASUREMENT AFSSMACS_TorqueEnable "AFSSMACS_TorqueEnable" UBYTE Bool_ON_OFF 1 2 0 1 BIT_MASK 0x01 ECU_ADDRESS 0x700024A2 /end MEASUREMENT
/begin MEASUREMENT AFSSMACS_TxMcuMode "AFSSMACS_TxMcuMode" UBYTE F_1_p0_2 1 2 0 255 ECU_ADDRESS 0x700024A1 /end MEASUREMENT
/begin MEASUREMENT AFSSMACS_TxMotorMode "AFSSMACS_TxMotorMode" UBYTE F_1_p0_2 1 2 0 255 ECU_ADDRESS 0x700024A0 /end MEASUREMENT
/begin MEASUREMENT AFSSMMAM_AclState "value of McuState after bypass" UWORD F_1_p0_2 1 2 0 65535 ECU_ADDRESS 0x700024C8 /end MEASUREMENT
/begin MEASUREMENT AFSSMMAM_EVBHV_CheckEnable "AFSSMMAM_EVBHV_CheckEnable" UBYTE Bool_ON_OFF 1 2 0 1 BIT_MASK 0x01 ECU_ADDRESS 0x700024C7 /end MEASUREMENT
/begin MEASUREMENT AFSSMMAM_EVBLV_CheckEnable "AFSSMMAM_EVBLV_CheckEnable" UBYTE Bool_ON_OFF 1 2 0 1 BIT_MASK 0x01 ECU_ADDRESS 0x700024C6 /end MEASUREMENT
/begin MEASUREMENT AFSSMMAM_EVIBT_State "AFSSMMAM_EVIBT_State" UWORD F_1_p0_2 1 2 0 65535 ECU_ADDRESS 0x700024C4 /end MEASUREMENT
/begin MEASUREMENT AFSTCGTC_I0dqTgt[0] "AFSTCGTC_I0dqTgt" FLOAT32_IEEE F_1_p0_2 1 2 -3.402823466E+038 3.402823466E+038 ECU_ADDRESS 0x700024E0 /end MEASUREMENT
/begin MEASUREMENT AFSTCGTC_I0dqTgt[1] "AFSTCGTC_I0dqTgt" FLOAT32_IEEE F_1_p0_2 1 2 -3.402823466E+038 3.402823466E+038 ECU_ADDRESS 0x700024E4 /end MEASUREMENT
/begin MEASUREMENT AFSTCGTC_I0dqTgt[2] "AFSTCGTC_I0dqTgt" FLOAT32_IEEE F_1_p0_2 1 2 -3.402823466E+038 3.402823466E+038 ECU_ADDRESS 0x700024E8 /end MEASUREMENT
/begin MEASUREMENT AFSTCGTC_MecaSpeedRpmTgt "AFSTCGTC_MecaSpeedRpmTgt" FLOAT32_IEEE F_1_p0_2 1 2 -1000000 1000000 ECU_ADDRESS 0x700024DC /end MEASUREMENT
/begin MEASUREMENT AFSTCGTC_ScsStartCmd "AFSTCGTC_ScsStartCmd" UBYTE Bool_ON_OFF 1 2 0 1 BIT_MASK 0x01 ECU_ADDRESS 0x700024D9 /end MEASUREMENT
/begin MEASUREMENT AFSTCGTC_SpdRpmTgtStartFlg "AFSTCGTC_SpdRpmTgtStartFlg" UBYTE Bool_ON_OFF 1 2 0 1 BIT_MASK 0x01 ECU_ADDRESS 0x700024D8 /end MEASUREMENT
/begin MEASUREMENT AFSTCGTC_U0dqTgt[0] "AFSTCGTC_U0dqTgt" FLOAT32_IEEE F_1_p0_2 1 2 -3.402823466E+038 3.402823466E+038 ECU_ADDRESS 0x700024CC /end MEASUREMENT
/begin MEASUREMENT AFSTCGTC_U0dqTgt[1] "AFSTCGTC_U0dqTgt" FLOAT32_IEEE F_1_p0_2 1 2 -3.402823466E+038 3.402823466E+038 ECU_ADDRESS 0x700024D0 /end MEASUREMENT
/begin MEASUREMENT AFSTCGTC_U0dqTgt[2] "AFSTCGTC_U0dqTgt" FLOAT32_IEEE F_1_p0_2 1 2 -3.402823466E+038 3.402823466E+038 ECU_ADDRESS 0x700024D4 /end MEASUREMENT
/begin MEASUREMENT AFS_AFTAclState_U16 "AFS_AFTAclState_U16" UWORD F_1_p0_2 1 2 0 65535 ECU_ADDRESS 0x70002584 /end MEASUREMENT
/begin MEASUREMENT AFS_AftAppliedTorqueRate_F32 "AFS_AftAppliedTorqueRate_F32" FLOAT32_IEEE F_1_p0_2 1 2 -3.402823466E+038 3.402823466E+038 ECU_ADDRESS 0x70002580 /end MEASUREMENT
/begin MEASUREMENT AFS_BSWReadyStatus_B "AFS_BSWReadyStatus_B" UBYTE Bool_ON_OFF 1 2 0 1 BIT_MASK 0x01 ECU_ADDRESS 0x7000257F /end MEASUREMENT
/begin MEASUREMENT AFS_BatVotValidFlag_B "AFS_BatVotValidFlag_B" UBYTE Bool_ON_OFF 1 2 0 1 BIT_MASK 0x01 ECU_ADDRESS 0x7000257E /end MEASUREMENT
/begin MEASUREMENT AFS_BusVoltageGain_U16 "AFS_BusVoltageGain_U16" UWORD F_1_p0_2 1 2 0 65535 ECU_ADDRESS 0x7000257C /end MEASUREMENT
/begin MEASUREMENT AFS_CmdAftShutDownRes_B "AFS_CmdAftShutDownRes_B" UBYTE Bool_ON_OFF 1 2 0 1 BIT_MASK 0x01 ECU_ADDRESS 0x7000257B /end MEASUREMENT
/begin MEASUREMENT AFS_CmdAftStartRes_B "AFS_CmdAftStartRes_B" UBYTE Bool_ON_OFF 1 2 0 1 BIT_MASK 0x01 ECU_ADDRESS 0x7000257A /end MEASUREMENT
/begin MEASUREMENT AFS_CommandBoardTempLV2_U16 "AFS_CommandBoardTempLV2_U16" UWORD F_1_p0_2 1 2 0 65535 ECU_ADDRESS 0x70002578 /end MEASUREMENT
/begin MEASUREMENT AFS_CommandBoardTempLV_U16 "AFS_CommandBoardTempLV_U16" UWORD F_1_p0_2 1 2 0 65535 ECU_ADDRESS 0x70002576 /end MEASUREMENT
/begin MEASUREMENT AFS_CoolingTemp_U16 "AFS_CoolingTemp_U16" UWORD F_1_p0_2 1 2 0 65535 ECU_ADDRESS 0x70002574 /end MEASUREMENT
/begin MEASUREMENT AFS_CrashOutSts_U8 "AFS_CrashOutSts_U8" UBYTE F_1_p0_2 1 2 0 255 ECU_ADDRESS 0x70002573 /end MEASUREMENT
/begin MEASUREMENT AFS_DeratingStatus_B "AFS_DeratingStatus_B" UBYTE Bool_ON_OFF 1 2 0 1 BIT_MASK 0x01 ECU_ADDRESS 0x70002572 /end MEASUREMENT
/begin MEASUREMENT AFS_DriverBoardTemp_U16 "AFS_DriverBoardTemp_U16" UWORD F_1_p0_2 1 2 0 65535 ECU_ADDRESS 0x70002570 /end MEASUREMENT
/begin MEASUREMENT AFS_DutyCycle3_F32[0] "AFS_DutyCycle3_F32" FLOAT32_IEEE F_1_p0_2 1 2 0 1 ECU_ADDRESS 0x70002564 /end MEASUREMENT
/begin MEASUREMENT AFS_DutyCycle3_F32[1] "AFS_DutyCycle3_F32" FLOAT32_IEEE F_1_p0_2 1 2 0 1 ECU_ADDRESS 0x70002568 /end MEASUREMENT
/begin MEASUREMENT AFS_DutyCycle3_F32[2] "AFS_DutyCycle3_F32" FLOAT32_IEEE F_1_p0_2 1 2 0 1 ECU_ADDRESS 0x7000256C /end MEASUREMENT
/begin MEASUREMENT AFS_EmWorkModCmd_U8 "AFS_EmWorkModCmd_U8" UBYTE F_1_p0_2 1 2 0 255 ECU_ADDRESS 0x70002560 /end MEASUREMENT
/begin MEASUREMENT AFS_EstPowmdlDrtGain_F32 "AFS_EstPowmdlDrtGain_F32" FLOAT32_IEEE F_1_p0_2 1 2 -3.402823466E+038 3.402823466E+038 ECU_ADDRESS 0x7000255C /end MEASUREMENT
/begin MEASUREMENT AFS_FaultLevel_U16 "AFS_FaultLevel_U16" UWORD F_1_p0_2 1 2 0 65535 ECU_ADDRESS 0x7000255A /end MEASUREMENT
/begin MEASUREMENT AFS_HwOverVoltFlg_B "AFS_HwOverVoltFlg_B" UBYTE Bool_ON_OFF 1 2 0 1 BIT_MASK 0x01 ECU_ADDRESS 0x70002558 /end MEASUREMENT
/begin MEASUREMENT AFS_IbatHV_U16 "AFS_IbatHV_U16" UWORD F_1_p0_2 1 2 0 65535 ECU_ADDRESS 0x70002556 /end MEASUREMENT
/begin MEASUREMENT AFS_IbatRmsHV_U16 "AFS_IbatRmsHV_U16" UWORD F_1_p0_2 1 2 0 65535 ECU_ADDRESS 0x70002554 /end MEASUREMENT
/begin MEASUREMENT AFS_Idref_F32 "AFS_Idref_F32" FLOAT32_IEEE F_1_p0_2 1 2 -3.402823466E+038 3.402823466E+038 ECU_ADDRESS 0x70002550 /end MEASUREMENT
/begin MEASUREMENT AFS_Iqref_F32 "AFS_Iqref_F32" FLOAT32_IEEE F_1_p0_2 1 2 -3.402823466E+038 3.402823466E+038 ECU_ADDRESS 0x7000254C /end MEASUREMENT
/begin MEASUREMENT AFS_Iuvw3_F32[0] "AFS_Iuvw3_F32" FLOAT32_IEEE F_1_p0_2 1 2 -3.402823466E+038 3.402823466E+038 ECU_ADDRESS 0x70002540 /end MEASUREMENT
/begin MEASUREMENT AFS_Iuvw3_F32[1] "AFS_Iuvw3_F32" FLOAT32_IEEE F_1_p0_2 1 2 -3.402823466E+038 3.402823466E+038 ECU_ADDRESS 0x70002544 /end MEASUREMENT
/begin MEASUREMENT AFS_Iuvw3_F32[2] "AFS_Iuvw3_F32" FLOAT32_IEEE F_1_p0_2 1 2 -3.402823466E+038 3.402823466E+038 ECU_ADDRESS 0x70002548 /end MEASUREMENT
/begin MEASUREMENT AFS_KEYON_B "AFS_KEYON_B" UBYTE Bool_ON_OFF 1 2 0 1 BIT_MASK 0x01 ECU_ADDRESS 0x7000253C /end MEASUREMENT
/begin MEASUREMENT AFS_MecaSpeedRpm_F32 "AFS_MecaSpeedRpm_F32" FLOAT32_IEEE F_1_p0_2 1 2 -3.402823466E+038 3.402823466E+038 ECU_ADDRESS 0x70002538 /end MEASUREMENT
/begin MEASUREMENT AFS_ModeReq_U8 "AFS_ModeReq_U8" UBYTE F_1_p0_2 1 2 0 255 ECU_ADDRESS 0x70002534 /end MEASUREMENT
/begin MEASUREMENT AFS_MotorAppliedTorque_F32 "AFS_MotorAppliedTorque_F32" FLOAT32_IEEE F_1_p0_2 1 2 -3.402823466E+038 3.402823466E+038 ECU_ADDRESS 0x70002530 /end MEASUREMENT
/begin MEASUREMENT AFS_MotorMagnetDrtGain_F32 "AFS_MotorMagnetDrtGain_F32" FLOAT32_IEEE F_1_p0_2 1 2 -3.402823466E+038 3.402823466E+038 ECU_ADDRESS 0x7000252C /end MEASUREMENT
/begin MEASUREMENT AFS_MotorWindingDrtGain_F32 "AFS_MotorWindingDrtGain_F32" FLOAT32_IEEE F_1_p0_2 1 2 -3.402823466E+038 3.402823466E+038 ECU_ADDRESS 0x70002528 /end MEASUREMENT
/begin MEASUREMENT AFS_MotorWindingTemp1L_U16 "AFS_MotorWindingTemp1L_U16" UWORD F_1_p0_2 1 2 0 65535 ECU_ADDRESS 0x70002526 /end MEASUREMENT
/begin MEASUREMENT AFS_MotorWindingTemp1_U16 "AFS_MotorWindingTemp1_U16" UWORD F_1_p0_2 1 2 0 65535 ECU_ADDRESS 0x70002524 /end MEASUREMENT
/begin MEASUREMENT AFS_MotorWindingTemp2L_U16 "AFS_MotorWindingTemp2L_U16" UWORD F_1_p0_2 1 2 0 65535 ECU_ADDRESS 0x70002522 /end MEASUREMENT
/begin MEASUREMENT AFS_MotorWindingTemp2_U16 "AFS_MotorWindingTemp2_U16" UWORD F_1_p0_2 1 2 0 65535 ECU_ADDRESS 0x70002520 /end MEASUREMENT
/begin MEASUREMENT AFS_OilTemp_F32 "AFS_OilTemp_F32" FLOAT32_IEEE F_1_p0_2 1 2 -3.402823466E+038 3.402823466E+038 ECU_ADDRESS 0x7000251C /end MEASUREMENT
/begin MEASUREMENT AFS_OpenAngleState_U8 "AFS_OpenAngleState_U8" UBYTE F_1_p0_2 1 2 0 255 ECU_ADDRESS 0x7000251A /end MEASUREMENT
/begin MEASUREMENT AFS_P5VPort_U16 "AFS_P5VPort_U16" UWORD F_1_p0_2 1 2 0 65535 ECU_ADDRESS 0x70002518 /end MEASUREMENT
/begin MEASUREMENT AFS_PowerModuleTempU_F32 "AFS_PowerModuleTempU_F32" FLOAT32_IEEE F_1_p0_2 1 2 -3.402823466E+038 3.402823466E+038 ECU_ADDRESS 0x70002514 /end MEASUREMENT
/begin MEASUREMENT AFS_PowerModuleTempV_F32 "AFS_PowerModuleTempV_F32" FLOAT32_IEEE F_1_p0_2 1 2 -3.402823466E+038 3.402823466E+038 ECU_ADDRESS 0x70002510 /end MEASUREMENT
/begin MEASUREMENT AFS_PowerModuleTempW_F32 "AFS_PowerModuleTempW_F32" FLOAT32_IEEE F_1_p0_2 1 2 -3.402823466E+038 3.402823466E+038 ECU_ADDRESS 0x7000250C /end MEASUREMENT
/begin MEASUREMENT AFS_PowmdlDrtGain_F32 "AFS_PowmdlDrtGain_F32" FLOAT32_IEEE F_1_p0_2 1 2 -3.402823466E+038 3.402823466E+038 ECU_ADDRESS 0x70002508 /end MEASUREMENT
/begin MEASUREMENT AFS_PreChargeRlySts_B "AFS_PreChargeRlySts_B" UBYTE Bool_ON_OFF 1 2 0 1 BIT_MASK 0x01 ECU_ADDRESS 0x70002504 /end MEASUREMENT
/begin MEASUREMENT AFS_SpdSet_F32 "AFS_SpdSet_F32" FLOAT32_IEEE F_1_p0_2 1 2 -1000000 1000000 ECU_ADDRESS 0x70002500 /end MEASUREMENT
/begin MEASUREMENT AFS_UbatHV2_F32 "AFS_UbatHV2_F32" FLOAT32_IEEE F_1_p0_2 1 2 -3.402823466E+038 3.402823466E+038 ECU_ADDRESS 0x700024FC /end MEASUREMENT
/begin MEASUREMENT AFS_UbatHV_F32 "AFS_UbatHV_F32" FLOAT32_IEEE F_1_p0_2 1 2 -3.402823466E+038 3.402823466E+038 ECU_ADDRESS 0x700024F8 /end MEASUREMENT
/begin MEASUREMENT AFS_UbatLV_U16 "AFS_UbatLV_U16" UWORD F_1_p0_2 1 2 0 65535 ECU_ADDRESS 0x700024F4 /end MEASUREMENT
/begin MEASUREMENT AFS_Ubms_F32 "AFS_Ubms_F32" FLOAT32_IEEE F_1_p0_2 1 2 -3.402823466E+038 3.402823466E+038 ECU_ADDRESS 0x700024F0 /end MEASUREMENT
/begin MEASUREMENT AFS_VcuMcuEnableReq_U8 "AFS_VcuMcuEnableReq_U8" UBYTE F_1_p0_2 1 2 0 255 ECU_ADDRESS 0x700024EE /end MEASUREMENT
/begin MEASUREMENT AFS_stMainNeg_B "AFS_stMainNeg_B" UBYTE Bool_ON_OFF 1 2 0 1 BIT_MASK 0x01 ECU_ADDRESS 0x700024ED /end MEASUREMENT
/begin MEASUREMENT AFS_stMainPos_B "AFS_stMainPos_B" UBYTE Bool_ON_OFF 1 2 0 1 BIT_MASK 0x01 ECU_ADDRESS 0x700024EC /end MEASUREMENT
/begin MEASUREMENT AFT_AFTModeReq_U16 "AFT_AFTModeReq_U16" UWORD F_1_p0_2 1 2 0 65535 ECU_ADDRESS 0x70003168 /end MEASUREMENT
/begin MEASUREMENT AFT_AkdAfterAsc_B "AFT_AkdAfterAsc_B" UBYTE Bool_ON_OFF 1 2 0 1 BIT_MASK 0x01 ECU_ADDRESS 0x70003166 /end MEASUREMENT
/begin MEASUREMENT AFT_BSWReadyStatus_B "AFT_BSWReadyStatus_B" UBYTE Bool_ON_OFF 1 2 0 1 BIT_MASK 0x01 ECU_ADDRESS 0x70003165 /end MEASUREMENT
/begin MEASUREMENT AFT_BhvCheckEna_B "AFT_BhvCheckEna_B" UBYTE Bool_ON_OFF 1 2 0 1 BIT_MASK 0x01 ECU_ADDRESS 0x70003164 /end MEASUREMENT
/begin MEASUREMENT AFT_CmdAftShutDownReq_B "AFT_CmdAftShutDownReq_B" UBYTE Bool_ON_OFF 1 2 0 1 BIT_MASK 0x01 ECU_ADDRESS 0x70003163 /end MEASUREMENT
/begin MEASUREMENT AFT_CmdAftStartReq_B "AFT_CmdAftStartReq_B" UBYTE Bool_ON_OFF 1 2 0 1 BIT_MASK 0x01 ECU_ADDRESS 0x70003162 /end MEASUREMENT
/begin MEASUREMENT AFT_CmdPwmDirectRes_B "AFT_CmdPwmDirectRes_B" UBYTE Bool_ON_OFF 1 2 0 1 BIT_MASK 0x01 ECU_ADDRESS 0x70003161 /end MEASUREMENT
/begin MEASUREMENT AFT_CmdPwmOffRes_B "AFT_CmdPwmOffRes_B" UBYTE Bool_ON_OFF 1 2 0 1 BIT_MASK 0x01 ECU_ADDRESS 0x70003160 /end MEASUREMENT
/begin MEASUREMENT AFT_DutyCycle3_F32[0] "AFT_DutyCycle3_F32" FLOAT32_IEEE F_1_p0_2 1 2 -3.402823466E+038 3.402823466E+038 ECU_ADDRESS 0x70003154 /end MEASUREMENT
/begin MEASUREMENT AFT_DutyCycle3_F32[1] "AFT_DutyCycle3_F32" FLOAT32_IEEE F_1_p0_2 1 2 -3.402823466E+038 3.402823466E+038 ECU_ADDRESS 0x70003158 /end MEASUREMENT
/begin MEASUREMENT AFT_DutyCycle3_F32[2] "AFT_DutyCycle3_F32" FLOAT32_IEEE F_1_p0_2 1 2 -3.402823466E+038 3.402823466E+038 ECU_ADDRESS 0x7000315C /end MEASUREMENT
/begin MEASUREMENT AFT_EXTPrechargeFinish_B "AFT_EXTPrechargeFinish_B" UBYTE Bool_ON_OFF 1 2 0 1 BIT_MASK 0x01 ECU_ADDRESS 0x70003152 /end MEASUREMENT
/begin MEASUREMENT AFT_ExtCurrentGain_U16[0] "AFT_ExtCurrentGain_U16" UWORD F_1_p0_2 1 2 0 65535 ECU_ADDRESS 0x7000314C /end MEASUREMENT
/begin MEASUREMENT AFT_ExtCurrentGain_U16[1] "AFT_ExtCurrentGain_U16" UWORD F_1_p0_2 1 2 0 65535 ECU_ADDRESS 0x7000314E /end MEASUREMENT
/begin MEASUREMENT AFT_ExtCurrentGain_U16[2] "AFT_ExtCurrentGain_U16" UWORD F_1_p0_2 1 2 0 65535 ECU_ADDRESS 0x70003150 /end MEASUREMENT
/begin MEASUREMENT AFT_ExtIuvw3RmsSum_F32[0] "AFT_ExtIuvw3RmsSum_F32" FLOAT32_IEEE F_1_p0_2 1 2 -3.402823466E+038 3.402823466E+038 ECU_ADDRESS 0x70003140 /end MEASUREMENT
/begin MEASUREMENT AFT_ExtIuvw3RmsSum_F32[1] "AFT_ExtIuvw3RmsSum_F32" FLOAT32_IEEE F_1_p0_2 1 2 -3.402823466E+038 3.402823466E+038 ECU_ADDRESS 0x70003144 /end MEASUREMENT
/begin MEASUREMENT AFT_ExtIuvw3RmsSum_F32[2] "AFT_ExtIuvw3RmsSum_F32" FLOAT32_IEEE F_1_p0_2 1 2 -3.402823466E+038 3.402823466E+038 ECU_ADDRESS 0x70003148 /end MEASUREMENT
/begin MEASUREMENT AFT_FaultLevel_U16 "AFT_FaultLevel_U16" UWORD F_1_p0_2 1 2 0 65535 ECU_ADDRESS 0x7000313E /end MEASUREMENT
/begin MEASUREMENT AFT_FtRunFlg_U16 "AFT_FtRunFlg_U16" UWORD F_1_p0_2 1 2 0 65535 ECU_ADDRESS 0x7000313C /end MEASUREMENT
/begin MEASUREMENT AFT_I0dqTgt3_F32[0] "AFT_I0dqTgt3_F32" FLOAT32_IEEE F_1_p0_2 1 2 -3.402823466E+038 3.402823466E+038 ECU_ADDRESS 0x70003130 /end MEASUREMENT
/begin MEASUREMENT AFT_I0dqTgt3_F32[1] "AFT_I0dqTgt3_F32" FLOAT32_IEEE F_1_p0_2 1 2 -3.402823466E+038 3.402823466E+038 ECU_ADDRESS 0x70003134 /end MEASUREMENT
/begin MEASUREMENT AFT_I0dqTgt3_F32[2] "AFT_I0dqTgt3_F32" FLOAT32_IEEE F_1_p0_2 1 2 -3.402823466E+038 3.402823466E+038 ECU_ADDRESS 0x70003138 /end MEASUREMENT
/begin MEASUREMENT AFT_Iuvw3_U16[0] "AFT_Iuvw3_U16" UWORD F_1_p0_2 1 2 0 65535 ECU_ADDRESS 0x70003128 /end MEASUREMENT
/begin MEASUREMENT AFT_Iuvw3_U16[1] "AFT_Iuvw3_U16" UWORD F_1_p0_2 1 2 0 65535 ECU_ADDRESS 0x7000312A /end MEASUREMENT
/begin MEASUREMENT ESM_ESM_MODE_FT "ESM_ESM_MODE_FT" UBYTE Bool_ON_OFF 1 2 0 1 BIT_MASK 0x04 ECU_ADDRESS 0x7002B2BA /end MEASUREMENT
/begin MEASUREMENT ESM_ESM_MODE_NF "ESM_ESM_MODE_NF" UBYTE Bool_ON_OFF 1 2 0 1 BIT_MASK 0x01 ECU_ADDRESS 0x7002B2BA /end MEASUREMENT
/begin MEASUREMENT ESM_EsmMode "ESM_EsmMode" UWORD ESM_EsmMode_conv 1 2 1 4 ECU_ADDRESS 0x7002B2BA /end MEASUREMENT
/begin MEASUREMENT ESM_OpFtState "ESM_OpFtState" UWORD I_1 1 2 0 65535 ECU_ADDRESS 0x7002B2AE /end MEASUREMENT
/begin MEASUREMENT ESM_OpNfState "ESM_OpNfState" UWORD I_1 1 2 0 65535 ECU_ADDRESS 0x7002B2AC /end MEASUREMENT
/begin MEASUREMENT ESM_PwrLFtState "ESM_PwrLFtState" UWORD I_1 1 2 0 65535 ECU_ADDRESS 0x7002B2AA /end MEASUREMENT
/begin MEASUREMENT ESM_PwrLNfState "ESM_PwrLNfState" UWORD I_1 1 2 0 65535 ECU_ADDRESS 0x7002B2A8 /end MEASUREMENT
/begin MEASUREMENT ESM_StpIIFtState "ESM_StpIIFtState" UWORD I_1 1 2 0 65535 ECU_ADDRESS 0x7002B2A2 /end MEASUREMENT
/begin MEASUREMENT ESM_StpIINfState "ESM_StpIINfState" UWORD I_1 1 2 0 65535 ECU_ADDRESS 0x7002B2A0 /end MEASUREMENT
/begin MEASUREMENT ESM_StpIState "ESM_StpIState" UWORD I_1 1 2 0 65535 ECU_ADDRESS 0x7002B29E /end MEASUREMENT
/begin MEASUREMENT ESM_bAfterrunFin "ESM_bAfterrunFin" UBYTE Bool_ON_OFF 1 2 0 1 BIT_MASK 0x01 ECU_ADDRESS 0x7002B2B8 /end MEASUREMENT
/begin MEASUREMENT ESM_bAfterrunReq "ESM_bAfterrunReq" UBYTE Bool_ON_OFF 1 2 0 1 BIT_MASK 0x01 ECU_ADDRESS 0x7002B2B7 /end MEASUREMENT
/begin MEASUREMENT ESM_bCallAppliOn "ESM_bCallAppliOn" UBYTE Bool_ON_OFF 1 2 0 1 BIT_MASK 0x01 ECU_ADDRESS 0x7002B2B6 /end MEASUREMENT
/begin MEASUREMENT ESM_bMcuEnaReq "ESM_bMcuEnaReq" UBYTE Bool_ON_OFF 1 2 0 1 BIT_MASK 0x01 ECU_ADDRESS 0x7002B2B5 /end MEASUREMENT
/begin MEASUREMENT ESM_bPwrDnReadyFlg "ESM_bPwrDnReadyFlg" UBYTE Bool_ON_OFF 1 2 0 1 BIT_MASK 0x01 ECU_ADDRESS 0x7002B2B4 /end MEASUREMENT
/begin MEASUREMENT ESM_bPwrLNfClrFltFinsh "ESM_bPwrLNfClrFltFinsh" UBYTE Bool_ON_OFF 1 2 0 1 BIT_MASK 0x01 ECU_ADDRESS 0x7002B2B3 /end MEASUREMENT
/begin MEASUREMENT ESM_u16AfterrunCnt "ESM_u16AfterrunCnt" UWORD I_1 1 2 0 65535 ECU_ADDRESS 0x7002B29C /end MEASUREMENT
/begin MEASUREMENT ESM_u16CmdReq "ESM_u16CmdReq" UWORD I_1 1 2 0 65535 ECU_ADDRESS 0x7002B29A /end MEASUREMENT
/begin MEASUREMENT ESM_u16CmdReqNm1 "ESM_u16CmdReqNm1" UWORD I_1 1 2 0 65535 ECU_ADDRESS 0x7002B298 /end MEASUREMENT
/begin MEASUREMENT ESM_u16CmdRes "ESM_u16CmdRes" UWORD I_1 1 2 0 65535 ECU_ADDRESS 0x7002B296 /end MEASUREMENT
/begin MEASUREMENT ESM_u8AllowPwrDnDelay "ESM_u8AllowPwrDnDelay" UBYTE I_1 1 2 0 255 ECU_ADDRESS 0x7002B2B2 /end MEASUREMENT
/begin MEASUREMENT ESM_u8PwrLNfStep "ESM_u8PwrLNfStep" UBYTE I_1 1 2 0 255 ECU_ADDRESS 0x7002B2B1 /end MEASUREMENT
/begin MEASUREMENT ESM_u8PwrOffTim "ESM_u8PwrOffTim" UBYTE I_1 1 2 0 255 ECU_ADDRESS 0x7002B2B0 /end MEASUREMENT
/begin MEASUREMENT ESM_u8RestartDelayCnt "ESM_u8RestartDelayCnt" UBYTE I_1 1 2 0 255 ECU_ADDRESS 0x7002B295 /end MEASUREMENT
/begin MEASUREMENT FSEVBHV_A2DBackResCorrdVoltage "Corrected ADC value of the battery voltage." FLOAT32_IEEE F_1_p0_2 1 2 0 4095 ECU_ADDRESS 0x700028B8 /end MEASUREMENT
/begin MEASUREMENT FSEVBHV_A2DResCorrdVoltage "Corrected ADC value of the battery voltage." FLOAT32_IEEE F_1_p0_2 1 2 0 4095 ECU_ADDRESS 0x700028B4 /end MEASUREMENT
/begin MEASUREMENT FSEVBHV_ActVoltage "FSEVBHV_ActVoltage" FLOAT32_IEEE F_1_p0_2 1 2 0 605 ECU_ADDRESS 0x700028B0 /end MEASUREMENT
/begin MEASUREMENT FSEVBHV_BackupVoltage "Current value of the HV battery scaled voltage." FLOAT32_IEEE F_1_p0_2 1 2 0 605 ECU_ADDRESS 0x700028AC /end MEASUREMENT
/begin MEASUREMENT FSEVBHV_BackupVoltageFild "Filtered value of the battery voltage with 1 time delay." FLOAT32_IEEE F_1_p0_2 1 2 0 605 ECU_ADDRESS 0x700028A8 /end MEASUREMENT
/begin MEASUREMENT FSEVBHV_BackupVoltageFildZ "Filtered value of the battery voltage with 1 time delay." FLOAT32_IEEE F_1_p0_2 1 2 0 605 ECU_ADDRESS 0x700028A4 /end MEASUREMENT
/begin MEASUREMENT FSEVBHV_SampleVolOutRngHDetn "FSEVBHV_SampleVolOutRngHDetn" UBYTE Bool_ON_OFF 1 2 0 1 BIT_MASK 0x01 ECU_ADDRESS 0x700028A3 /end MEASUREMENT
/begin MEASUREMENT FSEVBHV_SampleVolOutRngLDetn "FSEVBHV_SampleVolOutRngLDetn" UBYTE Bool_ON_OFF 1 2 0 1 BIT_MASK 0x01 ECU_ADDRESS 0x700028A2 /end MEASUREMENT
/begin MEASUREMENT FSEVBHV_UnderVoltageWarnDetn "FSEVBHV_UnderVoltageWarnDetn" UBYTE Bool_ON_OFF 1 2 0 1 BIT_MASK 0x01 ECU_ADDRESS 0x700028A1 /end MEASUREMENT
/begin MEASUREMENT FSEVBHV_VolNotRationalDetn "Fault on the battery voltage measure detection." UBYTE Bool_ON_OFF 1 2 0 1 BIT_MASK 0x01 ECU_ADDRESS 0x700028A0 /end MEASUREMENT
/begin MEASUREMENT FSEVBHV_Voltage "Current value of the HV battery scaled voltage." FLOAT32_IEEE F_1_p0_2 1 2 0 605 ECU_ADDRESS 0x7000289C /end MEASUREMENT
/begin MEASUREMENT FSEVBHV_Voltage1Fild "Filtered value of the battery voltage." FLOAT32_IEEE F_1_p0_2 1 2 0 605 ECU_ADDRESS 0x70002898 /end MEASUREMENT
/begin MEASUREMENT FSEVBHV_Voltage1FildZ "Filtered value of the battery voltage." FLOAT32_IEEE F_1_p0_2 1 2 0 605 ECU_ADDRESS 0x70002894 /end MEASUREMENT
/begin MEASUREMENT FSEVBHV_VoltageFild "Filtered value of the battery voltage." FLOAT32_IEEE F_1_p0_2 1 2 0 605 ECU_ADDRESS 0x70002890 /end MEASUREMENT
/begin MEASUREMENT FSEVBHV_VoltageFildZ "Filtered value of the battery voltage with 1 time delay." FLOAT32_IEEE F_1_p0_2 1 2 0 605 ECU_ADDRESS 0x7000288C /end MEASUREMENT
/begin MEASUREMENT FSEVBHV_VoltageGndDetn "FSEVBHV_VoltageGndDetn" UBYTE Bool_ON_OFF 1 2 0 1 BIT_MASK 0x01 ECU_ADDRESS 0x70002889 /end MEASUREMENT
/begin MEASUREMENT FSEVBHV_VoltageVccDetn "FSEVBHV_VoltageVccDetn" UBYTE Bool_ON_OFF 1 2 0 1 BIT_MASK 0x01 ECU_ADDRESS 0x70002888 /end MEASUREMENT
/begin MEASUREMENT FSEVBLV_A2DResCorrdVoltage "Corrected ADC value of the battery voltage." FLOAT32_IEEE F_1_p0_2 1 2 0 4095 ECU_ADDRESS 0x700028D8 /end MEASUREMENT
/begin MEASUREMENT FSEVBLV_LowVoltageWarnDetnZ "FSEVBLV_LowVoltageWarnDetnZ" UBYTE Bool_ON_OFF 1 2 0 1 BIT_MASK 0x01 ECU_ADDRESS 0x700028D4 /end MEASUREMENT
/begin MEASUREMENT FSEVBLV_P5VHSRefCompGain "FSEVBLV_P5VHSRefCompGain" FLOAT32_IEEE F_1_p0_2 1 2 -3.402823466E+038 3.402823466E+038 ECU_ADDRESS 0x700028D0 /end MEASUREMENT
/begin MEASUREMENT FSEVBLV_UnderVoltageWarnDetn "FSEVBLV_UnderVoltageWarnDetn" UBYTE Bool_ON_OFF 1 2 0 1 BIT_MASK 0x01 ECU_ADDRESS 0x700028CC /end MEASUREMENT
/begin MEASUREMENT FSEVBLV_Voltage "Current value of the HV battery scaled voltage." FLOAT32_IEEE F_1_p0_2 1 2 0 605 ECU_ADDRESS 0x700028C8 /end MEASUREMENT
/begin MEASUREMENT FSEVBLV_VoltageFild "Filtered value of the battery voltage." FLOAT32_IEEE F_1_p0_2 1 2 0 605 ECU_ADDRESS 0x700028C4 /end MEASUREMENT
/begin MEASUREMENT FSEVBLV_VoltageFildZ "Filtered value of the battery voltage with 1 time delay." FLOAT32_IEEE F_1_p0_2 1 2 0 605 ECU_ADDRESS 0x700028C0 /end MEASUREMENT
/begin MEASUREMENT FSEVBLV_VoltageGndDetn "FSEVBLV_VoltageGndDetn" UBYTE Bool_ON_OFF 1 2 0 1 BIT_MASK 0x01 ECU_ADDRESS 0x700028BD /end MEASUREMENT
/begin MEASUREMENT FSEVBLV_VoltageVccDetn "FSEVBLV_VoltageVccDetn" UBYTE Bool_ON_OFF 1 2 0 1 BIT_MASK 0x01 ECU_ADDRESS 0x700028BC /end MEASUREMENT
/begin MEASUREMENT FSEVETA_CmdBoardRational "FSEVETA_CmdBoardRational" UBYTE Bool_ON_OFF 1 2 0 1 BIT_MASK 0x01 ECU_ADDRESS 0x7000297E /end MEASUREMENT
/begin MEASUREMENT FSEVETA_CoolingRational "FSEVETA_CoolingRational" UBYTE Bool_ON_OFF 1 2 0 1 BIT_MASK 0x01 ECU_ADDRESS 0x7000297D /end MEASUREMENT
/begin MEASUREMENT FSEVETA_CoolingRationalDetn "FSEVETA_CoolingRationalDetn" UBYTE Bool_ON_OFF 1 2 0 1 BIT_MASK 0x01 ECU_ADDRESS 0x7000297C /end MEASUREMENT
/begin MEASUREMENT FSEVETA_CorrdTempCooling "FSEVETA_CorrdTempCooling" FLOAT32_IEEE F_1_p0_2 1 2 -1000 1000 ECU_ADDRESS 0x70002978 /end MEASUREMENT
/begin MEASUREMENT FSEVETA_CorrdTempDrvBoardLeft "FSEVETA_CorrdTempDrvBoardLeft" FLOAT32_IEEE F_1_p0_2 1 2 -1000 1000 ECU_ADDRESS 0x70002974 /end MEASUREMENT
/begin MEASUREMENT FSEVETA_CorrdTempIgbtLeftU "FSEVETA_CorrdTempIgbtLeftU" FLOAT32_IEEE F_1_p0_2 1 2 -1000 1000 ECU_ADDRESS 0x70002970 /end MEASUREMENT
/begin MEASUREMENT FSEVETA_CorrdTempIgbtLeftV "FSEVETA_CorrdTempIgbtLeftV" FLOAT32_IEEE F_1_p0_2 1 2 -1000 1000 ECU_ADDRESS 0x7000296C /end MEASUREMENT
/begin MEASUREMENT FSEVETA_CorrdTempIgbtLeftW "FSEVETA_CorrdTempIgbtLeftW" FLOAT32_IEEE F_1_p0_2 1 2 -1000 1000 ECU_ADDRESS 0x70002968 /end MEASUREMENT
/begin MEASUREMENT FSEVETA_CorrdTempLVCmdBoard "FSEVETA_CorrdTempLVCmdBoard" FLOAT32_IEEE F_1_p0_2 1 2 -3.402823466E+038 3.402823466E+038 ECU_ADDRESS 0x70002964 /end MEASUREMENT
/begin MEASUREMENT FSEVETA_CorrdTempLVCmdBoard2 "FSEVETA_CorrdTempLVCmdBoard2" FLOAT32_IEEE F_1_p0_2 1 2 -3.402823466E+038 3.402823466E+038 ECU_ADDRESS 0x70002960 /end MEASUREMENT
/begin MEASUREMENT FSEVETA_CounterNumberZ "FSEVETA_CounterNumberZ" UWORD F_1_p0_2 1 2 0 65535 ECU_ADDRESS 0x7000295E /end MEASUREMENT
/begin MEASUREMENT FSEVETA_CtlBdTempRationalDetn "FSEVETA_CtlBdTempRationalDetn" UBYTE Bool_ON_OFF 1 2 0 1 BIT_MASK 0x01 ECU_ADDRESS 0x7000295D /end MEASUREMENT
/begin MEASUREMENT FSEVETA_DrvBoardRational "FSEVETA_DrvBoardRational" UBYTE Bool_ON_OFF 1 2 0 1 BIT_MASK 0x01 ECU_ADDRESS 0x7000295C /end MEASUREMENT
/begin MEASUREMENT FSEVETA_DrvBoardTmpDiff "FSEVETA_DrvBoardTmpDiff" FLOAT32_IEEE F_1_p0_2 1 2 -1000 1000 ECU_ADDRESS 0x70002958 /end MEASUREMENT
/begin MEASUREMENT FSEVETA_DrvTempRationDetn "FSEVETA_DrvTempRationDetn" UBYTE Bool_ON_OFF 1 2 0 1 BIT_MASK 0x01 ECU_ADDRESS 0x70002957 /end MEASUREMENT
/begin MEASUREMENT FSEVETA_IgbtTempRationa "FSEVETA_IgbtTempRationa" UBYTE Bool_ON_OFF 1 2 0 1 BIT_MASK 0x01 ECU_ADDRESS 0x70002956 /end MEASUREMENT
/begin MEASUREMENT FSEVETA_IgbtTempRationalDetn "FSEVETA_IgbtTempRationalDetn" UBYTE Bool_ON_OFF 1 2 0 1 BIT_MASK 0x01 ECU_ADDRESS 0x70002955 /end MEASUREMENT
/begin MEASUREMENT FSEVETA_IgbtTempSlopOver "FSEVETA_IgbtTempSlopOver" UBYTE Bool_ON_OFF 1 2 0 1 BIT_MASK 0x01 ECU_ADDRESS 0x70002954 /end MEASUREMENT
/begin MEASUREMENT FSEVETA_IgbtTempZ "FSEVETA_IgbtTempZ" FLOAT32_IEEE F_1_p0_2 1 2 -3.402823466E+038 3.402823466E+038 ECU_ADDRESS 0x70002950 /end MEASUREMENT
/begin MEASUREMENT FSEVETA_OverTempCoolingDetn "FSEVETA_OverTempCoolingDetn" UBYTE Bool_ON_OFF 1 2 0 1 BIT_MASK 0x01 ECU_ADDRESS 0x7000294D /end MEASUREMENT
/begin MEASUREMENT FSEVETA_OverTempNTC2CmdBoardDetn "FSEVETA_OverTempNTC2CmdBoardDetn" UBYTE Bool_ON_OFF 1 2 0 1 BIT_MASK 0x01 ECU_ADDRESS 0x7000294C /end MEASUREMENT
/begin MEASUREMENT FSEVETA_TempCmdBoard "FSEVETA_TempCmdBoard" FLOAT32_IEEE F_1_p0_2 1 2 -3.402823466E+038 3.402823466E+038 ECU_ADDRESS 0x70002948 /end MEASUREMENT
/begin MEASUREMENT FSEVETA_TempCooling "FSEVETA_TempCooling" FLOAT32_IEEE F_1_p0_2 1 2 -1000 1000 ECU_ADDRESS 0x70002944 /end MEASUREMENT
/begin MEASUREMENT FSEVETA_TempCoolingFild "FSEVETA_TempCoolingFild" FLOAT32_IEEE F_1_p0_2 1 2 -1000 1000 ECU_ADDRESS 0x70002940 /end MEASUREMENT
/begin MEASUREMENT FSEVETA_TempCoolingFildZ "FSEVETA_TempCoolingFildZ" FLOAT32_IEEE F_1_p0_2 1 2 -1000 1000 ECU_ADDRESS 0x7000293C /end MEASUREMENT
/begin MEASUREMENT FSEVETA_TempCoolingGndDetn "FSEVETA_TempCoolingGndDetn" UBYTE Bool_ON_OFF 1 2 0 1 BIT_MASK 0x01 ECU_ADDRESS 0x70002939 /end MEASUREMENT
/begin MEASUREMENT FSEVETA_TempCoolingVccDetn "FSEVETA_TempCoolingVccDetn" UBYTE Bool_ON_OFF 1 2 0 1 BIT_MASK 0x01 ECU_ADDRESS 0x70002938 /end MEASUREMENT
/begin MEASUREMENT FSEVETA_TempDrvBoard "FSEVETA_TempDrvBoard" FLOAT32_IEEE F_1_p0_2 1 2 -1000 1000 ECU_ADDRESS 0x70002934 /end MEASUREMENT
/begin MEASUREMENT FSEVETA_TempDrvBoardLeft "FSEVETA_TempDrvBoardLeft" FLOAT32_IEEE F_1_p0_2 1 2 -1000 1000 ECU_ADDRESS 0x70002930 /end MEASUREMENT
/begin MEASUREMENT FSEVETA_TempDrvBoardLeftFild "FSEVETA_TempDrvBoardLeftFild" FLOAT32_IEEE F_1_p0_2 1 2 -1000 1000 ECU_ADDRESS 0x7000292C /end MEASUREMENT
/begin MEASUREMENT FSEVETA_TempDrvBoardLeftFildZ "FSEVETA_TempDrvBoardLeftFildZ" FLOAT32_IEEE F_1_p0_2 1 2 -1000 1000 ECU_ADDRESS 0x70002928 /end MEASUREMENT
/begin MEASUREMENT FSEVETA_TempIgbt "FSEVETA_TempIgbt" FLOAT32_IEEE F_1_p0_2 1 2 -1000 1000 ECU_ADDRESS 0x70002924 /end MEASUREMENT
/begin MEASUREMENT FSEVETA_TempIgbtLeftFild "FSEVETA_TempIgbtLeftFild" FLOAT32_IEEE F_1_p0_2 1 2 -1000 1000 ECU_ADDRESS 0x70002920 /end MEASUREMENT
/begin MEASUREMENT FSEVETA_TempIgbtLeftFildU "FSEVETA_TempIgbtLeftFildU" FLOAT32_IEEE F_1_p0_2 1 2 -1000 1000 ECU_ADDRESS 0x7000291C /end MEASUREMENT
/begin MEASUREMENT FSEVETA_TempIgbtLeftFildV "FSEVETA_TempIgbtLeftFildV" FLOAT32_IEEE F_1_p0_2 1 2 -1000 1000 ECU_ADDRESS 0x70002918 /end MEASUREMENT
/begin MEASUREMENT FSEVETA_TempIgbtLeftFildW "FSEVETA_TempIgbtLeftFildW" FLOAT32_IEEE F_1_p0_2 1 2 -1000 1000 ECU_ADDRESS 0x70002914 /end MEASUREMENT
/begin MEASUREMENT FSEVETA_TempIgbtLeftFildZU "FSEVETA_TempIgbtLeftFildZU" FLOAT32_IEEE F_1_p0_2 1 2 -1000 1000 ECU_ADDRESS 0x70002910 /end MEASUREMENT
/begin MEASUREMENT FSEVETA_TempIgbtLeftFildZV "FSEVETA_TempIgbtLeftFildZV" FLOAT32_IEEE F_1_p0_2 1 2 -1000 1000 ECU_ADDRESS 0x7000290C /end MEASUREMENT
/begin MEASUREMENT FSEVETA_TempIgbtLeftFildZW "FSEVETA_TempIgbtLeftFildZW" FLOAT32_IEEE F_1_p0_2 1 2 -1000 1000 ECU_ADDRESS 0x70002908 /end MEASUREMENT
/begin MEASUREMENT FSEVETA_TempIgbtLeftU "FSEVETA_TempIgbtLeftU" FLOAT32_IEEE F_1_p0_2 1 2 -1000 1000 ECU_ADDRESS 0x70002904 /end MEASUREMENT
/begin MEASUREMENT FSEVETA_TempIgbtLeftV "FSEVETA_TempIgbtLeftV" FLOAT32_IEEE F_1_p0_2 1 2 -1000 1000 ECU_ADDRESS 0x70002900 /end MEASUREMENT
/begin MEASUREMENT FSEVETA_TempIgbtLeftW "FSEVETA_TempIgbtLeftW" FLOAT32_IEEE F_1_p0_2 1 2 -1000 1000 ECU_ADDRESS 0x700028FC /end MEASUREMENT
/begin MEASUREMENT FSEVETA_TempLVCmdBoard "FSEVETA_TempLVCmdBoard" FLOAT32_IEEE F_1_p0_2 1 2 -3.402823466E+038 3.402823466E+038 ECU_ADDRESS 0x700028F8 /end MEASUREMENT
/begin MEASUREMENT FSEVETA_TempLVCmdBoard2 "FSEVETA_TempLVCmdBoard2" FLOAT32_IEEE F_1_p0_2 1 2 -3.402823466E+038 3.402823466E+038 ECU_ADDRESS 0x700028F4 /end MEASUREMENT
/begin MEASUREMENT FSEVETA_TempLVCmdBoard2Fild "FSEVETA_TempLVCmdBoard2Fild" FLOAT32_IEEE F_1_p0_2 1 2 -100 500 ECU_ADDRESS 0x700028F0 /end MEASUREMENT
/begin MEASUREMENT FSEVETA_TempLVCmdBoard2FildZ "FSEVETA_TempLVCmdBoard2FildZ" FLOAT32_IEEE F_1_p0_2 1 2 -3.402823466E+038 3.402823466E+038 ECU_ADDRESS 0x700028EC /end MEASUREMENT
/begin MEASUREMENT FSEVETA_TempLVCmdBoardFild "FSEVETA_TempLVCmdBoardFild" FLOAT32_IEEE F_1_p0_2 1 2 -100 500 ECU_ADDRESS 0x700028E8 /end MEASUREMENT
/begin MEASUREMENT FSEVETA_TempLVCmdBoardFildZ "FSEVETA_TempLVCmdBoardFildZ" FLOAT32_IEEE F_1_p0_2 1 2 -3.402823466E+038 3.402823466E+038 ECU_ADDRESS 0x700028E4 /end MEASUREMENT
/begin MEASUREMENT FSEVETA_TempNTC1CmdBoardGndDetn "FSEVETA_TempNTC1CmdBoardGndDetn" UBYTE Bool_ON_OFF 1 2 0 1 BIT_MASK 0x01 ECU_ADDRESS 0x700028E3 /end MEASUREMENT
/begin MEASUREMENT FSEVETA_TempNTC1CmdBoardVccDetn "FSEVETA_TempNTC1CmdBoardVccDetn" UBYTE Bool_ON_OFF 1 2 0 1 BIT_MASK 0x01 ECU_ADDRESS 0x700028E2 /end MEASUREMENT
/begin MEASUREMENT FSEVETA_TempNTC2CmdBoardGndDetn "FSEVETA_TempNTC2CmdBoardGndDetn" UBYTE Bool_ON_OFF 1 2 0 1 BIT_MASK 0x01 ECU_ADDRESS 0x700028E1 /end MEASUREMENT
/begin MEASUREMENT FSEVETA_TempNTC2CmdBoardVccDetn "FSEVETA_TempNTC2CmdBoardVccDetn" UBYTE Bool_ON_OFF 1 2 0 1 BIT_MASK 0x01 ECU_ADDRESS 0x700028E0 /end MEASUREMENT
/begin MEASUREMENT FSEVETA_UnderTempCoolingDetn "FSEVETA_UnderTempCoolingDetn" UBYTE Bool_ON_OFF 1 2 0 1 BIT_MASK 0x01 ECU_ADDRESS 0x700028DF /end MEASUREMENT
/begin MEASUREMENT FSEVETA_UnderTempIgbtLeftDetn "FSEVETA_UnderTempIgbtLeftDetn" UBYTE Bool_ON_OFF 1 2 0 1 BIT_MASK 0x01 ECU_ADDRESS 0x700028DE /end MEASUREMENT
/begin MEASUREMENT FSEVETA_UnderTempNTC1CmdBoardDetn "FSEVETA_UnderTempNTC1CmdBoardDetn" UBYTE Bool_ON_OFF 1 2 0 1 BIT_MASK 0x01 ECU_ADDRESS 0x700028DD /end MEASUREMENT
/begin MEASUREMENT FSEVETA_UnderTempNTC2CmdBoardDetn "FSEVETA_UnderTempNTC2CmdBoardDetn" UBYTE Bool_ON_OFF 1 2 0 1 BIT_MASK 0x01 ECU_ADDRESS 0x700028DC /end MEASUREMENT
/begin MEASUREMENT FSEVIBT_EstiIbatHv "FSEVIBT_EstiIbatHv" FLOAT32_IEEE F_1_p0_2 1 2 -3.402823466E+038 3.402823466E+038 ECU_ADDRESS 0x70002988 /end MEASUREMENT
/begin MEASUREMENT FSEVIBT_IbatHVFild "FSEVIBT_IbatHVFild" FLOAT32_IEEE F_1_p0_2 1 2 -1000 1000 ECU_ADDRESS 0x70002984 /end MEASUREMENT
/begin MEASUREMENT FSEVIBT_IbatHVFildZ "FSEVIBT_IbatHVFildZ" FLOAT32_IEEE F_1_p0_2 1 2 -1000 1000 ECU_ADDRESS 0x70002980 /end MEASUREMENT
/begin MEASUREMENT FSEXCTX_MaxAvailableTorqueFild "maximal available torque." FLOAT32_IEEE F_1_p0_2 1 2 -500 500 ECU_ADDRESS 0x700029AC /end MEASUREMENT
/begin MEASUREMENT FSEXCTX_MaxAvailableTorqueFildZ "maximal available torque." FLOAT32_IEEE F_1_p0_2 1 2 -500 500 ECU_ADDRESS 0x700029A8 /end MEASUREMENT
/begin MEASUREMENT FSEXCTX_MinAvailableTorqueFild "FSEXCTX_MinAvailableTorqueFild" FLOAT32_IEEE F_1_p0_2 1 2 -500 500 ECU_ADDRESS 0x700029A4 /end MEASUREMENT
/begin MEASUREMENT FSEXCTX_MinAvailableTorqueFildZ "FSEXCTX_MinAvailableTorqueFildZ" FLOAT32_IEEE F_1_p0_2 1 2 -500 500 ECU_ADDRESS 0x700029A0 /end MEASUREMENT
/begin MEASUREMENT FSEXCTX_MotorAppliedTorque "Current value of applied torque." FLOAT32_IEEE F_1_p0_2 1 2 -500 500 ECU_ADDRESS 0x7000299C /end MEASUREMENT
/begin MEASUREMENT FSEXCTX_MotorSpeed "Current value of  motor speed." FLOAT32_IEEE F_1_p0_2 1 2 -1000000 1000000 ECU_ADDRESS 0x70002998 /end MEASUREMENT
/begin MEASUREMENT FSEXCTX_MotorState "Current value of motor state" UWORD F_1_p0_2 1 2 0 65535 ECU_ADDRESS 0x70002996 /end MEASUREMENT
/begin MEASUREMENT FSEXCTX_SwVerNum1 "FSEXCTX_SwVerNum1" UWORD F_1_p0_2 1 2 0 31 ECU_ADDRESS 0x70002994 /end MEASUREMENT
/begin MEASUREMENT FSEXCTX_SwVerNum2 "FSEXCTX_SwVerNum2" UWORD F_1_p0_2 1 2 0 31 ECU_ADDRESS 0x70002992 /end MEASUREMENT
/begin MEASUREMENT FSEXCTX_SwVerNum3 "FSEXCTX_SwVerNum3" UWORD F_1_p0_2 1 2 0 31 ECU_ADDRESS 0x70002990 /end MEASUREMENT
/begin MEASUREMENT FSEXCTX_SwVerNum4 "FSEXCTX_SwVerNum4" UWORD F_1_p0_2 1 2 0 31 ECU_ADDRESS 0x7000298E /end MEASUREMENT
/begin MEASUREMENT FSEXCTX_SysTempOvrInd "FSEXCTX_SysTempOvrInd" UBYTE Bool_ON_OFF 1 2 0 1 BIT_MASK 0x01 ECU_ADDRESS 0x7000298C /end MEASUREMENT
/begin MEASUREMENT FSMTMTA_CorrdTempWindingHead1 "FSMTMTA_CorrdTempWindingHead1" FLOAT32_IEEE F_1_p0_2 1 2 -3.402823466E+038 3.402823466E+038 ECU_ADDRESS 0x700029E4 /end MEASUREMENT
/begin MEASUREMENT FSMTMTA_CorrdTempWindingHead2 "FSMTMTA_CorrdTempWindingHead2" FLOAT32_IEEE F_1_p0_2 1 2 -3.402823466E+038 3.402823466E+038 ECU_ADDRESS 0x700029E0 /end MEASUREMENT
/begin MEASUREMENT FSMTMTA_OverTempWdgHead2Detn "FSMTMTA_OverTempWdgHead2Detn" UBYTE Bool_ON_OFF 1 2 0 1 BIT_MASK 0x01 ECU_ADDRESS 0x700029DD /end MEASUREMENT
/begin MEASUREMENT FSMTMTA_TempWindHeadRationalDetn "FSMTMTA_TempWindHeadRationalDetn" UBYTE Bool_ON_OFF 1 2 0 1 BIT_MASK 0x01 ECU_ADDRESS 0x700029DC /end MEASUREMENT
/begin MEASUREMENT FSMTMTA_TempWindingHead1 "FSMTMTA_TempWindingHead1" FLOAT32_IEEE F_1_p0_2 1 2 -3.402823466E+038 3.402823466E+038 ECU_ADDRESS 0x700029D0 /end MEASUREMENT
/begin MEASUREMENT FSMTMTA_TempWindingHead1Fild "FSMTMTA_TempWindingHead1Fild" FLOAT32_IEEE F_1_p0_2 1 2 -3.402823466E+038 3.402823466E+038 ECU_ADDRESS 0x700029CC /end MEASUREMENT
/begin MEASUREMENT FSMTMTA_TempWindingHead1FildZ "FSMTMTA_TempWindingHead1FildZ" FLOAT32_IEEE F_1_p0_2 1 2 -3.402823466E+038 3.402823466E+038 ECU_ADDRESS 0x700029C8 /end MEASUREMENT
/begin MEASUREMENT FSMTMTA_TempWindingHead2 "FSMTMTA_TempWindingHead2" FLOAT32_IEEE F_1_p0_2 1 2 -3.402823466E+038 3.402823466E+038 ECU_ADDRESS 0x700029C4 /end MEASUREMENT
/begin MEASUREMENT FSMTMTA_TempWindingHead2Fild "FSMTMTA_TempWindingHead2Fild" FLOAT32_IEEE F_1_p0_2 1 2 -3.402823466E+038 3.402823466E+038 ECU_ADDRESS 0x700029C0 /end MEASUREMENT
/begin MEASUREMENT FSMTMTA_TempWindingHead2FildZ "FSMTMTA_TempWindingHead2FildZ" FLOAT32_IEEE F_1_p0_2 1 2 -3.402823466E+038 3.402823466E+038 ECU_ADDRESS 0x700029BC /end MEASUREMENT
/begin MEASUREMENT FSMTMTA_TempWindingHead2GndDetn "FSMTMTA_TempWindingHead2GndDetn" UBYTE Bool_ON_OFF 1 2 0 1 BIT_MASK 0x01 ECU_ADDRESS 0x700029B9 /end MEASUREMENT
/begin MEASUREMENT FSMTMTA_TempWindingHead2VccDetn "FSMTMTA_TempWindingHead2VccDetn" UBYTE Bool_ON_OFF 1 2 0 1 BIT_MASK 0x01 ECU_ADDRESS 0x700029B8 /end MEASUREMENT
/begin MEASUREMENT FSMTMTA_TempWindingMax "FSMTMTA_TempWindingMax" FLOAT32_IEEE F_1_p0_2 1 2 -3.402823466E+038 3.402823466E+038 ECU_ADDRESS 0x700029B4 /end MEASUREMENT
/begin MEASUREMENT FSMTMTA_TempWinding[0] "FSMTMTA_TempWinding" FLOAT32_IEEE F_1_p0_2 1 2 -3.402823466E+038 3.402823466E+038 ECU_ADDRESS 0x700029D4 /end MEASUREMENT
/begin MEASUREMENT FSMTMTA_TempWinding[1] "FSMTMTA_TempWinding" FLOAT32_IEEE F_1_p0_2 1 2 -3.402823466E+038 3.402823466E+038 ECU_ADDRESS 0x700029D8 /end MEASUREMENT
/begin MEASUREMENT FSMTMTA_UnderTempWdgHead1Detn "FSMTMTA_UnderTempWdgHead1Detn" UBYTE Bool_ON_OFF 1 2 0 1 BIT_MASK 0x01 ECU_ADDRESS 0x700029B1 /end MEASUREMENT
/begin MEASUREMENT FSMTMTA_UnderTempWdgHead2Detn "FSMTMTA_UnderTempWdgHead2Detn" UBYTE Bool_ON_OFF 1 2 0 1 BIT_MASK 0x01 ECU_ADDRESS 0x700029B0 /end MEASUREMENT
/begin MEASUREMENT FSMTRDG_A2DResCorrdCosH "FSMTRDG_A2DResCorrdCosH" FLOAT32_IEEE F_1_p0_2 1 2 -3.402823466E+038 3.402823466E+038 ECU_ADDRESS 0x70002A70 /end MEASUREMENT
/begin MEASUREMENT FSMTRDG_A2DResCorrdCosL "FSMTRDG_A2DResCorrdCosL" FLOAT32_IEEE F_1_p0_2 1 2 -3.402823466E+038 3.402823466E+038 ECU_ADDRESS 0x70002A6C /end MEASUREMENT
/begin MEASUREMENT FSMTRDG_A2DResCorrdExitation "FSMTRDG_A2DResCorrdExitation" FLOAT32_IEEE F_1_p0_2 1 2 -3.402823466E+038 3.402823466E+038 ECU_ADDRESS 0x70002A68 /end MEASUREMENT
/begin MEASUREMENT FSMTRDG_A2DResCorrdSinH "FSMTRDG_A2DResCorrdSinH" FLOAT32_IEEE F_1_p0_2 1 2 -3.402823466E+038 3.402823466E+038 ECU_ADDRESS 0x70002A64 /end MEASUREMENT
/begin MEASUREMENT FSMTRDG_A2DResCorrdSinL "FSMTRDG_A2DResCorrdSinL" FLOAT32_IEEE F_1_p0_2 1 2 -3.402823466E+038 3.402823466E+038 ECU_ADDRESS 0x70002A60 /end MEASUREMENT
/begin MEASUREMENT FSMTRDG_CosHGndDetn "FSMTRDG_CosHGndDetn" UBYTE Bool_ON_OFF 1 2 0 1 BIT_MASK 0x01 ECU_ADDRESS 0x70002A5D /end MEASUREMENT
/begin MEASUREMENT FSMTRDG_CosHVccDetn "FSMTRDG_CosHVccDetn" UBYTE Bool_ON_OFF 1 2 0 1 BIT_MASK 0x01 ECU_ADDRESS 0x70002A5C /end MEASUREMENT
/begin MEASUREMENT FSMTRDG_CosHVolt "FSMTRDG_CosHVolt" FLOAT32_IEEE F_1_p0_2 1 2 -3.402823466E+038 3.402823466E+038 ECU_ADDRESS 0x70002A58 /end MEASUREMENT
/begin MEASUREMENT FSMTRDG_CosHVoltFild "FSMTRDG_CosHVoltFild" FLOAT32_IEEE F_1_p0_2 1 2 -3.402823466E+038 3.402823466E+038 ECU_ADDRESS 0x70002A54 /end MEASUREMENT
/begin MEASUREMENT FSMTRDG_CosHVoltFildZ "FSMTRDG_CosHVoltFildZ" FLOAT32_IEEE F_1_p0_2 1 2 -3.402823466E+038 3.402823466E+038 ECU_ADDRESS 0x70002A50 /end MEASUREMENT
/begin MEASUREMENT FSMTRDG_CosLGndDetn "FSMTRDG_CosLGndDetn" UBYTE Bool_ON_OFF 1 2 0 1 BIT_MASK 0x01 ECU_ADDRESS 0x70002A4D /end MEASUREMENT
/begin MEASUREMENT FSMTRDG_CosLVccDetn "FSMTRDG_CosLVccDetn" UBYTE Bool_ON_OFF 1 2 0 1 BIT_MASK 0x01 ECU_ADDRESS 0x70002A4C /end MEASUREMENT
/begin MEASUREMENT FSMTRDG_CosLVolt "FSMTRDG_CosLVolt" FLOAT32_IEEE F_1_p0_2 1 2 -3.402823466E+038 3.402823466E+038 ECU_ADDRESS 0x70002A48 /end MEASUREMENT
/begin MEASUREMENT FSMTRDG_CosLVoltFild "FSMTRDG_CosLVoltFild" FLOAT32_IEEE F_1_p0_2 1 2 -3.402823466E+038 3.402823466E+038 ECU_ADDRESS 0x70002A44 /end MEASUREMENT
/begin MEASUREMENT FSMTRDG_CosLVoltFildZ "FSMTRDG_CosLVoltFildZ" FLOAT32_IEEE F_1_p0_2 1 2 -3.402823466E+038 3.402823466E+038 ECU_ADDRESS 0x70002A40 /end MEASUREMENT
/begin MEASUREMENT FSMTRDG_CosLegInternalFail "FSMTRDG_CosLegInternalFail" UBYTE Bool_ON_OFF 1 2 0 1 BIT_MASK 0x01 ECU_ADDRESS 0x70002A3F /end MEASUREMENT
/begin MEASUREMENT FSMTRDG_CosLegInternalFailDetn "FSMTRDG_CosLegInternalFailDetn" UBYTE Bool_ON_OFF 1 2 0 1 BIT_MASK 0x01 ECU_ADDRESS 0x70002A3E /end MEASUREMENT
/begin MEASUREMENT FSMTRDG_CosLegNormal "FSMTRDG_CosLegNormal" UBYTE Bool_ON_OFF 1 2 0 1 BIT_MASK 0x01 ECU_ADDRESS 0x70002A3D /end MEASUREMENT
/begin MEASUREMENT FSMTRDG_CosLegOpen "FSMTRDG_CosLegOpen" UBYTE Bool_ON_OFF 1 2 0 1 BIT_MASK 0x01 ECU_ADDRESS 0x70002A3C /end MEASUREMENT
/begin MEASUREMENT FSMTRDG_CosLegOpenDetn "FSMTRDG_CosLegOpenDetn" UBYTE Bool_ON_OFF 1 2 0 1 BIT_MASK 0x01 ECU_ADDRESS 0x70002A3B /end MEASUREMENT
/begin MEASUREMENT FSMTRDG_CosLegShortGnd "FSMTRDG_CosLegShortGnd" UBYTE Bool_ON_OFF 1 2 0 1 BIT_MASK 0x01 ECU_ADDRESS 0x70002A3A /end MEASUREMENT
/begin MEASUREMENT FSMTRDG_CosLegShortGndDetn "FSMTRDG_CosLegShortGndDetn" UBYTE Bool_ON_OFF 1 2 0 1 BIT_MASK 0x01 ECU_ADDRESS 0x70002A39 /end MEASUREMENT
/begin MEASUREMENT FSMTRDG_CosLegShortVcc "FSMTRDG_CosLegShortVcc" UBYTE Bool_ON_OFF 1 2 0 1 BIT_MASK 0x01 ECU_ADDRESS 0x70002A38 /end MEASUREMENT
/begin MEASUREMENT FSMTRDG_CosLegShortVccDetn "FSMTRDG_CosLegShortVccDetn" UBYTE Bool_ON_OFF 1 2 0 1 BIT_MASK 0x01 ECU_ADDRESS 0x70002A37 /end MEASUREMENT
/begin MEASUREMENT FSMTRDG_ExcDutyCycleErrDetn "FSMTRDG_ExcDutyCycleErrDetn" UBYTE Bool_ON_OFF 1 2 0 1 BIT_MASK 0x01 ECU_ADDRESS 0x70002A36 /end MEASUREMENT
/begin MEASUREMENT FSMTRDG_ExcFreqErrDetn "FSMTRDG_ExcFreqErrDetn" UBYTE Bool_ON_OFF 1 2 0 1 BIT_MASK 0x01 ECU_ADDRESS 0x70002A35 /end MEASUREMENT
/begin MEASUREMENT FSMTRDG_ExcInternalFail "FSMTRDG_ExcInternalFail" UBYTE Bool_ON_OFF 1 2 0 1 BIT_MASK 0x01 ECU_ADDRESS 0x70002A34 /end MEASUREMENT
/begin MEASUREMENT FSMTRDG_ExcInternalFailDetn "FSMTRDG_ExcInternalFailDetn" UBYTE Bool_ON_OFF 1 2 0 1 BIT_MASK 0x01 ECU_ADDRESS 0x70002A33 /end MEASUREMENT
/begin MEASUREMENT FSMTRDG_ExcNormal "FSMTRDG_ExcNormal" UBYTE Bool_ON_OFF 1 2 0 1 BIT_MASK 0x01 ECU_ADDRESS 0x70002A32 /end MEASUREMENT
/begin MEASUREMENT FSMTRDG_ExcOpen "FSMTRDG_ExcOpen" UBYTE Bool_ON_OFF 1 2 0 1 BIT_MASK 0x01 ECU_ADDRESS 0x70002A31 /end MEASUREMENT
/begin MEASUREMENT FSMTRDG_ExcOpenDetn "FSMTRDG_ExcOpenDetn" UBYTE Bool_ON_OFF 1 2 0 1 BIT_MASK 0x01 ECU_ADDRESS 0x70002A30 /end MEASUREMENT
/begin MEASUREMENT FSMTRDG_ExcShortGnd "FSMTRDG_ExcShortGnd" UBYTE Bool_ON_OFF 1 2 0 1 BIT_MASK 0x01 ECU_ADDRESS 0x70002A2F /end MEASUREMENT
/begin MEASUREMENT FSMTRDG_ExcShortVcc "FSMTRDG_ExcShortVcc" UBYTE Bool_ON_OFF 1 2 0 1 BIT_MASK 0x01 ECU_ADDRESS 0x70002A2E /end MEASUREMENT
/begin MEASUREMENT FSMTRDG_ExcSignalGNDDetn "FSMTRDG_ExcSignalGNDDetn" UBYTE Bool_ON_OFF 1 2 0 1 BIT_MASK 0x01 ECU_ADDRESS 0x70002A2D /end MEASUREMENT
/begin MEASUREMENT FSMTRDG_ExcSignalVCCDetn "FSMTRDG_ExcSignalVCCDetn" UBYTE Bool_ON_OFF 1 2 0 1 BIT_MASK 0x01 ECU_ADDRESS 0x70002A2C /end MEASUREMENT
/begin MEASUREMENT FSMTRDG_ExcVoltageFild "FSMTRDG_ExcVoltageFild" FLOAT32_IEEE F_1_p0_2 1 2 -3.402823466E+038 3.402823466E+038 ECU_ADDRESS 0x70002A28 /end MEASUREMENT
/begin MEASUREMENT FSMTRDG_ExcVoltageFildZ "FSMTRDG_ExcVoltageFildZ" FLOAT32_IEEE F_1_p0_2 1 2 -3.402823466E+038 3.402823466E+038 ECU_ADDRESS 0x70002A24 /end MEASUREMENT
/begin MEASUREMENT FSMTRDG_ExitationDiagIO "FSMTRDG_ExitationDiagIO" UBYTE Bool_ON_OFF 1 2 0 1 BIT_MASK 0x01 ECU_ADDRESS 0x70002A22 /end MEASUREMENT
/begin MEASUREMENT FSMTRDG_ExitationGndDetn "FSMTRDG_ExitationGndDetn" UBYTE Bool_ON_OFF 1 2 0 1 BIT_MASK 0x01 ECU_ADDRESS 0x70002A21 /end MEASUREMENT
/begin MEASUREMENT FSMTRDG_ExitationVccDetn "FSMTRDG_ExitationVccDetn" UBYTE Bool_ON_OFF 1 2 0 1 BIT_MASK 0x01 ECU_ADDRESS 0x70002A20 /end MEASUREMENT
/begin MEASUREMENT FSMTRDG_ExitationVolt "FSMTRDG_ExitationVolt" FLOAT32_IEEE F_1_p0_2 1 2 -3.402823466E+038 3.402823466E+038 ECU_ADDRESS 0x70002A1C /end MEASUREMENT
/begin MEASUREMENT FSMTRDG_IOcounterZ "FSMTRDG_IOcounterZ" UWORD F_1_p0_2 1 2 0 65535 ECU_ADDRESS 0x70002A18 /end MEASUREMENT
/begin MEASUREMENT FSMTRDG_IOinZ "FSMTRDG_IOinZ" UBYTE Bool_ON_OFF 1 2 0 1 BIT_MASK 0x01 ECU_ADDRESS 0x70002A17 /end MEASUREMENT
/begin MEASUREMENT FSMTRDG_IOoutZ "FSMTRDG_IOoutZ" UBYTE Bool_ON_OFF 1 2 0 1 BIT_MASK 0x01 ECU_ADDRESS 0x70002A16 /end MEASUREMENT
/begin MEASUREMENT FSMTRDG_OverVoltageDetn "Fault on the battery voltage measure detection." UBYTE Bool_ON_OFF 1 2 0 1 BIT_MASK 0x01 ECU_ADDRESS 0x70002A15 /end MEASUREMENT
/begin MEASUREMENT FSMTRDG_SinCosHLGnd "FSMTRDG_SinCosHLGnd" UBYTE Bool_ON_OFF 1 2 0 1 BIT_MASK 0x01 ECU_ADDRESS 0x70002A14 /end MEASUREMENT
/begin MEASUREMENT FSMTRDG_SinCosHLOpen "FSMTRDG_SinCosHLOpen" UBYTE Bool_ON_OFF 1 2 0 1 BIT_MASK 0x01 ECU_ADDRESS 0x70002A13 /end MEASUREMENT
/begin MEASUREMENT FSMTRDG_SinCosHLVcc "FSMTRDG_SinCosHLVcc" UBYTE Bool_ON_OFF 1 2 0 1 BIT_MASK 0x01 ECU_ADDRESS 0x70002A12 /end MEASUREMENT
/begin MEASUREMENT FSMTRDG_SinHGndDetn "FSMTRDG_SinHGndDetn" UBYTE Bool_ON_OFF 1 2 0 1 BIT_MASK 0x01 ECU_ADDRESS 0x70002A11 /end MEASUREMENT
/begin MEASUREMENT FSMTRDG_SinHVccDetn "FSMTRDG_SinHVccDetn" UBYTE Bool_ON_OFF 1 2 0 1 BIT_MASK 0x01 ECU_ADDRESS 0x70002A10 /end MEASUREMENT
/begin MEASUREMENT FSMTRDG_SinHVolt "FSMTRDG_SinHVolt" FLOAT32_IEEE F_1_p0_2 1 2 -3.402823466E+038 3.402823466E+038 ECU_ADDRESS 0x70002A0C /end MEASUREMENT
/begin MEASUREMENT FSMTRDG_SinHVoltFild "FSMTRDG_SinHVoltFild" FLOAT32_IEEE F_1_p0_2 1 2 -3.402823466E+038 3.402823466E+038 ECU_ADDRESS 0x70002A08 /end MEASUREMENT
/begin MEASUREMENT FSMTRDG_SinHVoltFildZ "FSMTRDG_SinHVoltFildZ" FLOAT32_IEEE F_1_p0_2 1 2 -3.402823466E+038 3.402823466E+038 ECU_ADDRESS 0x70002A04 /end MEASUREMENT
/begin MEASUREMENT FSMTRDG_SinLGndDetn "FSMTRDG_SinLGndDetn" UBYTE Bool_ON_OFF 1 2 0 1 BIT_MASK 0x01 ECU_ADDRESS 0x70002A01 /end MEASUREMENT
/begin MEASUREMENT FSMTRDG_SinLVccDetn "FSMTRDG_SinLVccDetn" UBYTE Bool_ON_OFF 1 2 0 1 BIT_MASK 0x01 ECU_ADDRESS 0x70002A00 /end MEASUREMENT
/begin MEASUREMENT FSMTRDG_SinLVolt "FSMTRDG_SinLVolt" FLOAT32_IEEE F_1_p0_2 1 2 -3.402823466E+038 3.402823466E+038 ECU_ADDRESS 0x700029FC /end MEASUREMENT
/begin MEASUREMENT FSMTRDG_SinLVoltFild "FSMTRDG_SinLVoltFild" FLOAT32_IEEE F_1_p0_2 1 2 -3.402823466E+038 3.402823466E+038 ECU_ADDRESS 0x700029F8 /end MEASUREMENT
/begin MEASUREMENT FSMTRDG_SinLVoltFildZ "FSMTRDG_SinLVoltFildZ" FLOAT32_IEEE F_1_p0_2 1 2 -3.402823466E+038 3.402823466E+038 ECU_ADDRESS 0x700029F4 /end MEASUREMENT
/begin MEASUREMENT FSMTRDG_SinLegInternalFail "FSMTRDG_SinLegInternalFail" UBYTE Bool_ON_OFF 1 2 0 1 BIT_MASK 0x01 ECU_ADDRESS 0x700029F1 /end MEASUREMENT
/begin MEASUREMENT FSMTRDG_SinLegInternalFailDetn "FSMTRDG_SinLegInternalFailDetn" UBYTE Bool_ON_OFF 1 2 0 1 BIT_MASK 0x01 ECU_ADDRESS 0x700029F0 /end MEASUREMENT
/begin MEASUREMENT FSMTRDG_SinLegNormal "FSMTRDG_SinLegNormal" UBYTE Bool_ON_OFF 1 2 0 1 BIT_MASK 0x01 ECU_ADDRESS 0x700029EF /end MEASUREMENT
/begin MEASUREMENT FSMTRDG_SinLegOpen "FSMTRDG_SinLegOpen" UBYTE Bool_ON_OFF 1 2 0 1 BIT_MASK 0x01 ECU_ADDRESS 0x700029EE /end MEASUREMENT
/begin MEASUREMENT FSMTRDG_SinLegOpenDetn "FSMTRDG_SinLegOpenDetn" UBYTE Bool_ON_OFF 1 2 0 1 BIT_MASK 0x01 ECU_ADDRESS 0x700029ED /end MEASUREMENT
/begin MEASUREMENT FSMTRDG_SinLegShortGnd "FSMTRDG_SinLegShortGnd" UBYTE Bool_ON_OFF 1 2 0 1 BIT_MASK 0x01 ECU_ADDRESS 0x700029EC /end MEASUREMENT
/begin MEASUREMENT FSMTRDG_SinLegShortGndDetn "FSMTRDG_SinLegShortGndDetn" UBYTE Bool_ON_OFF 1 2 0 1 BIT_MASK 0x01 ECU_ADDRESS 0x700029EB /end MEASUREMENT
/begin MEASUREMENT FSMTRDG_SinLegShortVcc "FSMTRDG_SinLegShortVcc" UBYTE Bool_ON_OFF 1 2 0 1 BIT_MASK 0x01 ECU_ADDRESS 0x700029EA /end MEASUREMENT
/begin MEASUREMENT FSMTRDG_SinLegShortVccDetn "FSMTRDG_SinLegShortVccDetn" UBYTE Bool_ON_OFF 1 2 0 1 BIT_MASK 0x01 ECU_ADDRESS 0x700029E9 /end MEASUREMENT
/begin MEASUREMENT FSMTRDG_UnderVoltageDetn "Fault on the battery voltage measure detection." UBYTE Bool_ON_OFF 1 2 0 1 BIT_MASK 0x01 ECU_ADDRESS 0x700029E8 /end MEASUREMENT
/begin MEASUREMENT FSSMACS_AbsMecaSpeedRpmFild "FSSMACS_AbsMecaSpeedRpmFild" FLOAT32_IEEE F_1_p0_2 1 2 -3.402823466E+038 3.402823466E+038 ECU_ADDRESS 0x700026EC /end MEASUREMENT
/begin MEASUREMENT FSSMACS_AbsMecaSpeedRpmFildZ "FSSMACS_AbsMecaSpeedRpmFildZ" FLOAT32_IEEE F_1_p0_2 1 2 -3.402823466E+038 3.402823466E+038 ECU_ADDRESS 0x700026E8 /end MEASUREMENT
/begin MEASUREMENT FSSMACS_AclState "FSSMACS_AclState" UWORD F_1_p0_2 1 2 0 65535 ECU_ADDRESS 0x700026E6 /end MEASUREMENT
/begin MEASUREMENT FSSMACS_CmdFtShutDownReq "FSSMACS_CmdFtShutDownReq" UBYTE Bool_ON_OFF 1 2 0 1 BIT_MASK 0x01 ECU_ADDRESS 0x700026E4 /end MEASUREMENT
/begin MEASUREMENT FSSMACS_CmdFtStartReq "FSSMACS_CmdFtStartReq" UBYTE Bool_ON_OFF 1 2 0 1 BIT_MASK 0x01 ECU_ADDRESS 0x700026E3 /end MEASUREMENT
/begin MEASUREMENT FSSMACS_CmdSwShutDownReq "FSSMACS_CmdSwShutDownReq" UBYTE Bool_ON_OFF 1 2 0 1 BIT_MASK 0x01 ECU_ADDRESS 0x700026E2 /end MEASUREMENT
/begin MEASUREMENT FSSMACS_FTModeReq "FSSMACS_FTModeReq" UWORD F_1_p0_2 1 2 0 65535 ECU_ADDRESS 0x700026E0 /end MEASUREMENT
/begin MEASUREMENT FSSMACS_KL15 "FSSMACS_KL15" UBYTE Bool_ON_OFF 1 2 0 1 BIT_MASK 0x01 ECU_ADDRESS 0x700026DE /end MEASUREMENT
/begin MEASUREMENT FSSMACS_KL15counterZ "FSSMACS_KL15counterZ" UWORD F_1_p0_2 1 2 0 65535 ECU_ADDRESS 0x700026DC /end MEASUREMENT
/begin MEASUREMENT FSSMACS_KL15in "FSSMACS_KL15in" UBYTE Bool_ON_OFF 1 2 0 1 BIT_MASK 0x01 ECU_ADDRESS 0x700026DB /end MEASUREMENT
/begin MEASUREMENT FSSMACS_KL15inZ "FSSMACS_KL15inZ" UBYTE Bool_ON_OFF 1 2 0 1 BIT_MASK 0x01 ECU_ADDRESS 0x700026DA /end MEASUREMENT
/begin MEASUREMENT FSSMACS_KL15outZ "FSSMACS_KL15outZ" UBYTE Bool_ON_OFF 1 2 0 1 BIT_MASK 0x01 ECU_ADDRESS 0x700026D9 /end MEASUREMENT
/begin MEASUREMENT FSSMACS_NormalStartFtFlg "FSSMACS_NormalStartFtFlg" UBYTE Bool_ON_OFF 1 2 0 1 BIT_MASK 0x01 ECU_ADDRESS 0x700026D8 /end MEASUREMENT
/begin MEASUREMENT FSSMACS_OcFailure "FSSMACS_OcFailure" UBYTE Bool_ON_OFF 1 2 0 1 BIT_MASK 0x01 ECU_ADDRESS 0x700026D7 /end MEASUREMENT
/begin MEASUREMENT FSSMACS_OcFinish "FSSMACS_OcFinish" UBYTE Bool_ON_OFF 1 2 0 1 BIT_MASK 0x01 ECU_ADDRESS 0x700026D6 /end MEASUREMENT
/begin MEASUREMENT FSSMACS_RuningShutDelayComfCntZ "FSSMACS_RuningShutDelayComfCntZ" UWORD F_1_p0_2 1 2 0 65535 ECU_ADDRESS 0x700026D4 /end MEASUREMENT
/begin MEASUREMENT FSSMACS_RunningAllowShutDownFlg "FSSMACS_RunningAllowShutDownFlg" UBYTE Bool_ON_OFF 1 2 0 1 BIT_MASK 0x01 ECU_ADDRESS 0x700026D2 /end MEASUREMENT
/begin MEASUREMENT FSSMACS_SCSpeedReady "FSSMACS_SCSpeedReady" UBYTE Bool_ON_OFF 1 2 0 1 BIT_MASK 0x01 ECU_ADDRESS 0x700026D1 /end MEASUREMENT
/begin MEASUREMENT FSSMACS_SCSpeedReadyinZ "FSSMACS_SCSpeedReadyinZ" UBYTE Bool_ON_OFF 1 2 0 1 BIT_MASK 0x01 ECU_ADDRESS 0x700026D0 /end MEASUREMENT
/begin MEASUREMENT FSSMACS_SCSpeedReadyoutZ "FSSMACS_SCSpeedReadyoutZ" UBYTE Bool_ON_OFF 1 2 0 1 BIT_MASK 0x01 ECU_ADDRESS 0x700026CF /end MEASUREMENT
/begin MEASUREMENT FSSMACS_SelfCheakErrFlg "FSSMACS_SelfCheakErrFlg" UBYTE Bool_ON_OFF 1 2 0 1 BIT_MASK 0x01 ECU_ADDRESS 0x700026CE /end MEASUREMENT
/begin MEASUREMENT FSSMACS_SpeedReadycounterZ "FSSMACS_SpeedReadycounterZ" UWORD F_1_p0_2 1 2 0 65535 ECU_ADDRESS 0x700026CC /end MEASUREMENT
/begin MEASUREMENT FSSMACS_TorqueEnable "FSSMACS_TorqueEnable" UBYTE Bool_ON_OFF 1 2 0 1 BIT_MASK 0x01 ECU_ADDRESS 0x700026CA /end MEASUREMENT
/begin MEASUREMENT FSSMACS_TxMcuMode "FSSMACS_TxMcuMode" UBYTE F_1_p0_2 1 2 0 255 ECU_ADDRESS 0x700026C9 /end MEASUREMENT
/begin MEASUREMENT FSSMACS_TxMotorMode "FSSMACS_TxMotorMode" UBYTE F_1_p0_2 1 2 0 255 ECU_ADDRESS 0x700026C8 /end MEASUREMENT
/begin MEASUREMENT FSSMMAM_AclState "value of McuState after bypass" UWORD F_1_p0_2 1 2 0 65535 ECU_ADDRESS 0x700026F6 /end MEASUREMENT
/begin MEASUREMENT FSSMMAM_EVBHV_CheckEnable "FSSMMAM_EVBHV_CheckEnable" UBYTE Bool_ON_OFF 1 2 0 1 BIT_MASK 0x01 ECU_ADDRESS 0x700026F5 /end MEASUREMENT
/begin MEASUREMENT FSSMMAM_EVBLV_CheckEnable "FSSMMAM_EVBLV_CheckEnable" UBYTE Bool_ON_OFF 1 2 0 1 BIT_MASK 0x01 ECU_ADDRESS 0x700026F4 /end MEASUREMENT
/begin MEASUREMENT FSSMMAM_EVIBT_State "FSSMMAM_EVIBT_State" UWORD F_1_p0_2 1 2 0 65535 ECU_ADDRESS 0x700026F2 /end MEASUREMENT
/begin MEASUREMENT FSSMMAM_MTRDG_CheckEnable "FSSMMAM_MTRDG_CheckEnable" UBYTE Bool_ON_OFF 1 2 0 1 BIT_MASK 0x01 ECU_ADDRESS 0x700026F0 /end MEASUREMENT
/begin MEASUREMENT FSTCGTC_AccCheckCnt "FSTCGTC_AccCheckCnt" UWORD F_1_p0_2 1 2 0 65535 ECU_ADDRESS 0x700027C0 /end MEASUREMENT
/begin MEASUREMENT FSTCGTC_ActiveSpdLmtSpeed "FSTCGTC_ActiveSpdLmtSpeed" FLOAT32_IEEE F_1_p0_2 1 2 -3.402823466E+038 3.402823466E+038 ECU_ADDRESS 0x700027BC /end MEASUREMENT
/begin MEASUREMENT FSTCGTC_ActiveSpdLmtTrqMax "FSTCGTC_ActiveSpdLmtTrqMax" FLOAT32_IEEE F_1_p0_2 1 2 -3.402823466E+038 3.402823466E+038 ECU_ADDRESS 0x700027B8 /end MEASUREMENT
/begin MEASUREMENT FSTCGTC_ActiveSpdLmtTrqMin "FSTCGTC_ActiveSpdLmtTrqMin" FLOAT32_IEEE F_1_p0_2 1 2 -3.402823466E+038 3.402823466E+038 ECU_ADDRESS 0x700027B4 /end MEASUREMENT
/begin MEASUREMENT FSTCGTC_AntiForwardKi "FSTCGTC_AntiForwardKi" FLOAT32_IEEE F_1_p0_2 1 2 -3.402823466E+038 3.402823466E+038 ECU_ADDRESS 0x700027B0 /end MEASUREMENT
/begin MEASUREMENT FSTCGTC_AntiForwardKp "FSTCGTC_AntiForwardKp" FLOAT32_IEEE F_1_p0_2 1 2 -3.402823466E+038 3.402823466E+038 ECU_ADDRESS 0x700027AC /end MEASUREMENT
/begin MEASUREMENT FSTCGTC_AntiReverseKi "FSTCGTC_AntiReverseKi" FLOAT32_IEEE F_1_p0_2 1 2 -3.402823466E+038 3.402823466E+038 ECU_ADDRESS 0x700027A8 /end MEASUREMENT
/begin MEASUREMENT FSTCGTC_AntiReverseKp "FSTCGTC_AntiReverseKp" FLOAT32_IEEE F_1_p0_2 1 2 -3.402823466E+038 3.402823466E+038 ECU_ADDRESS 0x700027A4 /end MEASUREMENT
/begin MEASUREMENT FSTCGTC_BrakeCheckCnt "FSTCGTC_BrakeCheckCnt" UWORD F_1_p0_2 1 2 0 65535 ECU_ADDRESS 0x700027A2 /end MEASUREMENT
/begin MEASUREMENT FSTCGTC_BrakeExistHacFlg "FSTCGTC_BrakeExistHacFlg" UBYTE Bool_ON_OFF 1 2 0 1 BIT_MASK 0x01 ECU_ADDRESS 0x700027A0 /end MEASUREMENT
/begin MEASUREMENT FSTCGTC_CanTorqueRef "FSTCGTC_CanTorqueRef" FLOAT32_IEEE F_1_p0_2 1 2 -3.402823466E+038 3.402823466E+038 ECU_ADDRESS 0x7000279C /end MEASUREMENT
/begin MEASUREMENT FSTCGTC_FwdSpeedError "FSTCGTC_FwdSpeedError" FLOAT32_IEEE F_1_p0_2 1 2 -3.402823466E+038 3.402823466E+038 ECU_ADDRESS 0x70002798 /end MEASUREMENT
/begin MEASUREMENT FSTCGTC_FwdSpeedKiSum "FSTCGTC_FwdSpeedKiSum" FLOAT32_IEEE F_1_p0_2 1 2 -3.402823466E+038 3.402823466E+038 ECU_ADDRESS 0x70002794 /end MEASUREMENT
/begin MEASUREMENT FSTCGTC_FwdSpeedKiSumZ "FSTCGTC_FwdSpeedKiSumZ" FLOAT32_IEEE F_1_p0_2 1 2 -3.402823466E+038 3.402823466E+038 ECU_ADDRESS 0x70002790 /end MEASUREMENT
/begin MEASUREMENT FSTCGTC_FwdSpeedKpSum "FSTCGTC_FwdSpeedKpSum" FLOAT32_IEEE F_1_p0_2 1 2 -3.402823466E+038 3.402823466E+038 ECU_ADDRESS 0x7000278C /end MEASUREMENT
/begin MEASUREMENT FSTCGTC_FwdSpeedRef "FSTCGTC_FwdSpeedRef" FLOAT32_IEEE F_1_p0_2 1 2 -3.402823466E+038 3.402823466E+038 ECU_ADDRESS 0x70002788 /end MEASUREMENT
/begin MEASUREMENT FSTCGTC_FwdTorque "FSTCGTC_FwdTorque" FLOAT32_IEEE F_1_p0_2 1 2 -3.402823466E+038 3.402823466E+038 ECU_ADDRESS 0x70002784 /end MEASUREMENT
/begin MEASUREMENT FSTCGTC_HacEnable "FSTCGTC_HacEnable" UBYTE Bool_ON_OFF 1 2 0 1 BIT_MASK 0x01 ECU_ADDRESS 0x70002782 /end MEASUREMENT
/begin MEASUREMENT FSTCGTC_HacEnableCnt "FSTCGTC_HacEnableCnt" UWORD F_1_p0_2 1 2 0 65535 ECU_ADDRESS 0x70002780 /end MEASUREMENT
/begin MEASUREMENT FSTCGTC_HacEnableNumber "FSTCGTC_HacEnableNumber" UBYTE F_1_p0_2 1 2 0 255 ECU_ADDRESS 0x7000277E /end MEASUREMENT
/begin MEASUREMENT FSTCGTC_HacTempOutCnt "FSTCGTC_HacTempOutCnt" UWORD F_1_p0_2 1 2 0 65535 ECU_ADDRESS 0x7000277C /end MEASUREMENT
/begin MEASUREMENT FSTCGTC_HacTempOutFlg "FSTCGTC_HacTempOutFlg" UBYTE Bool_ON_OFF 1 2 0 1 BIT_MASK 0x01 ECU_ADDRESS 0x7000277A /end MEASUREMENT
/begin MEASUREMENT FSTCGTC_HandBrakeCheckCnt "FSTCGTC_HandBrakeCheckCnt" UWORD F_1_p0_2 1 2 0 65535 ECU_ADDRESS 0x70002778 /end MEASUREMENT
/begin MEASUREMENT FSTCGTC_I0dqTgt[0] "FSTCGTC_I0dqTgt" FLOAT32_IEEE F_1_p0_2 1 2 -3.402823466E+038 3.402823466E+038 ECU_ADDRESS 0x7000276C /end MEASUREMENT
/begin MEASUREMENT FSTCGTC_I0dqTgt[1] "FSTCGTC_I0dqTgt" FLOAT32_IEEE F_1_p0_2 1 2 -3.402823466E+038 3.402823466E+038 ECU_ADDRESS 0x70002770 /end MEASUREMENT
/begin MEASUREMENT FSTCGTC_I0dqTgt[2] "FSTCGTC_I0dqTgt" FLOAT32_IEEE F_1_p0_2 1 2 -3.402823466E+038 3.402823466E+038 ECU_ADDRESS 0x70002774 /end MEASUREMENT
/begin MEASUREMENT FSTCGTC_LmtSpdGenTrqMax "FSTCGTC_LmtSpdGenTrqMax" FLOAT32_IEEE F_1_p0_2 1 2 -3.402823466E+038 3.402823466E+038 ECU_ADDRESS 0x70002768 /end MEASUREMENT
/begin MEASUREMENT FSTCGTC_LocalGearState "FSTCGTC_LocalGearState" UBYTE F_1_p0_2 1 2 0 255 ECU_ADDRESS 0x70002764 /end MEASUREMENT
/begin MEASUREMENT FSTCGTC_MecaSpeedRpmTgt "FSTCGTC_MecaSpeedRpmTgt" FLOAT32_IEEE F_1_p0_2 1 2 -1000000 1000000 ECU_ADDRESS 0x70002760 /end MEASUREMENT
/begin MEASUREMENT FSTCGTC_OpenLoopLutEn "FSTCGTC_OpenLoopLutEn" UBYTE Bool_ON_OFF 1 2 0 1 BIT_MASK 0x01 ECU_ADDRESS 0x7000275E /end MEASUREMENT
/begin MEASUREMENT FSTCGTC_OpenLoopLutEnCnt "FSTCGTC_OpenLoopLutEnCnt" UWORD F_1_p0_2 1 2 0 65535 ECU_ADDRESS 0x7000275C /end MEASUREMENT
/begin MEASUREMENT FSTCGTC_OutSlopSlipCnt "FSTCGTC_OutSlopSlipCnt" UWORD F_1_p0_2 1 2 0 65535 ECU_ADDRESS 0x7000275A /end MEASUREMENT
/begin MEASUREMENT FSTCGTC_OutSlopSlipFlg "FSTCGTC_OutSlopSlipFlg" UBYTE Bool_ON_OFF 1 2 0 1 BIT_MASK 0x01 ECU_ADDRESS 0x70002759 /end MEASUREMENT
/begin MEASUREMENT FSTCGTC_RampAssistfFlg "FSTCGTC_RampAssistfFlg" UBYTE Bool_ON_OFF 1 2 0 1 BIT_MASK 0x01 ECU_ADDRESS 0x70002758 /end MEASUREMENT
/begin MEASUREMENT FSTCGTC_RevSpeedError "FSTCGTC_RevSpeedError" FLOAT32_IEEE F_1_p0_2 1 2 -3.402823466E+038 3.402823466E+038 ECU_ADDRESS 0x70002754 /end MEASUREMENT
/begin MEASUREMENT FSTCGTC_RevSpeedKiSum "FSTCGTC_RevSpeedKiSum" FLOAT32_IEEE F_1_p0_2 1 2 -3.402823466E+038 3.402823466E+038 ECU_ADDRESS 0x70002750 /end MEASUREMENT
/begin MEASUREMENT FSTCGTC_RevSpeedKiSumZ "FSTCGTC_RevSpeedKiSumZ" FLOAT32_IEEE F_1_p0_2 1 2 -3.402823466E+038 3.402823466E+038 ECU_ADDRESS 0x7000274C /end MEASUREMENT
/begin MEASUREMENT FSTCGTC_RevSpeedKpSum "FSTCGTC_RevSpeedKpSum" FLOAT32_IEEE F_1_p0_2 1 2 -3.402823466E+038 3.402823466E+038 ECU_ADDRESS 0x70002748 /end MEASUREMENT
/begin MEASUREMENT FSTCGTC_RevSpeedRef "FSTCGTC_RevSpeedRef" FLOAT32_IEEE F_1_p0_2 1 2 -3.402823466E+038 3.402823466E+038 ECU_ADDRESS 0x70002744 /end MEASUREMENT
/begin MEASUREMENT FSTCGTC_RevTorque "FSTCGTC_RevTorque" FLOAT32_IEEE F_1_p0_2 1 2 -3.402823466E+038 3.402823466E+038 ECU_ADDRESS 0x70002740 /end MEASUREMENT
/begin MEASUREMENT FSTCGTC_ShiftingFlg "FSTCGTC_ShiftingFlg" UBYTE Bool_ON_OFF 1 2 0 1 BIT_MASK 0x01 ECU_ADDRESS 0x7000273C /end MEASUREMENT
/begin MEASUREMENT FSTCGTC_SpdLmtIntegratorZ "FSTCGTC_SpdLmtIntegratorZ" FLOAT32_IEEE F_1_p0_2 1 2 -3.402823466E+038 3.402823466E+038 ECU_ADDRESS 0x70002738 /end MEASUREMENT
/begin MEASUREMENT FSTCGTC_SpdLmtSpdErr "FSTCGTC_SpdLmtSpdErr" FLOAT32_IEEE F_1_p0_2 1 2 -3.402823466E+038 3.402823466E+038 ECU_ADDRESS 0x70002734 /end MEASUREMENT
/begin MEASUREMENT FSTCGTC_SpdLmtTorqueTgt "FSTCGTC_SpdLmtTorqueTgt" FLOAT32_IEEE F_1_p0_2 1 2 -3.402823466E+038 3.402823466E+038 ECU_ADDRESS 0x70002730 /end MEASUREMENT
/begin MEASUREMENT FSTCGTC_SpdLmtTrqComp "FSTCGTC_SpdLmtTrqComp" FLOAT32_IEEE F_1_p0_2 1 2 -3.402823466E+038 3.402823466E+038 ECU_ADDRESS 0x7000272C /end MEASUREMENT
/begin MEASUREMENT FSTCGTC_SpdLmtTrqSatZ "FSTCGTC_SpdLmtTrqSatZ" UBYTE Bool_ON_OFF 1 2 0 1 BIT_MASK 0x01 ECU_ADDRESS 0x70002728 /end MEASUREMENT
/begin MEASUREMENT FSTCGTC_StopCheckCnt "FSTCGTC_StopCheckCnt" UWORD F_1_p0_2 1 2 0 65535 ECU_ADDRESS 0x70002726 /end MEASUREMENT
/begin MEASUREMENT FSTCGTC_ToVcuTrqCheckCnt "FSTCGTC_ToVcuTrqCheckCnt" UWORD F_1_p0_2 1 2 0 65535 ECU_ADDRESS 0x70002724 /end MEASUREMENT
/begin MEASUREMENT FSTCGTC_TorquePreTgtZ "FSTCGTC_TorquePreTgtZ" FLOAT32_IEEE F_1_p0_2 1 2 -3.402823466E+038 3.402823466E+038 ECU_ADDRESS 0x70002720 /end MEASUREMENT
/begin MEASUREMENT FSTCGTC_TorqueRefLimZ "FSTCGTC_TorqueRefLimZ" FLOAT32_IEEE F_1_p0_2 1 2 -500 500 ECU_ADDRESS 0x7000271C /end MEASUREMENT
/begin MEASUREMENT FSTCGTC_TorqueTgt "Current value of the torque reference after the second filter." FLOAT32_IEEE F_1_p0_2 1 2 -500 500 ECU_ADDRESS 0x70002718 /end MEASUREMENT
/begin MEASUREMENT FSTCGTC_TorqueTgtPhy "Current value of the torque reference after the second filter." FLOAT32_IEEE F_1_p0_2 1 2 -500 500 ECU_ADDRESS 0x70002714 /end MEASUREMENT
/begin MEASUREMENT FSTCGTC_TorqueTgtPhyComp "Current value of the torque reference after the second filter." FLOAT32_IEEE F_1_p0_2 1 2 -500 500 ECU_ADDRESS 0x70002710 /end MEASUREMENT
/begin MEASUREMENT FSTCGTC_TorqueTgtZ "Previous value of the torque reference after the second filter." FLOAT32_IEEE F_1_p0_2 1 2 -500 500 ECU_ADDRESS 0x7000270C /end MEASUREMENT
/begin MEASUREMENT FSTCGTC_U0dqTgt[0] "FSTCGTC_U0dqTgt" FLOAT32_IEEE F_1_p0_2 1 2 -3.402823466E+038 3.402823466E+038 ECU_ADDRESS 0x70002700 /end MEASUREMENT
/begin MEASUREMENT FSTCGTC_U0dqTgt[1] "FSTCGTC_U0dqTgt" FLOAT32_IEEE F_1_p0_2 1 2 -3.402823466E+038 3.402823466E+038 ECU_ADDRESS 0x70002704 /end MEASUREMENT
/begin MEASUREMENT FSTCGTC_U0dqTgt[2] "FSTCGTC_U0dqTgt" FLOAT32_IEEE F_1_p0_2 1 2 -3.402823466E+038 3.402823466E+038 ECU_ADDRESS 0x70002708 /end MEASUREMENT
/begin MEASUREMENT FSTCGTC_VehicleDirMecaSpeedRpm "FSTCGTC_VehicleDirMecaSpeedRpm" FLOAT32_IEEE F_1_p0_2 1 2 -3.402823466E+038 3.402823466E+038 ECU_ADDRESS 0x700026FC /end MEASUREMENT
/begin MEASUREMENT FSTCGTC_ZeroTorqueCompEnable "FSTCGTC_ZeroTorqueCompEnable" UBYTE Bool_ON_OFF 1 2 0 1 BIT_MASK 0x01 ECU_ADDRESS 0x700026F8 /end MEASUREMENT
/begin MEASUREMENT FS_AN_ExitationDiag_U16 "FS_AN_ExitationDiag_U16" UWORD F_1_p0_2 1 2 0 65535 ECU_ADDRESS 0x70002886 /end MEASUREMENT
/begin MEASUREMENT FS_AN_P5VHSREF_U16 "FS_AN_P5VHSREF_U16" UWORD F_1_p0_2 1 2 0 65535 ECU_ADDRESS 0x70002884 /end MEASUREMENT
/begin MEASUREMENT FS_AccPedPos_F32 "FS_AccPedPos_F32" FLOAT32_IEEE F_1_p0_2 1 2 -3.402823466E+038 3.402823466E+038 ECU_ADDRESS 0x70002880 /end MEASUREMENT
/begin MEASUREMENT FS_BMS_Ubms_F32 "FS_BMS_Ubms_F32" FLOAT32_IEEE F_1_p0_2 1 2 -3.402823466E+038 3.402823466E+038 ECU_ADDRESS 0x7000287C /end MEASUREMENT
/begin MEASUREMENT FS_BMS_stMain_Neg_B "FS_BMS_stMain_Neg_B" UBYTE Bool_ON_OFF 1 2 0 1 BIT_MASK 0x01 ECU_ADDRESS 0x7000287A /end MEASUREMENT
/begin MEASUREMENT FS_BMS_stMain_Pos_B "FS_BMS_stMain_Pos_B" UBYTE Bool_ON_OFF 1 2 0 1 BIT_MASK 0x01 ECU_ADDRESS 0x70002879 /end MEASUREMENT
/begin MEASUREMENT FS_BSWReadyStatus_B "FS_BSWReadyStatus_B" UBYTE Bool_ON_OFF 1 2 0 1 BIT_MASK 0x01 ECU_ADDRESS 0x70002878 /end MEASUREMENT
/begin MEASUREMENT FS_BusVoltageGain_U16 "FS_BusVoltageGain_U16" UWORD F_1_p0_2 1 2 0 65535 ECU_ADDRESS 0x70002876 /end MEASUREMENT
/begin MEASUREMENT FS_CmdFtShutDownRes_B "FS_CmdFtShutDownRes_B" UBYTE Bool_ON_OFF 1 2 0 1 BIT_MASK 0x01 ECU_ADDRESS 0x70002875 /end MEASUREMENT
/begin MEASUREMENT FS_CmdFtStartRes_B "FS_CmdFtStartRes_B" UBYTE Bool_ON_OFF 1 2 0 1 BIT_MASK 0x01 ECU_ADDRESS 0x70002874 /end MEASUREMENT
/begin MEASUREMENT FS_CommandBoardTempHV_U16 "FS_CommandBoardTempHV_U16" UWORD F_1_p0_2 1 2 0 65535 ECU_ADDRESS 0x70002872 /end MEASUREMENT
/begin MEASUREMENT FS_CommandBoardTempLV2_U16 "FS_CommandBoardTempLV2_U16" UWORD F_1_p0_2 1 2 0 65535 ECU_ADDRESS 0x70002870 /end MEASUREMENT
/begin MEASUREMENT FS_CommandBoardTempLV_U16 "FS_CommandBoardTempLV_U16" UWORD F_1_p0_2 1 2 0 65535 ECU_ADDRESS 0x7000286E /end MEASUREMENT
/begin MEASUREMENT FS_CoolTempValidFlag_B "FS_CoolTempValidFlag_B" UBYTE Bool_ON_OFF 1 2 0 1 BIT_MASK 0x01 ECU_ADDRESS 0x7000286C /end MEASUREMENT
/begin MEASUREMENT FS_CoolingTemp_U16 "FS_CoolingTemp_U16" UWORD F_1_p0_2 1 2 0 65535 ECU_ADDRESS 0x7000286A /end MEASUREMENT
/begin MEASUREMENT FS_CosHDiag_U16 "FS_CosHDiag_U16" UWORD F_1_p0_2 1 2 0 65535 ECU_ADDRESS 0x70002868 /end MEASUREMENT
/begin MEASUREMENT FS_CosLDiag_U16 "FS_CosLDiag_U16" UWORD F_1_p0_2 1 2 0 65535 ECU_ADDRESS 0x70002866 /end MEASUREMENT
/begin MEASUREMENT FS_DriverBoardTemp_U16 "FS_DriverBoardTemp_U16" UWORD F_1_p0_2 1 2 0 65535 ECU_ADDRESS 0x70002864 /end MEASUREMENT
/begin MEASUREMENT FS_DutyCycle3_F32[0] "FS_DutyCycle3_F32" FLOAT32_IEEE F_1_p0_2 1 2 -3.402823466E+038 3.402823466E+038 ECU_ADDRESS 0x70002858 /end MEASUREMENT
/begin MEASUREMENT FS_DutyCycle3_F32[1] "FS_DutyCycle3_F32" FLOAT32_IEEE F_1_p0_2 1 2 -3.402823466E+038 3.402823466E+038 ECU_ADDRESS 0x7000285C /end MEASUREMENT
/begin MEASUREMENT FS_DutyCycle3_F32[2] "FS_DutyCycle3_F32" FLOAT32_IEEE F_1_p0_2 1 2 -3.402823466E+038 3.402823466E+038 ECU_ADDRESS 0x70002860 /end MEASUREMENT
/begin MEASUREMENT FS_EXT_CrashOutSts_U8 "FS_EXT_CrashOutSts_U8" UBYTE F_1_p0_2 1 2 0 255 ECU_ADDRESS 0x70002854 /end MEASUREMENT
/begin MEASUREMENT FS_EstPowmdlDrtGain_F32 "FS_EstPowmdlDrtGain_F32" FLOAT32_IEEE F_1_p0_2 1 2 -3.402823466E+038 3.402823466E+038 ECU_ADDRESS 0x70002850 /end MEASUREMENT
/begin MEASUREMENT FS_FTAclState_U16 "FS_FTAclState_U16" UWORD F_1_p0_2 1 2 0 65535 ECU_ADDRESS 0x7000284C /end MEASUREMENT
/begin MEASUREMENT FS_FTRealTrqRate_F32 "FS_FTRealTrqRate_F32" FLOAT32_IEEE F_1_p0_2 1 2 -3.402823466E+038 3.402823466E+038 ECU_ADDRESS 0x70002848 /end MEASUREMENT
/begin MEASUREMENT FS_FTResloverFault_B "FS_FTResloverFault_B" UBYTE Bool_ON_OFF 1 2 0 1 BIT_MASK 0x01 ECU_ADDRESS 0x70002844 /end MEASUREMENT
/begin MEASUREMENT FS_FaultLevel_U16 "FS_FaultLevel_U16" UWORD F_1_p0_2 1 2 0 65535 ECU_ADDRESS 0x70002842 /end MEASUREMENT
/begin MEASUREMENT FS_FootbrakeState_U16 "FS_FootbrakeState_U16" UWORD F_1_p0_2 1 2 0 65535 ECU_ADDRESS 0x70002840 /end MEASUREMENT
/begin MEASUREMENT FS_GCUCooling_F32 "FS_GCUCooling_F32" FLOAT32_IEEE F_1_p0_2 1 2 -3.402823466E+038 3.402823466E+038 ECU_ADDRESS 0x7000283C /end MEASUREMENT
/begin MEASUREMENT FS_HandBrake_B "FS_HandBrake_B" UBYTE Bool_ON_OFF 1 2 0 1 BIT_MASK 0x01 ECU_ADDRESS 0x70002839 /end MEASUREMENT
/begin MEASUREMENT FS_IO_ExitationDiag_B "FS_IO_ExitationDiag_B" UBYTE Bool_ON_OFF 1 2 0 1 BIT_MASK 0x01 ECU_ADDRESS 0x70002838 /end MEASUREMENT
/begin MEASUREMENT FS_Id_ref_F32 "FS_Id_ref_F32" FLOAT32_IEEE F_1_p0_2 1 2 -3.402823466E+038 3.402823466E+038 ECU_ADDRESS 0x70002834 /end MEASUREMENT
/begin MEASUREMENT FS_Iq_ref_F32 "FS_Iq_ref_F32" FLOAT32_IEEE F_1_p0_2 1 2 -3.402823466E+038 3.402823466E+038 ECU_ADDRESS 0x70002830 /end MEASUREMENT
/begin MEASUREMENT FS_Iuvw3_F32[0] "FS_Iuvw3_F32" FLOAT32_IEEE F_1_p0_2 1 2 -3.402823466E+038 3.402823466E+038 ECU_ADDRESS 0x70002824 /end MEASUREMENT
/begin MEASUREMENT FS_Iuvw3_F32[1] "FS_Iuvw3_F32" FLOAT32_IEEE F_1_p0_2 1 2 -3.402823466E+038 3.402823466E+038 ECU_ADDRESS 0x70002828 /end MEASUREMENT
/begin MEASUREMENT FS_Iuvw3_F32[2] "FS_Iuvw3_F32" FLOAT32_IEEE F_1_p0_2 1 2 -3.402823466E+038 3.402823466E+038 ECU_ADDRESS 0x7000282C /end MEASUREMENT
/begin MEASUREMENT FS_KEY_ON_B "FS_KEY_ON_B" UBYTE Bool_ON_OFF 1 2 0 1 BIT_MASK 0x01 ECU_ADDRESS 0x70002820 /end MEASUREMENT
/begin MEASUREMENT FS_MaxMinTorqueAvailable_F32 "FS_MaxMinTorqueAvailable_F32" FLOAT32_IEEE F_1_p0_2 1 2 -3.402823466E+038 3.402823466E+038 ECU_ADDRESS 0x70002818 /end MEASUREMENT
/begin MEASUREMENT FS_MecaSpeedRds_F32 "FS_MecaSpeedRds_F32" FLOAT32_IEEE F_1_p0_2 1 2 -3.402823466E+038 3.402823466E+038 ECU_ADDRESS 0x70002814 /end MEASUREMENT
/begin MEASUREMENT FS_MecaSpeedRpm_F32 "FS_MecaSpeedRpm_F32" FLOAT32_IEEE F_1_p0_2 1 2 -3.402823466E+038 3.402823466E+038 ECU_ADDRESS 0x70002810 /end MEASUREMENT
/begin MEASUREMENT FS_MotorAppliedTorque_F32 "FS_MotorAppliedTorque_F32" FLOAT32_IEEE F_1_p0_2 1 2 -3.402823466E+038 3.402823466E+038 ECU_ADDRESS 0x7000280C /end MEASUREMENT
/begin MEASUREMENT FS_MotorMagnetDrtGain_F32 "FS_MotorMagnetDrtGain_F32" FLOAT32_IEEE F_1_p0_2 1 2 -3.402823466E+038 3.402823466E+038 ECU_ADDRESS 0x70002808 /end MEASUREMENT
/begin MEASUREMENT FS_MotorWindingDrtGain_F32 "FS_MotorWindingDrtGain_F32" FLOAT32_IEEE F_1_p0_2 1 2 -3.402823466E+038 3.402823466E+038 ECU_ADDRESS 0x70002804 /end MEASUREMENT
/begin MEASUREMENT FS_MotorWindingTemp1_U16 "FS_MotorWindingTemp1_U16" UWORD F_1_p0_2 1 2 0 65535 ECU_ADDRESS 0x70002800 /end MEASUREMENT
/begin MEASUREMENT FS_MotorWindingTemp2_U16 "FS_MotorWindingTemp2_U16" UWORD F_1_p0_2 1 2 0 65535 ECU_ADDRESS 0x700027FE /end MEASUREMENT
/begin MEASUREMENT FS_OcCycleFinish_B "FS_OcCycleFinish_B" UBYTE Bool_ON_OFF 1 2 0 1 BIT_MASK 0x01 ECU_ADDRESS 0x700027FD /end MEASUREMENT
/begin MEASUREMENT FS_OcRotoringFailFlg_B "FS_OcRotoringFailFlg_B" UBYTE Bool_ON_OFF 1 2 0 1 BIT_MASK 0x01 ECU_ADDRESS 0x700027FC /end MEASUREMENT
/begin MEASUREMENT FS_P5VPort_U16 "FS_P5VPort_U16" UWORD F_1_p0_2 1 2 0 65535 ECU_ADDRESS 0x700027FA /end MEASUREMENT
/begin MEASUREMENT FS_PowerModuleTemp_U_U16 "FS_PowerModuleTemp_U_U16" UWORD F_1_p0_2 1 2 0 65535 ECU_ADDRESS 0x700027F8 /end MEASUREMENT
/begin MEASUREMENT FS_PowerModuleTemp_V_U16 "FS_PowerModuleTemp_V_U16" UWORD F_1_p0_2 1 2 0 65535 ECU_ADDRESS 0x700027F6 /end MEASUREMENT
/begin MEASUREMENT FS_PowerModuleTemp_W_U16 "FS_PowerModuleTemp_W_U16" UWORD F_1_p0_2 1 2 0 65535 ECU_ADDRESS 0x700027F4 /end MEASUREMENT
/begin MEASUREMENT FS_PowmdlDrtGain_F32 "FS_PowmdlDrtGain_F32" FLOAT32_IEEE F_1_p0_2 1 2 -3.402823466E+038 3.402823466E+038 ECU_ADDRESS 0x700027F0 /end MEASUREMENT
/begin MEASUREMENT FS_SinHDiag_U16 "FS_SinHDiag_U16" UWORD F_1_p0_2 1 2 0 65535 ECU_ADDRESS 0x700027EC /end MEASUREMENT
/begin MEASUREMENT FS_SinLDiag_U16 "FS_SinLDiag_U16" UWORD F_1_p0_2 1 2 0 65535 ECU_ADDRESS 0x700027EA /end MEASUREMENT
/begin MEASUREMENT FS_SlideSlopReq_B "FS_SlideSlopReq_B" UBYTE Bool_ON_OFF 1 2 0 1 BIT_MASK 0x01 ECU_ADDRESS 0x700027E8 /end MEASUREMENT
/begin MEASUREMENT FS_TorqueSlewRate_F32 "FS_TorqueSlewRate_F32" FLOAT32_IEEE F_1_p0_2 1 2 -3.402823466E+038 3.402823466E+038 ECU_ADDRESS 0x700027E4 /end MEASUREMENT
/begin MEASUREMENT FS_UbatHV2_U16 "FS_UbatHV2_U16" UWORD F_1_p0_2 1 2 0 65535 ECU_ADDRESS 0x700027E2 /end MEASUREMENT
/begin MEASUREMENT FS_UbatHV_U16 "FS_UbatHV_U16" UWORD F_1_p0_2 1 2 0 65535 ECU_ADDRESS 0x700027E0 /end MEASUREMENT
/begin MEASUREMENT FS_UbatLV_U16 "FS_UbatLV_U16" UWORD F_1_p0_2 1 2 0 65535 ECU_ADDRESS 0x700027DE /end MEASUREMENT
/begin MEASUREMENT FS_UdsOcEnable_B "FS_UdsOcEnable_B" UBYTE Bool_ON_OFF 1 2 0 1 BIT_MASK 0x01 ECU_ADDRESS 0x700027DC /end MEASUREMENT
/begin MEASUREMENT FS_UdsOcRdResFlag_B "FS_UdsOcRdResFlag_B" UBYTE Bool_ON_OFF 1 2 0 1 BIT_MASK 0x01 ECU_ADDRESS 0x700027DB /end MEASUREMENT
/begin MEASUREMENT FS_UdsOcStartReq_B "FS_UdsOcStartReq_B" UBYTE Bool_ON_OFF 1 2 0 1 BIT_MASK 0x01 ECU_ADDRESS 0x700027DA /end MEASUREMENT
/begin MEASUREMENT FS_VCU_AKD_Req_B "FS_VCU_AKD_Req_B" UBYTE Bool_ON_OFF 1 2 0 1 BIT_MASK 0x01 ECU_ADDRESS 0x700027D9 /end MEASUREMENT
/begin MEASUREMENT FS_VCU_DCU_ModeReq_U8 "FS_VCU_DCU_ModeReq_U8" UBYTE F_1_p0_2 1 2 0 255 ECU_ADDRESS 0x700027D8 /end MEASUREMENT
/begin MEASUREMENT FS_VCU_DCU_SpdSet_F32 "FS_VCU_DCU_SpdSet_F32" FLOAT32_IEEE F_1_p0_2 1 2 -1000000 1000000 ECU_ADDRESS 0x700027D4 /end MEASUREMENT
/begin MEASUREMENT FS_VCU_DCU_TorqMax_F32 "FS_VCU_DCU_TorqMax_F32" FLOAT32_IEEE F_1_p0_2 1 2 -500 500 ECU_ADDRESS 0x700027D0 /end MEASUREMENT
/begin MEASUREMENT FS_VCU_DCU_TorqMin_F32 "FS_VCU_DCU_TorqMin_F32" FLOAT32_IEEE F_1_p0_2 1 2 -500 500 ECU_ADDRESS 0x700027CC /end MEASUREMENT
/begin MEASUREMENT FS_VCU_DCU_TorqSet_F32 "FS_VCU_DCU_TorqSet_F32" FLOAT32_IEEE F_1_p0_2 1 2 -500 500 ECU_ADDRESS 0x700027C8 /end MEASUREMENT
/begin MEASUREMENT FS_VCU_PowerOff_Req_B "FS_VCU_PowerOff_Req_B" UBYTE Bool_ON_OFF 1 2 0 1 BIT_MASK 0x01 ECU_ADDRESS 0x700027C5 /end MEASUREMENT
/begin MEASUREMENT FS_VCU_PreChargeRlySts_B "FS_VCU_PreChargeRlySts_B" UBYTE Bool_ON_OFF 1 2 0 1 BIT_MASK 0x01 ECU_ADDRESS 0x700027C4 /end MEASUREMENT
/begin MEASUREMENT FS_VcuMcuEnableReq_U8 "FS_VcuMcuEnableReq_U8" UBYTE F_1_p0_2 1 2 0 255 ECU_ADDRESS 0x700027C3 /end MEASUREMENT
/begin MEASUREMENT FS_VehicleGear_U8 "FS_VehicleGear_U8" UBYTE F_1_p0_2 1 2 0 255 ECU_ADDRESS 0x700027C2 /end MEASUREMENT
/begin MEASUREMENT GESM_ESM_MODE_FT "GESM_ESM_MODE_FT" UBYTE Bool_ON_OFF 1 2 0 1 BIT_MASK 0x04 ECU_ADDRESS 0x70021FC4 /end MEASUREMENT
/begin MEASUREMENT GESM_ESM_MODE_NF "GESM_ESM_MODE_NF" UBYTE Bool_ON_OFF 1 2 0 1 BIT_MASK 0x01 ECU_ADDRESS 0x70021FC4 /end MEASUREMENT
/begin MEASUREMENT GESM_EsmMode "GESM_EsmMode" UWORD GESM_EsmMode_conv 1 2 1 4 ECU_ADDRESS 0x70021FC4 /end MEASUREMENT
/begin MEASUREMENT GESM_OpFtState "GESM_OpFtState" UWORD I_1 1 2 0 65535 ECU_ADDRESS 0x70021FB8 /end MEASUREMENT
/begin MEASUREMENT GESM_OpNfState "GESM_OpNfState" UWORD I_1 1 2 0 65535 ECU_ADDRESS 0x70021FB6 /end MEASUREMENT
/begin MEASUREMENT GESM_PwrLFtState "GESM_PwrLFtState" UWORD I_1 1 2 0 65535 ECU_ADDRESS 0x70021FB4 /end MEASUREMENT
/begin MEASUREMENT GESM_PwrLNfState "GESM_PwrLNfState" UWORD I_1 1 2 0 65535 ECU_ADDRESS 0x70021FB2 /end MEASUREMENT
/begin MEASUREMENT GESM_StpIIFtState "GESM_StpIIFtState" UWORD I_1 1 2 0 65535 ECU_ADDRESS 0x70021FAC /end MEASUREMENT
/begin MEASUREMENT GESM_StpIINfState "GESM_StpIINfState" UWORD I_1 1 2 0 65535 ECU_ADDRESS 0x70021FAA /end MEASUREMENT
/begin MEASUREMENT GESM_StpIState "GESM_StpIState" UWORD I_1 1 2 0 65535 ECU_ADDRESS 0x70021FA8 /end MEASUREMENT
/begin MEASUREMENT GESM_bAfterrunFin "GESM_bAfterrunFin" UBYTE Bool_ON_OFF 1 2 0 1 BIT_MASK 0x01 ECU_ADDRESS 0x70021FC2 /end MEASUREMENT
/begin MEASUREMENT GESM_bAfterrunReq "GESM_bAfterrunReq" UBYTE Bool_ON_OFF 1 2 0 1 BIT_MASK 0x01 ECU_ADDRESS 0x70021FC1 /end MEASUREMENT
/begin MEASUREMENT GESM_bCallAppliOn "GESM_bCallAppliOn" UBYTE Bool_ON_OFF 1 2 0 1 BIT_MASK 0x01 ECU_ADDRESS 0x70021FC0 /end MEASUREMENT
/begin MEASUREMENT GESM_bMcuEnaReq "GESM_bMcuEnaReq" UBYTE Bool_ON_OFF 1 2 0 1 BIT_MASK 0x01 ECU_ADDRESS 0x70021FBF /end MEASUREMENT
/begin MEASUREMENT GESM_bPwrDnReadyFlg "GESM_bPwrDnReadyFlg" UBYTE Bool_ON_OFF 1 2 0 1 BIT_MASK 0x01 ECU_ADDRESS 0x70021FBE /end MEASUREMENT
/begin MEASUREMENT GESM_bPwrLNfClrFltFinsh "GESM_bPwrLNfClrFltFinsh" UBYTE Bool_ON_OFF 1 2 0 1 BIT_MASK 0x01 ECU_ADDRESS 0x70021FBD /end MEASUREMENT
/begin MEASUREMENT GESM_u16AfterrunCnt "GESM_u16AfterrunCnt" UWORD I_1 1 2 0 65535 ECU_ADDRESS 0x70021FA6 /end MEASUREMENT
/begin MEASUREMENT GESM_u16CmdReq "GESM_u16CmdReq" UWORD I_1 1 2 0 65535 ECU_ADDRESS 0x70021FA4 /end MEASUREMENT
/begin MEASUREMENT GESM_u16CmdReqNm1 "GESM_u16CmdReqNm1" UWORD I_1 1 2 0 65535 ECU_ADDRESS 0x70021FA2 /end MEASUREMENT
/begin MEASUREMENT GESM_u16CmdRes "GESM_u16CmdRes" UWORD I_1 1 2 0 65535 ECU_ADDRESS 0x70021FA0 /end MEASUREMENT
/begin MEASUREMENT GESM_u8AllowPwrDnDelay "GESM_u8AllowPwrDnDelay" UBYTE I_1 1 2 0 255 ECU_ADDRESS 0x70021FBC /end MEASUREMENT
/begin MEASUREMENT GESM_u8PwrLNfStep "GESM_u8PwrLNfStep" UBYTE I_1 1 2 0 255 ECU_ADDRESS 0x70021FBB /end MEASUREMENT
/begin MEASUREMENT GESM_u8PwrOffTim "GESM_u8PwrOffTim" UBYTE I_1 1 2 0 255 ECU_ADDRESS 0x70021FBA /end MEASUREMENT
/begin MEASUREMENT GESM_u8RestartDelayCnt "GESM_u8RestartDelayCnt" UBYTE I_1 1 2 0 255 ECU_ADDRESS 0x70021F9F /end MEASUREMENT
/begin MEASUREMENT RCEVHCM_A2DResCorrdVoltage "RCEVHCM_A2DResCorrdVoltage" FLOAT32_IEEE F_1_p0_2 1 2 -3.402823466E+038 3.402823466E+038 ECU_ADDRESS 0x70002BA8 /end MEASUREMENT
/begin MEASUREMENT RCEVHCM_A2DResCorrdVoltage1 "RCEVHCM_A2DResCorrdVoltage1" FLOAT32_IEEE F_1_p0_2 1 2 -3.402823466E+038 3.402823466E+038 ECU_ADDRESS 0x70002BA4 /end MEASUREMENT
/begin MEASUREMENT RCEVHCM_A2DResCorrdVoltage2 "RCEVHCM_A2DResCorrdVoltage2" FLOAT32_IEEE F_1_p0_2 1 2 -3.402823466E+038 3.402823466E+038 ECU_ADDRESS 0x70002BA0 /end MEASUREMENT
/begin MEASUREMENT RCEVHCM_A2DResCorrdVoltage3 "RCEVHCM_A2DResCorrdVoltage3" FLOAT32_IEEE F_1_p0_2 1 2 -3.402823466E+038 3.402823466E+038 ECU_ADDRESS 0x70002B9C /end MEASUREMENT
/begin MEASUREMENT RCEVHCM_A2DResCorrdVoltage4 "RCEVHCM_A2DResCorrdVoltage4" FLOAT32_IEEE F_1_p0_2 1 2 -3.402823466E+038 3.402823466E+038 ECU_ADDRESS 0x70002B98 /end MEASUREMENT
/begin MEASUREMENT RCEVHCM_A2DResCorrdVoltage5 "RCEVHCM_A2DResCorrdVoltage5" FLOAT32_IEEE F_1_p0_2 1 2 -3.402823466E+038 3.402823466E+038 ECU_ADDRESS 0x70002B94 /end MEASUREMENT
/begin MEASUREMENT RCEVHCM_A2DResCorrdVoltage6 "RCEVHCM_A2DResCorrdVoltage6" FLOAT32_IEEE F_1_p0_2 1 2 -3.402823466E+038 3.402823466E+038 ECU_ADDRESS 0x70002B90 /end MEASUREMENT
/begin MEASUREMENT RCEVHCM_A2DResCorrdVoltage7 "RCEVHCM_A2DResCorrdVoltage7" FLOAT32_IEEE F_1_p0_2 1 2 -3.402823466E+038 3.402823466E+038 ECU_ADDRESS 0x70002B8C /end MEASUREMENT
/begin MEASUREMENT RCEVHCM_A2DResCorrdVoltage8 "RCEVHCM_A2DResCorrdVoltage8" FLOAT32_IEEE F_1_p0_2 1 2 -3.402823466E+038 3.402823466E+038 ECU_ADDRESS 0x70002B88 /end MEASUREMENT
/begin MEASUREMENT RCEVHCM_BusCloseFlg "RCEVHCM_BusCloseFlg" UBYTE Bool_ON_OFF 1 2 0 1 BIT_MASK 0x01 ECU_ADDRESS 0x70002B84 /end MEASUREMENT
/begin MEASUREMENT RCEVHCM_BusVoltage "RCEVHCM_BusVoltage" FLOAT32_IEEE F_1_p0_2 1 2 -3.402823466E+038 3.402823466E+038 ECU_ADDRESS 0x70002B80 /end MEASUREMENT
/begin MEASUREMENT RCEVHCM_BusVoltageFild "RCEVHCM_BusVoltageFild" FLOAT32_IEEE F_1_p0_2 1 2 -3.402823466E+038 3.402823466E+038 ECU_ADDRESS 0x70002B7C /end MEASUREMENT
/begin MEASUREMENT RCEVHCM_BusVoltageFildZ "RCEVHCM_BusVoltageFildZ" FLOAT32_IEEE F_1_p0_2 1 2 -3.402823466E+038 3.402823466E+038 ECU_ADDRESS 0x70002B78 /end MEASUREMENT
/begin MEASUREMENT RCEVHCM_KM1CloseFlg "RCEVHCM_KM1CloseFlg" UBYTE Bool_ON_OFF 1 2 0 1 BIT_MASK 0x01 ECU_ADDRESS 0x70002B74 /end MEASUREMENT
/begin MEASUREMENT RCEVHCM_KM1Voltage "RCEVHCM_KM1Voltage" FLOAT32_IEEE F_1_p0_2 1 2 -3.402823466E+038 3.402823466E+038 ECU_ADDRESS 0x70002B70 /end MEASUREMENT
/begin MEASUREMENT RCEVHCM_KM1VoltageFild "RCEVHCM_KM1VoltageFild" FLOAT32_IEEE F_1_p0_2 1 2 -3.402823466E+038 3.402823466E+038 ECU_ADDRESS 0x70002B6C /end MEASUREMENT
/begin MEASUREMENT RCEVHCM_KM1VoltageFildZ "RCEVHCM_KM1VoltageFildZ" FLOAT32_IEEE F_1_p0_2 1 2 -3.402823466E+038 3.402823466E+038 ECU_ADDRESS 0x70002B68 /end MEASUREMENT
/begin MEASUREMENT RCEVHCM_KM2CloseFlg "RCEVHCM_KM2CloseFlg" UBYTE Bool_ON_OFF 1 2 0 1 BIT_MASK 0x01 ECU_ADDRESS 0x70002B64 /end MEASUREMENT
/begin MEASUREMENT RCEVHCM_KM2Voltage "RCEVHCM_KM2Voltage" FLOAT32_IEEE F_1_p0_2 1 2 -3.402823466E+038 3.402823466E+038 ECU_ADDRESS 0x70002B60 /end MEASUREMENT
/begin MEASUREMENT RCEVHCM_KM2VoltageFild "RCEVHCM_KM2VoltageFild" FLOAT32_IEEE F_1_p0_2 1 2 -3.402823466E+038 3.402823466E+038 ECU_ADDRESS 0x70002B5C /end MEASUREMENT
/begin MEASUREMENT RCEVHCM_KM2VoltageFildZ "RCEVHCM_KM2VoltageFildZ" FLOAT32_IEEE F_1_p0_2 1 2 -3.402823466E+038 3.402823466E+038 ECU_ADDRESS 0x70002B58 /end MEASUREMENT
/begin MEASUREMENT RCEVHCM_KM3CloseFlg "RCEVHCM_KM3CloseFlg" UBYTE Bool_ON_OFF 1 2 0 1 BIT_MASK 0x01 ECU_ADDRESS 0x70002B54 /end MEASUREMENT
/begin MEASUREMENT RCEVHCM_KM3Voltage "RCEVHCM_KM3Voltage" FLOAT32_IEEE F_1_p0_2 1 2 -3.402823466E+038 3.402823466E+038 ECU_ADDRESS 0x70002B50 /end MEASUREMENT
/begin MEASUREMENT RCEVHCM_KM3VoltageFild "RCEVHCM_KM3VoltageFild" FLOAT32_IEEE F_1_p0_2 1 2 -3.402823466E+038 3.402823466E+038 ECU_ADDRESS 0x70002B4C /end MEASUREMENT
/begin MEASUREMENT RCEVHCM_KM3VoltageFildZ "RCEVHCM_KM3VoltageFildZ" FLOAT32_IEEE F_1_p0_2 1 2 -3.402823466E+038 3.402823466E+038 ECU_ADDRESS 0x70002B48 /end MEASUREMENT
/begin MEASUREMENT RCEVHCM_KM4CloseFlg "RCEVHCM_KM4CloseFlg" UBYTE Bool_ON_OFF 1 2 0 1 BIT_MASK 0x01 ECU_ADDRESS 0x70002B44 /end MEASUREMENT
/begin MEASUREMENT RCEVHCM_KM4Voltage "RCEVHCM_KM4Voltage" FLOAT32_IEEE F_1_p0_2 1 2 -3.402823466E+038 3.402823466E+038 ECU_ADDRESS 0x70002B40 /end MEASUREMENT
/begin MEASUREMENT RCEVHCM_KM4VoltageFild "RCEVHCM_KM4VoltageFild" FLOAT32_IEEE F_1_p0_2 1 2 -3.402823466E+038 3.402823466E+038 ECU_ADDRESS 0x70002B3C /end MEASUREMENT
/begin MEASUREMENT RCEVHCM_KM4VoltageFildZ "RCEVHCM_KM4VoltageFildZ" FLOAT32_IEEE F_1_p0_2 1 2 -3.402823466E+038 3.402823466E+038 ECU_ADDRESS 0x70002B38 /end MEASUREMENT
/begin MEASUREMENT RCEVHCM_KM5CloseFlg "RCEVHCM_KM5CloseFlg" UBYTE Bool_ON_OFF 1 2 0 1 BIT_MASK 0x01 ECU_ADDRESS 0x70002B34 /end MEASUREMENT
/begin MEASUREMENT RCEVHCM_KM5Voltage "RCEVHCM_KM5Voltage" FLOAT32_IEEE F_1_p0_2 1 2 -3.402823466E+038 3.402823466E+038 ECU_ADDRESS 0x70002B30 /end MEASUREMENT
/begin MEASUREMENT RCEVHCM_KM5VoltageFild "RCEVHCM_KM5VoltageFild" FLOAT32_IEEE F_1_p0_2 1 2 -3.402823466E+038 3.402823466E+038 ECU_ADDRESS 0x70002B2C /end MEASUREMENT
/begin MEASUREMENT RCEVHCM_KM5VoltageFildZ "RCEVHCM_KM5VoltageFildZ" FLOAT32_IEEE F_1_p0_2 1 2 -3.402823466E+038 3.402823466E+038 ECU_ADDRESS 0x70002B28 /end MEASUREMENT
/begin MEASUREMENT RCEVHCM_KM6CloseFlg "RCEVHCM_KM6CloseFlg" UBYTE Bool_ON_OFF 1 2 0 1 BIT_MASK 0x01 ECU_ADDRESS 0x70002B24 /end MEASUREMENT
/begin MEASUREMENT RCEVHCM_KM6Voltage "RCEVHCM_KM6Voltage" FLOAT32_IEEE F_1_p0_2 1 2 -3.402823466E+038 3.402823466E+038 ECU_ADDRESS 0x70002B20 /end MEASUREMENT
/begin MEASUREMENT RCEVHCM_KM6VoltageFild "RCEVHCM_KM6VoltageFild" FLOAT32_IEEE F_1_p0_2 1 2 -3.402823466E+038 3.402823466E+038 ECU_ADDRESS 0x70002B1C /end MEASUREMENT
/begin MEASUREMENT RCEVHCM_KM6VoltageFildZ "RCEVHCM_KM6VoltageFildZ" FLOAT32_IEEE F_1_p0_2 1 2 -3.402823466E+038 3.402823466E+038 ECU_ADDRESS 0x70002B18 /end MEASUREMENT
/begin MEASUREMENT RCEVHCM_KM7CloseFlg "RCEVHCM_KM7CloseFlg" UBYTE Bool_ON_OFF 1 2 0 1 BIT_MASK 0x01 ECU_ADDRESS 0x70002B14 /end MEASUREMENT
/begin MEASUREMENT RCEVHCM_KM7Voltage "RCEVHCM_KM7Voltage" FLOAT32_IEEE F_1_p0_2 1 2 -3.402823466E+038 3.402823466E+038 ECU_ADDRESS 0x70002B10 /end MEASUREMENT
/begin MEASUREMENT RCEVHCM_KM7VoltageFild "RCEVHCM_KM7VoltageFild" FLOAT32_IEEE F_1_p0_2 1 2 -3.402823466E+038 3.402823466E+038 ECU_ADDRESS 0x70002B0C /end MEASUREMENT
/begin MEASUREMENT RCEVHCM_KM7VoltageFildZ "RCEVHCM_KM7VoltageFildZ" FLOAT32_IEEE F_1_p0_2 1 2 -3.402823466E+038 3.402823466E+038 ECU_ADDRESS 0x70002B08 /end MEASUREMENT
/begin MEASUREMENT RCEVHCM_KM8CloseFlg "RCEVHCM_KM8CloseFlg" UBYTE Bool_ON_OFF 1 2 0 1 BIT_MASK 0x01 ECU_ADDRESS 0x70002B04 /end MEASUREMENT
/begin MEASUREMENT RCEVHCM_KM8Voltage "RCEVHCM_KM8Voltage" FLOAT32_IEEE F_1_p0_2 1 2 -3.402823466E+038 3.402823466E+038 ECU_ADDRESS 0x70002B00 /end MEASUREMENT
/begin MEASUREMENT RCEVHCM_KM8VoltageFild "RCEVHCM_KM8VoltageFild" FLOAT32_IEEE F_1_p0_2 1 2 -3.402823466E+038 3.402823466E+038 ECU_ADDRESS 0x70002AFC /end MEASUREMENT
/begin MEASUREMENT RCEVHCM_KM8VoltageFildZ "RCEVHCM_KM8VoltageFildZ" FLOAT32_IEEE F_1_p0_2 1 2 -3.402823466E+038 3.402823466E+038 ECU_ADDRESS 0x70002AF8 /end MEASUREMENT
/begin MEASUREMENT RCSMACS_BswKM1PowerOff "RCSMACS_BswKM1PowerOff" UBYTE Bool_ON_OFF 1 2 0 1 BIT_MASK 0x01 ECU_ADDRESS 0x70002ADB /end MEASUREMENT
/begin MEASUREMENT RCSMACS_BswKM1PowerOn "RCSMACS_BswKM1PowerOn" UBYTE Bool_ON_OFF 1 2 0 1 BIT_MASK 0x01 ECU_ADDRESS 0x70002ADA /end MEASUREMENT
/begin MEASUREMENT RCSMACS_BswKM2PowerOff "RCSMACS_BswKM2PowerOff" UBYTE Bool_ON_OFF 1 2 0 1 BIT_MASK 0x01 ECU_ADDRESS 0x70002AD9 /end MEASUREMENT
/begin MEASUREMENT RCSMACS_BswKM2PowerOn "RCSMACS_BswKM2PowerOn" UBYTE Bool_ON_OFF 1 2 0 1 BIT_MASK 0x01 ECU_ADDRESS 0x70002AD8 /end MEASUREMENT
/begin MEASUREMENT RCSMACS_BswKM3PowerOff "RCSMACS_BswKM3PowerOff" UBYTE Bool_ON_OFF 1 2 0 1 BIT_MASK 0x01 ECU_ADDRESS 0x70002AD7 /end MEASUREMENT
/begin MEASUREMENT RCSMACS_BswKM3PowerOn "RCSMACS_BswKM3PowerOn" UBYTE Bool_ON_OFF 1 2 0 1 BIT_MASK 0x01 ECU_ADDRESS 0x70002AD6 /end MEASUREMENT
/begin MEASUREMENT RCSMACS_BswKM4PowerOff "RCSMACS_BswKM4PowerOff" UBYTE Bool_ON_OFF 1 2 0 1 BIT_MASK 0x01 ECU_ADDRESS 0x70002AD5 /end MEASUREMENT
/begin MEASUREMENT RCSMACS_BswKM4PowerOn "RCSMACS_BswKM4PowerOn" UBYTE Bool_ON_OFF 1 2 0 1 BIT_MASK 0x01 ECU_ADDRESS 0x70002AD4 /end MEASUREMENT
/begin MEASUREMENT RCSMACS_BswKM5PowerOff "RCSMACS_BswKM5PowerOff" UBYTE Bool_ON_OFF 1 2 0 1 BIT_MASK 0x01 ECU_ADDRESS 0x70002AD3 /end MEASUREMENT
/begin MEASUREMENT RCSMACS_BswKM5PowerOn "RCSMACS_BswKM5PowerOn" UBYTE Bool_ON_OFF 1 2 0 1 BIT_MASK 0x01 ECU_ADDRESS 0x70002AD2 /end MEASUREMENT
/begin MEASUREMENT RCSMACS_BswKM6PowerOff "RCSMACS_BswKM6PowerOff" UBYTE Bool_ON_OFF 1 2 0 1 BIT_MASK 0x01 ECU_ADDRESS 0x70002AD1 /end MEASUREMENT
/begin MEASUREMENT RCSMACS_BswKM6PowerOn "RCSMACS_BswKM6PowerOn" UBYTE Bool_ON_OFF 1 2 0 1 BIT_MASK 0x01 ECU_ADDRESS 0x70002AD0 /end MEASUREMENT
/begin MEASUREMENT RCSMACS_BswKM7PowerOff "RCSMACS_BswKM7PowerOff" UBYTE Bool_ON_OFF 1 2 0 1 BIT_MASK 0x01 ECU_ADDRESS 0x70002ACF /end MEASUREMENT
/begin MEASUREMENT RCSMACS_BswKM7PowerOn "RCSMACS_BswKM7PowerOn" UBYTE Bool_ON_OFF 1 2 0 1 BIT_MASK 0x01 ECU_ADDRESS 0x70002ACE /end MEASUREMENT
/begin MEASUREMENT RCSMACS_BswKM8PowerOff "RCSMACS_BswKM8PowerOff" UBYTE Bool_ON_OFF 1 2 0 1 BIT_MASK 0x01 ECU_ADDRESS 0x70002ACD /end MEASUREMENT
/begin MEASUREMENT RCSMACS_BswKM8PowerOn "RCSMACS_BswKM8PowerOn" UBYTE Bool_ON_OFF 1 2 0 1 BIT_MASK 0x01 ECU_ADDRESS 0x70002ACC /end MEASUREMENT
/begin MEASUREMENT RCSMACS_Err1CheckFinish "RCSMACS_Err1CheckFinish" UBYTE Bool_ON_OFF 1 2 0 1 BIT_MASK 0x01 ECU_ADDRESS 0x70002ACB /end MEASUREMENT
/begin MEASUREMENT RCSMACS_Err2CheckFinish "RCSMACS_Err2CheckFinish" UBYTE Bool_ON_OFF 1 2 0 1 BIT_MASK 0x01 ECU_ADDRESS 0x70002ACA /end MEASUREMENT
/begin MEASUREMENT RCSMACS_Err3CheckFinish "RCSMACS_Err3CheckFinish" UBYTE Bool_ON_OFF 1 2 0 1 BIT_MASK 0x01 ECU_ADDRESS 0x70002AC9 /end MEASUREMENT
/begin MEASUREMENT RCSMACS_Err4CheckFinish "RCSMACS_Err4CheckFinish" UBYTE Bool_ON_OFF 1 2 0 1 BIT_MASK 0x01 ECU_ADDRESS 0x70002AC8 /end MEASUREMENT
/begin MEASUREMENT RCSMACS_Err5CheckFinish "RCSMACS_Err5CheckFinish" UBYTE Bool_ON_OFF 1 2 0 1 BIT_MASK 0x01 ECU_ADDRESS 0x70002AC7 /end MEASUREMENT
/begin MEASUREMENT RCSMACS_Err6CheckFinish "RCSMACS_Err6CheckFinish" UBYTE Bool_ON_OFF 1 2 0 1 BIT_MASK 0x01 ECU_ADDRESS 0x70002AC6 /end MEASUREMENT
/begin MEASUREMENT RCSMACS_Err7CheckFinish "RCSMACS_Err7CheckFinish" UBYTE Bool_ON_OFF 1 2 0 1 BIT_MASK 0x01 ECU_ADDRESS 0x70002AC5 /end MEASUREMENT
/begin MEASUREMENT RCSMACS_Err8CheckFinish "RCSMACS_Err8CheckFinish" UBYTE Bool_ON_OFF 1 2 0 1 BIT_MASK 0x01 ECU_ADDRESS 0x70002AC4 /end MEASUREMENT
/begin MEASUREMENT RCSMACS_KM1AclState "RCSMACS_KM1AclState" UWORD F_1_p0_2 1 2 0 65535 ECU_ADDRESS 0x70002AC2 /end MEASUREMENT
/begin MEASUREMENT RCSMACS_KM1ConnectSts "RCSMACS_KM1ConnectSts" UWORD F_1_p0_2 1 2 0 65535 ECU_ADDRESS 0x70002AC0 /end MEASUREMENT
/begin MEASUREMENT RCSMACS_KM1FaultSts "RCSMACS_KM1FaultSts" UWORD F_1_p0_2 1 2 0 65535 ECU_ADDRESS 0x70002ABE /end MEASUREMENT
/begin MEASUREMENT RCSMACS_KM1StateChange "RCSMACS_KM1StateChange" UWORD F_1_p0_2 1 2 0 65535 ECU_ADDRESS 0x70002ABC /end MEASUREMENT
/begin MEASUREMENT RCSMACS_KM2AclState "RCSMACS_KM2AclState" UWORD F_1_p0_2 1 2 0 65535 ECU_ADDRESS 0x70002ABA /end MEASUREMENT
/begin MEASUREMENT RCSMACS_KM2ConnectSts "RCSMACS_KM2ConnectSts" UWORD F_1_p0_2 1 2 0 65535 ECU_ADDRESS 0x70002AB8 /end MEASUREMENT
/begin MEASUREMENT RCSMACS_KM2FaultSts "RCSMACS_KM2FaultSts" UWORD F_1_p0_2 1 2 0 65535 ECU_ADDRESS 0x70002AB6 /end MEASUREMENT
/begin MEASUREMENT RCSMACS_KM2StateChange "RCSMACS_KM2StateChange" UWORD F_1_p0_2 1 2 0 65535 ECU_ADDRESS 0x70002AB4 /end MEASUREMENT
/begin MEASUREMENT RCSMACS_KM3AclState "RCSMACS_KM3AclState" UWORD F_1_p0_2 1 2 0 65535 ECU_ADDRESS 0x70002AB2 /end MEASUREMENT
/begin MEASUREMENT RCSMACS_KM3ConnectSts "RCSMACS_KM3ConnectSts" UWORD F_1_p0_2 1 2 0 65535 ECU_ADDRESS 0x70002AB0 /end MEASUREMENT
/begin MEASUREMENT RCSMACS_KM3FaultSts "RCSMACS_KM3FaultSts" UWORD F_1_p0_2 1 2 0 65535 ECU_ADDRESS 0x70002AAE /end MEASUREMENT
/begin MEASUREMENT RCSMACS_KM3StateChange "RCSMACS_KM3StateChange" UWORD F_1_p0_2 1 2 0 65535 ECU_ADDRESS 0x70002AAC /end MEASUREMENT
/begin MEASUREMENT RCSMACS_KM4AclState "RCSMACS_KM4AclState" UWORD F_1_p0_2 1 2 0 65535 ECU_ADDRESS 0x70002AAA /end MEASUREMENT
/begin MEASUREMENT RCSMACS_KM4ConnectSts "RCSMACS_KM4ConnectSts" UWORD F_1_p0_2 1 2 0 65535 ECU_ADDRESS 0x70002AA8 /end MEASUREMENT
/begin MEASUREMENT RCSMACS_KM4FaultSts "RCSMACS_KM4FaultSts" UWORD F_1_p0_2 1 2 0 65535 ECU_ADDRESS 0x70002AA6 /end MEASUREMENT
/begin MEASUREMENT RCSMACS_KM4StateChange "RCSMACS_KM4StateChange" UWORD F_1_p0_2 1 2 0 65535 ECU_ADDRESS 0x70002AA4 /end MEASUREMENT
/begin MEASUREMENT RCSMACS_KM5AclState "RCSMACS_KM5AclState" UWORD F_1_p0_2 1 2 0 65535 ECU_ADDRESS 0x70002AA2 /end MEASUREMENT
/begin MEASUREMENT RCSMACS_KM5ConnectSts "RCSMACS_KM5ConnectSts" UWORD F_1_p0_2 1 2 0 65535 ECU_ADDRESS 0x70002AA0 /end MEASUREMENT
/begin MEASUREMENT RCSMACS_KM5FaultSts "RCSMACS_KM5FaultSts" UWORD F_1_p0_2 1 2 0 65535 ECU_ADDRESS 0x70002A9E /end MEASUREMENT
/begin MEASUREMENT RCSMACS_KM5StateChange "RCSMACS_KM5StateChange" UWORD F_1_p0_2 1 2 0 65535 ECU_ADDRESS 0x70002A9C /end MEASUREMENT
/begin MEASUREMENT RCSMACS_KM6AclState "RCSMACS_KM6AclState" UWORD F_1_p0_2 1 2 0 65535 ECU_ADDRESS 0x70002A9A /end MEASUREMENT
/begin MEASUREMENT RCSMACS_KM6ConnectSts "RCSMACS_KM6ConnectSts" UWORD F_1_p0_2 1 2 0 65535 ECU_ADDRESS 0x70002A98 /end MEASUREMENT
/begin MEASUREMENT RCSMACS_KM6FaultSts "RCSMACS_KM6FaultSts" UWORD F_1_p0_2 1 2 0 65535 ECU_ADDRESS 0x70002A96 /end MEASUREMENT
/begin MEASUREMENT RCSMACS_KM6StateChange "RCSMACS_KM6StateChange" UWORD F_1_p0_2 1 2 0 65535 ECU_ADDRESS 0x70002A94 /end MEASUREMENT
/begin MEASUREMENT RCSMACS_KM7AclState "RCSMACS_KM7AclState" UWORD F_1_p0_2 1 2 0 65535 ECU_ADDRESS 0x70002A92 /end MEASUREMENT
/begin MEASUREMENT RCSMACS_KM7ConnectSts "RCSMACS_KM7ConnectSts" UWORD F_1_p0_2 1 2 0 65535 ECU_ADDRESS 0x70002A90 /end MEASUREMENT
/begin MEASUREMENT RCSMACS_KM7FaultSts "RCSMACS_KM7FaultSts" UWORD F_1_p0_2 1 2 0 65535 ECU_ADDRESS 0x70002A8E /end MEASUREMENT
/begin MEASUREMENT RCSMACS_KM7StateChange "RCSMACS_KM7StateChange" UWORD F_1_p0_2 1 2 0 65535 ECU_ADDRESS 0x70002A8C /end MEASUREMENT
/begin MEASUREMENT RCSMACS_KM8AclState "RCSMACS_KM8AclState" UWORD F_1_p0_2 1 2 0 65535 ECU_ADDRESS 0x70002A8A /end MEASUREMENT
/begin MEASUREMENT RCSMACS_KM8ConnectSts "RCSMACS_KM8ConnectSts" UWORD F_1_p0_2 1 2 0 65535 ECU_ADDRESS 0x70002A88 /end MEASUREMENT
/begin MEASUREMENT RCSMACS_KM8FaultSts "RCSMACS_KM8FaultSts" UWORD F_1_p0_2 1 2 0 65535 ECU_ADDRESS 0x70002A86 /end MEASUREMENT
/begin MEASUREMENT RCSMACS_KM8StateChange "RCSMACS_KM8StateChange" UWORD F_1_p0_2 1 2 0 65535 ECU_ADDRESS 0x70002A84 /end MEASUREMENT
/begin MEASUREMENT RCSMACS_Rly1ErrCheckDelay "RCSMACS_Rly1ErrCheckDelay" UWORD F_1_p0_2 1 2 0 65535 ECU_ADDRESS 0x70002A82 /end MEASUREMENT
/begin MEASUREMENT RCSMACS_Rly2ErrCheckDelay "RCSMACS_Rly2ErrCheckDelay" UWORD F_1_p0_2 1 2 0 65535 ECU_ADDRESS 0x70002A80 /end MEASUREMENT
/begin MEASUREMENT RCSMACS_Rly3ErrCheckDelay "RCSMACS_Rly3ErrCheckDelay" UWORD F_1_p0_2 1 2 0 65535 ECU_ADDRESS 0x70002A7E /end MEASUREMENT
/begin MEASUREMENT RCSMACS_Rly4ErrCheckDelay "RCSMACS_Rly4ErrCheckDelay" UWORD F_1_p0_2 1 2 0 65535 ECU_ADDRESS 0x70002A7C /end MEASUREMENT
/begin MEASUREMENT RCSMACS_Rly5ErrCheckDelay "RCSMACS_Rly5ErrCheckDelay" UWORD F_1_p0_2 1 2 0 65535 ECU_ADDRESS 0x70002A7A /end MEASUREMENT
/begin MEASUREMENT RCSMACS_Rly6ErrCheckDelay "RCSMACS_Rly6ErrCheckDelay" UWORD F_1_p0_2 1 2 0 65535 ECU_ADDRESS 0x70002A78 /end MEASUREMENT
/begin MEASUREMENT RCSMACS_Rly7ErrCheckDelay "RCSMACS_Rly7ErrCheckDelay" UWORD F_1_p0_2 1 2 0 65535 ECU_ADDRESS 0x70002A76 /end MEASUREMENT
/begin MEASUREMENT RCSMACS_Rly8ErrCheckDelay "RCSMACS_Rly8ErrCheckDelay" UWORD F_1_p0_2 1 2 0 65535 ECU_ADDRESS 0x70002A74 /end MEASUREMENT
/begin MEASUREMENT RC_AN_Bus_Status "RC_AN_Bus_Status" UWORD F_1_p0_2 1 2 0 65535 ECU_ADDRESS 0x70002AF6 /end MEASUREMENT
/begin MEASUREMENT RC_AN_KM1_Status "RC_AN_KM1_Status" UWORD F_1_p0_2 1 2 0 65535 ECU_ADDRESS 0x70002AF4 /end MEASUREMENT
/begin MEASUREMENT RC_AN_KM2_Status "RC_AN_KM2_Status" UWORD F_1_p0_2 1 2 0 65535 ECU_ADDRESS 0x70002AF2 /end MEASUREMENT
/begin MEASUREMENT RC_AN_KM3_Status "RC_AN_KM3_Status" UWORD F_1_p0_2 1 2 0 65535 ECU_ADDRESS 0x70002AF0 /end MEASUREMENT
/begin MEASUREMENT RC_AN_KM4_Status "RC_AN_KM4_Status" UWORD F_1_p0_2 1 2 0 65535 ECU_ADDRESS 0x70002AEE /end MEASUREMENT
/begin MEASUREMENT RC_AN_KM5_Status "RC_AN_KM5_Status" UWORD F_1_p0_2 1 2 0 65535 ECU_ADDRESS 0x70002AEC /end MEASUREMENT
/begin MEASUREMENT RC_AN_KM6_Status "RC_AN_KM6_Status" UWORD F_1_p0_2 1 2 0 65535 ECU_ADDRESS 0x70002AEA /end MEASUREMENT
/begin MEASUREMENT RC_AN_KM7_Status "RC_AN_KM7_Status" UWORD F_1_p0_2 1 2 0 65535 ECU_ADDRESS 0x70002AE8 /end MEASUREMENT
/begin MEASUREMENT RC_AN_KM8_Status "RC_AN_KM8_Status" UWORD F_1_p0_2 1 2 0 65535 ECU_ADDRESS 0x70002AE6 /end MEASUREMENT
/begin MEASUREMENT RC_VCU_KM10_Cmd "RC_VCU_KM10_Cmd" UBYTE Bool_ON_OFF 1 2 0 1 BIT_MASK 0x01 ECU_ADDRESS 0x70002AE5 /end MEASUREMENT
/begin MEASUREMENT RC_VCU_KM1_Cmd "RC_VCU_KM1_Cmd" UBYTE Bool_ON_OFF 1 2 0 1 BIT_MASK 0x01 ECU_ADDRESS 0x70002AE4 /end MEASUREMENT
/begin MEASUREMENT RC_VCU_KM2_Cmd "RC_VCU_KM2_Cmd" UBYTE Bool_ON_OFF 1 2 0 1 BIT_MASK 0x01 ECU_ADDRESS 0x70002AE3 /end MEASUREMENT
/begin MEASUREMENT RC_VCU_KM3_Cmd "RC_VCU_KM3_Cmd" UBYTE Bool_ON_OFF 1 2 0 1 BIT_MASK 0x01 ECU_ADDRESS 0x70002AE2 /end MEASUREMENT
/begin MEASUREMENT RC_VCU_KM4_Cmd "RC_VCU_KM4_Cmd" UBYTE Bool_ON_OFF 1 2 0 1 BIT_MASK 0x01 ECU_ADDRESS 0x70002AE1 /end MEASUREMENT
/begin MEASUREMENT RC_VCU_KM5_Cmd "RC_VCU_KM5_Cmd" UBYTE Bool_ON_OFF 1 2 0 1 BIT_MASK 0x01 ECU_ADDRESS 0x70002AE0 /end MEASUREMENT
/begin MEASUREMENT RC_VCU_KM6_Cmd "RC_VCU_KM6_Cmd" UBYTE Bool_ON_OFF 1 2 0 1 BIT_MASK 0x01 ECU_ADDRESS 0x70002ADF /end MEASUREMENT
/begin MEASUREMENT RC_VCU_KM7_Cmd "RC_VCU_KM7_Cmd" UBYTE Bool_ON_OFF 1 2 0 1 BIT_MASK 0x01 ECU_ADDRESS 0x70002ADE /end MEASUREMENT
/begin MEASUREMENT RC_VCU_KM8_Cmd "RC_VCU_KM8_Cmd" UBYTE Bool_ON_OFF 1 2 0 1 BIT_MASK 0x01 ECU_ADDRESS 0x70002ADD /end MEASUREMENT
/begin MEASUREMENT RC_VCU_KM9_Cmd "RC_VCU_KM9_Cmd" UBYTE Bool_ON_OFF 1 2 0 1 BIT_MASK 0x01 ECU_ADDRESS 0x70002ADC /end MEASUREMENT
/begin MEASUREMENT SPY_bBufFull "SPY_bBufFull" UBYTE Bool_ON_OFF 1 2 0 1 BIT_MASK 0x01 ECU_ADDRESS 0x7002B294 /end MEASUREMENT
/begin MEASUREMENT SPY_u16DaqListFirstElmIdx "SPY_u16DaqListFirstElmIdx" UWORD I_1 1 2 0 65535 ECU_ADDRESS 0x7002B292 /end MEASUREMENT
/begin MEASUREMENT SPY_u16NrOfElmsToTx "SPY_u16NrOfElmsToTx" UWORD I_1 1 2 0 65535 ECU_ADDRESS 0x7002B290 /end MEASUREMENT
/begin MEASUREMENT SPY_u16PreTrigSmplIdx "SPY_u16PreTrigSmplIdx" UWORD I_1 1 2 0 65535 ECU_ADDRESS 0x7002B28E /end MEASUREMENT
/begin MEASUREMENT SPY_u16RmngSmplIdx "SPY_u16RmngSmplIdx" UWORD I_1 1 2 0 65535 ECU_ADDRESS 0x7002B28C /end MEASUREMENT
/begin MEASUREMENT SPY_u16SmplIdx "SPY_u16SmplIdx" UWORD I_1 1 2 0 65535 ECU_ADDRESS 0x7002B28A /end MEASUREMENT
/begin MEASUREMENT SPY_u16TrigSmplIdx "SPY_u16TrigSmplIdx" UWORD I_1 1 2 0 65535 ECU_ADDRESS 0x7002B288 /end MEASUREMENT
/begin COMPU_METHOD I_1 "" RAT_FUNC "%9.2" "-" COEFFS 0 1 0 0 0 1 /end COMPU_METHOD
/begin COMPU_METHOD F_1_p0_2 "" RAT_FUNC "%9.2" "" COEFFS 0 1 0 0 0 1 /end COMPU_METHOD
/begin COMPU_METHOD F_5_p0_26 "" RAT_FUNC "%9.2" "ms" COEFFS 0 1 0 0 0 5 /end COMPU_METHOD
/begin COMPU_METHOD Id_0x00 "" RAT_FUNC "%9.2" "." COEFFS 0 1 0 0 0 1 /end COMPU_METHOD
/begin COMPU_METHOD Bool_ON_OFF "" TAB_VERB "%8.4" "." COMPU_TAB_REF Bool_ON_OFF_table /end COMPU_METHOD
/begin COMPU_VTAB Bool_ON_OFF_table "" TAB_VERB 2 0 "OFF" 1 "ON" /end COMPU_VTAB
/begin FUNCTION SPY ""
 /begin OUT_MEASUREMENT SPY_bBufFull SPY_u16DaqListFirstElmIdx SPY_u16NrOfElmsToTx SPY_u16PreTrigSmplIdx SPY_u16RmngSmplIdx SPY_u16SmplIdx SPY_u16TrigSmplIdx /end OUT_MEASUREMENT
/end FUNCTION
/begin FUNCTION STFSRV ""
 /begin DEF_CHARACTERISTIC ESM_bPowerOffModeInhC ESM_ku16AfterrunToutCntC GESM_bPowerOffModeInhC GESM_ku16AfterrunToutCntC /end DEF_CHARACTERISTIC
 /begin OUT_MEASUREMENT ESM_bAfterrunFin ESM_bAfterrunReq ESM_bCallAppliOn ESM_bMcuEnaReq ESM_bPwrDnReadyFlg ESM_bPwrLNfClrFltFinsh ESM_ESM_MODE_FT ESM_ESM_MODE_NF ESM_EsmMode ESM_OpFtState ESM_OpNfState ESM_PwrLFtState ESM_PwrLNfState ESM_StpIIFtState ESM_StpIINfState ESM_StpIState ESM_u16AfterrunCnt ESM_u16CmdReq ESM_u16CmdReqNm1 ESM_u16CmdRes ESM_u8AllowPwrDnDelay ESM_u8PwrLNfStep ESM_u8PwrOffTim ESM_u8RestartDelayCnt GESM_bAfterrunFin GESM_bAfterrunReq GESM_bCallAppliOn GESM_bMcuEnaReq GESM_bPwrDnReadyFlg GESM_bPwrLNfClrFltFinsh GESM_ESM_MODE_FT GESM_ESM_MODE_NF GESM_EsmMode GESM_OpFtState GESM_OpNfState GESM_PwrLFtState GESM_PwrLNfState GESM_StpIIFtState GESM_StpIINfState GESM_StpIState GESM_u16AfterrunCnt GESM_u16CmdReq GESM_u16CmdReqNm1 GESM_u16CmdRes GESM_u8AllowPwrDnDelay GESM_u8PwrLNfStep GESM_u8PwrOffTim GESM_u8RestartDelayCnt /end OUT_MEASUREMENT
/end FUNCTION
/begin FUNCTION SWC_FS ""
 /begin DEF_CHARACTERISTIC AFSEVBHV_A2dMaxValueC AFSEVBHV_A2dMinValueC AFSEVBHV_A2DOffsetVoltageC AFSEVBHV_BackVoltageThrdC AFSEVBHV_CutOffFrequencyC AFSEVBHV_ExtUbatGainEnC AFSEVBHV_ExtUbatGainMaxC AFSEVBHV_ExtUbatGainMinC AFSEVBHV_GainCorrnC AFSEVBHV_GainCorrnPwmC AFSEVBHV_GainScalingC AFSEVBHV_HighVoltageThrC AFSEVBHV_HighVoltRdyThrC AFSEVBHV_LowVoltageThrC AFSEVBHV_VisuAdUbatC AFSEVBHV_VisuAdUbatEnC AFSEVBHV_VolNotRationalEnC AFSEVBHV_VolNotRationalNumC AFSEVBLV_A2dMaxValueC AFSEVBLV_A2dMinValueC AFSEVBLV_A2DOffsetVoltageC AFSEVBLV_CutOffFrequencyC AFSEVBLV_GainCorrnC AFSEVBLV_GainScalingC AFSEVBLV_HighVoltageThrC AFSEVBLV_LowVoltageThrC AFSEVBLV_P5VAD2VoltC AFSEVBLV_P5VRefC AFSEVBLV_P5VRefErrBurstC AFSEVETA_A2dMaxValueC AFSEVETA_A2dMinValueC AFSEVETA_CoolShortCircuitGndC AFSEVETA_CoolShortCircuitVccC AFSEVETA_CutOffFrequencyC AFSEVETA_FaultPeriodCounterC AFSEVETA_GainTempCoolingC AFSEVETA_GainTempDrvBoardLeftC AFSEVETA_GainTempIgbtLeftC AFSEVETA_GainTempLVCmdBoardC AFSEVETA_HighTempCmdBoard2ThdC AFSEVETA_HighTempCmdBoardThdC AFSEVETA_HighTempCoolingThdC AFSEVETA_HighTempDrvLeftThdC AFSEVETA_HighTempIgbtLeftThdC AFSEVETA_IgbtRationalThdC AFSEVETA_IgbtTempSlopDetnEnC AFSEVETA_IgbtTempSlopMaxC AFSEVETA_IOFilterC AFSEVETA_LowTempCmdBoard2ThdC AFSEVETA_LowTempCmdBoardThdC AFSEVETA_LowTempDrvLeftThdC AFSEVETA_LutInTempCmdBoardC AFSEVETA_LutInTempDrvBoardC AFSEVETA_LutInTempIgbtCU AFSEVETA_LutInTempIgbtCV AFSEVETA_LutInTempIgbtCW AFSEVETA_LutInTempPt100C AFSEVETA_LutOutTempCmdBoardC AFSEVETA_LutOutTempDrvBoardC AFSEVETA_LutOutTempIgbtCU AFSEVETA_LutOutTempIgbtCV AFSEVETA_LutOutTempIgbtCW AFSEVETA_LutOutTempPt100C AFSEVETA_MotorSpeedC AFSEVETA_OffsetTempCoolingC AFSEVETA_OffsetTempDrvBoardLeftC AFSEVETA_OffsetTempIgbtLeftC AFSEVETA_OffsetTempLVCmdBoardC AFSEVETA_OperationalC AFSEVETA_ShortCircuitGndC AFSEVETA_ShortCircuitVccC AFSEVETA_TempIgbtGndC AFSEVETA_TempIgbtGndStopOvTEnC AFSEVETA_TempRationalEnC AFSEVIBT_IbatRmsGainC AFSEVIBT_LowPassFiltNumC AFSEXCTX_DrtGainC AFSMTMTA_A2dMaxValueC AFSMTMTA_A2dMinValueC AFSMTMTA_CutOffFrequencyC AFSMTMTA_GainTempWindingHead1C AFSMTMTA_HighTempWdgHead1ThdC AFSMTMTA_LutInTempMotorC AFSMTMTA_LutOutTempMotorC AFSMTMTA_OffsetTempWindingHead1C AFSMTMTA_ShortCircuitGndC AFSMTMTA_ShortCircuitVccC AFSSMACS_AbsMecaSpeedTrC AFSSMACS_AkdEnterSpdThrdC AFSSMACS_AkdExitSpdThrdC AFSSMACS_AkdStopVoltageC AFSSMACS_AkdTimeoutCntC AFSSMACS_AllowStartSpeedRpmC AFSSMACS_AuxDischgeEnC AFSSMACS_BenchKL15EnaC AFSSMACS_DeaultSpdModeC AFSSMACS_HiPwrRdyVoltC AFSSMACS_HiPwrStbVoltC AFSSMACS_KL15FilterC AFSSMACS_ManualModeReqC AFSSMACS_PreCharFinVoltC AFSSMACS_ReverseKL15EnaC AFSSMACS_SpeedReadyFilterC AFSSMACS_SpeedReadyThresholdC AFSSMACS_TorqueEnterSpdThrdC AFSSMACS_TorqueExitSpdThrdC AFSSMACS_ZeroTorqCounterC AFSSMMAM_AclStateBypassOnOffC AFSSMMAM_AclStateBypassValueC AFSTCGTC_CanSpeedTgtEnC AFSTCGTC_I0dqTgtC AFSTCGTC_MecaSpeedRpmTgtC AFSTCGTC_MecaSpeedRpmTgtDiffC AFSTCGTC_MecaSpeedRpmTgtDutyC AFSTCGTC_MecaSpeedRpmTgtEnC AFSTCGTC_MecaSpeedRpmTgtFrecC AFSTCGTC_MecaSpeedRpmTgtMinC AFSTCGTC_MecaSpeedRpmTgtModeC AFSTCGTC_SinLutC AFSTCGTC_U0dqTgtC FSEVBHV_A2dMaxValueC FSEVBHV_A2dMinValueC FSEVBHV_A2DOffsetVoltageC FSEVBHV_BackVoltageThrdC FSEVBHV_CutOffFrequencyC FSEVBHV_ExtUbatGainMaxC FSEVBHV_ExtUbatGainMinC FSEVBHV_GainCorrnC FSEVBHV_GainScalingC FSEVBHV_HighVoltageThrC FSEVBHV_LowVoltageThrC FSEVBHV_VisuAdUbat2C FSEVBHV_VisuAdUbat2EnC FSEVBHV_VisuAdUbatC FSEVBHV_VisuAdUbatEnC FSEVBLV_A2dMaxValueC FSEVBLV_A2dMinValueC FSEVBLV_A2DOffsetVoltageC FSEVBLV_CutOffFrequencyC FSEVBLV_GainCorrnC FSEVBLV_GainScalingC FSEVBLV_HighVoltageThrC FSEVBLV_LowHysteresisRangeC FSEVBLV_LowVoltageThrC FSEVBLV_LowVoltageWarnThrC FSEVBLV_P5VAD2VoltC FSEVBLV_P5VHSRefAdC FSEVBLV_P5VHSRefCompEnC FSEVBLV_P5VRefC FSEVBLV_P5VRefErrBurstC FSEVBLV_SensCompGainMaxC FSEVBLV_SensCompGainMinC FSEVBLV_ShortCircuitGndC FSEVBLV_ShortCircuitVccC FSEVETA_A2dMaxValueC FSEVETA_A2dMinValueC FSEVETA_CmdBoardRationalThdC FSEVETA_CmdShortCircuitGndC FSEVETA_CmdShortCircuitVccC FSEVETA_CoolingRationalThdC FSEVETA_CoolShortCircuitGndC FSEVETA_CoolShortCircuitVccC FSEVETA_CutOffFrequencyC FSEVETA_DrvBoardRationalThdC FSEVETA_FaultPeriodCounterC FSEVETA_GainTempCoolingC FSEVETA_GainTempDrvBoardLeftC FSEVETA_GainTempIgbtLeftC FSEVETA_GainTempLVCmdBoardC FSEVETA_HighTempCmdBoard2ThdC FSEVETA_HighTempCmdBoardThdC FSEVETA_HighTempCoolingThdC FSEVETA_HighTempIgbtLeftThdC FSEVETA_IgbtRationalThdC FSEVETA_IgbtTempSlopDetnEnC FSEVETA_IgbtTempSlopMaxC FSEVETA_InterShortCircuitGndC FSEVETA_InterShortCircuitVccC FSEVETA_LowTempCmdBoard2ThdC FSEVETA_LowTempCmdBoardThdC FSEVETA_LowTempCoolingThdC FSEVETA_LowTempIgbtLeftThdC FSEVETA_LutInTempCmdBoardC FSEVETA_LutInTempDrvBoardC FSEVETA_LutInTempIgbtCU FSEVETA_LutInTempIgbtCV FSEVETA_LutInTempIgbtCW FSEVETA_LutInTempPt100C FSEVETA_LutOutTempCmdBoardC FSEVETA_LutOutTempDrvBoardC FSEVETA_LutOutTempIgbtCU FSEVETA_LutOutTempIgbtCV FSEVETA_LutOutTempIgbtCW FSEVETA_LutOutTempPt100C FSEVETA_MotorSpeedC FSEVETA_OffsetTempCoolingC FSEVETA_OffsetTempDrvBoardLeftC FSEVETA_OffsetTempIgbtLeftC FSEVETA_OffsetTempLVCmdBoardC FSEVETA_OperationalC FSEVETA_ShortCircuitGndC FSEVETA_ShortCircuitVccC FSEVETA_TempRationalEnC FSEVIBT_IbatRmsGainC FSEVIBT_LowPassFiltNumC FSEXCTX_DrtGainC FSEXCTX_SpeedFirstFildTrC FSEXCTX_TorqueCanFild2TrC FSEXCTX_TorqueCanFildTrC FSMTMTA_A2dMaxValueC FSMTMTA_A2dMinValueC FSMTMTA_CutOffFrequencyC FSMTMTA_GainTempWindingHead1C FSMTMTA_GainTempWindingHead2C FSMTMTA_HighTempWdgHead1ThdC FSMTMTA_HighTempWdgHead2ThdC FSMTMTA_LowTempWindingHead1ThdC FSMTMTA_LowTempWindingHead2ThdC FSMTMTA_LutInTempMotorC FSMTMTA_LutOutTempMotorC FSMTMTA_OffsetTempWindingHead1C FSMTMTA_OffsetTempWindingHead2C FSMTMTA_ShortCircuitGndC FSMTMTA_ShortCircuitVccC FSMTRDG_A2dMaxValueC FSMTRDG_A2dMinValueC FSMTRDG_A2DOffsetCosHC FSMTRDG_A2DOffsetCosLC FSMTRDG_A2DOffsetExtationC FSMTRDG_A2DOffsetSinHC FSMTRDG_A2DOffsetSinLC FSMTRDG_CosHScalingC FSMTRDG_CosLScalingC FSMTRDG_CutOffFrequencyC FSMTRDG_ExitationScalingC FSMTRDG_GainCosHC FSMTRDG_GainCosLC FSMTRDG_GainExitationVoltC FSMTRDG_GainSinHC FSMTRDG_GainSinLC FSMTRDG_IOFilterC FSMTRDG_SinHScalingC FSMTRDG_SinLScalingC FSSMACS_AbsMecaSpeedTrC FSSMACS_AkdEnterSpdThrdC FSSMACS_AkdExitSpdThrdC FSSMACS_AkdStopVoltageC FSSMACS_AkdTimeoutCntC FSSMACS_AllowShutdownTrqRateC FSSMACS_AllowStartSpeedRpmC FSSMACS_BenchKL15EnaC FSSMACS_HiPwrRdyVoltC FSSMACS_HiPwrStbVoltC FSSMACS_KL15FilterC FSSMACS_ManualModeReqC FSSMACS_OcCntMaxValueC FSSMACS_OcLowVolMaxC FSSMACS_OcLowVolMinC FSSMACS_PreCharFinVoltC FSSMACS_ReverseKL15EnaC FSSMACS_RuningShutDelayComfCntC FSSMACS_SpeedReadyFilterC FSSMACS_SpeedReadyThresholdC FSSMACS_TorqueEnterSpdThrdC FSSMACS_TorqueExitSpdThrdC FSSMACS_UdsOCBenchModeOnOffC FSSMACS_UdsOcEnableC FSSMACS_UdsOcRdResFlagC FSSMACS_UdsOcStartReqC FSSMACS_Volt2BmsDiffC FSSMACS_ZeroTorqCounterC FSSMMAM_AclStateBypassOnOffC FSSMMAM_AclStateBypassValueC FSTCGTC_AccCheckCntThrdC FSTCGTC_AccPedThdC FSTCGTC_ActiveSpdLmtEnC FSTCGTC_BrakeCheckCntThrdC FSTCGTC_BrakePedPosSlopThrdC FSTCGTC_CanTrqTgtRelatedGearEnC FSTCGTC_CtrlTrLutInSpdC FSTCGTC_CtrlTrLutOutC FSTCGTC_fC FSTCGTC_HacDisableTrasCntC FSTCGTC_HacEnableCntMaxC FSTCGTC_HacEnableNumberMaxC FSTCGTC_HacEnSpeedMaxC FSTCGTC_HacEnSpeedThrdC FSTCGTC_HacTempOutCntC FSTCGTC_HandBrakeCheckCntC FSTCGTC_HandBrakeCheckThrdC FSTCGTC_I0dqTgtC FSTCGTC_jC FSTCGTC_LmtSpdChgPwrMinC FSTCGTC_LmtSpdChgPwrModeC FSTCGTC_LmtSpdMotorGenEffC FSTCGTC_LmtSpdTrqSatThrdC FSTCGTC_LutInTrqCompSpdC FSTCGTC_LutOutTrqCompTorqC FSTCGTC_MecaSpdOffsetC FSTCGTC_MecaSpeedRpmTgtC FSTCGTC_MecaSpeedTgtModeC FSTCGTC_MotorDirRevEnableC FSTCGTC_MotorMaxSpeedC FSTCGTC_MotorMinSpeedC FSTCGTC_OpenLoopLutEnCntC FSTCGTC_RunSpeedThrdC FSTCGTC_SlopSlipEnableC FSTCGTC_StopCheckCntThrdC FSTCGTC_StopSpeedThrdC FSTCGTC_TorqSlewRateC FSTCGTC_TorquePreFildTrC FSTCGTC_TorqueTgtC FSTCGTC_TorqueTgtDirectionC FSTCGTC_TorqueTgtModeC FSTCGTC_ToVcuTrqCheckCntC FSTCGTC_ToVcuTrqMaxRateC FSTCGTC_U0dqTgtC FSTCGTC_ZeroToqueLowSpeedThrdC FSTCGTC_ZeroTorqueCompTgtC FSTCGTC_ZeroTorqueOffsetEnableC RCEVHCM_A2dMaxValueC RCEVHCM_A2dMinValueC RCEVHCM_A2DOffsetVoltageC RCEVHCM_CutOffFrequencyC RCEVHCM_GainCorrnC RCEVHCM_GainScalingC RCEVHCM_HighVoltRdyThrC /end DEF_CHARACTERISTIC
 /begin OUT_MEASUREMENT AFS_AFTAclState_U16 AFS_AftAppliedTorqueRate_F32 AFS_BatVotValidFlag_B AFS_BSWReadyStatus_B AFS_BusVoltageGain_U16 AFS_CmdAftShutDownRes_B AFS_CmdAftStartRes_B AFS_CommandBoardTempLV2_U16 AFS_CommandBoardTempLV_U16 AFS_CoolingTemp_U16 AFS_CrashOutSts_U8 AFS_DeratingStatus_B AFS_DriverBoardTemp_U16 AFS_DutyCycle3_F32[0] AFS_DutyCycle3_F32[1] AFS_DutyCycle3_F32[2] AFS_EmWorkModCmd_U8 AFS_EstPowmdlDrtGain_F32 AFS_FaultLevel_U16 AFS_HwOverVoltFlg_B AFS_IbatHV_U16 AFS_IbatRmsHV_U16 AFS_Idref_F32 AFS_Iqref_F32 AFS_Iuvw3_F32[0] AFS_Iuvw3_F32[1] AFS_Iuvw3_F32[2] AFS_KEYON_B AFS_MecaSpeedRpm_F32 AFS_ModeReq_U8 AFS_MotorAppliedTorque_F32 AFS_MotorMagnetDrtGain_F32 AFS_MotorWindingDrtGain_F32 AFS_MotorWindingTemp1_U16 AFS_MotorWindingTemp1L_U16 AFS_MotorWindingTemp2_U16 AFS_MotorWindingTemp2L_U16 AFS_OilTemp_F32 AFS_OpenAngleState_U8 AFS_P5VPort_U16 AFS_PowerModuleTempU_F32 AFS_PowerModuleTempV_F32 AFS_PowerModuleTempW_F32 AFS_PowmdlDrtGain_F32 AFS_PreChargeRlySts_B AFS_SpdSet_F32 AFS_stMainNeg_B AFS_stMainPos_B AFS_UbatHV2_F32 AFS_UbatHV_F32 AFS_UbatLV_U16 AFS_Ubms_F32 AFS_VcuMcuEnableReq_U8 AFSEVBHV_A2DBackResCorrdVoltage AFSEVBHV_A2DResCorrdVoltage AFSEVBHV_ActVoltage AFSEVBHV_BackupVoltage AFSEVBHV_BackupVoltageFild AFSEVBHV_BackupVoltageFildZ AFSEVBHV_ExtUbatGain AFSEVBHV_HighVoltReady AFSEVBHV_VolNotRationalDetn AFSEVBHV_VolNotRationalErr AFSEVBHV_Voltage AFSEVBHV_Voltage1Fild AFSEVBHV_Voltage1FildZ AFSEVBHV_VoltageFild AFSEVBHV_VoltageFildZ AFSEVBHV_VoltageGndDetn AFSEVBHV_VoltageVccDetn AFSEVBLV_A2DResCorrdVoltage AFSEVBLV_Voltage AFSEVBLV_VoltageFild AFSEVBLV_VoltageFildZ AFSEVETA_CorrdTempCooling AFSEVETA_CorrdTempDrvBoardLeft AFSEVETA_CorrdTempIgbtLeftU AFSEVETA_CorrdTempIgbtLeftV AFSEVETA_CorrdTempIgbtLeftW AFSEVETA_CorrdTempLVCmdBoard AFSEVETA_CorrdTempLVCmdBoard2 AFSEVETA_CounterNumberZ AFSEVETA_IgbtTempRationa AFSEVETA_IgbtTempRationalDetn AFSEVETA_IgbtTempSlopOver AFSEVETA_IgbtTempZ AFSEVETA_IOCoolingFlowDetection AFSEVETA_IOcounterZ AFSEVETA_IOinZ AFSEVETA_IOoutZ AFSEVETA_OverTempCoolingDetn AFSEVETA_OverTempDrvLeftDetn AFSEVETA_OverTempNTC2CmdBoardDetn AFSEVETA_TempCmdBoard AFSEVETA_TempCooling AFSEVETA_TempCoolingFild AFSEVETA_TempCoolingFildZ AFSEVETA_TempCoolingGndDetn AFSEVETA_TempCoolingVccDetn AFSEVETA_TempDrvBoard AFSEVETA_TempDrvBoardLeft AFSEVETA_TempDrvBoardLeftFild AFSEVETA_TempDrvBoardLeftFildZ AFSEVETA_TempIgbt AFSEVETA_TempIgbtLeftFild AFSEVETA_TempIgbtLeftFildU AFSEVETA_TempIgbtLeftFildV AFSEVETA_TempIgbtLeftFildW AFSEVETA_TempIgbtLeftFildZU AFSEVETA_TempIgbtLeftFildZV AFSEVETA_TempIgbtLeftFildZW AFSEVETA_TempIgbtLeftU AFSEVETA_TempIgbtLeftV AFSEVETA_TempIgbtLeftW AFSEVETA_TempLVCmdBoard AFSEVETA_TempLVCmdBoard2 AFSEVETA_TempLVCmdBoard2Fild AFSEVETA_TempLVCmdBoard2FildZ AFSEVETA_TempLVCmdBoardFild AFSEVETA_TempLVCmdBoardFildZ AFSEVETA_UnderTempDrvLeftDetn AFSEVETA_UnderTempNTC1CmdBoardDetn AFSEVETA_UnderTempNTC2CmdBoardDetn AFSEVIBT_EstiIbatHv AFSEVIBT_IbatHVFild AFSEVIBT_IbatHVFildZ AFSEXCTX_DCcurrentActual AFSEXCTX_DCvoltActual AFSEXCTX_DeratingStatus AFSEXCTX_HVReadyStatus AFSEXCTX_Idirect AFSEXCTX_InverterTemp AFSEXCTX_Iquadra AFSEXCTX_MotorAppliedTorque AFSEXCTX_MotorSpeed AFSEXCTX_MotorState AFSEXCTX_MotorTemp AFSEXCTX_RotorTemp AFSEXCTX_SwVerNum1 AFSEXCTX_SwVerNum2 AFSEXCTX_SwVerNum3 AFSEXCTX_SwVerNum4 AFSEXCTX_SysTempOvrInd AFSMTMTA_CorrdTempWindingHead1 AFSMTMTA_TempWinding[0] AFSMTMTA_TempWinding[1] AFSMTMTA_TempWindingHead1 AFSMTMTA_TempWindingHead1Fild AFSMTMTA_TempWindingHead1FildZ AFSMTMTA_TempWindingMax AFSSMACS_AbsMecaSpeedRpmFild AFSSMACS_AbsMecaSpeedRpmFildZ AFSSMACS_AclState AFSSMACS_CmdFtShutDownReq AFSSMACS_CmdFtStartReq AFSSMACS_CmdSwShutDownReq AFSSMACS_FTModeReq AFSSMACS_KL15 AFSSMACS_KL15counterZ AFSSMACS_KL15in AFSSMACS_KL15inZ AFSSMACS_KL15outZ AFSSMACS_NormalStartFtFlg AFSSMACS_SCSpeedReady AFSSMACS_SCSpeedReadyinZ AFSSMACS_SCSpeedReadyoutZ AFSSMACS_SpeedReadycounterZ AFSSMACS_TorqueEnable AFSSMACS_TxMcuMode AFSSMACS_TxMotorMode AFSSMMAM_AclState AFSSMMAM_EVBHV_CheckEnable AFSSMMAM_EVBLV_CheckEnable AFSSMMAM_EVIBT_State AFSTCGTC_I0dqTgt[0] AFSTCGTC_I0dqTgt[1] AFSTCGTC_I0dqTgt[2] AFSTCGTC_MecaSpeedRpmTgt AFSTCGTC_ScsStartCmd AFSTCGTC_SpdRpmTgtStartFlg AFSTCGTC_U0dqTgt[0] AFSTCGTC_U0dqTgt[1] AFSTCGTC_U0dqTgt[2] FS_AccPedPos_F32 FS_AN_ExitationDiag_U16 FS_AN_P5VHSREF_U16 FS_BMS_stMain_Neg_B FS_BMS_stMain_Pos_B FS_BMS_Ubms_F32 FS_BSWReadyStatus_B FS_BusVoltageGain_U16 FS_CmdFtShutDownRes_B FS_CmdFtStartRes_B FS_CommandBoardTempHV_U16 FS_CommandBoardTempLV2_U16 FS_CommandBoardTempLV_U16 FS_CoolingTemp_U16 FS_CoolTempValidFlag_B FS_CosHDiag_U16 FS_CosLDiag_U16 FS_DriverBoardTemp_U16 FS_DutyCycle3_F32[0] FS_DutyCycle3_F32[1] FS_DutyCycle3_F32[2] FS_EstPowmdlDrtGain_F32 FS_EXT_CrashOutSts_U8 FS_FaultLevel_U16 FS_FootbrakeState_U16 FS_FTAclState_U16 FS_FTRealTrqRate_F32 FS_FTResloverFault_B FS_GCUCooling_F32 FS_HandBrake_B FS_Id_ref_F32 FS_IO_ExitationDiag_B FS_Iq_ref_F32 FS_Iuvw3_F32[0] FS_Iuvw3_F32[1] FS_Iuvw3_F32[2] FS_KEY_ON_B FS_MaxMinTorqueAvailable_F32 FS_MecaSpeedRds_F32 FS_MecaSpeedRpm_F32 FS_MotorAppliedTorque_F32 FS_MotorMagnetDrtGain_F32 FS_MotorWindingDrtGain_F32 FS_MotorWindingTemp1_U16 FS_MotorWindingTemp2_U16 FS_OcCycleFinish_B FS_OcRotoringFailFlg_B FS_P5VPort_U16 FS_PowerModuleTemp_U_U16 FS_PowerModuleTemp_V_U16 FS_PowerModuleTemp_W_U16 FS_PowmdlDrtGain_F32 FS_SinHDiag_U16 FS_SinLDiag_U16 FS_SlideSlopReq_B FS_TorqueSlewRate_F32 FS_UbatHV2_U16 FS_UbatHV_U16 FS_UbatLV_U16 FS_UdsOcEnable_B FS_UdsOcRdResFlag_B FS_UdsOcStartReq_B FS_VCU_AKD_Req_B FS_VCU_DCU_ModeReq_U8 FS_VCU_DCU_SpdSet_F32 FS_VCU_DCU_TorqMax_F32 FS_VCU_DCU_TorqMin_F32 FS_VCU_DCU_TorqSet_F32 FS_VCU_PowerOff_Req_B FS_VCU_PreChargeRlySts_B FS_VcuMcuEnableReq_U8 FS_VehicleGear_U8 FSEVBHV_A2DBackResCorrdVoltage FSEVBHV_A2DResCorrdVoltage FSEVBHV_ActVoltage FSEVBHV_BackupVoltage FSEVBHV_BackupVoltageFild FSEVBHV_BackupVoltageFildZ FSEVBHV_SampleVolOutRngHDetn FSEVBHV_SampleVolOutRngLDetn FSEVBHV_UnderVoltageWarnDetn FSEVBHV_VolNotRationalDetn FSEVBHV_Voltage FSEVBHV_Voltage1Fild FSEVBHV_Voltage1FildZ FSEVBHV_VoltageFild FSEVBHV_VoltageFildZ FSEVBHV_VoltageGndDetn FSEVBHV_VoltageVccDetn FSEVBLV_A2DResCorrdVoltage FSEVBLV_LowVoltageWarnDetnZ FSEVBLV_P5VHSRefCompGain FSEVBLV_UnderVoltageWarnDetn FSEVBLV_Voltage FSEVBLV_VoltageFild FSEVBLV_VoltageFildZ FSEVBLV_VoltageGndDetn FSEVBLV_VoltageVccDetn FSEVETA_CmdBoardRational FSEVETA_CoolingRational FSEVETA_CoolingRationalDetn FSEVETA_CorrdTempCooling FSEVETA_CorrdTempDrvBoardLeft FSEVETA_CorrdTempIgbtLeftU FSEVETA_CorrdTempIgbtLeftV FSEVETA_CorrdTempIgbtLeftW FSEVETA_CorrdTempLVCmdBoard FSEVETA_CorrdTempLVCmdBoard2 FSEVETA_CounterNumberZ FSEVETA_CtlBdTempRationalDetn FSEVETA_DrvBoardRational FSEVETA_DrvBoardTmpDiff FSEVETA_DrvTempRationDetn FSEVETA_IgbtTempRationa FSEVETA_IgbtTempRationalDetn FSEVETA_IgbtTempSlopOver FSEVETA_IgbtTempZ FSEVETA_OverTempCoolingDetn FSEVETA_OverTempNTC2CmdBoardDetn FSEVETA_TempCmdBoard FSEVETA_TempCooling FSEVETA_TempCoolingFild FSEVETA_TempCoolingFildZ FSEVETA_TempCoolingGndDetn FSEVETA_TempCoolingVccDetn FSEVETA_TempDrvBoard FSEVETA_TempDrvBoardLeft FSEVETA_TempDrvBoardLeftFild FSEVETA_TempDrvBoardLeftFildZ FSEVETA_TempIgbt FSEVETA_TempIgbtLeftFild FSEVETA_TempIgbtLeftFildU FSEVETA_TempIgbtLeftFildV FSEVETA_TempIgbtLeftFildW FSEVETA_TempIgbtLeftFildZU FSEVETA_TempIgbtLeftFildZV FSEVETA_TempIgbtLeftFildZW FSEVETA_TempIgbtLeftU FSEVETA_TempIgbtLeftV FSEVETA_TempIgbtLeftW FSEVETA_TempLVCmdBoard FSEVETA_TempLVCmdBoard2 FSEVETA_TempLVCmdBoard2Fild FSEVETA_TempLVCmdBoard2FildZ FSEVETA_TempLVCmdBoardFild FSEVETA_TempLVCmdBoardFildZ FSEVETA_TempNTC1CmdBoardGndDetn FSEVETA_TempNTC1CmdBoardVccDetn FSEVETA_TempNTC2CmdBoardGndDetn FSEVETA_TempNTC2CmdBoardVccDetn FSEVETA_UnderTempCoolingDetn FSEVETA_UnderTempIgbtLeftDetn FSEVETA_UnderTempNTC1CmdBoardDetn FSEVETA_UnderTempNTC2CmdBoardDetn FSEVIBT_EstiIbatHv FSEVIBT_IbatHVFild FSEVIBT_IbatHVFildZ FSEXCTX_MaxAvailableTorqueFild FSEXCTX_MaxAvailableTorqueFildZ FSEXCTX_MinAvailableTorqueFild FSEXCTX_MinAvailableTorqueFildZ FSEXCTX_MotorAppliedTorque FSEXCTX_MotorSpeed FSEXCTX_MotorState FSEXCTX_SwVerNum1 FSEXCTX_SwVerNum2 FSEXCTX_SwVerNum3 FSEXCTX_SwVerNum4 FSEXCTX_SysTempOvrInd FSMTMTA_CorrdTempWindingHead1 FSMTMTA_CorrdTempWindingHead2 FSMTMTA_OverTempWdgHead2Detn FSMTMTA_TempWindHeadRationalDetn FSMTMTA_TempWinding[0] FSMTMTA_TempWinding[1] FSMTMTA_TempWindingHead1 FSMTMTA_TempWindingHead1Fild FSMTMTA_TempWindingHead1FildZ FSMTMTA_TempWindingHead2 FSMTMTA_TempWindingHead2Fild FSMTMTA_TempWindingHead2FildZ FSMTMTA_TempWindingHead2GndDetn FSMTMTA_TempWindingHead2VccDetn FSMTMTA_TempWindingMax FSMTMTA_UnderTempWdgHead1Detn FSMTMTA_UnderTempWdgHead2Detn FSMTRDG_A2DResCorrdCosH FSMTRDG_A2DResCorrdCosL FSMTRDG_A2DResCorrdExitation FSMTRDG_A2DResCorrdSinH FSMTRDG_A2DResCorrdSinL FSMTRDG_CosHGndDetn FSMTRDG_CosHVccDetn FSMTRDG_CosHVolt FSMTRDG_CosHVoltFild FSMTRDG_CosHVoltFildZ FSMTRDG_CosLegInternalFail FSMTRDG_CosLegInternalFailDetn FSMTRDG_CosLegNormal FSMTRDG_CosLegOpen FSMTRDG_CosLegOpenDetn FSMTRDG_CosLegShortGnd FSMTRDG_CosLegShortGndDetn FSMTRDG_CosLegShortVcc FSMTRDG_CosLegShortVccDetn FSMTRDG_CosLGndDetn FSMTRDG_CosLVccDetn FSMTRDG_CosLVolt FSMTRDG_CosLVoltFild FSMTRDG_CosLVoltFildZ FSMTRDG_ExcDutyCycleErrDetn FSMTRDG_ExcFreqErrDetn FSMTRDG_ExcInternalFail FSMTRDG_ExcInternalFailDetn FSMTRDG_ExcNormal FSMTRDG_ExcOpen FSMTRDG_ExcOpenDetn FSMTRDG_ExcShortGnd FSMTRDG_ExcShortVcc FSMTRDG_ExcSignalGNDDetn FSMTRDG_ExcSignalVCCDetn FSMTRDG_ExcVoltageFild FSMTRDG_ExcVoltageFildZ FSMTRDG_ExitationDiagIO FSMTRDG_ExitationGndDetn FSMTRDG_ExitationVccDetn FSMTRDG_ExitationVolt FSMTRDG_IOcounterZ FSMTRDG_IOinZ FSMTRDG_IOoutZ FSMTRDG_OverVoltageDetn FSMTRDG_SinCosHLGnd FSMTRDG_SinCosHLOpen FSMTRDG_SinCosHLVcc FSMTRDG_SinHGndDetn FSMTRDG_SinHVccDetn FSMTRDG_SinHVolt FSMTRDG_SinHVoltFild FSMTRDG_SinHVoltFildZ FSMTRDG_SinLegInternalFail FSMTRDG_SinLegInternalFailDetn FSMTRDG_SinLegNormal FSMTRDG_SinLegOpen FSMTRDG_SinLegOpenDetn FSMTRDG_SinLegShortGnd FSMTRDG_SinLegShortGndDetn FSMTRDG_SinLegShortVcc FSMTRDG_SinLegShortVccDetn FSMTRDG_SinLGndDetn FSMTRDG_SinLVccDetn FSMTRDG_SinLVolt FSMTRDG_SinLVoltFild FSMTRDG_SinLVoltFildZ FSMTRDG_UnderVoltageDetn FSSMACS_AbsMecaSpeedRpmFild FSSMACS_AbsMecaSpeedRpmFildZ FSSMACS_AclState FSSMACS_CmdFtShutDownReq FSSMACS_CmdFtStartReq FSSMACS_CmdSwShutDownReq FSSMACS_FTModeReq FSSMACS_KL15 FSSMACS_KL15counterZ FSSMACS_KL15in FSSMACS_KL15inZ FSSMACS_KL15outZ FSSMACS_NormalStartFtFlg FSSMACS_OcFailure FSSMACS_OcFinish FSSMACS_RuningShutDelayComfCntZ FSSMACS_RunningAllowShutDownFlg FSSMACS_SCSpeedReady FSSMACS_SCSpeedReadyinZ FSSMACS_SCSpeedReadyoutZ FSSMACS_SelfCheakErrFlg FSSMACS_SpeedReadycounterZ FSSMACS_TorqueEnable FSSMACS_TxMcuMode FSSMACS_TxMotorMode FSSMMAM_AclState FSSMMAM_EVBHV_CheckEnable FSSMMAM_EVBLV_CheckEnable FSSMMAM_EVIBT_State FSSMMAM_MTRDG_CheckEnable FSTCGTC_AccCheckCnt FSTCGTC_ActiveSpdLmtSpeed FSTCGTC_ActiveSpdLmtTrqMax FSTCGTC_ActiveSpdLmtTrqMin FSTCGTC_AntiForwardKi FSTCGTC_AntiForwardKp FSTCGTC_AntiReverseKi FSTCGTC_AntiReverseKp FSTCGTC_BrakeCheckCnt FSTCGTC_BrakeExistHacFlg FSTCGTC_CanTorqueRef FSTCGTC_FwdSpeedError FSTCGTC_FwdSpeedKiSum FSTCGTC_FwdSpeedKiSumZ FSTCGTC_FwdSpeedKpSum FSTCGTC_FwdSpeedRef FSTCGTC_FwdTorque FSTCGTC_HacEnable FSTCGTC_HacEnableCnt FSTCGTC_HacEnableNumber FSTCGTC_HacTempOutCnt FSTCGTC_HacTempOutFlg FSTCGTC_HandBrakeCheckCnt FSTCGTC_I0dqTgt[0] FSTCGTC_I0dqTgt[1] FSTCGTC_I0dqTgt[2] FSTCGTC_LmtSpdGenTrqMax FSTCGTC_LocalGearState FSTCGTC_MecaSpeedRpmTgt FSTCGTC_OpenLoopLutEn FSTCGTC_OpenLoopLutEnCnt FSTCGTC_OutSlopSlipCnt FSTCGTC_OutSlopSlipFlg FSTCGTC_RampAssistfFlg FSTCGTC_RevSpeedError FSTCGTC_RevSpeedKiSum FSTCGTC_RevSpeedKiSumZ FSTCGTC_RevSpeedKpSum FSTCGTC_RevSpeedRef FSTCGTC_RevTorque FSTCGTC_ShiftingFlg FSTCGTC_SpdLmtIntegratorZ FSTCGTC_SpdLmtSpdErr FSTCGTC_SpdLmtTorqueTgt FSTCGTC_SpdLmtTrqComp FSTCGTC_SpdLmtTrqSatZ FSTCGTC_StopCheckCnt FSTCGTC_TorquePreTgtZ FSTCGTC_TorqueRefLimZ FSTCGTC_TorqueTgt FSTCGTC_TorqueTgtPhy FSTCGTC_TorqueTgtPhyComp FSTCGTC_TorqueTgtZ FSTCGTC_ToVcuTrqCheckCnt FSTCGTC_U0dqTgt[0] FSTCGTC_U0dqTgt[1] FSTCGTC_U0dqTgt[2] FSTCGTC_VehicleDirMecaSpeedRpm FSTCGTC_ZeroTorqueCompEnable RC_AN_Bus_Status RC_AN_KM1_Status RC_AN_KM2_Status RC_AN_KM3_Status RC_AN_KM4_Status RC_AN_KM5_Status RC_AN_KM6_Status RC_AN_KM7_Status RC_AN_KM8_Status RC_VCU_KM10_Cmd RC_VCU_KM1_Cmd RC_VCU_KM2_Cmd RC_VCU_KM3_Cmd RC_VCU_KM4_Cmd RC_VCU_KM5_Cmd RC_VCU_KM6_Cmd RC_VCU_KM7_Cmd RC_VCU_KM8_Cmd RC_VCU_KM9_Cmd RCEVHCM_A2DResCorrdVoltage RCEVHCM_A2DResCorrdVoltage1 RCEVHCM_A2DResCorrdVoltage2 RCEVHCM_A2DResCorrdVoltage3 RCEVHCM_A2DResCorrdVoltage4 RCEVHCM_A2DResCorrdVoltage5 RCEVHCM_A2DResCorrdVoltage6 RCEVHCM_A2DResCorrdVoltage7 RCEVHCM_A2DResCorrdVoltage8 RCEVHCM_BusCloseFlg RCEVHCM_BusVoltage RCEVHCM_BusVoltageFild RCEVHCM_BusVoltageFildZ RCEVHCM_KM1CloseFlg RCEVHCM_KM1Voltage RCEVHCM_KM1VoltageFild RCEVHCM_KM1VoltageFildZ RCEVHCM_KM2CloseFlg RCEVHCM_KM2Voltage RCEVHCM_KM2VoltageFild RCEVHCM_KM2VoltageFildZ RCEVHCM_KM3CloseFlg RCEVHCM_KM3Voltage RCEVHCM_KM3VoltageFild RCEVHCM_KM3VoltageFildZ RCEVHCM_KM4CloseFlg RCEVHCM_KM4Voltage RCEVHCM_KM4VoltageFild RCEVHCM_KM4VoltageFildZ RCEVHCM_KM5CloseFlg RCEVHCM_KM5Voltage RCEVHCM_KM5VoltageFild RCEVHCM_KM5VoltageFildZ RCEVHCM_KM6CloseFlg RCEVHCM_KM6Voltage RCEVHCM_KM6VoltageFild RCEVHCM_KM6VoltageFildZ RCEVHCM_KM7CloseFlg RCEVHCM_KM7Voltage RCEVHCM_KM7VoltageFild RCEVHCM_KM7VoltageFildZ RCEVHCM_KM8CloseFlg RCEVHCM_KM8Voltage RCEVHCM_KM8VoltageFild RCEVHCM_KM8VoltageFildZ RCSMACS_BswKM1PowerOff RCSMACS_BswKM1PowerOn RCSMACS_BswKM2PowerOff RCSMACS_BswKM2PowerOn RCSMACS_BswKM3PowerOff RCSMACS_BswKM3PowerOn RCSMACS_BswKM4PowerOff RCSMACS_BswKM4PowerOn RCSMACS_BswKM5PowerOff RCSMACS_BswKM5PowerOn RCSMACS_BswKM6PowerOff RCSMACS_BswKM6PowerOn RCSMACS_BswKM7PowerOff RCSMACS_BswKM7PowerOn RCSMACS_BswKM8PowerOff RCSMACS_BswKM8PowerOn RCSMACS_Err1CheckFinish RCSMACS_Err2CheckFinish RCSMACS_Err3CheckFinish RCSMACS_Err4CheckFinish RCSMACS_Err5CheckFinish RCSMACS_Err6CheckFinish RCSMACS_Err7CheckFinish RCSMACS_Err8CheckFinish RCSMACS_KM1AclState RCSMACS_KM1ConnectSts RCSMACS_KM1FaultSts RCSMACS_KM1StateChange RCSMACS_KM2AclState RCSMACS_KM2ConnectSts RCSMACS_KM2FaultSts RCSMACS_KM2StateChange RCSMACS_KM3AclState RCSMACS_KM3ConnectSts RCSMACS_KM3FaultSts RCSMACS_KM3StateChange RCSMACS_KM4AclState RCSMACS_KM4ConnectSts RCSMACS_KM4FaultSts RCSMACS_KM4StateChange RCSMACS_KM5AclState RCSMACS_KM5ConnectSts RCSMACS_KM5FaultSts RCSMACS_KM5StateChange RCSMACS_KM6AclState RCSMACS_KM6ConnectSts RCSMACS_KM6FaultSts RCSMACS_KM6StateChange RCSMACS_KM7AclState RCSMACS_KM7ConnectSts RCSMACS_KM7FaultSts RCSMACS_KM7StateChange RCSMACS_KM8AclState RCSMACS_KM8ConnectSts RCSMACS_KM8FaultSts RCSMACS_KM8StateChange RCSMACS_Rly1ErrCheckDelay RCSMACS_Rly2ErrCheckDelay RCSMACS_Rly3ErrCheckDelay RCSMACS_Rly4ErrCheckDelay RCSMACS_Rly5ErrCheckDelay RCSMACS_Rly6ErrCheckDelay RCSMACS_Rly7ErrCheckDelay RCSMACS_Rly8ErrCheckDelay /end OUT_MEASUREMENT
/end FUNCTION
/begin FUNCTION SWC_FT ""
 /begin OUT_MEASUREMENT AFT_AFTModeReq_U16 AFT_AkdAfterAsc_B AFT_BhvCheckEna_B AFT_BSWReadyStatus_B AFT_CmdAftShutDownReq_B AFT_CmdAftStartReq_B AFT_CmdPwmDirectRes_B AFT_CmdPwmOffRes_B AFT_DutyCycle3_F32[0] AFT_DutyCycle3_F32[1] AFT_DutyCycle3_F32[2] AFT_ExtCurrentGain_U16[0] AFT_ExtCurrentGain_U16[1] AFT_ExtCurrentGain_U16[2] AFT_ExtIuvw3RmsSum_F32[0] AFT_ExtIuvw3RmsSum_F32[1] AFT_ExtIuvw3RmsSum_F32[2] AFT_EXTPrechargeFinish_B AFT_FaultLevel_U16 AFT_FtRunFlg_U16 AFT_I0dqTgt3_F32[0] AFT_I0dqTgt3_F32[1] AFT_I0dqTgt3_F32[2] AFT_Iuvw3_U16[0] AFT_Iuvw3_U16[1] /end OUT_MEASUREMENT
/end FUNCTION
/begin COMPU_METHOD ESM_EsmMode_conv "" TAB_VERB "%8.4" "." COMPU_TAB_REF ESM_EsmMode_table /end COMPU_METHOD
/begin COMPU_VTAB ESM_EsmMode_table "" TAB_VERB 2 1 "ESM_ESM_MODE_NF" 4 "ESM_ESM_MODE_FT" /end COMPU_VTAB
/begin COMPU_METHOD GESM_EsmMode_conv "" TAB_VERB "%8.4" "." COMPU_TAB_REF GESM_EsmMode_table /end COMPU_METHOD
/begin COMPU_VTAB GESM_EsmMode_table "" TAB_VERB 2 1 "GESM_ESM_MODE_NF" 4 "GESM_ESM_MODE_FT" /end COMPU_VTAB
/end MODULE
/end PROJECT
