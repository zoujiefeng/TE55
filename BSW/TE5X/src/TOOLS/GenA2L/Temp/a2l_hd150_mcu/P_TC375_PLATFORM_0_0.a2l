ASAP2_VERSION 1 3
/begin PROJECT P_TC375_PLATFORM_0_0 "P_TC375_PLATFORM_0_0"
/begin HEADER "" VERSION "5210.00" PROJECT_NO D0 /end HEADER
/begin MODULE P_TC375_PLATFORM_0_0 "Invt"
/begin MOD_COMMON "" DEPOSIT ABSOLUTE ALIGNMENT_BYTE 1 ALIGNMENT_WORD 2 ALIGNMENT_LONG 4 ALIGNMENT_FLOAT32_IEEE 4 ALIGNMENT_FLOAT64_IEEE 8 BYTE_ORDER MSB_LAST /end MOD_COMMON
/begin RECORD_LAYOUT DATA_RECORD_UBYTE FNC_VALUES 1 UBYTE ROW_DIR DIRECT /end RECORD_LAYOUT
/begin RECORD_LAYOUT DATA_RECORD_UWORD FNC_VALUES 1 UWORD ROW_DIR DIRECT /end RECORD_LAYOUT
/begin RECORD_LAYOUT DATA_RECORD_SWORD FNC_VALUES 1 SWORD ROW_DIR DIRECT /end RECORD_LAYOUT
/begin RECORD_LAYOUT DATA_RECORD_ULONG FNC_VALUES 1 ULONG ROW_DIR DIRECT /end RECORD_LAYOUT
/begin RECORD_LAYOUT DATA_RECORD_SLONG FNC_VALUES 1 SLONG ROW_DIR DIRECT /end RECORD_LAYOUT
/begin RECORD_LAYOUT DATA_RECORD_FLOAT32_IEEE FNC_VALUES 1 FLOAT32_IEEE ROW_DIR DIRECT /end RECORD_LAYOUT
/begin CHARACTERISTIC AFTASBDS_BatVoltDrtEnableC "AFTASBDS_BatVoltDrtEnableC" VALUE 0x80059F44 DATA_RECORD_UBYTE 1 Bool_ON_OFF 0 1 BIT_MASK 0x01 /end CHARACTERISTIC
/begin CHARACTERISTIC AFTASBDS_LutBatteryDeratingGainC "AFTASBDS_LutBatteryDeratingGainC" CURVE 0x80059F2C DATA_RECORD_FLOAT32_IEEE 1 F_1_p0_2 0 1
 /begin AXIS_DESCR FIX_AXIS NO_INPUT_QUANTITY Id_0x00 6 0 5 MAX_GRAD 100.0 FIX_AXIS_PAR_DIST 0 1 6 /end AXIS_DESCR
/end CHARACTERISTIC
/begin CHARACTERISTIC AFTASBDS_LutBatteryVoltageC "AFTASBDS_LutBatteryVoltageC" CURVE 0x80059F14 DATA_RECORD_FLOAT32_IEEE 1200 F_1_p0_2 0 1200
 /begin AXIS_DESCR FIX_AXIS NO_INPUT_QUANTITY Id_0x00 6 0 5 MAX_GRAD 100.0 FIX_AXIS_PAR_DIST 0 1 6 /end AXIS_DESCR
/end CHARACTERISTIC
/begin CHARACTERISTIC AFTASBDS_LutInMecaSpeedRpmC "AFTASBDS_LutInMecaSpeedRpmC" CURVE 0x80059F08 DATA_RECORD_FLOAT32_IEEE 30000 F_1_p0_2 0 30000
 /begin AXIS_DESCR FIX_AXIS NO_INPUT_QUANTITY Id_0x00 3 0 2 MAX_GRAD 100.0 FIX_AXIS_PAR_DIST 0 1 3 /end AXIS_DESCR
/end CHARACTERISTIC
/begin CHARACTERISTIC AFTASBDS_LutOutDeratingGainC "AFTASBDS_LutOutDeratingGainC" CURVE 0x80059EFC DATA_RECORD_FLOAT32_IEEE 1 F_1_p0_2 0 1
 /begin AXIS_DESCR FIX_AXIS NO_INPUT_QUANTITY Id_0x00 3 0 2 MAX_GRAD 100.0 FIX_AXIS_PAR_DIST 0 1 3 /end AXIS_DESCR
/end CHARACTERISTIC
/begin CHARACTERISTIC AFTASBDS_ManualDeratingGainC "AFTASBDS_ManualDeratingGainC" VALUE 0x80059EF8 DATA_RECORD_FLOAT32_IEEE 1 F_1_p0_2 0 1 /end CHARACTERISTIC
/begin CHARACTERISTIC AFTASBDS_MaxDeratingGainC "AFTASBDS_MaxDeratingGainC" VALUE 0x80059EF4 DATA_RECORD_FLOAT32_IEEE 1 F_1_p0_2 0 1 /end CHARACTERISTIC
/begin CHARACTERISTIC AFTASBDS_MinDeratingGainC "AFTASBDS_MinDeratingGainC" VALUE 0x80059EF0 DATA_RECORD_FLOAT32_IEEE 1 F_1_p0_2 0 1 /end CHARACTERISTIC
/begin CHARACTERISTIC AFTASBDS_UbatHVNominalC "AFTASBDS_UbatHVNominalC" VALUE 0x80059EEC DATA_RECORD_FLOAT32_IEEE 1200 F_1_p0_2 0 1200 /end CHARACTERISTIC
/begin CHARACTERISTIC AFTASDPM_I0DeratingMaxC "AFTASDPM_I0DeratingMaxC" VALUE 0x80059F64 DATA_RECORD_FLOAT32_IEEE 1200 F_1_p0_2 0 1200 /end CHARACTERISTIC
/begin CHARACTERISTIC AFTASDPM_I0DeratingMinC "AFTASDPM_I0DeratingMinC" VALUE 0x80059F60 DATA_RECORD_FLOAT32_IEEE 1200 F_1_p0_2 -1200 0 /end CHARACTERISTIC
/begin CHARACTERISTIC AFTASDPM_IdDeratingMaxC "AFTASDPM_IdDeratingMaxC" VALUE 0x80059F5C DATA_RECORD_FLOAT32_IEEE 1200 F_1_p0_2 0 1200 /end CHARACTERISTIC
/begin CHARACTERISTIC AFTASDPM_IdDeratingMinC "AFTASDPM_IdDeratingMinC" VALUE 0x80059F58 DATA_RECORD_FLOAT32_IEEE 1200 F_1_p0_2 -1200 0 /end CHARACTERISTIC
/begin CHARACTERISTIC AFTASDPM_IqDeratingMaxC "AFTASDPM_IqDeratingMaxC" VALUE 0x80059F54 DATA_RECORD_FLOAT32_IEEE 1200 F_1_p0_2 0 1200 /end CHARACTERISTIC
/begin CHARACTERISTIC AFTASDPM_IqDeratingMinC "AFTASDPM_IqDeratingMinC" VALUE 0x80059F50 DATA_RECORD_FLOAT32_IEEE 1200 F_1_p0_2 -1200 0 /end CHARACTERISTIC
/begin CHARACTERISTIC AFTASDPM_SpeedDrtMaxRpmC "AFTASDPM_SpeedDrtMaxRpmC" VALUE 0x80059F4C DATA_RECORD_FLOAT32_IEEE 25000 F_1_p0_2 0 25000 /end CHARACTERISTIC
/begin CHARACTERISTIC AFTASDPM_SpeedDrtMinRpmC "AFTASDPM_SpeedDrtMinRpmC" VALUE 0x80059F48 DATA_RECORD_FLOAT32_IEEE 25000 F_1_p0_2 -25000 0 /end CHARACTERISTIC
/begin CHARACTERISTIC AFTASETP_ControllerPmKiC "Controller integral coefficient." VALUE 0x80059F80 DATA_RECORD_FLOAT32_IEEE 1000 F_1_p0_2 0 1000 /end CHARACTERISTIC
/begin CHARACTERISTIC AFTASETP_ControllerPmKpC "Controller proportional coefficient." VALUE 0x80059F7C DATA_RECORD_FLOAT32_IEEE 1000 F_1_p0_2 0 1000 /end CHARACTERISTIC
/begin CHARACTERISTIC AFTASETP_MaxDeratingGainC "Gain maximal value." VALUE 0x80059F78 DATA_RECORD_FLOAT32_IEEE 1 F_1_p0_2 0 1 /end CHARACTERISTIC
/begin CHARACTERISTIC AFTASETP_MinDeratingGainC "Gain minimal value." VALUE 0x80059F74 DATA_RECORD_FLOAT32_IEEE 1 F_1_p0_2 0 1 /end CHARACTERISTIC
/begin CHARACTERISTIC AFTASETP_PmDrtEnableC "Enable derating" VALUE 0x80059F70 DATA_RECORD_UBYTE 1 Bool_ON_OFF 0 1 BIT_MASK 0x01 /end CHARACTERISTIC
/begin CHARACTERISTIC AFTASETP_PmKiMaxC "AFTASETP_PmKiMaxC" VALUE 0x80059F6C DATA_RECORD_FLOAT32_IEEE 1 F_1_p0_2 0 1 /end CHARACTERISTIC
/begin CHARACTERISTIC AFTASETP_PmMaximalTempC "AFTASETP_PmMaximalTempC" VALUE 0x80059F68 DATA_RECORD_FLOAT32_IEEE 200 F_1_p0_2 0 200 /end CHARACTERISTIC
/begin CHARACTERISTIC AFTASMTP_ControllerWndgKiC "Controller integral coefficient." VALUE 0x80059F9C DATA_RECORD_FLOAT32_IEEE 1000 F_1_p0_2 0 1000 /end CHARACTERISTIC
/begin CHARACTERISTIC AFTASMTP_ControllerWndgKpC "Controller proportional coefficient." VALUE 0x80059F98 DATA_RECORD_FLOAT32_IEEE 1000 F_1_p0_2 0 1000 /end CHARACTERISTIC
/begin CHARACTERISTIC AFTASMTP_MaxDeratingGainC "Gain maximal value." VALUE 0x80059F94 DATA_RECORD_FLOAT32_IEEE 1 F_1_p0_2 0 1 /end CHARACTERISTIC
/begin CHARACTERISTIC AFTASMTP_MinDeratingGainC "Gain minimal value." VALUE 0x80059F90 DATA_RECORD_FLOAT32_IEEE 1 F_1_p0_2 0 1 /end CHARACTERISTIC
/begin CHARACTERISTIC AFTASMTP_WndgDrtEnableC "Enable derating" VALUE 0x80059F8C DATA_RECORD_UBYTE 1 Bool_ON_OFF 0 1 BIT_MASK 0x01 /end CHARACTERISTIC
/begin CHARACTERISTIC AFTASMTP_WndgKiMaxC "AFTASMTP_WndgKiMaxC" VALUE 0x80059F88 DATA_RECORD_FLOAT32_IEEE 1 F_1_p0_2 0 1 /end CHARACTERISTIC
/begin CHARACTERISTIC AFTASMTP_WndgMaximalTempC "AFTASMTP_WndgMaximalTempC" VALUE 0x80059F84 DATA_RECORD_FLOAT32_IEEE 200 F_1_p0_2 0 200 /end CHARACTERISTIC
/begin CHARACTERISTIC AFTASOSP_LutMotDeratingGainC "AFTASOSP_LutMotDeratingGainC" CURVE 0x80059FB8 DATA_RECORD_FLOAT32_IEEE 1 F_1_p0_2 0 1
 /begin AXIS_DESCR FIX_AXIS NO_INPUT_QUANTITY Id_0x00 2 0 1 MAX_GRAD 100.0 FIX_AXIS_PAR_DIST 0 1 2 /end AXIS_DESCR
/end CHARACTERISTIC
/begin CHARACTERISTIC AFTASOSP_LutMotorSpeedC "AFTASOSP_LutMotorSpeedC" CURVE 0x80059FB0 DATA_RECORD_FLOAT32_IEEE 20000 F_1_p0_2 0 20000
 /begin AXIS_DESCR FIX_AXIS NO_INPUT_QUANTITY Id_0x00 2 0 1 MAX_GRAD 100.0 FIX_AXIS_PAR_DIST 0 1 2 /end AXIS_DESCR
/end CHARACTERISTIC
/begin CHARACTERISTIC AFTASOSP_ManualDeratingGainC "AFTASOSP_ManualDeratingGainC" VALUE 0x80059FAC DATA_RECORD_FLOAT32_IEEE 1 F_1_p0_2 0 1 /end CHARACTERISTIC
/begin CHARACTERISTIC AFTASOSP_MaxDeratingGainC "AFTASOSP_MaxDeratingGainC" VALUE 0x80059FA8 DATA_RECORD_FLOAT32_IEEE 1 F_1_p0_2 0 1 /end CHARACTERISTIC
/begin CHARACTERISTIC AFTASOSP_MinDeratingGainC "AFTASOSP_MinDeratingGainC" VALUE 0x80059FA4 DATA_RECORD_FLOAT32_IEEE 1 F_1_p0_2 0 1 /end CHARACTERISTIC
/begin CHARACTERISTIC AFTASOSP_MotorSpdDrtEnableC "AFTASOSP_MotorSpdDrtEnableC" VALUE 0x80059FA0 DATA_RECORD_UBYTE 1 Bool_ON_OFF 0 1 BIT_MASK 0x01 /end CHARACTERISTIC
/begin CHARACTERISTIC AFTCIVDC_AntiNarrowPulseEnC "AFTCIVDC_AntiNarrowPulseEnC" VALUE 0x8005A084 DATA_RECORD_UBYTE 1 Bool_ON_OFF 0 1 BIT_MASK 0x01 /end CHARACTERISTIC
/begin CHARACTERISTIC AFTCIVDC_Concordia33C "AFTCIVDC_Concordia33C" MAP 0x8005A060 DATA_RECORD_FLOAT32_IEEE 2 F_1_p0_2 -1 1
 /begin AXIS_DESCR FIX_AXIS NO_INPUT_QUANTITY Id_0x00 3 0 2 MAX_GRAD 100.0 FIX_AXIS_PAR_DIST 0 1 3 /end AXIS_DESCR
 /begin AXIS_DESCR FIX_AXIS NO_INPUT_QUANTITY Id_0x00 3 0 2 MAX_GRAD 100.0 FIX_AXIS_PAR_DIST 0 1 3 /end AXIS_DESCR
/end CHARACTERISTIC
/begin CHARACTERISTIC AFTCIVDC_DeadComDisableIsC "AFTCIVDC_DeadComDisableIsC" VALUE 0x8005A05C DATA_RECORD_FLOAT32_IEEE 3.402823466E+038 F_1_p0_2 -3.402823466E+038 3.402823466E+038 /end CHARACTERISTIC
/begin CHARACTERISTIC AFTCIVDC_DeadComEnableIsC "AFTCIVDC_DeadComEnableIsC" VALUE 0x8005A058 DATA_RECORD_FLOAT32_IEEE 3.402823466E+038 F_1_p0_2 -3.402823466E+038 3.402823466E+038 /end CHARACTERISTIC
/begin CHARACTERISTIC AFTCIVDC_DeadCompCurFildNumC "AFTCIVDC_DeadCompCurFildNumC" VALUE 0x8005A054 DATA_RECORD_FLOAT32_IEEE 3.402823466E+038 F_1_p0_2 -3.402823466E+038 3.402823466E+038 /end CHARACTERISTIC
/begin CHARACTERISTIC AFTCIVDC_DeadCompDutyFildNumC "AFTCIVDC_DeadCompDutyFildNumC" VALUE 0x8005A050 DATA_RECORD_FLOAT32_IEEE 3.402823466E+038 F_1_p0_2 -3.402823466E+038 3.402823466E+038 /end CHARACTERISTIC
/begin CHARACTERISTIC AFTCIVDC_DeadCurrentSwitchC "AFTCIVDC_DeadCurrentSwitchC" VALUE 0x8005A04C DATA_RECORD_UBYTE 1 Bool_ON_OFF 0 1 BIT_MASK 0x01 /end CHARACTERISTIC
/begin CHARACTERISTIC AFTCIVDC_DeadZnCompEnaC "AFTCIVDC_DeadZnCompEnaC" VALUE 0x8005A048 DATA_RECORD_UBYTE 1 Bool_ON_OFF 0 1 BIT_MASK 0x01 /end CHARACTERISTIC
/begin CHARACTERISTIC AFTCIVDC_DeadZnCompSpeedHighC "AFTCIVDC_DeadZnCompSpeedHighC" VALUE 0x8005A044 DATA_RECORD_FLOAT32_IEEE 3.402823466E+038 F_1_p0_2 -3.402823466E+038 3.402823466E+038 /end CHARACTERISTIC
/begin CHARACTERISTIC AFTCIVDC_DeadZnCompSpeedLowC "AFTCIVDC_DeadZnCompSpeedLowC" VALUE 0x8005A040 DATA_RECORD_FLOAT32_IEEE 3.402823466E+038 F_1_p0_2 -3.402823466E+038 3.402823466E+038 /end CHARACTERISTIC
/begin CHARACTERISTIC AFTCIVDC_DeadZoneTimeUsC "AFTCIVDC_DeadZoneTimeUsC" VALUE 0x8005A03C DATA_RECORD_FLOAT32_IEEE 10 F_1_p0_2 0 10 /end CHARACTERISTIC
/begin CHARACTERISTIC AFTCIVDC_DefaultPwmFrequencyC "AFTCIVDC_DefaultPwmFrequencyC" VALUE 0x8005A038 DATA_RECORD_UWORD 65535 F_1_p0_2 0 65535 /end CHARACTERISTIC
/begin CHARACTERISTIC AFTCIVDC_DutyCycleMaxC "AFTCIVDC_DutyCycleMaxC" VALUE 0x8005A034 DATA_RECORD_FLOAT32_IEEE 1 F_1_p0_2 0 1 /end CHARACTERISTIC
/begin CHARACTERISTIC AFTCIVDC_DutyCycleMinC "AFTCIVDC_DutyCycleMinC" VALUE 0x8005A030 DATA_RECORD_FLOAT32_IEEE 1 F_1_p0_2 0 1 /end CHARACTERISTIC
/begin CHARACTERISTIC AFTCIVDC_ExtPwmOnOff3C "AFTCIVDC_ExtPwmOnOff3C" CURVE 0x8005A02C DATA_RECORD_UBYTE 1 Bool_ON_OFF 0 1 BIT_MASK 0x01
 /begin AXIS_DESCR FIX_AXIS NO_INPUT_QUANTITY Id_0x00 3 0 2 MAX_GRAD 100.0 FIX_AXIS_PAR_DIST 0 1 3 /end AXIS_DESCR
/end CHARACTERISTIC
/begin CHARACTERISTIC AFTCIVDC_FpgaDutyCycleMinMaxC "AFTCIVDC_FpgaDutyCycleMinMaxC" CURVE 0x8005A024 DATA_RECORD_FLOAT32_IEEE 1 F_1_p0_2 0 1
 /begin AXIS_DESCR FIX_AXIS NO_INPUT_QUANTITY Id_0x00 2 0 1 MAX_GRAD 100.0 FIX_AXIS_PAR_DIST 0 1 2 /end AXIS_DESCR
/end CHARACTERISTIC
/begin CHARACTERISTIC AFTCIVDC_InitDutyCycle3C "AFTCIVDC_InitDutyCycle3C" CURVE 0x8005A018 DATA_RECORD_FLOAT32_IEEE 1 F_1_p0_2 0 1
 /begin AXIS_DESCR FIX_AXIS NO_INPUT_QUANTITY Id_0x00 3 0 2 MAX_GRAD 100.0 FIX_AXIS_PAR_DIST 0 1 3 /end AXIS_DESCR
/end CHARACTERISTIC
/begin CHARACTERISTIC AFTCIVDC_InitPwmOnOff3C "AFTCIVDC_InitPwmOnOff3C" CURVE 0x8005A014 DATA_RECORD_UBYTE 1 Bool_ON_OFF 0 1 BIT_MASK 0x01
 /begin AXIS_DESCR FIX_AXIS NO_INPUT_QUANTITY Id_0x00 3 0 2 MAX_GRAD 100.0 FIX_AXIS_PAR_DIST 0 1 3 /end AXIS_DESCR
/end CHARACTERISTIC
/begin CHARACTERISTIC AFTCIVDC_LutMecaspeedRpmC "AFTCIVDC_LutMecaspeedRpmC" CURVE 0x80059FF4 DATA_RECORD_FLOAT32_IEEE 3.402823466E+038 F_1_p0_2 -3.402823466E+038 3.402823466E+038
 /begin AXIS_DESCR FIX_AXIS NO_INPUT_QUANTITY Id_0x00 8 0 7 MAX_GRAD 100.0 FIX_AXIS_PAR_DIST 0 1 8 /end AXIS_DESCR
/end CHARACTERISTIC
/begin CHARACTERISTIC AFTCIVDC_LutPwmFrequenceC "AFTCIVDC_LutPwmFrequenceC" CURVE 0x80059FE4 DATA_RECORD_UWORD 65535 F_1_p0_2 0 65535
 /begin AXIS_DESCR FIX_AXIS NO_INPUT_QUANTITY Id_0x00 8 0 7 MAX_GRAD 100.0 FIX_AXIS_PAR_DIST 0 1 8 /end AXIS_DESCR
/end CHARACTERISTIC
/begin CHARACTERISTIC AFTCIVDC_MecaSpdCutOffFrequencyC "AFTCIVDC_MecaSpdCutOffFrequencyC" VALUE 0x80059FE0 DATA_RECORD_FLOAT32_IEEE 3.402823466E+038 F_1_p0_2 -3.402823466E+038 3.402823466E+038 /end CHARACTERISTIC
/begin CHARACTERISTIC AFTCIVDC_NarrowPulseTimeC "AFTCIVDC_NarrowPulseTimeC" VALUE 0x80059FDC DATA_RECORD_FLOAT32_IEEE 1 F_1_p0_2 0 1 /end CHARACTERISTIC
/begin CHARACTERISTIC AFTCIVDC_OperationnalPwmOnOff3C "AFTCIVDC_OperationnalPwmOnOff3C" CURVE 0x80059FD8 DATA_RECORD_UBYTE 1 Bool_ON_OFF 0 1 BIT_MASK 0x01
 /begin AXIS_DESCR FIX_AXIS NO_INPUT_QUANTITY Id_0x00 3 0 2 MAX_GRAD 100.0 FIX_AXIS_PAR_DIST 0 1 3 /end AXIS_DESCR
/end CHARACTERISTIC
/begin CHARACTERISTIC AFTCIVDC_PwmFrequenceMaxC "AFTCIVDC_PwmFrequenceMaxC" VALUE 0x80059FD4 DATA_RECORD_UWORD 65535 F_1_p0_2 0 65535 /end CHARACTERISTIC
/begin CHARACTERISTIC AFTCIVDC_PwmFrequenceMinC "AFTCIVDC_PwmFrequenceMinC" VALUE 0x80059FD0 DATA_RECORD_UWORD 65535 F_1_p0_2 0 65535 /end CHARACTERISTIC
/begin CHARACTERISTIC AFTCIVDC_PwmZeroMatchEnC "AFTCIVDC_PwmZeroMatchEnC" VALUE 0x80059FCC DATA_RECORD_UBYTE 1 Bool_ON_OFF 0 1 BIT_MASK 0x01 /end CHARACTERISTIC
/begin CHARACTERISTIC AFTCIVDC_PwmZeroMatchRevC "AFTCIVDC_PwmZeroMatchRevC" VALUE 0x80059FC8 DATA_RECORD_UBYTE 1 Bool_ON_OFF 0 1 BIT_MASK 0x01 /end CHARACTERISTIC
/begin CHARACTERISTIC AFTCIVDC_UbatHVLowSatC "AFTCIVDC_UbatHVLowSatC" VALUE 0x80059FC4 DATA_RECORD_FLOAT32_IEEE 99 F_1_p0_2 1 100 /end CHARACTERISTIC
/begin CHARACTERISTIC AFTCIVDC_VFreqEnableC "AFTCIVDC_VFreqEnableC" VALUE 0x80059FC0 DATA_RECORD_UBYTE 1 Bool_ON_OFF 0 1 BIT_MASK 0x01 /end CHARACTERISTIC
/begin CHARACTERISTIC AFTCMCCS_CurrentLoopOrgEnC "AFTCMCCS_CurrentLoopOrgEnC" VALUE 0x8005A558 DATA_RECORD_UBYTE 1 Bool_ON_OFF 0 1 BIT_MASK 0x01 /end CHARACTERISTIC
/begin CHARACTERISTIC AFTCMCCS_EM1dOpenLoopGainC "AFTCMCCS_EM1dOpenLoopGainC" VALUE 0x8005A554 DATA_RECORD_FLOAT32_IEEE 3.402823466E+038 F_1_p0_2 -3.402823466E+038 3.402823466E+038 /end CHARACTERISTIC
/begin CHARACTERISTIC AFTCMCCS_EM1qOpenLoopGainC "AFTCMCCS_EM1qOpenLoopGainC" VALUE 0x8005A550 DATA_RECORD_FLOAT32_IEEE 3.402823466E+038 F_1_p0_2 -3.402823466E+038 3.402823466E+038 /end CHARACTERISTIC
/begin CHARACTERISTIC AFTCMCCS_GenTableTorqueThrdC "AFTCMCCS_GenTableTorqueThrdC" VALUE 0x8005A54C DATA_RECORD_FLOAT32_IEEE 3.402823466E+038 F_1_p0_2 -3.402823466E+038 3.402823466E+038 /end CHARACTERISTIC
/begin CHARACTERISTIC AFTCMCCS_HFIAmplitudeC "AFTCMCCS_HFIAmplitudeC" VALUE 0x8005A548 DATA_RECORD_FLOAT32_IEEE 3.402823466E+038 F_1_p0_2 -3.402823466E+038 3.402823466E+038 /end CHARACTERISTIC
/begin CHARACTERISTIC AFTCMCCS_HFIEnC "AFTCMCCS_HFIEnC" VALUE 0x8005A544 DATA_RECORD_UBYTE 1 Bool_ON_OFF 0 1 BIT_MASK 0x01 /end CHARACTERISTIC
/begin CHARACTERISTIC AFTCMCCS_HFIOnePeriodPointsC "AFTCMCCS_HFIOnePeriodPointsC" VALUE 0x8005A540 DATA_RECORD_FLOAT32_IEEE 3.402823466E+038 F_1_p0_2 -3.402823466E+038 3.402823466E+038 /end CHARACTERISTIC
/begin CHARACTERISTIC AFTCMCCS_IdCurrLoopParOnOffC "AFTCMCCS_IdCurrLoopParOnOffC" VALUE 0x8005A53C DATA_RECORD_UBYTE 1 Bool_ON_OFF 0 1 BIT_MASK 0x01 /end CHARACTERISTIC
/begin CHARACTERISTIC AFTCMCCS_InitU0dqTgt3C "AFTCMCCS_InitU0dqTgt3C" CURVE 0x8005A530 DATA_RECORD_FLOAT32_IEEE 3.402823466E+038 F_1_p0_2 -3.402823466E+038 3.402823466E+038
 /begin AXIS_DESCR FIX_AXIS NO_INPUT_QUANTITY Id_0x00 3 0 2 MAX_GRAD 100.0 FIX_AXIS_PAR_DIST 0 1 3 /end AXIS_DESCR
/end CHARACTERISTIC
/begin CHARACTERISTIC AFTCMCCS_IqCurrLoopParOnOffC "AFTCMCCS_IqCurrLoopParOnOffC" VALUE 0x8005A52C DATA_RECORD_UBYTE 1 Bool_ON_OFF 0 1 BIT_MASK 0x01 /end CHARACTERISTIC
/begin CHARACTERISTIC AFTCMCCS_Lm0C "AFTCMCCS_Lm0C" VALUE 0x8005A528 DATA_RECORD_FLOAT32_IEEE 3.402823466E+038 F_1_p0_2 -3.402823466E+038 3.402823466E+038 /end CHARACTERISTIC
/begin CHARACTERISTIC AFTCMCCS_Lm1dC "AFTCMCCS_Lm1dC" VALUE 0x8005A524 DATA_RECORD_FLOAT32_IEEE 3.402823466E+038 F_1_p0_2 -3.402823466E+038 3.402823466E+038 /end CHARACTERISTIC
/begin CHARACTERISTIC AFTCMCCS_Lm1qC "AFTCMCCS_Lm1qC" VALUE 0x8005A520 DATA_RECORD_FLOAT32_IEEE 3.402823466E+038 F_1_p0_2 -3.402823466E+038 3.402823466E+038 /end CHARACTERISTIC
/begin CHARACTERISTIC AFTCMCCS_LutElecSpeedRds3C "AFTCMCCS_LutElecSpeedRds3C" CURVE 0x8005A514 DATA_RECORD_FLOAT32_IEEE 3.402823466E+038 F_1_p0_2 -3.402823466E+038 3.402823466E+038
 /begin AXIS_DESCR FIX_AXIS NO_INPUT_QUANTITY Id_0x00 3 0 2 MAX_GRAD 100.0 FIX_AXIS_PAR_DIST 0 1 3 /end AXIS_DESCR
/end CHARACTERISTIC
/begin CHARACTERISTIC AFTCMCCS_LutInSpeedRpmC "AFTCMCCS_LutInSpeedRpmC" CURVE 0x8005A4D4 DATA_RECORD_FLOAT32_IEEE 3.402823466E+038 F_1_p0_2 -3.402823466E+038 3.402823466E+038
 /begin AXIS_DESCR FIX_AXIS NO_INPUT_QUANTITY Id_0x00 16 0 15 MAX_GRAD 100.0 FIX_AXIS_PAR_DIST 0 1 16 /end AXIS_DESCR
/end CHARACTERISTIC
/begin CHARACTERISTIC AFTCMCCS_LutInUbatC "AFTCMCCS_LutInUbatC" CURVE 0x8005A4C4 DATA_RECORD_FLOAT32_IEEE 3.402823466E+038 F_1_p0_2 -3.402823466E+038 3.402823466E+038
 /begin AXIS_DESCR FIX_AXIS NO_INPUT_QUANTITY Id_0x00 4 0 3 MAX_GRAD 100.0 FIX_AXIS_PAR_DIST 0 1 4 /end AXIS_DESCR
/end CHARACTERISTIC
/begin CHARACTERISTIC AFTCMCCS_LutM0CtrlTrC "AFTCMCCS_LutM0CtrlTrC" CURVE 0x8005A4B8 DATA_RECORD_FLOAT32_IEEE 999.9999 F_1_p0_2 0.0001 1000
 /begin AXIS_DESCR FIX_AXIS NO_INPUT_QUANTITY Id_0x00 3 0 2 MAX_GRAD 100.0 FIX_AXIS_PAR_DIST 0 1 3 /end AXIS_DESCR
/end CHARACTERISTIC
/begin CHARACTERISTIC AFTCMCCS_LutOutM1dCtrlTrGC "AFTCMCCS_LutOutM1dCtrlTrGC" MAP 0x8005A3B8 DATA_RECORD_FLOAT32_IEEE 3.402823466E+038 F_1_p0_2 -3.402823466E+038 3.402823466E+038
 /begin AXIS_DESCR FIX_AXIS NO_INPUT_QUANTITY Id_0x00 4 0 3 MAX_GRAD 100.0 FIX_AXIS_PAR_DIST 0 1 4 /end AXIS_DESCR
 /begin AXIS_DESCR FIX_AXIS NO_INPUT_QUANTITY Id_0x00 16 0 15 MAX_GRAD 100.0 FIX_AXIS_PAR_DIST 0 1 16 /end AXIS_DESCR
/end CHARACTERISTIC
/begin CHARACTERISTIC AFTCMCCS_LutOutM1dCtrlTrMC "AFTCMCCS_LutOutM1dCtrlTrMC" MAP 0x8005A2B8 DATA_RECORD_FLOAT32_IEEE 3.402823466E+038 F_1_p0_2 -3.402823466E+038 3.402823466E+038
 /begin AXIS_DESCR FIX_AXIS NO_INPUT_QUANTITY Id_0x00 4 0 3 MAX_GRAD 100.0 FIX_AXIS_PAR_DIST 0 1 4 /end AXIS_DESCR
 /begin AXIS_DESCR FIX_AXIS NO_INPUT_QUANTITY Id_0x00 16 0 15 MAX_GRAD 100.0 FIX_AXIS_PAR_DIST 0 1 16 /end AXIS_DESCR
/end CHARACTERISTIC
/begin CHARACTERISTIC AFTCMCCS_LutOutM1qCtrlTrGC "AFTCMCCS_LutOutM1qCtrlTrGC" MAP 0x8005A1B8 DATA_RECORD_FLOAT32_IEEE 3.402823466E+038 F_1_p0_2 -3.402823466E+038 3.402823466E+038
 /begin AXIS_DESCR FIX_AXIS NO_INPUT_QUANTITY Id_0x00 4 0 3 MAX_GRAD 100.0 FIX_AXIS_PAR_DIST 0 1 4 /end AXIS_DESCR
 /begin AXIS_DESCR FIX_AXIS NO_INPUT_QUANTITY Id_0x00 16 0 15 MAX_GRAD 100.0 FIX_AXIS_PAR_DIST 0 1 16 /end AXIS_DESCR
/end CHARACTERISTIC
/begin CHARACTERISTIC AFTCMCCS_LutOutM1qCtrlTrMC "AFTCMCCS_LutOutM1qCtrlTrMC" MAP 0x8005A0B8 DATA_RECORD_FLOAT32_IEEE 3.402823466E+038 F_1_p0_2 -3.402823466E+038 3.402823466E+038
 /begin AXIS_DESCR FIX_AXIS NO_INPUT_QUANTITY Id_0x00 4 0 3 MAX_GRAD 100.0 FIX_AXIS_PAR_DIST 0 1 4 /end AXIS_DESCR
 /begin AXIS_DESCR FIX_AXIS NO_INPUT_QUANTITY Id_0x00 16 0 15 MAX_GRAD 100.0 FIX_AXIS_PAR_DIST 0 1 16 /end AXIS_DESCR
/end CHARACTERISTIC
/begin CHARACTERISTIC AFTCMCCS_M1dCtrlTrC "AFTCMCCS_M1dCtrlTrC" VALUE 0x8005A0B4 DATA_RECORD_FLOAT32_IEEE 999.9999 F_1_p0_2 0.0001 1000 /end CHARACTERISTIC
/begin CHARACTERISTIC AFTCMCCS_M1qCtrlTrC "AFTCMCCS_M1qCtrlTrC" VALUE 0x8005A0B0 DATA_RECORD_FLOAT32_IEEE 999.9999 F_1_p0_2 0.0001 1000 /end CHARACTERISTIC
/begin CHARACTERISTIC AFTCMCCS_PhimC "AFTCMCCS_PhimC" VALUE 0x8005A0AC DATA_RECORD_FLOAT32_IEEE 3.402823466E+038 F_1_p0_2 -3.402823466E+038 3.402823466E+038 /end CHARACTERISTIC
/begin CHARACTERISTIC AFTCMCCS_RsC "AFTCMCCS_RsC" VALUE 0x8005A0A8 DATA_RECORD_FLOAT32_IEEE 3.402823466E+038 F_1_p0_2 -3.402823466E+038 3.402823466E+038 /end CHARACTERISTIC
/begin CHARACTERISTIC AFTCMCCS_SampleTimeFactC "AFTCMCCS_SampleTimeFactC" VALUE 0x8005A0A4 DATA_RECORD_FLOAT32_IEEE 3.402823466E+038 F_1_p0_2 -3.402823466E+038 3.402823466E+038 /end CHARACTERISTIC
/begin CHARACTERISTIC AFTCMCCS_TransEmfM1dGainC "AFTCMCCS_TransEmfM1dGainC" VALUE 0x8005A0A0 DATA_RECORD_FLOAT32_IEEE 3.402823466E+038 F_1_p0_2 -3.402823466E+038 3.402823466E+038 /end CHARACTERISTIC
/begin CHARACTERISTIC AFTCMCCS_TransEmfM1qGainC "AFTCMCCS_TransEmfM1qGainC" VALUE 0x8005A09C DATA_RECORD_FLOAT32_IEEE 3.402823466E+038 F_1_p0_2 -3.402823466E+038 3.402823466E+038 /end CHARACTERISTIC
/begin CHARACTERISTIC AFTCMCCS_VariableLm1dOnOffC "AFTCMCCS_VariableLm1dOnOffC" VALUE 0x8005A098 DATA_RECORD_UBYTE 1 Bool_ON_OFF 0 1 BIT_MASK 0x01 /end CHARACTERISTIC
/begin CHARACTERISTIC AFTCMCCS_VariableLm1qOnOffC "AFTCMCCS_VariableLm1qOnOffC" VALUE 0x8005A094 DATA_RECORD_UBYTE 1 Bool_ON_OFF 0 1 BIT_MASK 0x01 /end CHARACTERISTIC
/begin CHARACTERISTIC AFTCMCCS_VariablePhimOnOffC "AFTCMCCS_VariablePhimOnOffC" VALUE 0x8005A090 DATA_RECORD_UBYTE 1 Bool_ON_OFF 0 1 BIT_MASK 0x01 /end CHARACTERISTIC
/begin CHARACTERISTIC AFTCMCCS_iM1dTgtFildTrC "AFTCMCCS_iM1dTgtFildTrC" VALUE 0x8005A08C DATA_RECORD_FLOAT32_IEEE 999.9999 F_1_p0_2 0.0001 1000 /end CHARACTERISTIC
/begin CHARACTERISTIC AFTCMCCS_iM1qTgtFildTrC "AFTCMCCS_iM1qTgtFildTrC" VALUE 0x8005A088 DATA_RECORD_FLOAT32_IEEE 999.9999 F_1_p0_2 0.0001 1000 /end CHARACTERISTIC
/begin CHARACTERISTIC AFTCMRPC_ConcordiaTrans33C "concordia transformation matrix" MAP 0x8005A580 DATA_RECORD_FLOAT32_IEEE 3.402823466E+038 F_1_p0_2 -3.402823466E+038 3.402823466E+038
 /begin AXIS_DESCR FIX_AXIS NO_INPUT_QUANTITY Id_0x00 3 0 2 MAX_GRAD 100.0 FIX_AXIS_PAR_DIST 0 1 3 /end AXIS_DESCR
 /begin AXIS_DESCR FIX_AXIS NO_INPUT_QUANTITY Id_0x00 3 0 2 MAX_GRAD 100.0 FIX_AXIS_PAR_DIST 0 1 3 /end AXIS_DESCR
/end CHARACTERISTIC
/begin CHARACTERISTIC AFTCMRPC_HFIENSOnOffC "AFTCMRPC_HFIENSOnOffC" VALUE 0x8005A57C DATA_RECORD_UBYTE 1 Bool_ON_OFF 0 1 BIT_MASK 0x01 /end CHARACTERISTIC
/begin CHARACTERISTIC AFTCMRPC_HFIEnC "AFTCMRPC_HFIEnC" VALUE 0x8005A578 DATA_RECORD_UBYTE 1 Bool_ON_OFF 0 1 BIT_MASK 0x01 /end CHARACTERISTIC
/begin CHARACTERISTIC AFTCMRPC_HFINSAddPiC "AFTCMRPC_HFINSAddPiC" VALUE 0x8005A574 DATA_RECORD_FLOAT32_IEEE 3.402823466E+038 F_1_p0_2 -3.402823466E+038 3.402823466E+038 /end CHARACTERISTIC
/begin CHARACTERISTIC AFTCMRPC_HFIPLLK1ParameterC "AFTCMRPC_HFIPLLK1ParameterC" VALUE 0x8005A570 DATA_RECORD_FLOAT32_IEEE 0.01 F_1_p0_2 0 0.01 /end CHARACTERISTIC
/begin CHARACTERISTIC AFTCMRPC_HFIPLLK2ParameterC "AFTCMRPC_HFIPLLK2ParameterC" VALUE 0x8005A56C DATA_RECORD_FLOAT32_IEEE 1E-005 F_1_p0_2 0 1E-005 /end CHARACTERISTIC
/begin CHARACTERISTIC AFTCMRPC_HFIPLLSpeedCutoffFrcC "AFTCMRPC_HFIPLLSpeedCutoffFrcC" VALUE 0x8005A568 DATA_RECORD_FLOAT32_IEEE 10000 F_1_p0_2 0 10000 /end CHARACTERISTIC
/begin CHARACTERISTIC AFTCMRPC_HFISHCutOffC "AFTCMRPC_HFISHCutOffC" VALUE 0x8005A564 DATA_RECORD_FLOAT32_IEEE 3.402823466E+038 F_1_p0_2 -3.402823466E+038 3.402823466E+038 /end CHARACTERISTIC
/begin CHARACTERISTIC AFTCMRPC_HFISecondHarmonicGainC "AFTCMRPC_HFISecondHarmonicGainC" VALUE 0x8005A560 DATA_RECORD_FLOAT32_IEEE 3.402823466E+038 F_1_p0_2 -3.402823466E+038 3.402823466E+038 /end CHARACTERISTIC
/begin CHARACTERISTIC AFTCMRPC_i2mGainC "AFTCMRPC_i2mGainC" VALUE 0x8005A55C DATA_RECORD_FLOAT32_IEEE 3.402823466E+038 F_1_p0_2 -3.402823466E+038 3.402823466E+038 /end CHARACTERISTIC
/begin CHARACTERISTIC AFTCMSCS_ClimbOverCntC "AFTCMSCS_ClimbOverCntC" VALUE 0x8005A6E8 DATA_RECORD_UWORD 65535 F_1_p0_2 0 65535 /end CHARACTERISTIC
/begin CHARACTERISTIC AFTCMSCS_ClimbOverSpdH2OMinRateC "AFTCMSCS_ClimbOverSpdH2OMinRateC" VALUE 0x8005A6E4 DATA_RECORD_FLOAT32_IEEE 0.99 F_1_p0_2 0.01 1 /end CHARACTERISTIC
/begin CHARACTERISTIC AFTCMSCS_ClimbOverSpdRateMaxC "AFTCMSCS_ClimbOverSpdRateMaxC" VALUE 0x8005A6E0 DATA_RECORD_FLOAT32_IEEE 2 F_1_p0_2 1 3 /end CHARACTERISTIC
/begin CHARACTERISTIC AFTCMSCS_ClimbOverSpeedRpmC "AFTCMSCS_ClimbOverSpeedRpmC" VALUE 0x8005A6DC DATA_RECORD_FLOAT32_IEEE 3.402823466E+038 F_1_p0_2 -3.402823466E+038 3.402823466E+038 /end CHARACTERISTIC
/begin CHARACTERISTIC AFTCMSCS_ClimbSpdUpStepRateMinC "AFTCMSCS_ClimbSpdUpStepRateMinC" VALUE 0x8005A6D8 DATA_RECORD_FLOAT32_IEEE 0.99 F_1_p0_2 0.01 1 /end CHARACTERISTIC
/begin CHARACTERISTIC AFTCMSCS_ClimbSpeedFailRateC "AFTCMSCS_ClimbSpeedFailRateC" VALUE 0x8005A6D4 DATA_RECORD_FLOAT32_IEEE 0.9 F_1_p0_2 0.1 1 /end CHARACTERISTIC
/begin CHARACTERISTIC AFTCMSCS_ClimbSpeedRpmUpStepC "AFTCMSCS_ClimbSpeedRpmUpStepC" VALUE 0x8005A6D0 DATA_RECORD_FLOAT32_IEEE 3.402823466E+038 F_1_p0_2 -3.402823466E+038 3.402823466E+038 /end CHARACTERISTIC
/begin CHARACTERISTIC AFTCMSCS_ClimbStIFAdaptEnAnglC "AFTCMSCS_ClimbStIFAdaptEnAnglC" VALUE 0x8005A6CC DATA_RECORD_FLOAT32_IEEE 3.402823466E+038 F_1_p0_2 -3.402823466E+038 3.402823466E+038 /end CHARACTERISTIC
/begin CHARACTERISTIC AFTCMSCS_ClimbStartCosPhiC "AFTCMSCS_ClimbStartCosPhiC" VALUE 0x8005A6C8 DATA_RECORD_FLOAT32_IEEE 3.402823466E+038 F_1_p0_2 -3.402823466E+038 3.402823466E+038 /end CHARACTERISTIC
/begin CHARACTERISTIC AFTCMSCS_ClimbStartDampingKwC "AFTCMSCS_ClimbStartDampingKwC" VALUE 0x8005A6C4 DATA_RECORD_FLOAT32_IEEE 3.402823466E+038 F_1_p0_2 -3.402823466E+038 3.402823466E+038 /end CHARACTERISTIC
/begin CHARACTERISTIC AFTCMSCS_ClimbStartIqC "AFTCMSCS_ClimbStartIqC" VALUE 0x8005A6C0 DATA_RECORD_FLOAT32_IEEE 3.402823466E+038 F_1_p0_2 -3.402823466E+038 3.402823466E+038 /end CHARACTERISTIC
/begin CHARACTERISTIC AFTCMSCS_ClimbStartKiC "AFTCMSCS_ClimbStartKiC" VALUE 0x8005A6BC DATA_RECORD_FLOAT32_IEEE 3.402823466E+038 F_1_p0_2 -3.402823466E+038 3.402823466E+038 /end CHARACTERISTIC
/begin CHARACTERISTIC AFTCMSCS_ClimbStartKpC "AFTCMSCS_ClimbStartKpC" VALUE 0x8005A6B8 DATA_RECORD_FLOAT32_IEEE 3.402823466E+038 F_1_p0_2 -3.402823466E+038 3.402823466E+038 /end CHARACTERISTIC
/begin CHARACTERISTIC AFTCMSCS_ClimbStartMinUErrC "AFTCMSCS_ClimbStartMinUErrC" VALUE 0x8005A6B4 DATA_RECORD_FLOAT32_IEEE 3.402823466E+038 F_1_p0_2 -3.402823466E+038 3.402823466E+038 /end CHARACTERISTIC
/begin CHARACTERISTIC AFTCMSCS_ClimbStartPmCutOffFreqC "AFTCMSCS_ClimbStartPmCutOffFreqC" VALUE 0x8005A6B0 DATA_RECORD_FLOAT32_IEEE 499.99 F_1_p0_2 0.01 500 /end CHARACTERISTIC
/begin CHARACTERISTIC AFTCMSCS_CloseIdTgtLutInSpeedRpmC "AFTCMSCS_CloseIdTgtLutInSpeedRpmC" CURVE 0x8005A6A8 DATA_RECORD_FLOAT32_IEEE 3.402823466E+038 F_1_p0_2 -3.402823466E+038 3.402823466E+038
 /begin AXIS_DESCR FIX_AXIS NO_INPUT_QUANTITY Id_0x00 2 0 1 MAX_GRAD 100.0 FIX_AXIS_PAR_DIST 0 1 2 /end AXIS_DESCR
/end CHARACTERISTIC
/begin CHARACTERISTIC AFTCMSCS_CloseIdTgtLutOutC "AFTCMSCS_CloseIdTgtLutOutC" CURVE 0x8005A6A0 DATA_RECORD_FLOAT32_IEEE 3.402823466E+038 F_1_p0_2 -3.402823466E+038 3.402823466E+038
 /begin AXIS_DESCR FIX_AXIS NO_INPUT_QUANTITY Id_0x00 2 0 1 MAX_GRAD 100.0 FIX_AXIS_PAR_DIST 0 1 2 /end AXIS_DESCR
/end CHARACTERISTIC
/begin CHARACTERISTIC AFTCMSCS_CloseLoopIdTgtC "AFTCMSCS_CloseLoopIdTgtC" VALUE 0x8005A69C DATA_RECORD_FLOAT32_IEEE 3.402823466E+038 F_1_p0_2 -3.402823466E+038 3.402823466E+038 /end CHARACTERISTIC
/begin CHARACTERISTIC AFTCMSCS_CloseLoopSpeedRpmC "AFTCMSCS_CloseLoopSpeedRpmC" VALUE 0x8005A698 DATA_RECORD_FLOAT32_IEEE 3.402823466E+038 F_1_p0_2 -3.402823466E+038 3.402823466E+038 /end CHARACTERISTIC
/begin CHARACTERISTIC AFTCMSCS_CloseRunFailCntC "AFTCMSCS_CloseRunFailCntC" VALUE 0x8005A694 DATA_RECORD_SWORD 65535 F_1_p0_2 -32768 32767 /end CHARACTERISTIC
/begin CHARACTERISTIC AFTCMSCS_Dece2ZeroCntC "AFTCMSCS_Dece2ZeroCntC" VALUE 0x8005A690 DATA_RECORD_UWORD 65535 F_1_p0_2 0 65535 /end CHARACTERISTIC
/begin CHARACTERISTIC AFTCMSCS_DeceSpeedRpmDownStepC "AFTCMSCS_DeceSpeedRpmDownStepC" VALUE 0x8005A68C DATA_RECORD_FLOAT32_IEEE 3.402823466E+038 F_1_p0_2 -3.402823466E+038 3.402823466E+038 /end CHARACTERISTIC
/begin CHARACTERISTIC AFTCMSCS_DecelerationIdC "AFTCMSCS_DecelerationIdC" VALUE 0x8005A688 DATA_RECORD_FLOAT32_IEEE 3.402823466E+038 F_1_p0_2 -3.402823466E+038 3.402823466E+038 /end CHARACTERISTIC
/begin CHARACTERISTIC AFTCMSCS_DecelerationIqC "AFTCMSCS_DecelerationIqC" VALUE 0x8005A684 DATA_RECORD_FLOAT32_IEEE 3.402823466E+038 F_1_p0_2 -3.402823466E+038 3.402823466E+038 /end CHARACTERISTIC
/begin CHARACTERISTIC AFTCMSCS_HFI2OBSCntC "AFTCMSCS_HFI2OBSCntC" VALUE 0x8005A680 DATA_RECORD_SWORD 65535 F_1_p0_2 -32768 32767 /end CHARACTERISTIC
/begin CHARACTERISTIC AFTCMSCS_HFI2OBSMecaSpdRpmRangeC "AFTCMSCS_HFI2OBSMecaSpdRpmRangeC" VALUE 0x8005A67C DATA_RECORD_FLOAT32_IEEE 3.402823466E+038 F_1_p0_2 -3.402823466E+038 3.402823466E+038 /end CHARACTERISTIC
/begin CHARACTERISTIC AFTCMSCS_HFICloseCntC "AFTCMSCS_HFICloseCntC" VALUE 0x8005A678 DATA_RECORD_UWORD 65535 F_1_p0_2 0 65535 /end CHARACTERISTIC
/begin CHARACTERISTIC AFTCMSCS_HFICloseFailNumMaxC "AFTCMSCS_HFICloseFailNumMaxC" VALUE 0x8005A674 DATA_RECORD_UBYTE 255 F_1_p0_2 0 255 /end CHARACTERISTIC
/begin CHARACTERISTIC AFTCMSCS_HFIElecThetaCloseMaxC "AFTCMSCS_HFIElecThetaCloseMaxC" VALUE 0x8005A670 DATA_RECORD_FLOAT32_IEEE 3.402823466E+038 F_1_p0_2 -3.402823466E+038 3.402823466E+038 /end CHARACTERISTIC
/begin CHARACTERISTIC AFTCMSCS_HFIMecaSpdRpmCloseMaxC "AFTCMSCS_HFIMecaSpdRpmCloseMaxC" VALUE 0x8005A66C DATA_RECORD_FLOAT32_IEEE 99 F_1_p0_2 1 100 /end CHARACTERISTIC
/begin CHARACTERISTIC AFTCMSCS_HFIThetaDiffMaxC "AFTCMSCS_HFIThetaDiffMaxC" VALUE 0x8005A668 DATA_RECORD_FLOAT32_IEEE 3.402823466E+038 F_1_p0_2 -3.402823466E+038 3.402823466E+038 /end CHARACTERISTIC
/begin CHARACTERISTIC AFTCMSCS_IdTgtFildTrC "AFTCMSCS_IdTgtFildTrC" VALUE 0x8005A664 DATA_RECORD_FLOAT32_IEEE 3.402823466E+038 F_1_p0_2 -3.402823466E+038 3.402823466E+038 /end CHARACTERISTIC
/begin CHARACTERISTIC AFTCMSCS_IqTgtFildTrC "AFTCMSCS_IqTgtFildTrC" VALUE 0x8005A660 DATA_RECORD_FLOAT32_IEEE 3.402823466E+038 F_1_p0_2 -3.402823466E+038 3.402823466E+038 /end CHARACTERISTIC
/begin CHARACTERISTIC AFTCMSCS_KwModeC "AFTCMSCS_KwModeC" VALUE 0x8005A65C DATA_RECORD_UBYTE 1 Bool_ON_OFF 0 1 BIT_MASK 0x01 /end CHARACTERISTIC
/begin CHARACTERISTIC AFTCMSCS_MaIqTgtLutInSpeedRpmC "AFTCMSCS_MaIqTgtLutInSpeedRpmC" CURVE 0x8005A64C DATA_RECORD_FLOAT32_IEEE 3.402823466E+038 F_1_p0_2 -3.402823466E+038 3.402823466E+038
 /begin AXIS_DESCR FIX_AXIS NO_INPUT_QUANTITY Id_0x00 4 0 3 MAX_GRAD 100.0 FIX_AXIS_PAR_DIST 0 1 4 /end AXIS_DESCR
/end CHARACTERISTIC
/begin CHARACTERISTIC AFTCMSCS_MaIqTgtLutOutC "AFTCMSCS_MaIqTgtLutOutC" CURVE 0x8005A63C DATA_RECORD_FLOAT32_IEEE 3.402823466E+038 F_1_p0_2 -3.402823466E+038 3.402823466E+038
 /begin AXIS_DESCR FIX_AXIS NO_INPUT_QUANTITY Id_0x00 4 0 3 MAX_GRAD 100.0 FIX_AXIS_PAR_DIST 0 1 4 /end AXIS_DESCR
/end CHARACTERISTIC
/begin CHARACTERISTIC AFTCMSCS_MagneticLinkCompIqMaxC "AFTCMSCS_MagneticLinkCompIqMaxC" VALUE 0x8005A638 DATA_RECORD_FLOAT32_IEEE 3.402823466E+038 F_1_p0_2 -3.402823466E+038 3.402823466E+038 /end CHARACTERISTIC
/begin CHARACTERISTIC AFTCMSCS_ManCtrlKiC "AFTCMSCS_ManCtrlKiC" VALUE 0x8005A634 DATA_RECORD_FLOAT32_IEEE 3.402823466E+038 F_1_p0_2 -3.402823466E+038 3.402823466E+038 /end CHARACTERISTIC
/begin CHARACTERISTIC AFTCMSCS_ManCtrlKpC "AFTCMSCS_ManCtrlKpC" VALUE 0x8005A630 DATA_RECORD_FLOAT32_IEEE 3.402823466E+038 F_1_p0_2 -3.402823466E+038 3.402823466E+038 /end CHARACTERISTIC
/begin CHARACTERISTIC AFTCMSCS_ManualIdTgtC "AFTCMSCS_ManualIdTgtC" VALUE 0x8005A62C DATA_RECORD_FLOAT32_IEEE 3.402823466E+038 F_1_p0_2 -3.402823466E+038 3.402823466E+038 /end CHARACTERISTIC
/begin CHARACTERISTIC AFTCMSCS_ManualIqTgtTableEnC "AFTCMSCS_ManualIqTgtTableEnC" VALUE 0x8005A628 DATA_RECORD_UBYTE 1 Bool_ON_OFF 0 1 BIT_MASK 0x01 /end CHARACTERISTIC
/begin CHARACTERISTIC AFTCMSCS_ManualObsStateC "AFTCMSCS_ManualObsStateC" VALUE 0x8005A624 DATA_RECORD_UBYTE 255 F_1_p0_2 0 255 /end CHARACTERISTIC
/begin CHARACTERISTIC AFTCMSCS_ManualOpenAngleStateC "AFTCMSCS_ManualOpenAngleStateC" VALUE 0x8005A620 DATA_RECORD_UBYTE 255 F_1_p0_2 0 255 /end CHARACTERISTIC
/begin CHARACTERISTIC AFTCMSCS_MotorReverseEnC "AFTCMSCS_MotorReverseEnC" VALUE 0x8005A61C DATA_RECORD_UBYTE 1 Bool_ON_OFF 0 1 BIT_MASK 0x01 /end CHARACTERISTIC
/begin CHARACTERISTIC AFTCMSCS_NotStopSpeedRpmC "AFTCMSCS_NotStopSpeedRpmC" VALUE 0x8005A618 DATA_RECORD_FLOAT32_IEEE 3.402823466E+038 F_1_p0_2 -3.402823466E+038 3.402823466E+038 /end CHARACTERISTIC
/begin CHARACTERISTIC AFTCMSCS_ObsStateByPassC "AFTCMSCS_ObsStateByPassC" VALUE 0x8005A614 DATA_RECORD_UBYTE 255 F_1_p0_2 0 255 /end CHARACTERISTIC
/begin CHARACTERISTIC AFTCMSCS_ObsStateByPassEnC "AFTCMSCS_ObsStateByPassEnC" VALUE 0x8005A610 DATA_RECORD_UBYTE 1 Bool_ON_OFF 0 1 BIT_MASK 0x01 /end CHARACTERISTIC
/begin CHARACTERISTIC AFTCMSCS_OpenAngleDeltaMinC "AFTCMSCS_OpenAngleDeltaMinC" VALUE 0x8005A60C DATA_RECORD_FLOAT32_IEEE 3.402823466E+038 F_1_p0_2 -3.402823466E+038 3.402823466E+038 /end CHARACTERISTIC
/begin CHARACTERISTIC AFTCMSCS_OverSpeedCntC "AFTCMSCS_OverSpeedCntC" VALUE 0x8005A608 DATA_RECORD_SWORD 65535 F_1_p0_2 -32768 32767 /end CHARACTERISTIC
/begin CHARACTERISTIC AFTCMSCS_OverSpeedRpmC "AFTCMSCS_OverSpeedRpmC" VALUE 0x8005A604 DATA_RECORD_FLOAT32_IEEE 3.402823466E+038 F_1_p0_2 -3.402823466E+038 3.402823466E+038 /end CHARACTERISTIC
/begin CHARACTERISTIC AFTCMSCS_PrePositionDCntC "AFTCMSCS_PrePositionDCntC" VALUE 0x8005A600 DATA_RECORD_UWORD 65535 F_1_p0_2 0 65535 /end CHARACTERISTIC
/begin CHARACTERISTIC AFTCMSCS_PrePositionIdC "AFTCMSCS_PrePositionIdC" VALUE 0x8005A5FC DATA_RECORD_FLOAT32_IEEE 3.402823466E+038 F_1_p0_2 -3.402823466E+038 3.402823466E+038 /end CHARACTERISTIC
/begin CHARACTERISTIC AFTCMSCS_PrePositionIqC "AFTCMSCS_PrePositionIqC" VALUE 0x8005A5F8 DATA_RECORD_FLOAT32_IEEE 3.402823466E+038 F_1_p0_2 -3.402823466E+038 3.402823466E+038 /end CHARACTERISTIC
/begin CHARACTERISTIC AFTCMSCS_PrePositionQCntC "AFTCMSCS_PrePositionQCntC" VALUE 0x8005A5F4 DATA_RECORD_UWORD 65535 F_1_p0_2 0 65535 /end CHARACTERISTIC
/begin CHARACTERISTIC AFTCMSCS_SPEED_MODE "AFTCMSCS_SPEED_MODE" VALUE 0x8005A5F0 DATA_RECORD_UWORD 65535 F_1_p0_2 0 65535 /end CHARACTERISTIC
/begin CHARACTERISTIC AFTCMSCS_ShiftIdIncreaseCntC "AFTCMSCS_ShiftIdIncreaseCntC" VALUE 0x8005A5EC DATA_RECORD_UWORD 65535 F_1_p0_2 0 65535 /end CHARACTERISTIC
/begin CHARACTERISTIC AFTCMSCS_ShiftIdIncreaseStepC "AFTCMSCS_ShiftIdIncreaseStepC" VALUE 0x8005A5E8 DATA_RECORD_FLOAT32_IEEE 3.402823466E+038 F_1_p0_2 -3.402823466E+038 3.402823466E+038 /end CHARACTERISTIC
/begin CHARACTERISTIC AFTCMSCS_ShiftIqDecreaseCntC "AFTCMSCS_ShiftIqDecreaseCntC" VALUE 0x8005A5E4 DATA_RECORD_UWORD 65535 F_1_p0_2 0 65535 /end CHARACTERISTIC
/begin CHARACTERISTIC AFTCMSCS_ShiftIqDecreaseRateC "AFTCMSCS_ShiftIqDecreaseRateC" VALUE 0x8005A5E0 DATA_RECORD_FLOAT32_IEEE 3.402823466E+038 F_1_p0_2 -3.402823466E+038 3.402823466E+038 /end CHARACTERISTIC
/begin CHARACTERISTIC AFTCMSCS_ShiftRunIdMinC "AFTCMSCS_ShiftRunIdMinC" VALUE 0x8005A5DC DATA_RECORD_FLOAT32_IEEE 3.402823466E+038 F_1_p0_2 -3.402823466E+038 3.402823466E+038 /end CHARACTERISTIC
/begin CHARACTERISTIC AFTCMSCS_ShiftRunIqMinC "AFTCMSCS_ShiftRunIqMinC" VALUE 0x8005A5D8 DATA_RECORD_FLOAT32_IEEE 3.402823466E+038 F_1_p0_2 -3.402823466E+038 3.402823466E+038 /end CHARACTERISTIC
/begin CHARACTERISTIC AFTCMSCS_ShiftRunTransTmsC "AFTCMSCS_ShiftRunTransTmsC" VALUE 0x8005A5D4 DATA_RECORD_UWORD 4999 F_1_p0_2 1 5000 /end CHARACTERISTIC
/begin CHARACTERISTIC AFTCMSCS_SpdMIqMinLutInSpdRpmC "AFTCMSCS_SpdMIqMinLutInSpdRpmC" CURVE 0x8005A5CC DATA_RECORD_FLOAT32_IEEE 3.402823466E+038 F_1_p0_2 -3.402823466E+038 3.402823466E+038
 /begin AXIS_DESCR FIX_AXIS NO_INPUT_QUANTITY Id_0x00 2 0 1 MAX_GRAD 100.0 FIX_AXIS_PAR_DIST 0 1 2 /end AXIS_DESCR
/end CHARACTERISTIC
/begin CHARACTERISTIC AFTCMSCS_SpdMIqMinLutOutC "AFTCMSCS_SpdMIqMinLutOutC" CURVE 0x8005A5C4 DATA_RECORD_FLOAT32_IEEE 3.402823466E+038 F_1_p0_2 -3.402823466E+038 3.402823466E+038
 /begin AXIS_DESCR FIX_AXIS NO_INPUT_QUANTITY Id_0x00 2 0 1 MAX_GRAD 100.0 FIX_AXIS_PAR_DIST 0 1 2 /end AXIS_DESCR
/end CHARACTERISTIC
/begin CHARACTERISTIC AFTCMSCS_SpeedDiffCntC "AFTCMSCS_SpeedDiffCntC" VALUE 0x8005A5C0 DATA_RECORD_SWORD 65535 F_1_p0_2 -32768 32767 /end CHARACTERISTIC
/begin CHARACTERISTIC AFTCMSCS_SpeedDiffRateC "AFTCMSCS_SpeedDiffRateC" VALUE 0x8005A5BC DATA_RECORD_FLOAT32_IEEE 1 F_1_p0_2 0 1 /end CHARACTERISTIC
/begin CHARACTERISTIC AFTCMSCS_SpeedFilterNumC "AFTCMSCS_SpeedFilterNumC" VALUE 0x8005A5B8 DATA_RECORD_FLOAT32_IEEE 0.999999 F_1_p0_2 1E-006 1 /end CHARACTERISTIC
/begin CHARACTERISTIC AFTCMSCS_StartFail2HFINumC "AFTCMSCS_StartFail2HFINumC" VALUE 0x8005A5B4 DATA_RECORD_UBYTE 255 F_1_p0_2 0 255 /end CHARACTERISTIC
/begin CHARACTERISTIC AFTCMSCS_StartFailCntC "AFTCMSCS_StartFailCntC" VALUE 0x8005A5B0 DATA_RECORD_SWORD 65535 F_1_p0_2 -32768 32767 /end CHARACTERISTIC
/begin CHARACTERISTIC AFTCMSCS_StartFailRateC "AFTCMSCS_StartFailRateC" VALUE 0x8005A5AC DATA_RECORD_FLOAT32_IEEE 3.402823466E+038 F_1_p0_2 -3.402823466E+038 3.402823466E+038 /end CHARACTERISTIC
/begin CHARACTERISTIC AFTCMSCS_StopRunCntC "AFTCMSCS_StopRunCntC" VALUE 0x8005A5A8 DATA_RECORD_UWORD 65535 F_1_p0_2 0 65535 /end CHARACTERISTIC
/begin CHARACTERISTIC AFTCMSCS_TorqueTgtMaxC "AFTCMSCS_TorqueTgtMaxC" VALUE 0x8005A5A4 DATA_RECORD_FLOAT32_IEEE 3.402823466E+038 F_1_p0_2 -3.402823466E+038 3.402823466E+038 /end CHARACTERISTIC
/begin CHARACTERISTIC AFTCMSTC_AccRpmBySecLutInSpdRpmC "target max acceleration toward positive infinity" CURVE 0x8005A6F8 DATA_RECORD_FLOAT32_IEEE 3.402823466E+038 F_1_p0_2 -3.402823466E+038 3.402823466E+038
 /begin AXIS_DESCR FIX_AXIS NO_INPUT_QUANTITY Id_0x00 3 0 2 MAX_GRAD 100.0 FIX_AXIS_PAR_DIST 0 1 3 /end AXIS_DESCR
/end CHARACTERISTIC
/begin CHARACTERISTIC AFTCMSTC_AccelRpmBySecondLutOutC "target max acceleration toward positive infinity" CURVE 0x8005A6EC DATA_RECORD_FLOAT32_IEEE 3.402823466E+038 F_1_p0_2 -3.402823466E+038 3.402823466E+038
 /begin AXIS_DESCR FIX_AXIS NO_INPUT_QUANTITY Id_0x00 3 0 2 MAX_GRAD 100.0 FIX_AXIS_PAR_DIST 0 1 3 /end AXIS_DESCR
/end CHARACTERISTIC
/begin CHARACTERISTIC AFTCMTCS_BenchElecPowerMaxC "AFTCMTCS_BenchElecPowerMaxC" VALUE 0x8005A9A8 DATA_RECORD_FLOAT32_IEEE 3.402823466E+038 F_1_p0_2 -3.402823466E+038 3.402823466E+038 /end CHARACTERISTIC
/begin CHARACTERISTIC AFTCMTCS_BenchElecTorqueMaxC "AFTCMTCS_BenchElecTorqueMaxC" VALUE 0x8005A9A4 DATA_RECORD_FLOAT32_IEEE 3.402823466E+038 F_1_p0_2 -3.402823466E+038 3.402823466E+038 /end CHARACTERISTIC
/begin CHARACTERISTIC AFTCMTCS_ExtTorqueMaxMinC "AFTCMTCS_ExtTorqueMaxMinC" CURVE 0x8005A99C DATA_RECORD_FLOAT32_IEEE 3.402823466E+038 F_1_p0_2 -3.402823466E+038 3.402823466E+038
 /begin AXIS_DESCR FIX_AXIS NO_INPUT_QUANTITY Id_0x00 2 0 1 MAX_GRAD 100.0 FIX_AXIS_PAR_DIST 0 1 2 /end AXIS_DESCR
/end CHARACTERISTIC
/begin CHARACTERISTIC AFTCMTCS_FluxControllerGainC "AFTCMTCS_FluxControllerGainC" VALUE 0x8005A998 DATA_RECORD_FLOAT32_IEEE 3.402823466E+038 F_1_p0_2 -3.402823466E+038 3.402823466E+038 /end CHARACTERISTIC
/begin CHARACTERISTIC AFTCMTCS_FluxControllerGainKiC "AFTCMTCS_FluxControllerGainKiC" VALUE 0x8005A994 DATA_RECORD_FLOAT32_IEEE 3.402823466E+038 F_1_p0_2 -3.402823466E+038 3.402823466E+038 /end CHARACTERISTIC
/begin CHARACTERISTIC AFTCMTCS_FluxControllerGainKpC "AFTCMTCS_FluxControllerGainKpC" VALUE 0x8005A990 DATA_RECORD_FLOAT32_IEEE 3.402823466E+038 F_1_p0_2 -3.402823466E+038 3.402823466E+038 /end CHARACTERISTIC
/begin CHARACTERISTIC AFTCMTCS_GainPhaseVoltagePeakC "AFTCMTCS_GainPhaseVoltagePeakC" VALUE 0x8005A98C DATA_RECORD_FLOAT32_IEEE 3.402823466E+038 F_1_p0_2 -3.402823466E+038 3.402823466E+038 /end CHARACTERISTIC
/begin CHARACTERISTIC AFTCMTCS_GenTableTorqueThrdC "AFTCMTCS_GenTableTorqueThrdC" VALUE 0x8005A988 DATA_RECORD_FLOAT32_IEEE 3.402823466E+038 F_1_p0_2 -3.402823466E+038 3.402823466E+038 /end CHARACTERISTIC
/begin CHARACTERISTIC AFTCMTCS_IdModeOnOffC "AFTCMTCS_IdModeOnOffC" VALUE 0x8005A984 DATA_RECORD_UBYTE 1 Bool_ON_OFF 0 1 BIT_MASK 0x01 /end CHARACTERISTIC
/begin CHARACTERISTIC AFTCMTCS_IdentificationAngleDegC "AFTCMTCS_IdentificationAngleDegC" VALUE 0x8005A980 DATA_RECORD_FLOAT32_IEEE 3.402823466E+038 F_1_p0_2 -3.402823466E+038 3.402823466E+038 /end CHARACTERISTIC
/begin CHARACTERISTIC AFTCMTCS_IdentificationIsTgtC "AFTCMTCS_IdentificationIsTgtC" VALUE 0x8005A97C DATA_RECORD_FLOAT32_IEEE 3.402823466E+038 F_1_p0_2 -3.402823466E+038 3.402823466E+038 /end CHARACTERISTIC
/begin CHARACTERISTIC AFTCMTCS_InitTorqueMaxMinC "AFTCMTCS_InitTorqueMaxMinC" CURVE 0x8005A974 DATA_RECORD_FLOAT32_IEEE 3.402823466E+038 F_1_p0_2 -3.402823466E+038 3.402823466E+038
 /begin AXIS_DESCR FIX_AXIS NO_INPUT_QUANTITY Id_0x00 2 0 1 MAX_GRAD 100.0 FIX_AXIS_PAR_DIST 0 1 2 /end AXIS_DESCR
/end CHARACTERISTIC
/begin CHARACTERISTIC AFTCMTCS_Initi0dqTgt3C "AFTCMTCS_Initi0dqTgt3C" CURVE 0x8005A968 DATA_RECORD_FLOAT32_IEEE 3.402823466E+038 F_1_p0_2 -3.402823466E+038 3.402823466E+038
 /begin AXIS_DESCR FIX_AXIS NO_INPUT_QUANTITY Id_0x00 3 0 2 MAX_GRAD 100.0 FIX_AXIS_PAR_DIST 0 1 3 /end AXIS_DESCR
/end CHARACTERISTIC
/begin CHARACTERISTIC AFTCMTCS_LutInSpeedRpmC "AFTCMTCS_LutInSpeedRpmC" CURVE 0x8005A938 DATA_RECORD_FLOAT32_IEEE 3.402823466E+038 F_1_p0_2 -3.402823466E+038 3.402823466E+038
 /begin AXIS_DESCR FIX_AXIS NO_INPUT_QUANTITY Id_0x00 12 0 11 MAX_GRAD 100.0 FIX_AXIS_PAR_DIST 0 1 12 /end AXIS_DESCR
/end CHARACTERISTIC
/begin CHARACTERISTIC AFTCMTCS_LutInUbatC "AFTCMTCS_LutInUbatC" CURVE 0x8005A924 DATA_RECORD_FLOAT32_IEEE 3.402823466E+038 F_1_p0_2 -3.402823466E+038 3.402823466E+038
 /begin AXIS_DESCR FIX_AXIS NO_INPUT_QUANTITY Id_0x00 5 0 4 MAX_GRAD 100.0 FIX_AXIS_PAR_DIST 0 1 5 /end AXIS_DESCR
/end CHARACTERISTIC
/begin CHARACTERISTIC AFTCMTCS_LutOutVolMarginGenC "AFTCMTCS_LutOutVolMarginGenC" MAP 0x8005A834 DATA_RECORD_FLOAT32_IEEE 3.402823466E+038 F_1_p0_2 -3.402823466E+038 3.402823466E+038
 /begin AXIS_DESCR FIX_AXIS NO_INPUT_QUANTITY Id_0x00 5 0 4 MAX_GRAD 100.0 FIX_AXIS_PAR_DIST 0 1 5 /end AXIS_DESCR
 /begin AXIS_DESCR FIX_AXIS NO_INPUT_QUANTITY Id_0x00 12 0 11 MAX_GRAD 100.0 FIX_AXIS_PAR_DIST 0 1 12 /end AXIS_DESCR
/end CHARACTERISTIC
/begin CHARACTERISTIC AFTCMTCS_LutOutVolMarginMotC "AFTCMTCS_LutOutVolMarginMotC" MAP 0x8005A744 DATA_RECORD_FLOAT32_IEEE 3.402823466E+038 F_1_p0_2 -3.402823466E+038 3.402823466E+038
 /begin AXIS_DESCR FIX_AXIS NO_INPUT_QUANTITY Id_0x00 5 0 4 MAX_GRAD 100.0 FIX_AXIS_PAR_DIST 0 1 5 /end AXIS_DESCR
 /begin AXIS_DESCR FIX_AXIS NO_INPUT_QUANTITY Id_0x00 12 0 11 MAX_GRAD 100.0 FIX_AXIS_PAR_DIST 0 1 12 /end AXIS_DESCR
/end CHARACTERISTIC
/begin CHARACTERISTIC AFTCMTCS_LutTorqueGainC "AFTCMTCS_LutTorqueGainC" CURVE 0x8005A734 DATA_RECORD_FLOAT32_IEEE 3.402823466E+038 F_1_p0_2 -3.402823466E+038 3.402823466E+038
 /begin AXIS_DESCR FIX_AXIS NO_INPUT_QUANTITY Id_0x00 4 0 3 MAX_GRAD 100.0 FIX_AXIS_PAR_DIST 0 1 4 /end AXIS_DESCR
/end CHARACTERISTIC
/begin CHARACTERISTIC AFTCMTCS_LutVoltageErrorC "AFTCMTCS_LutVoltageErrorC" CURVE 0x8005A724 DATA_RECORD_FLOAT32_IEEE 3.402823466E+038 F_1_p0_2 -3.402823466E+038 3.402823466E+038
 /begin AXIS_DESCR FIX_AXIS NO_INPUT_QUANTITY Id_0x00 4 0 3 MAX_GRAD 100.0 FIX_AXIS_PAR_DIST 0 1 4 /end AXIS_DESCR
/end CHARACTERISTIC
/begin CHARACTERISTIC AFTCMTCS_MaxErrorFor100C "AFTCMTCS_MaxErrorFor100C" VALUE 0x8005A720 DATA_RECORD_FLOAT32_IEEE 3.402823466E+038 F_1_p0_2 -3.402823466E+038 3.402823466E+038 /end CHARACTERISTIC
/begin CHARACTERISTIC AFTCMTCS_ParkCurrentMaxC "AFTCMTCS_ParkCurrentMaxC" VALUE 0x8005A71C DATA_RECORD_FLOAT32_IEEE 3.402823466E+038 F_1_p0_2 -3.402823466E+038 3.402823466E+038 /end CHARACTERISTIC
/begin CHARACTERISTIC AFTCMTCS_UbatHVLowSatC "AFTCMTCS_UbatHVLowSatC" VALUE 0x8005A718 DATA_RECORD_FLOAT32_IEEE 3.402823466E+038 F_1_p0_2 -3.402823466E+038 3.402823466E+038 /end CHARACTERISTIC
/begin CHARACTERISTIC AFTCMTCS_VoltMarginCtrlOnOffC "AFTCMTCS_VoltMarginCtrlOnOffC" VALUE 0x8005A714 DATA_RECORD_UBYTE 1 Bool_ON_OFF 0 1 BIT_MASK 0x01 /end CHARACTERISTIC
/begin CHARACTERISTIC AFTCMTCS_VoltageLimiterOnOffC "AFTCMTCS_VoltageLimiterOnOffC" VALUE 0x8005A710 DATA_RECORD_UBYTE 1 Bool_ON_OFF 0 1 BIT_MASK 0x01 /end CHARACTERISTIC
/begin CHARACTERISTIC AFTCMTCS_VoltageMarginC "AFTCMTCS_VoltageMarginC" VALUE 0x8005A70C DATA_RECORD_FLOAT32_IEEE 3.402823466E+038 F_1_p0_2 -3.402823466E+038 3.402823466E+038 /end CHARACTERISTIC
/begin CHARACTERISTIC AFTCMTCS_deg2radC "AFTCMTCS_deg2radC" VALUE 0x8005A708 DATA_RECORD_FLOAT32_IEEE 3.402823466E+038 F_1_p0_2 -3.402823466E+038 3.402823466E+038 /end CHARACTERISTIC
/begin CHARACTERISTIC AFTCMTCS_iqCorEnaC "AFTCMTCS_iqCorEnaC" VALUE 0x8005A704 DATA_RECORD_UBYTE 1 Bool_ON_OFF 0 1 BIT_MASK 0x01 /end CHARACTERISTIC
/begin CHARACTERISTIC AFTCMTTC_TorqueBySecondNegC "AFTCMTTC_TorqueBySecondNegC" VALUE 0x8005A9B8 DATA_RECORD_FLOAT32_IEEE 3.402823466E+038 F_1_p0_2 -3.402823466E+038 3.402823466E+038 /end CHARACTERISTIC
/begin CHARACTERISTIC AFTCMTTC_TorqueBySecondPosC "AFTCMTTC_TorqueBySecondPosC" VALUE 0x8005A9B4 DATA_RECORD_FLOAT32_IEEE 3.402823466E+038 F_1_p0_2 -3.402823466E+038 3.402823466E+038 /end CHARACTERISTIC
/begin CHARACTERISTIC AFTCMTTC_TorqueFildTrC "AFTCMTTC_TorqueFildTrC" VALUE 0x8005A9B0 DATA_RECORD_FLOAT32_IEEE 3.402823466E+038 F_1_p0_2 -3.402823466E+038 3.402823466E+038 /end CHARACTERISTIC
/begin CHARACTERISTIC AFTCMTTC_TrqSatThrdC "AFTCMTTC_TrqSatThrdC" VALUE 0x8005A9AC DATA_RECORD_FLOAT32_IEEE 3.402823466E+038 F_1_p0_2 -3.402823466E+038 3.402823466E+038 /end CHARACTERISTIC
/begin CHARACTERISTIC AFTDDLMP_I0LimitMaxC "The maximum current of I0 limit value in limp control mode." VALUE 0x8005A9E4 DATA_RECORD_FLOAT32_IEEE 2000 F_1_p0_2 -1000 1000 /end CHARACTERISTIC
/begin CHARACTERISTIC AFTDDLMP_I0LimitMinC "The minimum current of I0 limit value in limp control mode." VALUE 0x8005A9E0 DATA_RECORD_FLOAT32_IEEE 2000 F_1_p0_2 -1000 1000 /end CHARACTERISTIC
/begin CHARACTERISTIC AFTDDLMP_IdLimitMaxC "The maximum current of Id limit value in limp control mode." VALUE 0x8005A9DC DATA_RECORD_FLOAT32_IEEE 2000 F_1_p0_2 -1000 1000 /end CHARACTERISTIC
/begin CHARACTERISTIC AFTDDLMP_IdLimitMinC "The minimum current of Id limit value in limp control mode." VALUE 0x8005A9D8 DATA_RECORD_FLOAT32_IEEE 2000 F_1_p0_2 -1000 1000 /end CHARACTERISTIC
/begin CHARACTERISTIC AFTDDLMP_IqLimitMaxC "The maximum current of Iq limit value in limp control mode." VALUE 0x8005A9D4 DATA_RECORD_FLOAT32_IEEE 2000 F_1_p0_2 -1000 1000 /end CHARACTERISTIC
/begin CHARACTERISTIC AFTDDLMP_IqLimitMinC "The minimum current of Iq limit value in limp control mode." VALUE 0x8005A9D0 DATA_RECORD_FLOAT32_IEEE 2000 F_1_p0_2 -1000 1000 /end CHARACTERISTIC
/begin CHARACTERISTIC AFTDDLMP_PowerLimC "AFTDDLMP_PowerLimC" VALUE 0x8005A9CC DATA_RECORD_FLOAT32_IEEE 3.402823466E+038 F_1_p0_2 -3.402823466E+038 3.402823466E+038 /end CHARACTERISTIC
/begin CHARACTERISTIC AFTDDLMP_SpeedLimitMaxC "The maximum speed limit value in limp control mode." VALUE 0x8005A9C8 DATA_RECORD_FLOAT32_IEEE 40000 F_1_p0_2 -20000 20000 /end CHARACTERISTIC
/begin CHARACTERISTIC AFTDDLMP_SpeedLimitMinC "The minimum speed limit value in limp control mode." VALUE 0x8005A9C4 DATA_RECORD_FLOAT32_IEEE 40000 F_1_p0_2 -20000 20000 /end CHARACTERISTIC
/begin CHARACTERISTIC AFTDDLMP_TorqLimitMaxC "The maximum torque limit value in limp control mode." VALUE 0x8005A9C0 DATA_RECORD_FLOAT32_IEEE 1000 F_1_p0_2 -500 500 /end CHARACTERISTIC
/begin CHARACTERISTIC AFTDDLMP_TorqLimitMinC "The minimum torque limit value in limp control mode." VALUE 0x8005A9BC DATA_RECORD_FLOAT32_IEEE 1000 F_1_p0_2 -500 500 /end CHARACTERISTIC
/begin CHARACTERISTIC AFTMTLCS_A2DGainIsuLC "gain used to correct a sensor linearity error" VALUE 0x8005AC64 DATA_RECORD_FLOAT32_IEEE 3.402823466E+038 F_1_p0_2 -3.402823466E+038 3.402823466E+038 /end CHARACTERISTIC
/begin CHARACTERISTIC AFTMTLCS_A2DGainIsvLC "gain used to correct a sensor linearity error" VALUE 0x8005AC60 DATA_RECORD_FLOAT32_IEEE 3.402823466E+038 F_1_p0_2 -3.402823466E+038 3.402823466E+038 /end CHARACTERISTIC
/begin CHARACTERISTIC AFTMTLCS_A2DGainIswLC "gain used to correct a sensor linearity error" VALUE 0x8005AC5C DATA_RECORD_FLOAT32_IEEE 3.402823466E+038 F_1_p0_2 -3.402823466E+038 3.402823466E+038 /end CHARACTERISTIC
/begin CHARACTERISTIC AFTMTLCS_A2DHighThresholdC "AFTMTLCS_A2DHighThresholdC" VALUE 0x8005AC58 DATA_RECORD_UWORD 4095 F_1_p0_2 0 4095 /end CHARACTERISTIC
/begin CHARACTERISTIC AFTMTLCS_A2DLowThresholdC "AFTMTLCS_A2DLowThresholdC" VALUE 0x8005AC54 DATA_RECORD_UWORD 4095 F_1_p0_2 0 4095 /end CHARACTERISTIC
/begin CHARACTERISTIC AFTMTLCS_AD2CurrentUGainC "gain used to correct a sensor linearity error" VALUE 0x8005AC50 DATA_RECORD_FLOAT32_IEEE 3.402823466E+038 F_1_p0_2 -3.402823466E+038 3.402823466E+038 /end CHARACTERISTIC
/begin CHARACTERISTIC AFTMTLCS_AD2CurrentVGainC "gain used to correct a sensor linearity error" VALUE 0x8005AC4C DATA_RECORD_FLOAT32_IEEE 3.402823466E+038 F_1_p0_2 -3.402823466E+038 3.402823466E+038 /end CHARACTERISTIC
/begin CHARACTERISTIC AFTMTLCS_AD2CurrentWGainC "gain used to correct a sensor linearity error" VALUE 0x8005AC48 DATA_RECORD_FLOAT32_IEEE 3.402823466E+038 F_1_p0_2 -3.402823466E+038 3.402823466E+038 /end CHARACTERISTIC
/begin CHARACTERISTIC AFTMTLCS_ContorHighThresholdC "AFTMTLCS_ContorHighThresholdC" VALUE 0x8005AC44 DATA_RECORD_FLOAT32_IEEE 0.001 F_1_p0_2 0 0.001 /end CHARACTERISTIC
/begin CHARACTERISTIC AFTMTLCS_ContorOverLoadCntC "AFTMTLCS_ContorOverLoadCntC" VALUE 0x8005AC40 DATA_RECORD_FLOAT32_IEEE 3.402823466E+038 F_1_p0_2 -3.402823466E+038 3.402823466E+038 /end CHARACTERISTIC
/begin CHARACTERISTIC AFTMTLCS_ContorOverLoadCntMaxC "AFTMTLCS_ContorOverLoadCntMaxC" VALUE 0x8005AC3C DATA_RECORD_FLOAT32_IEEE 3.402823466E+038 F_1_p0_2 -3.402823466E+038 3.402823466E+038 /end CHARACTERISTIC
/begin CHARACTERISTIC AFTMTLCS_CounterInitC "AFTMTLCS_CounterInitC" VALUE 0x8005AC38 DATA_RECORD_ULONG 4294967295 F_1_p0_2 0 4294967295 /end CHARACTERISTIC
/begin CHARACTERISTIC AFTMTLCS_CurrentCalEnableC "AFTMTLCS_CurrentCalEnableC" VALUE 0x8005AC34 DATA_RECORD_UBYTE 1 Bool_ON_OFF 0 1 BIT_MASK 0x01 /end CHARACTERISTIC
/begin CHARACTERISTIC AFTMTLCS_CurrentOffsetInitC "AFTMTLCS_CurrentOffsetInitC" VALUE 0x8005AC30 DATA_RECORD_FLOAT32_IEEE 3.402823466E+038 F_1_p0_2 -3.402823466E+038 3.402823466E+038 /end CHARACTERISTIC
/begin CHARACTERISTIC AFTMTLCS_CurrentRmsCounterC "AFTMTLCS_CurrentRmsCounterC" VALUE 0x8005AC2C DATA_RECORD_ULONG 4294967295 F_1_p0_2 0 4294967295 /end CHARACTERISTIC
/begin CHARACTERISTIC AFTMTLCS_CurrentRmsCounterZC "AFTMTLCS_CurrentRmsCounterZC" VALUE 0x8005AC28 DATA_RECORD_FLOAT32_IEEE 3.402823466E+038 F_1_p0_2 -3.402823466E+038 3.402823466E+038 /end CHARACTERISTIC
/begin CHARACTERISTIC AFTMTLCS_CurrentRmsFTEnC "AFTMTLCS_CurrentRmsFTEnC" VALUE 0x8005AC24 DATA_RECORD_UBYTE 1 Bool_ON_OFF 0 1 BIT_MASK 0x01 /end CHARACTERISTIC
/begin CHARACTERISTIC AFTMTLCS_CurrentRmsSumInitC "AFTMTLCS_CurrentRmsSumInitC" VALUE 0x8005AC20 DATA_RECORD_FLOAT32_IEEE 3.402823466E+038 F_1_p0_2 -3.402823466E+038 3.402823466E+038 /end CHARACTERISTIC
/begin CHARACTERISTIC AFTMTLCS_ExtCurrentGainEnaC "AFTMTLCS_ExtCurrentGainEnaC" VALUE 0x8005AC1C DATA_RECORD_UBYTE 1 Bool_ON_OFF 0 1 BIT_MASK 0x01 /end CHARACTERISTIC
/begin CHARACTERISTIC AFTMTLCS_ExtCurrentGainMaxC "AFTMTLCS_ExtCurrentGainMaxC" VALUE 0x8005AC18 DATA_RECORD_FLOAT32_IEEE 3.402823466E+038 F_1_p0_2 -3.402823466E+038 3.402823466E+038 /end CHARACTERISTIC
/begin CHARACTERISTIC AFTMTLCS_ExtCurrentGainMinC "AFTMTLCS_ExtCurrentGainMinC" VALUE 0x8005AC14 DATA_RECORD_FLOAT32_IEEE 3.402823466E+038 F_1_p0_2 -3.402823466E+038 3.402823466E+038 /end CHARACTERISTIC
/begin CHARACTERISTIC AFTMTLCS_Init2DurationC "duration of init 2" VALUE 0x8005AC10 DATA_RECORD_FLOAT32_IEEE 3.402823466E+038 F_1_p0_2 -3.402823466E+038 3.402823466E+038 /end CHARACTERISTIC
/begin CHARACTERISTIC AFTMTLCS_InitIuvw3C "AFTMTLCS_InitIuvw3C" CURVE 0x8005AC04 DATA_RECORD_FLOAT32_IEEE 3.402823466E+038 F_1_p0_2 -3.402823466E+038 3.402823466E+038
 /begin AXIS_DESCR FIX_AXIS NO_INPUT_QUANTITY Id_0x00 3 0 2 MAX_GRAD 100.0 FIX_AXIS_PAR_DIST 0 1 3 /end AXIS_DESCR
/end CHARACTERISTIC
/begin CHARACTERISTIC AFTMTLCS_IuGainC "AFTMTLCS_IuGainC" VALUE 0x8005AC00 DATA_RECORD_FLOAT32_IEEE 3.402823466E+038 F_1_p0_2 -3.402823466E+038 3.402823466E+038 /end CHARACTERISTIC
/begin CHARACTERISTIC AFTMTLCS_IvGainC "AFTMTLCS_IvGainC" VALUE 0x8005ABFC DATA_RECORD_FLOAT32_IEEE 3.402823466E+038 F_1_p0_2 -3.402823466E+038 3.402823466E+038 /end CHARACTERISTIC
/begin CHARACTERISTIC AFTMTLCS_IwGainC "AFTMTLCS_IwGainC" VALUE 0x8005ABF8 DATA_RECORD_FLOAT32_IEEE 3.402823466E+038 F_1_p0_2 -3.402823466E+038 3.402823466E+038 /end CHARACTERISTIC
/begin CHARACTERISTIC AFTMTLCS_LostPhaseDelayCntC "AFTMTLCS_LostPhaseDelayCntC" VALUE 0x8005ABF4 DATA_RECORD_UWORD 65535 F_1_p0_2 0 65535 /end CHARACTERISTIC
/begin CHARACTERISTIC AFTMTLCS_LostPhaseEnaEleSpdRdsC "AFTMTLCS_LostPhaseEnaEleSpdRdsC" VALUE 0x8005ABF0 DATA_RECORD_FLOAT32_IEEE 3.402823466E+038 F_1_p0_2 -3.402823466E+038 3.402823466E+038 /end CHARACTERISTIC
/begin CHARACTERISTIC AFTMTLCS_LostPhaseMaxRateC "AFTMTLCS_LostPhaseMaxRateC" VALUE 0x8005ABEC DATA_RECORD_FLOAT32_IEEE 3.402823466E+038 F_1_p0_2 -3.402823466E+038 3.402823466E+038 /end CHARACTERISTIC
/begin CHARACTERISTIC AFTMTLCS_LostPhaseMinIRmsC "AFTMTLCS_LostPhaseMinIRmsC" VALUE 0x8005ABE8 DATA_RECORD_FLOAT32_IEEE 3.402823466E+038 F_1_p0_2 -3.402823466E+038 3.402823466E+038 /end CHARACTERISTIC
/begin CHARACTERISTIC AFTMTLCS_LutInCntrLoadRateC "AFTMTLCS_LutInCntrLoadRateC" CURVE 0x8005AB90 DATA_RECORD_FLOAT32_IEEE 3.402823466E+038 F_1_p0_2 -3.402823466E+038 3.402823466E+038
 /begin AXIS_DESCR FIX_AXIS NO_INPUT_QUANTITY Id_0x00 22 0 21 MAX_GRAD 100.0 FIX_AXIS_PAR_DIST 0 1 22 /end AXIS_DESCR
/end CHARACTERISTIC
/begin CHARACTERISTIC AFTMTLCS_LutInMotLoadCntC "AFTMTLCS_LutInMotLoadCntC" CURVE 0x8005AB64 DATA_RECORD_FLOAT32_IEEE 3.402823466E+038 F_1_p0_2 -3.402823466E+038 3.402823466E+038
 /begin AXIS_DESCR FIX_AXIS NO_INPUT_QUANTITY Id_0x00 11 0 10 MAX_GRAD 100.0 FIX_AXIS_PAR_DIST 0 1 11 /end AXIS_DESCR
/end CHARACTERISTIC
/begin CHARACTERISTIC AFTMTLCS_LutInMotLoadRateC "AFTMTLCS_LutInMotLoadRateC" CURVE 0x8005AB38 DATA_RECORD_FLOAT32_IEEE 3.402823466E+038 F_1_p0_2 -3.402823466E+038 3.402823466E+038
 /begin AXIS_DESCR FIX_AXIS NO_INPUT_QUANTITY Id_0x00 11 0 10 MAX_GRAD 100.0 FIX_AXIS_PAR_DIST 0 1 11 /end AXIS_DESCR
/end CHARACTERISTIC
/begin CHARACTERISTIC AFTMTLCS_LutOutCntrLoadCntC "AFTMTLCS_LutOutCntrLoadCntC" CURVE 0x8005AAE0 DATA_RECORD_FLOAT32_IEEE 3.402823466E+038 F_1_p0_2 -3.402823466E+038 3.402823466E+038
 /begin AXIS_DESCR FIX_AXIS NO_INPUT_QUANTITY Id_0x00 22 0 21 MAX_GRAD 100.0 FIX_AXIS_PAR_DIST 0 1 22 /end AXIS_DESCR
/end CHARACTERISTIC
/begin CHARACTERISTIC AFTMTLCS_MotCurrentThresholdC "AFTMTLCS_MotCurrentThresholdC" VALUE 0x8005AADC DATA_RECORD_FLOAT32_IEEE 0.001 F_1_p0_2 0 0.001 /end CHARACTERISTIC
/begin CHARACTERISTIC AFTMTLCS_MotorOverLoadCntC "AFTMTLCS_MotorOverLoadCntC" VALUE 0x8005AAD8 DATA_RECORD_FLOAT32_IEEE 3.402823466E+038 F_1_p0_2 -3.402823466E+038 3.402823466E+038 /end CHARACTERISTIC
/begin CHARACTERISTIC AFTMTLCS_MotorOverLoadCntMaxC "AFTMTLCS_MotorOverLoadCntMaxC" VALUE 0x8005AAD4 DATA_RECORD_FLOAT32_IEEE 3.402823466E+038 F_1_p0_2 -3.402823466E+038 3.402823466E+038 /end CHARACTERISTIC
/begin CHARACTERISTIC AFTMTLCS_SpdCutOffFrequencyC "AFTMTLCS_SpdCutOffFrequencyC" VALUE 0x8005AAD0 DATA_RECORD_FLOAT32_IEEE 3.402823466E+038 F_1_p0_2 -3.402823466E+038 3.402823466E+038 /end CHARACTERISTIC
/begin CHARACTERISTIC AFTMTLCS_SumErrorNegThrC "AFTMTLCS_SumErrorNegThrC" VALUE 0x8005AACC DATA_RECORD_FLOAT32_IEEE 200 F_1_p0_2 -200 0 /end CHARACTERISTIC
/begin CHARACTERISTIC AFTMTLCS_SumErrorPosThrC "AFTMTLCS_SumErrorPosThrC" VALUE 0x8005AAC8 DATA_RECORD_FLOAT32_IEEE 200 F_1_p0_2 0 200 /end CHARACTERISTIC
/begin CHARACTERISTIC AFTMTSEP_CurrentDelayTimeC "AFTMTSEP_CurrentDelayTimeC" VALUE 0x8005AC70 DATA_RECORD_FLOAT32_IEEE 3.402823466E+038 F_1_p0_2 -3.402823466E+038 3.402823466E+038 /end CHARACTERISTIC
/begin CHARACTERISTIC AFTMTSEP_TimeAdvanceFactC "AFTMTSEP_TimeAdvanceFactC" VALUE 0x8005AC6C DATA_RECORD_FLOAT32_IEEE 3.402823466E+038 F_1_p0_2 -3.402823466E+038 3.402823466E+038 /end CHARACTERISTIC
/begin CHARACTERISTIC AFTMTSEP_TimeDeltaC "AFTMTSEP_TimeDeltaC" VALUE 0x8005AC68 DATA_RECORD_FLOAT32_IEEE 3.402823466E+038 F_1_p0_2 -3.402823466E+038 3.402823466E+038 /end CHARACTERISTIC
/begin CHARACTERISTIC AFTSLOBS_CloseEleThetaRdC "AFTSLOBS_CloseEleThetaRdC" VALUE 0x8005AA90 DATA_RECORD_FLOAT32_IEEE 3.402823466E+038 F_1_p0_2 -3.402823466E+038 3.402823466E+038 /end CHARACTERISTIC
/begin CHARACTERISTIC AFTSLOBS_CloseElecSpeedRdsC "AFTSLOBS_CloseElecSpeedRdsC" VALUE 0x8005AA8C DATA_RECORD_FLOAT32_IEEE 3.402823466E+038 F_1_p0_2 -3.402823466E+038 3.402823466E+038 /end CHARACTERISTIC
/begin CHARACTERISTIC AFTSLOBS_DeltaUdKiC "AFTSLOBS_DeltaUdKiC" VALUE 0x8005AA88 DATA_RECORD_FLOAT32_IEEE 3.402823466E+038 F_1_p0_2 -3.402823466E+038 3.402823466E+038 /end CHARACTERISTIC
/begin CHARACTERISTIC AFTSLOBS_DeltaUdKiOnOffC "AFTSLOBS_DeltaUdKiOnOffC" VALUE 0x8005AA84 DATA_RECORD_UBYTE 1 Bool_ON_OFF 0 1 BIT_MASK 0x01 /end CHARACTERISTIC
/begin CHARACTERISTIC AFTSLOBS_DeltaUdKpC "AFTSLOBS_DeltaUdKpC" VALUE 0x8005AA80 DATA_RECORD_FLOAT32_IEEE 3.402823466E+038 F_1_p0_2 -3.402823466E+038 3.402823466E+038 /end CHARACTERISTIC
/begin CHARACTERISTIC AFTSLOBS_DeltaUd_Filter_NumZC "filter parameter" VALUE 0x8005AA7C DATA_RECORD_FLOAT32_IEEE 3.402823466E+038 F_1_p0_2 -3.402823466E+038 3.402823466E+038 /end CHARACTERISTIC
/begin CHARACTERISTIC AFTSLOBS_ElecSpeedRds_Filter_NumZC "filter parameter" VALUE 0x8005AA78 DATA_RECORD_FLOAT32_IEEE 3.402823466E+038 F_1_p0_2 -3.402823466E+038 3.402823466E+038 /end CHARACTERISTIC
/begin CHARACTERISTIC AFTSLOBS_ElecThetAddLutInSpdRdsC "AFTSLOBS_ElecThetAddLutInSpdRdsC" CURVE 0x8005AA68 DATA_RECORD_FLOAT32_IEEE 3.402823466E+038 F_1_p0_2 -3.402823466E+038 3.402823466E+038
 /begin AXIS_DESCR FIX_AXIS NO_INPUT_QUANTITY Id_0x00 4 0 3 MAX_GRAD 100.0 FIX_AXIS_PAR_DIST 0 1 4 /end AXIS_DESCR
/end CHARACTERISTIC
/begin CHARACTERISTIC AFTSLOBS_ElecThetaAddLutOutC "AFTSLOBS_ElecThetaAddLutOutC" CURVE 0x8005AA58 DATA_RECORD_FLOAT32_IEEE 3.402823466E+038 F_1_p0_2 -3.402823466E+038 3.402823466E+038
 /begin AXIS_DESCR FIX_AXIS NO_INPUT_QUANTITY Id_0x00 4 0 3 MAX_GRAD 100.0 FIX_AXIS_PAR_DIST 0 1 4 /end AXIS_DESCR
/end CHARACTERISTIC
/begin CHARACTERISTIC AFTSLOBS_ElecThetaCloseCntC "AFTSLOBS_ElecThetaCloseCntC" VALUE 0x8005AA54 DATA_RECORD_SWORD 65535 F_1_p0_2 -32768 32767 /end CHARACTERISTIC
/begin CHARACTERISTIC AFTSLOBS_ErrThetaElecMaxC "AFTSLOBS_ErrThetaElecMaxC" VALUE 0x8005AA50 DATA_RECORD_FLOAT32_IEEE 3.402823466E+038 F_1_p0_2 -3.402823466E+038 3.402823466E+038 /end CHARACTERISTIC
/begin CHARACTERISTIC AFTSLOBS_ErrThetaElecMinC "AFTSLOBS_ErrThetaElecMinC" VALUE 0x8005AA4C DATA_RECORD_FLOAT32_IEEE 3.402823466E+038 F_1_p0_2 -3.402823466E+038 3.402823466E+038 /end CHARACTERISTIC
/begin CHARACTERISTIC AFTSLOBS_LutInSpeedRpmC "AFTSLOBS_LutInSpeedRpmC" CURVE 0x8005AA30 DATA_RECORD_FLOAT32_IEEE 3.402823466E+038 F_1_p0_2 -3.402823466E+038 3.402823466E+038
 /begin AXIS_DESCR FIX_AXIS NO_INPUT_QUANTITY Id_0x00 7 0 6 MAX_GRAD 100.0 FIX_AXIS_PAR_DIST 0 1 7 /end AXIS_DESCR
/end CHARACTERISTIC
/begin CHARACTERISTIC AFTSLOBS_LutOutRunMinIsC "AFTSLOBS_LutOutRunMinIsC" CURVE 0x8005AA14 DATA_RECORD_FLOAT32_IEEE 3.402823466E+038 F_1_p0_2 -3.402823466E+038 3.402823466E+038
 /begin AXIS_DESCR FIX_AXIS NO_INPUT_QUANTITY Id_0x00 7 0 6 MAX_GRAD 100.0 FIX_AXIS_PAR_DIST 0 1 7 /end AXIS_DESCR
/end CHARACTERISTIC
/begin CHARACTERISTIC AFTSLOBS_NormlizationLowC "AFTSLOBS_NormlizationLowC" VALUE 0x8005AA10 DATA_RECORD_FLOAT32_IEEE 3.402823466E+038 F_1_p0_2 -3.402823466E+038 3.402823466E+038 /end CHARACTERISTIC
/begin CHARACTERISTIC AFTSLOBS_ObsvMultSignC "AFTSLOBS_ObsvMultSignC" VALUE 0x8005AA0C DATA_RECORD_FLOAT32_IEEE 3.402823466E+038 F_1_p0_2 -3.402823466E+038 3.402823466E+038 /end CHARACTERISTIC
/begin CHARACTERISTIC AFTSLOBS_PsiErrKpC "AFTSLOBS_PsiErrKpC" VALUE 0x8005AA08 DATA_RECORD_FLOAT32_IEEE 3.402823466E+038 F_1_p0_2 -3.402823466E+038 3.402823466E+038 /end CHARACTERISTIC
/begin CHARACTERISTIC AFTSLOBS_Rising2FastCntC "filter parameter" VALUE 0x8005AA04 DATA_RECORD_SWORD 65535 F_1_p0_2 -32768 32767 /end CHARACTERISTIC
/begin CHARACTERISTIC AFTSLOBS_Rising2FastSpeedRdsC "AFTSLOBS_Rising2FastSpeedRdsC" VALUE 0x8005AA00 DATA_RECORD_FLOAT32_IEEE 3.402823466E+038 F_1_p0_2 -3.402823466E+038 3.402823466E+038 /end CHARACTERISTIC
/begin CHARACTERISTIC AFTSLOBS_RunIsLowCntC "filter parameter" VALUE 0x8005A9FC DATA_RECORD_SWORD 65535 F_1_p0_2 -32768 32767 /end CHARACTERISTIC
/begin CHARACTERISTIC AFTSLOBS_SpdErrIqMinCntC "filter parameter" VALUE 0x8005A9F8 DATA_RECORD_SWORD 65535 F_1_p0_2 -32768 32767 /end CHARACTERISTIC
/begin CHARACTERISTIC AFTSLOBS_SpeedErrIqMinC "AFTSLOBS_SpeedErrIqMinC" VALUE 0x8005A9F4 DATA_RECORD_FLOAT32_IEEE 3.402823466E+038 F_1_p0_2 -3.402823466E+038 3.402823466E+038 /end CHARACTERISTIC
/begin CHARACTERISTIC AFTSLOBS_SwitchAtan2PllC "AFTSLOBS_SwitchAtan2PllC" VALUE 0x8005A9F0 DATA_RECORD_UBYTE 1 Bool_ON_OFF 0 1 BIT_MASK 0x01 /end CHARACTERISTIC
/begin CHARACTERISTIC AFTSLOBS_pK1ParameterC "AFTSLOBS_pK1ParameterC" VALUE 0x8005A9EC DATA_RECORD_FLOAT32_IEEE 3.402823466E+038 F_1_p0_2 -3.402823466E+038 3.402823466E+038 /end CHARACTERISTIC
/begin CHARACTERISTIC AFTSLOBS_pK2ParameterC "AFTSLOBS_pK2ParameterC" VALUE 0x8005A9E8 DATA_RECORD_FLOAT32_IEEE 3.402823466E+038 F_1_p0_2 -3.402823466E+038 3.402823466E+038 /end CHARACTERISTIC
/begin CHARACTERISTIC AFTSMACS_AclSpeedThdC "AFTSMACS_AclSpeedThdC" VALUE 0x8005AAAC DATA_RECORD_FLOAT32_IEEE 65535 F_1_p0_2 0 65535 /end CHARACTERISTIC
/begin CHARACTERISTIC AFTSMACS_BenchModeC "AFTSMACS_BenchModeC" VALUE 0x8005AAA8 DATA_RECORD_UBYTE 1 Bool_ON_OFF 0 1 BIT_MASK 0x01 /end CHARACTERISTIC
/begin CHARACTERISTIC AFTSMACS_PwmOffSpeedThdC "AFTSMACS_PwmOffSpeedThdC" VALUE 0x8005AAA4 DATA_RECORD_FLOAT32_IEEE 3.402823466E+038 F_1_p0_2 -3.402823466E+038 3.402823466E+038 /end CHARACTERISTIC
/begin CHARACTERISTIC AFTSMACS_ReinitFaultC "reinit all fault" VALUE 0x8005AAA0 DATA_RECORD_UBYTE 1 Bool_ON_OFF 0 1 BIT_MASK 0x01 /end CHARACTERISTIC
/begin CHARACTERISTIC AFTSMACS_TestFaultC "reinit all fault" VALUE 0x8005AA9C DATA_RECORD_UBYTE 1 Bool_ON_OFF 0 1 BIT_MASK 0x01 /end CHARACTERISTIC
/begin CHARACTERISTIC AFTSMACS_UbatHVMinC "AFTSMACS_UbatHVMinC" VALUE 0x8005AA98 DATA_RECORD_FLOAT32_IEEE 65535 F_1_p0_2 0 65535 /end CHARACTERISTIC
/begin CHARACTERISTIC AFTSMACS_VsiTimerFreqRatioRefC "0 =&gt; VSI switching frequency = SPI freq and 1 =&gt; VSI switching frequency = SPI freq / 2" VALUE 0x8005AA94 DATA_RECORD_UWORD 65535 F_1_p0_2 0 65535 /end CHARACTERISTIC
/begin CHARACTERISTIC AFTSMMAM_AclStateBypassOnOffC "AFTSMMAM_AclStateBypassOnOffC" VALUE 0x8005AAC4 DATA_RECORD_UBYTE 1 Bool_ON_OFF 0 1 BIT_MASK 0x01 /end CHARACTERISTIC
/begin CHARACTERISTIC AFTSMMAM_AclStateBypassValueC "AFTSMMAM_AclStateBypassValueC" VALUE 0x8005AAC0 DATA_RECORD_UWORD 65535 F_1_p0_2 0 65535 /end CHARACTERISTIC
/begin CHARACTERISTIC AFTSMMAM_AftModeReqBypassOnOffC "AFTSMMAM_AftModeReqBypassOnOffC" VALUE 0x8005AABC DATA_RECORD_UBYTE 1 Bool_ON_OFF 0 1 BIT_MASK 0x01 /end CHARACTERISTIC
/begin CHARACTERISTIC AFTSMMAM_AftModeReqBypassValueC "AFTSMMAM_AftModeReqBypassValueC" VALUE 0x8005AAB8 DATA_RECORD_UWORD 65535 F_1_p0_2 0 65535 /end CHARACTERISTIC
/begin CHARACTERISTIC AFTSMMAM_CMCCS_M0ConOnoffC "AFTSMMAM_CMCCS_M0ConOnoffC" VALUE 0x8005AAB4 DATA_RECORD_UBYTE 1 Bool_ON_OFF 0 1 BIT_MASK 0x01 /end CHARACTERISTIC
/begin CHARACTERISTIC AFTSMMAM_MTMEP_StateC "AFTSMMAM_MTMEP_StateC" VALUE 0x8005AAB0 DATA_RECORD_UWORD 65535 F_1_p0_2 0 65535 /end CHARACTERISTIC
/begin CHARACTERISTIC FTASBDS_BatVoltDrtEnableC "FTASBDS_BatVoltDrtEnableC" VALUE 0x8005ACCC DATA_RECORD_UBYTE 1 Bool_ON_OFF 0 1 BIT_MASK 0x01 /end CHARACTERISTIC
/begin CHARACTERISTIC FTASBDS_LutBatteryDeratingGainC "FTASBDS_LutBatteryDeratingGainC" CURVE 0x8005ACB4 DATA_RECORD_FLOAT32_IEEE 1 F_1_p0_2 0 1
 /begin AXIS_DESCR FIX_AXIS NO_INPUT_QUANTITY Id_0x00 6 0 5 MAX_GRAD 100.0 FIX_AXIS_PAR_DIST 0 1 6 /end AXIS_DESCR
/end CHARACTERISTIC
/begin CHARACTERISTIC FTASBDS_LutBatteryVoltageC "FTASBDS_LutBatteryVoltageC" CURVE 0x8005AC9C DATA_RECORD_FLOAT32_IEEE 1200 F_1_p0_2 0 1200
 /begin AXIS_DESCR FIX_AXIS NO_INPUT_QUANTITY Id_0x00 6 0 5 MAX_GRAD 100.0 FIX_AXIS_PAR_DIST 0 1 6 /end AXIS_DESCR
/end CHARACTERISTIC
/begin CHARACTERISTIC FTASBDS_LutInMecaSpeedRpmC "FTASBDS_LutInMecaSpeedRpmC" CURVE 0x8005AC90 DATA_RECORD_FLOAT32_IEEE 30000 F_1_p0_2 0 30000
 /begin AXIS_DESCR FIX_AXIS NO_INPUT_QUANTITY Id_0x00 3 0 2 MAX_GRAD 100.0 FIX_AXIS_PAR_DIST 0 1 3 /end AXIS_DESCR
/end CHARACTERISTIC
/begin CHARACTERISTIC FTASBDS_LutOutDeratingGainC "FTASBDS_LutOutDeratingGainC" CURVE 0x8005AC84 DATA_RECORD_FLOAT32_IEEE 1 F_1_p0_2 0 1
 /begin AXIS_DESCR FIX_AXIS NO_INPUT_QUANTITY Id_0x00 3 0 2 MAX_GRAD 100.0 FIX_AXIS_PAR_DIST 0 1 3 /end AXIS_DESCR
/end CHARACTERISTIC
/begin CHARACTERISTIC FTASBDS_ManualDeratingGainC "FTASBDS_ManualDeratingGainC" VALUE 0x8005AC80 DATA_RECORD_FLOAT32_IEEE 1 F_1_p0_2 0 1 /end CHARACTERISTIC
/begin CHARACTERISTIC FTASBDS_MaxDeratingGainC "FTASBDS_MaxDeratingGainC" VALUE 0x8005AC7C DATA_RECORD_FLOAT32_IEEE 1 F_1_p0_2 0 1 /end CHARACTERISTIC
/begin CHARACTERISTIC FTASBDS_MinDeratingGainC "FTASBDS_MinDeratingGainC" VALUE 0x8005AC78 DATA_RECORD_FLOAT32_IEEE 1 F_1_p0_2 0 1 /end CHARACTERISTIC
/begin CHARACTERISTIC FTASBDS_UbatHVNominalC "FTASBDS_UbatHVNominalC" VALUE 0x8005AC74 DATA_RECORD_FLOAT32_IEEE 1200 F_1_p0_2 0 1200 /end CHARACTERISTIC
/begin CHARACTERISTIC FTASDPM_I0DeratingMaxC "FTASDPM_I0DeratingMaxC" VALUE 0x8005ACEC DATA_RECORD_FLOAT32_IEEE 1200 F_1_p0_2 0 1200 /end CHARACTERISTIC
/begin CHARACTERISTIC FTASDPM_I0DeratingMinC "FTASDPM_I0DeratingMinC" VALUE 0x8005ACE8 DATA_RECORD_FLOAT32_IEEE 1200 F_1_p0_2 -1200 0 /end CHARACTERISTIC
/begin CHARACTERISTIC FTASDPM_IdDeratingMaxC "FTASDPM_IdDeratingMaxC" VALUE 0x8005ACE4 DATA_RECORD_FLOAT32_IEEE 1200 F_1_p0_2 0 1200 /end CHARACTERISTIC
/begin CHARACTERISTIC FTASDPM_IdDeratingMinC "FTASDPM_IdDeratingMinC" VALUE 0x8005ACE0 DATA_RECORD_FLOAT32_IEEE 1200 F_1_p0_2 -1200 0 /end CHARACTERISTIC
/begin CHARACTERISTIC FTASDPM_IqDeratingMaxC "FTASDPM_IqDeratingMaxC" VALUE 0x8005ACDC DATA_RECORD_FLOAT32_IEEE 1200 F_1_p0_2 0 1200 /end CHARACTERISTIC
/begin CHARACTERISTIC FTASDPM_IqDeratingMinC "FTASDPM_IqDeratingMinC" VALUE 0x8005ACD8 DATA_RECORD_FLOAT32_IEEE 1200 F_1_p0_2 -1200 0 /end CHARACTERISTIC
/begin CHARACTERISTIC FTASDPM_SpeedDrtMaxRpmC "FTASDPM_SpeedDrtMaxRpmC" VALUE 0x8005ACD4 DATA_RECORD_FLOAT32_IEEE 25000 F_1_p0_2 0 25000 /end CHARACTERISTIC
/begin CHARACTERISTIC FTASDPM_SpeedDrtMinRpmC "FTASDPM_SpeedDrtMinRpmC" VALUE 0x8005ACD0 DATA_RECORD_FLOAT32_IEEE 25000 F_1_p0_2 -25000 0 /end CHARACTERISTIC
/begin CHARACTERISTIC FTASETP_ControllerEstPmKiC "Controller integral coefficient." VALUE 0x8005AD5C DATA_RECORD_FLOAT32_IEEE 1000 F_1_p0_2 0 1000 /end CHARACTERISTIC
/begin CHARACTERISTIC FTASETP_ControllerEstPmKpC "Controller proportional coefficient." VALUE 0x8005AD58 DATA_RECORD_FLOAT32_IEEE 1000 F_1_p0_2 0 1000 /end CHARACTERISTIC
/begin CHARACTERISTIC FTASETP_ControllerPmKiC "Controller integral coefficient." VALUE 0x8005AD54 DATA_RECORD_FLOAT32_IEEE 1000 F_1_p0_2 0 1000 /end CHARACTERISTIC
/begin CHARACTERISTIC FTASETP_ControllerPmKpC "Controller proportional coefficient." VALUE 0x8005AD50 DATA_RECORD_FLOAT32_IEEE 1000 F_1_p0_2 0 1000 /end CHARACTERISTIC
/begin CHARACTERISTIC FTASETP_EstPmDrtEnableC "Enable derating" VALUE 0x8005AD4C DATA_RECORD_UBYTE 1 Bool_ON_OFF 0 1 BIT_MASK 0x01 /end CHARACTERISTIC
/begin CHARACTERISTIC FTASETP_EstPmKiMaxC "FTASETP_EstPmKiMaxC" VALUE 0x8005AD48 DATA_RECORD_FLOAT32_IEEE 1 F_1_p0_2 0 1 /end CHARACTERISTIC
/begin CHARACTERISTIC FTASETP_EstPmMaximalTempC "FTASETP_EstPmMaximalTempC" VALUE 0x8005AD44 DATA_RECORD_FLOAT32_IEEE 200 F_1_p0_2 0 200 /end CHARACTERISTIC
/begin CHARACTERISTIC FTASETP_LutInMecaSpeedRpmC "FTASETP_LutInMecaSpeedRpmC" CURVE 0x8005AD24 DATA_RECORD_FLOAT32_IEEE 40000 F_1_p0_2 -20000 20000
 /begin AXIS_DESCR FIX_AXIS NO_INPUT_QUANTITY Id_0x00 8 0 7 MAX_GRAD 100.0 FIX_AXIS_PAR_DIST 0 1 8 /end AXIS_DESCR
/end CHARACTERISTIC
/begin CHARACTERISTIC FTASETP_MaxDeratingGainC "Gain maximal value." VALUE 0x8005AD20 DATA_RECORD_FLOAT32_IEEE 1 F_1_p0_2 0 1 /end CHARACTERISTIC
/begin CHARACTERISTIC FTASETP_MinDeratingGainC "Gain minimal value." VALUE 0x8005AD1C DATA_RECORD_FLOAT32_IEEE 1 F_1_p0_2 0 1 /end CHARACTERISTIC
/begin CHARACTERISTIC FTASETP_OpenLoopEstPmDrtGainC "FTASETP_OpenLoopEstPmDrtGainC" CURVE 0x8005ACFC DATA_RECORD_FLOAT32_IEEE 1 F_1_p0_2 0 1
 /begin AXIS_DESCR FIX_AXIS NO_INPUT_QUANTITY Id_0x00 8 0 7 MAX_GRAD 100.0 FIX_AXIS_PAR_DIST 0 1 8 /end AXIS_DESCR
/end CHARACTERISTIC
/begin CHARACTERISTIC FTASETP_PmDrtEnableC "Enable derating" VALUE 0x8005ACF8 DATA_RECORD_UBYTE 1 Bool_ON_OFF 0 1 BIT_MASK 0x01 /end CHARACTERISTIC
/begin CHARACTERISTIC FTASETP_PmKiMaxC "FTASETP_PmKiMaxC" VALUE 0x8005ACF4 DATA_RECORD_FLOAT32_IEEE 1 F_1_p0_2 0 1 /end CHARACTERISTIC
/begin CHARACTERISTIC FTASETP_PmMaximalTempC "FTASETP_PmMaximalTempC" VALUE 0x8005ACF0 DATA_RECORD_FLOAT32_IEEE 200 F_1_p0_2 0 200 /end CHARACTERISTIC
/begin CHARACTERISTIC FTASMTP_ControllerWndgKiC "Controller integral coefficient." VALUE 0x8005AD78 DATA_RECORD_FLOAT32_IEEE 1000 F_1_p0_2 0 1000 /end CHARACTERISTIC
/begin CHARACTERISTIC FTASMTP_ControllerWndgKpC "Controller proportional coefficient." VALUE 0x8005AD74 DATA_RECORD_FLOAT32_IEEE 1000 F_1_p0_2 0 1000 /end CHARACTERISTIC
/begin CHARACTERISTIC FTASMTP_MaxDeratingGainC "Gain maximal value." VALUE 0x8005AD70 DATA_RECORD_FLOAT32_IEEE 1 F_1_p0_2 0 1 /end CHARACTERISTIC
/begin CHARACTERISTIC FTASMTP_MinDeratingGainC "Gain minimal value." VALUE 0x8005AD6C DATA_RECORD_FLOAT32_IEEE 1 F_1_p0_2 0 1 /end CHARACTERISTIC
/begin CHARACTERISTIC FTASMTP_WndgDrtEnableC "Enable derating" VALUE 0x8005AD68 DATA_RECORD_UBYTE 1 Bool_ON_OFF 0 1 BIT_MASK 0x01 /end CHARACTERISTIC
/begin CHARACTERISTIC FTASMTP_WndgKiMaxC "FTASMTP_WndgKiMaxC" VALUE 0x8005AD64 DATA_RECORD_FLOAT32_IEEE 1 F_1_p0_2 0 1 /end CHARACTERISTIC
/begin CHARACTERISTIC FTASMTP_WndgMaximalTempC "FTASMTP_WndgMaximalTempC" VALUE 0x8005AD60 DATA_RECORD_FLOAT32_IEEE 200 F_1_p0_2 0 200 /end CHARACTERISTIC
/begin CHARACTERISTIC FTASOSP_LutMotDeratingGainC "FTASOSP_LutMotDeratingGainC" CURVE 0x8005AD94 DATA_RECORD_FLOAT32_IEEE 1 F_1_p0_2 0 1
 /begin AXIS_DESCR FIX_AXIS NO_INPUT_QUANTITY Id_0x00 2 0 1 MAX_GRAD 100.0 FIX_AXIS_PAR_DIST 0 1 2 /end AXIS_DESCR
/end CHARACTERISTIC
/begin CHARACTERISTIC FTASOSP_LutMotorSpeedC "FTASOSP_LutMotorSpeedC" CURVE 0x8005AD8C DATA_RECORD_FLOAT32_IEEE 20000 F_1_p0_2 0 20000
 /begin AXIS_DESCR FIX_AXIS NO_INPUT_QUANTITY Id_0x00 2 0 1 MAX_GRAD 100.0 FIX_AXIS_PAR_DIST 0 1 2 /end AXIS_DESCR
/end CHARACTERISTIC
/begin CHARACTERISTIC FTASOSP_ManualDeratingGainC "FTASOSP_ManualDeratingGainC" VALUE 0x8005AD88 DATA_RECORD_FLOAT32_IEEE 1 F_1_p0_2 0 1 /end CHARACTERISTIC
/begin CHARACTERISTIC FTASOSP_MaxDeratingGainC "FTASOSP_MaxDeratingGainC" VALUE 0x8005AD84 DATA_RECORD_FLOAT32_IEEE 1 F_1_p0_2 0 1 /end CHARACTERISTIC
/begin CHARACTERISTIC FTASOSP_MinDeratingGainC "FTASOSP_MinDeratingGainC" VALUE 0x8005AD80 DATA_RECORD_FLOAT32_IEEE 1 F_1_p0_2 0 1 /end CHARACTERISTIC
/begin CHARACTERISTIC FTASOSP_MotorSpdDrtEnableC "FTASOSP_MotorSpdDrtEnableC" VALUE 0x8005AD7C DATA_RECORD_UBYTE 1 Bool_ON_OFF 0 1 BIT_MASK 0x01 /end CHARACTERISTIC
/begin CHARACTERISTIC FTCIVDC_AntiNarrowPulseEnC "FTCIVDC_AntiNarrowPulseEnC" VALUE 0x8005AF14 DATA_RECORD_UBYTE 1 Bool_ON_OFF 0 1 BIT_MASK 0x01 /end CHARACTERISTIC
/begin CHARACTERISTIC FTCIVDC_Concordia33C "FTCIVDC_Concordia33C" MAP 0x8005AEF0 DATA_RECORD_FLOAT32_IEEE 2 F_1_p0_2 -1 1
 /begin AXIS_DESCR FIX_AXIS NO_INPUT_QUANTITY Id_0x00 3 0 2 MAX_GRAD 100.0 FIX_AXIS_PAR_DIST 0 1 3 /end AXIS_DESCR
 /begin AXIS_DESCR FIX_AXIS NO_INPUT_QUANTITY Id_0x00 3 0 2 MAX_GRAD 100.0 FIX_AXIS_PAR_DIST 0 1 3 /end AXIS_DESCR
/end CHARACTERISTIC
/begin CHARACTERISTIC FTCIVDC_DeadComDisableIsC "FTCIVDC_DeadComDisableIsC" VALUE 0x8005AEEC DATA_RECORD_FLOAT32_IEEE 3.402823466E+038 F_1_p0_2 -3.402823466E+038 3.402823466E+038 /end CHARACTERISTIC
/begin CHARACTERISTIC FTCIVDC_DeadComEnableIsC "FTCIVDC_DeadComEnableIsC" VALUE 0x8005AEE8 DATA_RECORD_FLOAT32_IEEE 3.402823466E+038 F_1_p0_2 -3.402823466E+038 3.402823466E+038 /end CHARACTERISTIC
/begin CHARACTERISTIC FTCIVDC_DeadZnCompEnaC "FTCIVDC_DeadZnCompEnaC" VALUE 0x8005AEE4 DATA_RECORD_UBYTE 1 Bool_ON_OFF 0 1 BIT_MASK 0x01 /end CHARACTERISTIC
/begin CHARACTERISTIC FTCIVDC_DeadZnCompSpeedHighC "FTCIVDC_DeadZnCompSpeedHighC" VALUE 0x8005AEE0 DATA_RECORD_FLOAT32_IEEE 3.402823466E+038 F_1_p0_2 -3.402823466E+038 3.402823466E+038 /end CHARACTERISTIC
/begin CHARACTERISTIC FTCIVDC_DeadZnCompSpeedLowC "FTCIVDC_DeadZnCompSpeedLowC" VALUE 0x8005AEDC DATA_RECORD_FLOAT32_IEEE 3.402823466E+038 F_1_p0_2 -3.402823466E+038 3.402823466E+038 /end CHARACTERISTIC
/begin CHARACTERISTIC FTCIVDC_DeadZoneTimeUsC "FTCIVDC_DeadZoneTimeUsC" VALUE 0x8005AED8 DATA_RECORD_FLOAT32_IEEE 10 F_1_p0_2 0 10 /end CHARACTERISTIC
/begin CHARACTERISTIC FTCIVDC_DefaultPwmFrequencyC "FTCIVDC_DefaultPwmFrequencyC" VALUE 0x8005AED4 DATA_RECORD_UWORD 8000 F_1_p0_2 2000 10000 /end CHARACTERISTIC
/begin CHARACTERISTIC FTCIVDC_DutyCycleMaxC "FTCIVDC_DutyCycleMaxC" VALUE 0x8005AED0 DATA_RECORD_FLOAT32_IEEE 1 F_1_p0_2 0 1 /end CHARACTERISTIC
/begin CHARACTERISTIC FTCIVDC_DutyCycleMinC "FTCIVDC_DutyCycleMinC" VALUE 0x8005AECC DATA_RECORD_FLOAT32_IEEE 1 F_1_p0_2 0 1 /end CHARACTERISTIC
/begin CHARACTERISTIC FTCIVDC_ExtPwmOnOff3C "FTCIVDC_ExtPwmOnOff3C" CURVE 0x8005AEC8 DATA_RECORD_UBYTE 1 Bool_ON_OFF 0 1 BIT_MASK 0x01
 /begin AXIS_DESCR FIX_AXIS NO_INPUT_QUANTITY Id_0x00 3 0 2 MAX_GRAD 100.0 FIX_AXIS_PAR_DIST 0 1 3 /end AXIS_DESCR
/end CHARACTERISTIC
/begin CHARACTERISTIC FTCIVDC_FpgaDutyCycleMinMaxC "FTCIVDC_FpgaDutyCycleMinMaxC" CURVE 0x8005AEC0 DATA_RECORD_FLOAT32_IEEE 1 F_1_p0_2 0 1
 /begin AXIS_DESCR FIX_AXIS NO_INPUT_QUANTITY Id_0x00 2 0 1 MAX_GRAD 100.0 FIX_AXIS_PAR_DIST 0 1 2 /end AXIS_DESCR
/end CHARACTERISTIC
/begin CHARACTERISTIC FTCIVDC_FreqRangC "FTCIVDC_FreqRangC" VALUE 0x8005AEBC DATA_RECORD_FLOAT32_IEEE 3.402823466E+038 F_1_p0_2 -3.402823466E+038 3.402823466E+038 /end CHARACTERISTIC
/begin CHARACTERISTIC FTCIVDC_InitDutyCycle3C "FTCIVDC_InitDutyCycle3C" CURVE 0x8005AEB0 DATA_RECORD_FLOAT32_IEEE 1 F_1_p0_2 0 1
 /begin AXIS_DESCR FIX_AXIS NO_INPUT_QUANTITY Id_0x00 3 0 2 MAX_GRAD 100.0 FIX_AXIS_PAR_DIST 0 1 3 /end AXIS_DESCR
/end CHARACTERISTIC
/begin CHARACTERISTIC FTCIVDC_InitPwmOnOff3C "FTCIVDC_InitPwmOnOff3C" CURVE 0x8005AEAC DATA_RECORD_UBYTE 1 Bool_ON_OFF 0 1 BIT_MASK 0x01
 /begin AXIS_DESCR FIX_AXIS NO_INPUT_QUANTITY Id_0x00 3 0 2 MAX_GRAD 100.0 FIX_AXIS_PAR_DIST 0 1 3 /end AXIS_DESCR
/end CHARACTERISTIC
/begin CHARACTERISTIC FTCIVDC_LutDeadTimeCompUAngleC "FTCIVDC_LutDeadTimeCompUAngleC" CURVE 0x8005AE8C DATA_RECORD_FLOAT32_IEEE 3.402823466E+038 F_1_p0_2 -3.402823466E+038 3.402823466E+038
 /begin AXIS_DESCR FIX_AXIS NO_INPUT_QUANTITY Id_0x00 8 0 7 MAX_GRAD 100.0 FIX_AXIS_PAR_DIST 0 1 8 /end AXIS_DESCR
/end CHARACTERISTIC
/begin CHARACTERISTIC FTCIVDC_LutEitEstPwmRatioC "FTCIVDC_LutEitEstPwmRatioC" CURVE 0x8005AE34 DATA_RECORD_FLOAT32_IEEE 1.9 F_1_p0_2 0.1 2
 /begin AXIS_DESCR FIX_AXIS NO_INPUT_QUANTITY Id_0x00 6 0 5 MAX_GRAD 100.0 FIX_AXIS_PAR_DIST 0 1 6 /end AXIS_DESCR
/end CHARACTERISTIC
/begin CHARACTERISTIC FTCIVDC_LutInSpeedC "FTCIVDC_LutInSpeedC" CURVE 0x8005AE20 DATA_RECORD_FLOAT32_IEEE 3.402823466E+038 F_1_p0_2 -3.402823466E+038 3.402823466E+038
 /begin AXIS_DESCR FIX_AXIS NO_INPUT_QUANTITY Id_0x00 5 0 4 MAX_GRAD 100.0 FIX_AXIS_PAR_DIST 0 1 5 /end AXIS_DESCR
/end CHARACTERISTIC
/begin CHARACTERISTIC FTCIVDC_LutMecaspeedRpmC "FTCIVDC_LutMecaspeedRpmC" CURVE 0x8005AE08 DATA_RECORD_FLOAT32_IEEE 3.402823466E+038 F_1_p0_2 -3.402823466E+038 3.402823466E+038
 /begin AXIS_DESCR FIX_AXIS NO_INPUT_QUANTITY Id_0x00 6 0 5 MAX_GRAD 100.0 FIX_AXIS_PAR_DIST 0 1 6 /end AXIS_DESCR
/end CHARACTERISTIC
/begin CHARACTERISTIC FTCIVDC_LutOutDeadTimeCompGainC "FTCIVDC_LutOutDeadTimeCompGainC" CURVE 0x8005ADE8 DATA_RECORD_FLOAT32_IEEE 3.402823466E+038 F_1_p0_2 -3.402823466E+038 3.402823466E+038
 /begin AXIS_DESCR FIX_AXIS NO_INPUT_QUANTITY Id_0x00 8 0 7 MAX_GRAD 100.0 FIX_AXIS_PAR_DIST 0 1 8 /end AXIS_DESCR
/end CHARACTERISTIC
/begin CHARACTERISTIC FTCIVDC_LutOutFreqLmtC "FTCIVDC_LutOutFreqLmtC" CURVE 0x8005ADDC DATA_RECORD_UWORD 65535 F_1_p0_2 0 65535
 /begin AXIS_DESCR FIX_AXIS NO_INPUT_QUANTITY Id_0x00 5 0 4 MAX_GRAD 100.0 FIX_AXIS_PAR_DIST 0 1 5 /end AXIS_DESCR
/end CHARACTERISTIC
/begin CHARACTERISTIC FTCIVDC_LutPwmFrequenceC "FTCIVDC_LutPwmFrequenceC" CURVE 0x8005ADD0 DATA_RECORD_UWORD 28500 F_1_p0_2 1500 30000
 /begin AXIS_DESCR FIX_AXIS NO_INPUT_QUANTITY Id_0x00 6 0 5 MAX_GRAD 100.0 FIX_AXIS_PAR_DIST 0 1 6 /end AXIS_DESCR
/end CHARACTERISTIC
/begin CHARACTERISTIC FTCIVDC_MecaSpdCutOffFrequencyC "FTCIVDC_MecaSpdCutOffFrequencyC" VALUE 0x8005ADCC DATA_RECORD_FLOAT32_IEEE 3.402823466E+038 F_1_p0_2 -3.402823466E+038 3.402823466E+038 /end CHARACTERISTIC
/begin CHARACTERISTIC FTCIVDC_NarrowPulseTimeC "FTCIVDC_NarrowPulseTimeC" VALUE 0x8005ADC8 DATA_RECORD_FLOAT32_IEEE 10 F_1_p0_2 0 10 /end CHARACTERISTIC
/begin CHARACTERISTIC FTCIVDC_OperationnalPwmOnOff3C "FTCIVDC_OperationnalPwmOnOff3C" CURVE 0x8005ADC4 DATA_RECORD_UBYTE 1 Bool_ON_OFF 0 1 BIT_MASK 0x01
 /begin AXIS_DESCR FIX_AXIS NO_INPUT_QUANTITY Id_0x00 3 0 2 MAX_GRAD 100.0 FIX_AXIS_PAR_DIST 0 1 3 /end AXIS_DESCR
/end CHARACTERISTIC
/begin CHARACTERISTIC FTCIVDC_PwmFrequenceMaxC "FTCIVDC_PwmFrequenceMaxC" VALUE 0x8005ADC0 DATA_RECORD_UWORD 65535 F_1_p0_2 0 65535 /end CHARACTERISTIC
/begin CHARACTERISTIC FTCIVDC_PwmFrequenceMinC "FTCIVDC_PwmFrequenceMinC" VALUE 0x8005ADBC DATA_RECORD_UWORD 65535 F_1_p0_2 0 65535 /end CHARACTERISTIC
/begin CHARACTERISTIC FTCIVDC_PwmZeroMatchEnC "FTCIVDC_PwmZeroMatchEnC" VALUE 0x8005ADB8 DATA_RECORD_UBYTE 1 Bool_ON_OFF 0 1 BIT_MASK 0x01 /end CHARACTERISTIC
/begin CHARACTERISTIC FTCIVDC_PwmZeroMatchRevC "FTCIVDC_PwmZeroMatchRevC" VALUE 0x8005ADB4 DATA_RECORD_UBYTE 1 Bool_ON_OFF 0 1 BIT_MASK 0x01 /end CHARACTERISTIC
/begin CHARACTERISTIC FTCIVDC_RandFreqEnC "FTCIVDC_RandFreqEnC" VALUE 0x8005ADB0 DATA_RECORD_UBYTE 1 Bool_ON_OFF 0 1 BIT_MASK 0x01 /end CHARACTERISTIC
/begin CHARACTERISTIC FTCIVDC_RdFreqTimeC "FTCIVDC_RdFreqTimeC" VALUE 0x8005ADAC DATA_RECORD_UWORD 65535 F_1_p0_2 0 65535 /end CHARACTERISTIC
/begin CHARACTERISTIC FTCIVDC_SpdMaxC "FTCIVDC_SpdMaxC" VALUE 0x8005ADA8 DATA_RECORD_FLOAT32_IEEE 3.402823466E+038 F_1_p0_2 -3.402823466E+038 3.402823466E+038 /end CHARACTERISTIC
/begin CHARACTERISTIC FTCIVDC_SpdMinC "FTCIVDC_SpdMinC" VALUE 0x8005ADA4 DATA_RECORD_FLOAT32_IEEE 3.402823466E+038 F_1_p0_2 -3.402823466E+038 3.402823466E+038 /end CHARACTERISTIC
/begin CHARACTERISTIC FTCIVDC_UbatHVLowSatC "FTCIVDC_UbatHVLowSatC" VALUE 0x8005ADA0 DATA_RECORD_FLOAT32_IEEE 99 F_1_p0_2 1 100 /end CHARACTERISTIC
/begin CHARACTERISTIC FTCIVDC_VFreqEnableC "FTCIVDC_VFreqEnableC" VALUE 0x8005AD9C DATA_RECORD_UBYTE 1 Bool_ON_OFF 0 1 BIT_MASK 0x01 /end CHARACTERISTIC
/begin CHARACTERISTIC FTCMCCS_CurrentLoopOrgEnC "FTCMCCS_CurrentLoopOrgEnC" VALUE 0x8005B4D4 DATA_RECORD_UBYTE 1 Bool_ON_OFF 0 1 BIT_MASK 0x01 /end CHARACTERISTIC
/begin CHARACTERISTIC FTCMCCS_EM1dOpenLoopGainC "FTCMCCS_EM1dOpenLoopGainC" VALUE 0x8005B4D0 DATA_RECORD_FLOAT32_IEEE 3.402823466E+038 F_1_p0_2 -3.402823466E+038 3.402823466E+038 /end CHARACTERISTIC
/begin CHARACTERISTIC FTCMCCS_EM1qOpenLoopGainC "FTCMCCS_EM1qOpenLoopGainC" VALUE 0x8005B4CC DATA_RECORD_FLOAT32_IEEE 3.402823466E+038 F_1_p0_2 -3.402823466E+038 3.402823466E+038 /end CHARACTERISTIC
/begin CHARACTERISTIC FTCMCCS_GenTableTorqueThrdC "FTCMCCS_GenTableTorqueThrdC" VALUE 0x8005B4C8 DATA_RECORD_FLOAT32_IEEE 3.402823466E+038 F_1_p0_2 -3.402823466E+038 3.402823466E+038 /end CHARACTERISTIC
/begin CHARACTERISTIC FTCMCCS_IdCurrLoopParOnOffC "FTCMCCS_IdCurrLoopParOnOffC" VALUE 0x8005B4C4 DATA_RECORD_UBYTE 1 Bool_ON_OFF 0 1 BIT_MASK 0x01 /end CHARACTERISTIC
/begin CHARACTERISTIC FTCMCCS_InitU0dqTgt3C "FTCMCCS_InitU0dqTgt3C" CURVE 0x8005B4B8 DATA_RECORD_FLOAT32_IEEE 3.402823466E+038 F_1_p0_2 -3.402823466E+038 3.402823466E+038
 /begin AXIS_DESCR FIX_AXIS NO_INPUT_QUANTITY Id_0x00 3 0 2 MAX_GRAD 100.0 FIX_AXIS_PAR_DIST 0 1 3 /end AXIS_DESCR
/end CHARACTERISTIC
/begin CHARACTERISTIC FTCMCCS_IqCurrLoopParOnOffC "FTCMCCS_IqCurrLoopParOnOffC" VALUE 0x8005B4B4 DATA_RECORD_UBYTE 1 Bool_ON_OFF 0 1 BIT_MASK 0x01 /end CHARACTERISTIC
/begin CHARACTERISTIC FTCMCCS_Lm0C "FTCMCCS_Lm0C" VALUE 0x8005B4B0 DATA_RECORD_FLOAT32_IEEE 3.402823466E+038 F_1_p0_2 -3.402823466E+038 3.402823466E+038 /end CHARACTERISTIC
/begin CHARACTERISTIC FTCMCCS_Lm1dC "FTCMCCS_Lm1dC" VALUE 0x8005B4AC DATA_RECORD_FLOAT32_IEEE 3.402823466E+038 F_1_p0_2 -3.402823466E+038 3.402823466E+038 /end CHARACTERISTIC
/begin CHARACTERISTIC FTCMCCS_Lm1qC "FTCMCCS_Lm1qC" VALUE 0x8005B4A8 DATA_RECORD_FLOAT32_IEEE 3.402823466E+038 F_1_p0_2 -3.402823466E+038 3.402823466E+038 /end CHARACTERISTIC
/begin CHARACTERISTIC FTCMCCS_LutElecSpeedRds3C "FTCMCCS_LutElecSpeedRds3C" CURVE 0x8005B49C DATA_RECORD_FLOAT32_IEEE 3.402823466E+038 F_1_p0_2 -3.402823466E+038 3.402823466E+038
 /begin AXIS_DESCR FIX_AXIS NO_INPUT_QUANTITY Id_0x00 3 0 2 MAX_GRAD 100.0 FIX_AXIS_PAR_DIST 0 1 3 /end AXIS_DESCR
/end CHARACTERISTIC
/begin CHARACTERISTIC FTCMCCS_LutInSpeedRpmC "FTCMCCS_LutInSpeedRpmC" CURVE 0x8009A46C DATA_RECORD_FLOAT32_IEEE 3.402823466E+038 F_1_p0_2 -3.402823466E+038 3.402823466E+038
 /begin AXIS_DESCR FIX_AXIS NO_INPUT_QUANTITY Id_0x00 14 0 13 MAX_GRAD 100.0 FIX_AXIS_PAR_DIST 0 1 14 /end AXIS_DESCR
/end CHARACTERISTIC
/begin CHARACTERISTIC FTCMCCS_LutInUbatC "FTCMCCS_LutInUbatC" CURVE 0x8009A454 DATA_RECORD_FLOAT32_IEEE 3.402823466E+038 F_1_p0_2 -3.402823466E+038 3.402823466E+038
 /begin AXIS_DESCR FIX_AXIS NO_INPUT_QUANTITY Id_0x00 6 0 5 MAX_GRAD 100.0 FIX_AXIS_PAR_DIST 0 1 6 /end AXIS_DESCR
/end CHARACTERISTIC
/begin CHARACTERISTIC FTCMCCS_LutM0CtrlTrC "FTCMCCS_LutM0CtrlTrC" CURVE 0x8005B490 DATA_RECORD_FLOAT32_IEEE 999.9999 F_1_p0_2 0.0001 1000
 /begin AXIS_DESCR FIX_AXIS NO_INPUT_QUANTITY Id_0x00 3 0 2 MAX_GRAD 100.0 FIX_AXIS_PAR_DIST 0 1 3 /end AXIS_DESCR
/end CHARACTERISTIC
/begin CHARACTERISTIC FTCMCCS_LutOutM1dCtrlTrGC "FTCMCCS_LutOutM1dCtrlTrGC" MAP 0x8005B340 DATA_RECORD_FLOAT32_IEEE 3.402823466E+038 F_1_p0_2 -3.402823466E+038 3.402823466E+038
 /begin AXIS_DESCR FIX_AXIS NO_INPUT_QUANTITY Id_0x00 6 0 5 MAX_GRAD 100.0 FIX_AXIS_PAR_DIST 0 1 6 /end AXIS_DESCR
 /begin AXIS_DESCR FIX_AXIS NO_INPUT_QUANTITY Id_0x00 14 0 13 MAX_GRAD 100.0 FIX_AXIS_PAR_DIST 0 1 14 /end AXIS_DESCR
/end CHARACTERISTIC
/begin CHARACTERISTIC FTCMCCS_LutOutM1dCtrlTrMC "FTCMCCS_LutOutM1dCtrlTrMC" MAP 0x8005B1F0 DATA_RECORD_FLOAT32_IEEE 3.402823466E+038 F_1_p0_2 -3.402823466E+038 3.402823466E+038
 /begin AXIS_DESCR FIX_AXIS NO_INPUT_QUANTITY Id_0x00 6 0 5 MAX_GRAD 100.0 FIX_AXIS_PAR_DIST 0 1 6 /end AXIS_DESCR
 /begin AXIS_DESCR FIX_AXIS NO_INPUT_QUANTITY Id_0x00 14 0 13 MAX_GRAD 100.0 FIX_AXIS_PAR_DIST 0 1 14 /end AXIS_DESCR
/end CHARACTERISTIC
/begin CHARACTERISTIC FTCMCCS_LutOutM1qCtrlTrGC "FTCMCCS_LutOutM1qCtrlTrGC" MAP 0x8005B0A0 DATA_RECORD_FLOAT32_IEEE 3.402823466E+038 F_1_p0_2 -3.402823466E+038 3.402823466E+038
 /begin AXIS_DESCR FIX_AXIS NO_INPUT_QUANTITY Id_0x00 6 0 5 MAX_GRAD 100.0 FIX_AXIS_PAR_DIST 0 1 6 /end AXIS_DESCR
 /begin AXIS_DESCR FIX_AXIS NO_INPUT_QUANTITY Id_0x00 14 0 13 MAX_GRAD 100.0 FIX_AXIS_PAR_DIST 0 1 14 /end AXIS_DESCR
/end CHARACTERISTIC
/begin CHARACTERISTIC FTCMCCS_LutOutM1qCtrlTrMC "FTCMCCS_LutOutM1qCtrlTrMC" MAP 0x8005AF50 DATA_RECORD_FLOAT32_IEEE 3.402823466E+038 F_1_p0_2 -3.402823466E+038 3.402823466E+038
 /begin AXIS_DESCR FIX_AXIS NO_INPUT_QUANTITY Id_0x00 6 0 5 MAX_GRAD 100.0 FIX_AXIS_PAR_DIST 0 1 6 /end AXIS_DESCR
 /begin AXIS_DESCR FIX_AXIS NO_INPUT_QUANTITY Id_0x00 14 0 13 MAX_GRAD 100.0 FIX_AXIS_PAR_DIST 0 1 14 /end AXIS_DESCR
/end CHARACTERISTIC
/begin CHARACTERISTIC FTCMCCS_M1dCtrlTrC "FTCMCCS_M1dCtrlTrC" VALUE 0x8005AF4C DATA_RECORD_FLOAT32_IEEE 999.9999 F_1_p0_2 0.0001 1000 /end CHARACTERISTIC
/begin CHARACTERISTIC FTCMCCS_M1qCtrlTrC "FTCMCCS_M1qCtrlTrC" VALUE 0x8005AF48 DATA_RECORD_FLOAT32_IEEE 999.9999 F_1_p0_2 0.0001 1000 /end CHARACTERISTIC
/begin CHARACTERISTIC FTCMCCS_PhimC "FTCMCCS_PhimC" VALUE 0x8005AF44 DATA_RECORD_FLOAT32_IEEE 3.402823466E+038 F_1_p0_2 -3.402823466E+038 3.402823466E+038 /end CHARACTERISTIC
/begin CHARACTERISTIC FTCMCCS_RsC "FTCMCCS_RsC" VALUE 0x8005AF40 DATA_RECORD_FLOAT32_IEEE 3.402823466E+038 F_1_p0_2 -3.402823466E+038 3.402823466E+038 /end CHARACTERISTIC
/begin CHARACTERISTIC FTCMCCS_SampleTimeFactC "FTCMCCS_SampleTimeFactC" VALUE 0x8005AF3C DATA_RECORD_FLOAT32_IEEE 3.402823466E+038 F_1_p0_2 -3.402823466E+038 3.402823466E+038 /end CHARACTERISTIC
/begin CHARACTERISTIC FTCMCCS_TransEmfM1dGainC "FTCMCCS_TransEmfM1dGainC" VALUE 0x8005AF38 DATA_RECORD_FLOAT32_IEEE 3.402823466E+038 F_1_p0_2 -3.402823466E+038 3.402823466E+038 /end CHARACTERISTIC
/begin CHARACTERISTIC FTCMCCS_TransEmfM1qGainC "FTCMCCS_TransEmfM1qGainC" VALUE 0x8005AF34 DATA_RECORD_FLOAT32_IEEE 3.402823466E+038 F_1_p0_2 -3.402823466E+038 3.402823466E+038 /end CHARACTERISTIC
/begin CHARACTERISTIC FTCMCCS_VariableLm1dOnOffC "FTCMCCS_VariableLm1dOnOffC" VALUE 0x8005AF30 DATA_RECORD_UBYTE 1 Bool_ON_OFF 0 1 BIT_MASK 0x01 /end CHARACTERISTIC
/begin CHARACTERISTIC FTCMCCS_VariableLm1qOnOffC "FTCMCCS_VariableLm1qOnOffC" VALUE 0x8005AF2C DATA_RECORD_UBYTE 1 Bool_ON_OFF 0 1 BIT_MASK 0x01 /end CHARACTERISTIC
/begin CHARACTERISTIC FTCMCCS_VariablePhimOnOffC "FTCMCCS_VariablePhimOnOffC" VALUE 0x8005AF28 DATA_RECORD_UBYTE 1 Bool_ON_OFF 0 1 BIT_MASK 0x01 /end CHARACTERISTIC
/begin CHARACTERISTIC FTCMCCS_iM1dTgtFildTr0C "FTCMCCS_iM1dTgtFildTr0C" VALUE 0x8005AF24 DATA_RECORD_FLOAT32_IEEE 0.9999 F_1_p0_2 0.0001 1 /end CHARACTERISTIC
/begin CHARACTERISTIC FTCMCCS_iM1dTgtFildTrC "FTCMCCS_iM1dTgtFildTrC" VALUE 0x8005AF20 DATA_RECORD_FLOAT32_IEEE 999.9999 F_1_p0_2 0.0001 1000 /end CHARACTERISTIC
/begin CHARACTERISTIC FTCMCCS_iM1qTgtFildTr0C "FTCMCCS_iM1qTgtFildTr0C" VALUE 0x8005AF1C DATA_RECORD_FLOAT32_IEEE 0.9999 F_1_p0_2 0.0001 1 /end CHARACTERISTIC
/begin CHARACTERISTIC FTCMCCS_iM1qTgtFildTrC "FTCMCCS_iM1qTgtFildTrC" VALUE 0x8005AF18 DATA_RECORD_FLOAT32_IEEE 999.9999 F_1_p0_2 0.0001 1000 /end CHARACTERISTIC
/begin CHARACTERISTIC FTCMCTC_CoggingCompGainC "FTCMCTC_CoggingCompGainC" VALUE 0x8005B518 DATA_RECORD_FLOAT32_IEEE 3.402823466E+038 F_1_p0_2 -3.402823466E+038 3.402823466E+038 /end CHARACTERISTIC
/begin CHARACTERISTIC FTCMCTC_CoggingCompOnOffC "FTCMCTC_CoggingCompOnOffC" VALUE 0x8005B514 DATA_RECORD_UBYTE 1 Bool_ON_OFF 0 1 BIT_MASK 0x01 /end CHARACTERISTIC
/begin CHARACTERISTIC FTCMCTC_CoggingPhaseRdC "FTCMCTC_CoggingPhaseRdC" VALUE 0x8005B510 DATA_RECORD_FLOAT32_IEEE 3.402823466E+038 F_1_p0_2 -3.402823466E+038 3.402823466E+038 /end CHARACTERISTIC
/begin CHARACTERISTIC FTCMCTC_H3CurrentOnOffC "FTCMCTC_H3CurrentOnOffC" VALUE 0x8005B50C DATA_RECORD_UBYTE 1 Bool_ON_OFF 0 1 BIT_MASK 0x01 /end CHARACTERISTIC
/begin CHARACTERISTIC FTCMCTC_H3CurrentRatioC "FTCMCTC_H3CurrentRatioC" VALUE 0x8005B508 DATA_RECORD_FLOAT32_IEEE 3.402823466E+038 F_1_p0_2 -3.402823466E+038 3.402823466E+038 /end CHARACTERISTIC
/begin CHARACTERISTIC FTCMCTC_LutCoggingCompGainC "FTCMCTC_LutCoggingCompGainC" CURVE 0x8005B4FC DATA_RECORD_FLOAT32_IEEE 3.402823466E+038 F_1_p0_2 -3.402823466E+038 3.402823466E+038
 /begin AXIS_DESCR FIX_AXIS NO_INPUT_QUANTITY Id_0x00 3 0 2 MAX_GRAD 100.0 FIX_AXIS_PAR_DIST 0 1 3 /end AXIS_DESCR
/end CHARACTERISTIC
/begin CHARACTERISTIC FTCMCTC_LutElecSpeedRds2C "FTCMCTC_LutElecSpeedRds2C" CURVE 0x8005B4F0 DATA_RECORD_FLOAT32_IEEE 3.402823466E+038 F_1_p0_2 -3.402823466E+038 3.402823466E+038
 /begin AXIS_DESCR FIX_AXIS NO_INPUT_QUANTITY Id_0x00 3 0 2 MAX_GRAD 100.0 FIX_AXIS_PAR_DIST 0 1 3 /end AXIS_DESCR
/end CHARACTERISTIC
/begin CHARACTERISTIC FTCMCTC_LutElecSpeedRdsC "FTCMCTC_LutElecSpeedRdsC" CURVE 0x8005B4E4 DATA_RECORD_FLOAT32_IEEE 3.402823466E+038 F_1_p0_2 -3.402823466E+038 3.402823466E+038
 /begin AXIS_DESCR FIX_AXIS NO_INPUT_QUANTITY Id_0x00 3 0 2 MAX_GRAD 100.0 FIX_AXIS_PAR_DIST 0 1 3 /end AXIS_DESCR
/end CHARACTERISTIC
/begin CHARACTERISTIC FTCMCTC_LutH3CompGainC "FTCMCTC_LutH3CompGainC" CURVE 0x8005B4D8 DATA_RECORD_FLOAT32_IEEE 3.402823466E+038 F_1_p0_2 -3.402823466E+038 3.402823466E+038
 /begin AXIS_DESCR FIX_AXIS NO_INPUT_QUANTITY Id_0x00 3 0 2 MAX_GRAD 100.0 FIX_AXIS_PAR_DIST 0 1 3 /end AXIS_DESCR
/end CHARACTERISTIC
/begin CHARACTERISTIC FTCMHIJ_11thIdCtrlTrC "FTCMHIJ_11thIdCtrlTrC" VALUE 0x8005C20C DATA_RECORD_FLOAT32_IEEE 3.402823466E+038 F_1_p0_2 -3.402823466E+038 3.402823466E+038 /end CHARACTERISTIC
/begin CHARACTERISTIC FTCMHIJ_11thIqCtrlTrC "FTCMHIJ_11thIqCtrlTrC" VALUE 0x8005C208 DATA_RECORD_FLOAT32_IEEE 3.402823466E+038 F_1_p0_2 -3.402823466E+038 3.402823466E+038 /end CHARACTERISTIC
/begin CHARACTERISTIC FTCMHIJ_11thMtrLdqCoeffC "FTCMHIJ_11thMtrLdqCoeffC" VALUE 0x8005C204 DATA_RECORD_FLOAT32_IEEE 3.402823466E+038 F_1_p0_2 -3.402823466E+038 3.402823466E+038 /end CHARACTERISTIC
/begin CHARACTERISTIC FTCMHIJ_11thSecLpfFrqThrC "FTCMHIJ_11thSecLpfFrqThrC" VALUE 0x8005C200 DATA_RECORD_FLOAT32_IEEE 3.402823466E+038 F_1_p0_2 -3.402823466E+038 3.402823466E+038 /end CHARACTERISTIC
/begin CHARACTERISTIC FTCMHIJ_11thUsLimtC "FTCMHIJ_11thUsLimtC" VALUE 0x8005C1FC DATA_RECORD_FLOAT32_IEEE 3.402823466E+038 F_1_p0_2 -3.402823466E+038 3.402823466E+038 /end CHARACTERISTIC
/begin CHARACTERISTIC FTCMHIJ_13thIdCtrlTrC "FTCMHIJ_13thIdCtrlTrC" VALUE 0x8005C1F8 DATA_RECORD_FLOAT32_IEEE 3.402823466E+038 F_1_p0_2 -3.402823466E+038 3.402823466E+038 /end CHARACTERISTIC
/begin CHARACTERISTIC FTCMHIJ_13thMtrLdqCoeffC "FTCMHIJ_13thMtrLdqCoeffC" VALUE 0x8005C1F4 DATA_RECORD_FLOAT32_IEEE 3.402823466E+038 F_1_p0_2 -3.402823466E+038 3.402823466E+038 /end CHARACTERISTIC
/begin CHARACTERISTIC FTCMHIJ_13thUsLimtC "FTCMHIJ_13thUsLimtC" VALUE 0x8005C1F0 DATA_RECORD_FLOAT32_IEEE 3.402823466E+038 F_1_p0_2 -3.402823466E+038 3.402823466E+038 /end CHARACTERISTIC
/begin CHARACTERISTIC FTCMHIJ_3rdSecLpfFrqThrC "FTCMHIJ_3rdSecLpfFrqThrC" VALUE 0x8005C1EC DATA_RECORD_FLOAT32_IEEE 3.402823466E+038 F_1_p0_2 -3.402823466E+038 3.402823466E+038 /end CHARACTERISTIC
/begin CHARACTERISTIC FTCMHIJ_48thLutInSpeedC "FTCMHIJ_48thLutInSpeedC" CURVE 0x8005C1BC DATA_RECORD_FLOAT32_IEEE 3.402823466E+038 F_1_p0_2 -3.402823466E+038 3.402823466E+038
 /begin AXIS_DESCR FIX_AXIS NO_INPUT_QUANTITY Id_0x00 12 0 11 MAX_GRAD 100.0 FIX_AXIS_PAR_DIST 0 1 12 /end AXIS_DESCR
/end CHARACTERISTIC
/begin CHARACTERISTIC FTCMHIJ_48thLutInTorqueGenC "FTCMHIJ_48thLutInTorqueGenC" CURVE 0x8005C1A4 DATA_RECORD_FLOAT32_IEEE 3.402823466E+038 F_1_p0_2 -3.402823466E+038 3.402823466E+038
 /begin AXIS_DESCR FIX_AXIS NO_INPUT_QUANTITY Id_0x00 6 0 5 MAX_GRAD 100.0 FIX_AXIS_PAR_DIST 0 1 6 /end AXIS_DESCR
/end CHARACTERISTIC
/begin CHARACTERISTIC FTCMHIJ_48thLutInTorqueMotC "FTCMHIJ_48thLutInTorqueMotC" CURVE 0x8005C18C DATA_RECORD_FLOAT32_IEEE 3.402823466E+038 F_1_p0_2 -3.402823466E+038 3.402823466E+038
 /begin AXIS_DESCR FIX_AXIS NO_INPUT_QUANTITY Id_0x00 6 0 5 MAX_GRAD 100.0 FIX_AXIS_PAR_DIST 0 1 6 /end AXIS_DESCR
/end CHARACTERISTIC
/begin CHARACTERISTIC FTCMHIJ_5thIdCtrlTrC "FTCMHIJ_5thIdCtrlTrC" VALUE 0x8005C188 DATA_RECORD_FLOAT32_IEEE 3.402823466E+038 F_1_p0_2 -3.402823466E+038 3.402823466E+038 /end CHARACTERISTIC
/begin CHARACTERISTIC FTCMHIJ_5thIqCtrlTrC "FTCMHIJ_5thIqCtrlTrC" VALUE 0x8005C184 DATA_RECORD_FLOAT32_IEEE 3.402823466E+038 F_1_p0_2 -3.402823466E+038 3.402823466E+038 /end CHARACTERISTIC
/begin CHARACTERISTIC FTCMHIJ_5thMtrLdCoeffC "FTCMHIJ_5thMtrLdCoeffC" VALUE 0x8005C180 DATA_RECORD_FLOAT32_IEEE 3.402823466E+038 F_1_p0_2 -3.402823466E+038 3.402823466E+038 /end CHARACTERISTIC
/begin CHARACTERISTIC FTCMHIJ_5thMtrLqCoeffC "FTCMHIJ_5thMtrLqCoeffC" VALUE 0x8005C17C DATA_RECORD_FLOAT32_IEEE 3.402823466E+038 F_1_p0_2 -3.402823466E+038 3.402823466E+038 /end CHARACTERISTIC
/begin CHARACTERISTIC FTCMHIJ_5thMtrRsCoeffC "FTCMHIJ_5thMtrRsCoeffC" VALUE 0x8005C178 DATA_RECORD_FLOAT32_IEEE 3.402823466E+038 F_1_p0_2 -3.402823466E+038 3.402823466E+038 /end CHARACTERISTIC
/begin CHARACTERISTIC FTCMHIJ_5thSecLpfFrqThrC "FTCMHIJ_5thSecLpfFrqThrC" VALUE 0x8005C174 DATA_RECORD_FLOAT32_IEEE 3.402823466E+038 F_1_p0_2 -3.402823466E+038 3.402823466E+038 /end CHARACTERISTIC
/begin CHARACTERISTIC FTCMHIJ_5thUsLimtC "FTCMHIJ_5thUsLimtC" VALUE 0x8005C170 DATA_RECORD_FLOAT32_IEEE 3.402823466E+038 F_1_p0_2 -3.402823466E+038 3.402823466E+038 /end CHARACTERISTIC
/begin CHARACTERISTIC FTCMHIJ_7thIdCtrlTrC "FTCMHIJ_7thIdCtrlTrC" VALUE 0x8005C16C DATA_RECORD_FLOAT32_IEEE 3.402823466E+038 F_1_p0_2 -3.402823466E+038 3.402823466E+038 /end CHARACTERISTIC
/begin CHARACTERISTIC FTCMHIJ_7thIqCtrlTrC "FTCMHIJ_7thIqCtrlTrC" VALUE 0x8005C168 DATA_RECORD_FLOAT32_IEEE 3.402823466E+038 F_1_p0_2 -3.402823466E+038 3.402823466E+038 /end CHARACTERISTIC
/begin CHARACTERISTIC FTCMHIJ_7thMtrLdCoeffC "FTCMHIJ_7thMtrLdCoeffC" VALUE 0x8005C164 DATA_RECORD_FLOAT32_IEEE 3.402823466E+038 F_1_p0_2 -3.402823466E+038 3.402823466E+038 /end CHARACTERISTIC
/begin CHARACTERISTIC FTCMHIJ_7thMtrLqCoeffC "FTCMHIJ_7thMtrLqCoeffC" VALUE 0x8005C160 DATA_RECORD_FLOAT32_IEEE 3.402823466E+038 F_1_p0_2 -3.402823466E+038 3.402823466E+038 /end CHARACTERISTIC
/begin CHARACTERISTIC FTCMHIJ_7thMtrRsCoeffC "FTCMHIJ_7thMtrRsCoeffC" VALUE 0x8005C15C DATA_RECORD_FLOAT32_IEEE 3.402823466E+038 F_1_p0_2 -3.402823466E+038 3.402823466E+038 /end CHARACTERISTIC
/begin CHARACTERISTIC FTCMHIJ_7thSecLpfFrqThrC "FTCMHIJ_7thSecLpfFrqThrC" VALUE 0x8005C158 DATA_RECORD_FLOAT32_IEEE 3.402823466E+038 F_1_p0_2 -3.402823466E+038 3.402823466E+038 /end CHARACTERISTIC
/begin CHARACTERISTIC FTCMHIJ_7thUsLimtC "FTCMHIJ_7thUsLimtC" VALUE 0x8005C154 DATA_RECORD_FLOAT32_IEEE 3.402823466E+038 F_1_p0_2 -3.402823466E+038 3.402823466E+038 /end CHARACTERISTIC
/begin CHARACTERISTIC FTCMHIJ_HijCurTgtLpfFcC "FTCMHIJ_HijCurTgtLpfFcC" VALUE 0x8005C150 DATA_RECORD_FLOAT32_IEEE 3.402823466E+038 F_1_p0_2 -3.402823466E+038 3.402823466E+038 /end CHARACTERISTIC
/begin CHARACTERISTIC FTCMHIJ_HijCurrentOnOffC "FTCMHIJ_HijCurrentOnOffC" VALUE 0x8005C14C DATA_RECORD_UBYTE 1 Bool_ON_OFF 0 1 BIT_MASK 0x01 /end CHARACTERISTIC
/begin CHARACTERISTIC FTCMHIJ_Hmc11OrderGainC "FTCMHIJ_Hmc11OrderGainC" VALUE 0x8005C148 DATA_RECORD_FLOAT32_IEEE 3.402823466E+038 F_1_p0_2 -3.402823466E+038 3.402823466E+038 /end CHARACTERISTIC
/begin CHARACTERISTIC FTCMHIJ_Hmc13OrderGainC "FTCMHIJ_Hmc13OrderGainC" VALUE 0x8005C144 DATA_RECORD_FLOAT32_IEEE 3.402823466E+038 F_1_p0_2 -3.402823466E+038 3.402823466E+038 /end CHARACTERISTIC
/begin CHARACTERISTIC FTCMHIJ_Hmc5OrderGainC "FTCMHIJ_Hmc5OrderGainC" VALUE 0x8005C140 DATA_RECORD_FLOAT32_IEEE 3.402823466E+038 F_1_p0_2 -3.402823466E+038 3.402823466E+038 /end CHARACTERISTIC
/begin CHARACTERISTIC FTCMHIJ_Hmc7OrderGainC "FTCMHIJ_Hmc7OrderGainC" VALUE 0x8005C13C DATA_RECORD_FLOAT32_IEEE 3.402823466E+038 F_1_p0_2 -3.402823466E+038 3.402823466E+038 /end CHARACTERISTIC
/begin CHARACTERISTIC FTCMHIJ_LpfDampCoeffC "FTCMHIJ_LpfDampCoeffC" VALUE 0x8005C138 DATA_RECORD_FLOAT32_IEEE 3.402823466E+038 F_1_p0_2 -3.402823466E+038 3.402823466E+038 /end CHARACTERISTIC
/begin CHARACTERISTIC FTCMHIJ_LutInSpeedC "FTCMHIJ_LutInSpeedC" CURVE 0x8005C118 DATA_RECORD_FLOAT32_IEEE 3.402823466E+038 F_1_p0_2 -3.402823466E+038 3.402823466E+038
 /begin AXIS_DESCR FIX_AXIS NO_INPUT_QUANTITY Id_0x00 8 0 7 MAX_GRAD 100.0 FIX_AXIS_PAR_DIST 0 1 8 /end AXIS_DESCR
/end CHARACTERISTIC
/begin CHARACTERISTIC FTCMHIJ_LutInTorqueC "FTCMHIJ_LutInTorqueC" CURVE 0x8005C104 DATA_RECORD_FLOAT32_IEEE 3.402823466E+038 F_1_p0_2 -3.402823466E+038 3.402823466E+038
 /begin AXIS_DESCR FIX_AXIS NO_INPUT_QUANTITY Id_0x00 5 0 4 MAX_GRAD 100.0 FIX_AXIS_PAR_DIST 0 1 5 /end AXIS_DESCR
/end CHARACTERISTIC
/begin CHARACTERISTIC FTCMHIJ_LutOut11thIdTgtGenC "FTCMHIJ_LutOut11thIdTgtGenC" MAP 0x8005BFE4 DATA_RECORD_FLOAT32_IEEE 3.402823466E+038 F_1_p0_2 -3.402823466E+038 3.402823466E+038
 /begin AXIS_DESCR FIX_AXIS NO_INPUT_QUANTITY Id_0x00 6 0 5 MAX_GRAD 100.0 FIX_AXIS_PAR_DIST 0 1 6 /end AXIS_DESCR
 /begin AXIS_DESCR FIX_AXIS NO_INPUT_QUANTITY Id_0x00 12 0 11 MAX_GRAD 100.0 FIX_AXIS_PAR_DIST 0 1 12 /end AXIS_DESCR
/end CHARACTERISTIC
/begin CHARACTERISTIC FTCMHIJ_LutOut11thIdTgtMotC "FTCMHIJ_LutOut11thIdTgtMotC" MAP 0x8005BEC4 DATA_RECORD_FLOAT32_IEEE 3.402823466E+038 F_1_p0_2 -3.402823466E+038 3.402823466E+038
 /begin AXIS_DESCR FIX_AXIS NO_INPUT_QUANTITY Id_0x00 6 0 5 MAX_GRAD 100.0 FIX_AXIS_PAR_DIST 0 1 6 /end AXIS_DESCR
 /begin AXIS_DESCR FIX_AXIS NO_INPUT_QUANTITY Id_0x00 12 0 11 MAX_GRAD 100.0 FIX_AXIS_PAR_DIST 0 1 12 /end AXIS_DESCR
/end CHARACTERISTIC
/begin CHARACTERISTIC FTCMHIJ_LutOut11thIqTgtGenC "FTCMHIJ_LutOut11thIqTgtGenC" MAP 0x8005BDA4 DATA_RECORD_FLOAT32_IEEE 3.402823466E+038 F_1_p0_2 -3.402823466E+038 3.402823466E+038
 /begin AXIS_DESCR FIX_AXIS NO_INPUT_QUANTITY Id_0x00 6 0 5 MAX_GRAD 100.0 FIX_AXIS_PAR_DIST 0 1 6 /end AXIS_DESCR
 /begin AXIS_DESCR FIX_AXIS NO_INPUT_QUANTITY Id_0x00 12 0 11 MAX_GRAD 100.0 FIX_AXIS_PAR_DIST 0 1 12 /end AXIS_DESCR
/end CHARACTERISTIC
/begin CHARACTERISTIC FTCMHIJ_LutOut11thIqTgtMotC "FTCMHIJ_LutOut11thIqTgtMotC" MAP 0x8005BC84 DATA_RECORD_FLOAT32_IEEE 3.402823466E+038 F_1_p0_2 -3.402823466E+038 3.402823466E+038
 /begin AXIS_DESCR FIX_AXIS NO_INPUT_QUANTITY Id_0x00 6 0 5 MAX_GRAD 100.0 FIX_AXIS_PAR_DIST 0 1 6 /end AXIS_DESCR
 /begin AXIS_DESCR FIX_AXIS NO_INPUT_QUANTITY Id_0x00 12 0 11 MAX_GRAD 100.0 FIX_AXIS_PAR_DIST 0 1 12 /end AXIS_DESCR
/end CHARACTERISTIC
/begin CHARACTERISTIC FTCMHIJ_LutOut13thIdTgtGenC "FTCMHIJ_LutOut13thIdTgtGenC" MAP 0x8005BB64 DATA_RECORD_FLOAT32_IEEE 3.402823466E+038 F_1_p0_2 -3.402823466E+038 3.402823466E+038
 /begin AXIS_DESCR FIX_AXIS NO_INPUT_QUANTITY Id_0x00 6 0 5 MAX_GRAD 100.0 FIX_AXIS_PAR_DIST 0 1 6 /end AXIS_DESCR
 /begin AXIS_DESCR FIX_AXIS NO_INPUT_QUANTITY Id_0x00 12 0 11 MAX_GRAD 100.0 FIX_AXIS_PAR_DIST 0 1 12 /end AXIS_DESCR
/end CHARACTERISTIC
/begin CHARACTERISTIC FTCMHIJ_LutOut13thIdTgtMotC "FTCMHIJ_LutOut13thIdTgtMotC" MAP 0x8005BA44 DATA_RECORD_FLOAT32_IEEE 3.402823466E+038 F_1_p0_2 -3.402823466E+038 3.402823466E+038
 /begin AXIS_DESCR FIX_AXIS NO_INPUT_QUANTITY Id_0x00 6 0 5 MAX_GRAD 100.0 FIX_AXIS_PAR_DIST 0 1 6 /end AXIS_DESCR
 /begin AXIS_DESCR FIX_AXIS NO_INPUT_QUANTITY Id_0x00 12 0 11 MAX_GRAD 100.0 FIX_AXIS_PAR_DIST 0 1 12 /end AXIS_DESCR
/end CHARACTERISTIC
/begin CHARACTERISTIC FTCMHIJ_LutOut13thIqTgtGenC "FTCMHIJ_LutOut13thIqTgtGenC" MAP 0x8005B924 DATA_RECORD_FLOAT32_IEEE 3.402823466E+038 F_1_p0_2 -3.402823466E+038 3.402823466E+038
 /begin AXIS_DESCR FIX_AXIS NO_INPUT_QUANTITY Id_0x00 6 0 5 MAX_GRAD 100.0 FIX_AXIS_PAR_DIST 0 1 6 /end AXIS_DESCR
 /begin AXIS_DESCR FIX_AXIS NO_INPUT_QUANTITY Id_0x00 12 0 11 MAX_GRAD 100.0 FIX_AXIS_PAR_DIST 0 1 12 /end AXIS_DESCR
/end CHARACTERISTIC
/begin CHARACTERISTIC FTCMHIJ_LutOut13thIqTgtMotC "FTCMHIJ_LutOut13thIqTgtMotC" MAP 0x8005B804 DATA_RECORD_FLOAT32_IEEE 3.402823466E+038 F_1_p0_2 -3.402823466E+038 3.402823466E+038
 /begin AXIS_DESCR FIX_AXIS NO_INPUT_QUANTITY Id_0x00 6 0 5 MAX_GRAD 100.0 FIX_AXIS_PAR_DIST 0 1 6 /end AXIS_DESCR
 /begin AXIS_DESCR FIX_AXIS NO_INPUT_QUANTITY Id_0x00 12 0 11 MAX_GRAD 100.0 FIX_AXIS_PAR_DIST 0 1 12 /end AXIS_DESCR
/end CHARACTERISTIC
/begin CHARACTERISTIC FTCMHIJ_LutOut5thIdTgtC "FTCMHIJ_LutOut5thIdTgtC" MAP 0x8005B764 DATA_RECORD_FLOAT32_IEEE 3.402823466E+038 F_1_p0_2 -3.402823466E+038 3.402823466E+038
 /begin AXIS_DESCR FIX_AXIS NO_INPUT_QUANTITY Id_0x00 5 0 4 MAX_GRAD 100.0 FIX_AXIS_PAR_DIST 0 1 5 /end AXIS_DESCR
 /begin AXIS_DESCR FIX_AXIS NO_INPUT_QUANTITY Id_0x00 8 0 7 MAX_GRAD 100.0 FIX_AXIS_PAR_DIST 0 1 8 /end AXIS_DESCR
/end CHARACTERISTIC
/begin CHARACTERISTIC FTCMHIJ_LutOut5thIqTgtC "FTCMHIJ_LutOut5thIqTgtC" MAP 0x8005B6C4 DATA_RECORD_FLOAT32_IEEE 3.402823466E+038 F_1_p0_2 -3.402823466E+038 3.402823466E+038
 /begin AXIS_DESCR FIX_AXIS NO_INPUT_QUANTITY Id_0x00 5 0 4 MAX_GRAD 100.0 FIX_AXIS_PAR_DIST 0 1 5 /end AXIS_DESCR
 /begin AXIS_DESCR FIX_AXIS NO_INPUT_QUANTITY Id_0x00 8 0 7 MAX_GRAD 100.0 FIX_AXIS_PAR_DIST 0 1 8 /end AXIS_DESCR
/end CHARACTERISTIC
/begin CHARACTERISTIC FTCMHIJ_LutOut7thIdTgtC "FTCMHIJ_LutOut7thIdTgtC" MAP 0x8005B624 DATA_RECORD_FLOAT32_IEEE 3.402823466E+038 F_1_p0_2 -3.402823466E+038 3.402823466E+038
 /begin AXIS_DESCR FIX_AXIS NO_INPUT_QUANTITY Id_0x00 5 0 4 MAX_GRAD 100.0 FIX_AXIS_PAR_DIST 0 1 5 /end AXIS_DESCR
 /begin AXIS_DESCR FIX_AXIS NO_INPUT_QUANTITY Id_0x00 8 0 7 MAX_GRAD 100.0 FIX_AXIS_PAR_DIST 0 1 8 /end AXIS_DESCR
/end CHARACTERISTIC
/begin CHARACTERISTIC FTCMHIJ_LutOut7thIqTgtC "FTCMHIJ_LutOut7thIqTgtC" MAP 0x8005B584 DATA_RECORD_FLOAT32_IEEE 3.402823466E+038 F_1_p0_2 -3.402823466E+038 3.402823466E+038
 /begin AXIS_DESCR FIX_AXIS NO_INPUT_QUANTITY Id_0x00 5 0 4 MAX_GRAD 100.0 FIX_AXIS_PAR_DIST 0 1 5 /end AXIS_DESCR
 /begin AXIS_DESCR FIX_AXIS NO_INPUT_QUANTITY Id_0x00 8 0 7 MAX_GRAD 100.0 FIX_AXIS_PAR_DIST 0 1 8 /end AXIS_DESCR
/end CHARACTERISTIC
/begin CHARACTERISTIC FTCMHIJ_ThetaCompFactInvC "FTCMHIJ_ThetaCompFactInvC" VALUE 0x8005B580 DATA_RECORD_FLOAT32_IEEE 3.402823466E+038 F_1_p0_2 -3.402823466E+038 3.402823466E+038 /end CHARACTERISTIC
/begin CHARACTERISTIC FTCMHIJ_b11thHijEnC "FTCMHIJ_b11thHijEnC" VALUE 0x8005B57C DATA_RECORD_UBYTE 1 Bool_ON_OFF 0 1 BIT_MASK 0x01 /end CHARACTERISTIC
/begin CHARACTERISTIC FTCMHIJ_b13thHijEnC "FTCMHIJ_b13thHijEnC" VALUE 0x8005B578 DATA_RECORD_UBYTE 1 Bool_ON_OFF 0 1 BIT_MASK 0x01 /end CHARACTERISTIC
/begin CHARACTERISTIC FTCMHIJ_b5thHijEnC "FTCMHIJ_b5thHijEnC" VALUE 0x8005B574 DATA_RECORD_UBYTE 1 Bool_ON_OFF 0 1 BIT_MASK 0x01 /end CHARACTERISTIC
/begin CHARACTERISTIC FTCMHIJ_b7thHijEnC "FTCMHIJ_b7thHijEnC" VALUE 0x8005B570 DATA_RECORD_UBYTE 1 Bool_ON_OFF 0 1 BIT_MASK 0x01 /end CHARACTERISTIC
/begin CHARACTERISTIC FTCMHIJ_bHijUoutActiveC "FTCMHIJ_bHijUoutActiveC" VALUE 0x8005B56C DATA_RECORD_UBYTE 1 Bool_ON_OFF 0 1 BIT_MASK 0x01 /end CHARACTERISTIC
/begin CHARACTERISTIC FTCMRPC_ConcordiaTrans33C "concordia transformation matrix" MAP 0x8005C210 DATA_RECORD_FLOAT32_IEEE 3.402823466E+038 F_1_p0_2 -3.402823466E+038 3.402823466E+038
 /begin AXIS_DESCR FIX_AXIS NO_INPUT_QUANTITY Id_0x00 3 0 2 MAX_GRAD 100.0 FIX_AXIS_PAR_DIST 0 1 3 /end AXIS_DESCR
 /begin AXIS_DESCR FIX_AXIS NO_INPUT_QUANTITY Id_0x00 3 0 2 MAX_GRAD 100.0 FIX_AXIS_PAR_DIST 0 1 3 /end AXIS_DESCR
/end CHARACTERISTIC
/begin CHARACTERISTIC FTCMSCS_CtrlSatToC "FTCMSCS_CtrlSatToC" VALUE 0x8005C254 DATA_RECORD_SWORD 65535 F_1_p0_2 -32768 32767 /end CHARACTERISTIC
/begin CHARACTERISTIC FTCMSCS_CtrlTrC "FTCMSCS_CtrlTrC" VALUE 0x8005C250 DATA_RECORD_FLOAT32_IEEE 3.402823466E+038 F_1_p0_2 -3.402823466E+038 3.402823466E+038 /end CHARACTERISTIC
/begin CHARACTERISTIC FTCMSCS_InitalValueEnC "FTCMSCS_InitalValueEnC" VALUE 0x8005C24C DATA_RECORD_UBYTE 1 Bool_ON_OFF 0 1 BIT_MASK 0x01 /end CHARACTERISTIC
/begin CHARACTERISTIC FTCMSCS_SpdAccPerMsThrC "FTCMSCS_SpdAccPerMsThrC" VALUE 0x8005C248 DATA_RECORD_FLOAT32_IEEE 3.402823466E+038 F_1_p0_2 -3.402823466E+038 3.402823466E+038 /end CHARACTERISTIC
/begin CHARACTERISTIC FTCMSCS_SpdOvershootFaultC "FTCMSCS_SpdOvershootFaultC" VALUE 0x8005C244 DATA_RECORD_SWORD 65535 F_1_p0_2 -32768 32767 /end CHARACTERISTIC
/begin CHARACTERISTIC FTCMSCS_ZeroSpdThrC "FTCMSCS_ZeroSpdThrC" VALUE 0x8005C240 DATA_RECORD_FLOAT32_IEEE 3.402823466E+038 F_1_p0_2 -3.402823466E+038 3.402823466E+038 /end CHARACTERISTIC
/begin CHARACTERISTIC FTCMSCS_ZeroSpdTimoutC "FTCMSCS_ZeroSpdTimoutC" VALUE 0x8005C23C DATA_RECORD_SWORD 65535 F_1_p0_2 -32768 32767 /end CHARACTERISTIC
/begin CHARACTERISTIC FTCMSCS_fC "FTCMSCS_fC" VALUE 0x8005C238 DATA_RECORD_FLOAT32_IEEE 3.402823466E+038 F_1_p0_2 -3.402823466E+038 3.402823466E+038 /end CHARACTERISTIC
/begin CHARACTERISTIC FTCMSCS_jC "FTCMSCS_jC" VALUE 0x8005C234 DATA_RECORD_FLOAT32_IEEE 3.402823466E+038 F_1_p0_2 -3.402823466E+038 3.402823466E+038 /end CHARACTERISTIC
/begin CHARACTERISTIC FTCMSTC_AccelNegRpmBySecondC "target max acceleration toward negative infinity" VALUE 0x8005C25C DATA_RECORD_FLOAT32_IEEE 3.402823466E+038 F_1_p0_2 -3.402823466E+038 3.402823466E+038 /end CHARACTERISTIC
/begin CHARACTERISTIC FTCMSTC_AccelPosRpmBySecondC "target max acceleration toward positive infinity" VALUE 0x8005C258 DATA_RECORD_FLOAT32_IEEE 3.402823466E+038 F_1_p0_2 -3.402823466E+038 3.402823466E+038 /end CHARACTERISTIC
/begin CHARACTERISTIC FTCMTCS_AccelPosRpmBySecondC "FTCMTCS_AccelPosRpmBySecondC" VALUE 0x8005CB64 DATA_RECORD_FLOAT32_IEEE 3.402823466E+038 F_1_p0_2 -3.402823466E+038 3.402823466E+038 /end CHARACTERISTIC
/begin CHARACTERISTIC FTCMTCS_AntiSlideEnaCountMaxC "FTCMTCS_AntiSlideEnaCountMaxC" VALUE 0x8005CB60 DATA_RECORD_SLONG 4294967295 F_1_p0_2 -2147483648 2147483647 /end CHARACTERISTIC
/begin CHARACTERISTIC FTCMTCS_AntiSlideEnableC "FTCMTCS_AntiSlideEnableC" VALUE 0x8005CB5C DATA_RECORD_UBYTE 1 Bool_ON_OFF 0 1 BIT_MASK 0x01 /end CHARACTERISTIC
/begin CHARACTERISTIC FTCMTCS_AntiSlideLutInGenMecaSpdC "FTCMTCS_AntiSlideLutInGenMecaSpdC" CURVE 0x8005CB50 DATA_RECORD_FLOAT32_IEEE 3.402823466E+038 F_1_p0_2 -3.402823466E+038 3.402823466E+038
 /begin AXIS_DESCR FIX_AXIS NO_INPUT_QUANTITY Id_0x00 3 0 2 MAX_GRAD 100.0 FIX_AXIS_PAR_DIST 0 1 3 /end AXIS_DESCR
/end CHARACTERISTIC
/begin CHARACTERISTIC FTCMTCS_AntiSlideLutInMecaSpdC "FTCMTCS_AntiSlideLutInMecaSpdC" CURVE 0x8005CB44 DATA_RECORD_FLOAT32_IEEE 3.402823466E+038 F_1_p0_2 -3.402823466E+038 3.402823466E+038
 /begin AXIS_DESCR FIX_AXIS NO_INPUT_QUANTITY Id_0x00 3 0 2 MAX_GRAD 100.0 FIX_AXIS_PAR_DIST 0 1 3 /end AXIS_DESCR
/end CHARACTERISTIC
/begin CHARACTERISTIC FTCMTCS_BenchElecPowerMaxC "FTCMTCS_BenchElecPowerMaxC" VALUE 0x8005CB40 DATA_RECORD_FLOAT32_IEEE 3.402823466E+038 F_1_p0_2 -3.402823466E+038 3.402823466E+038 /end CHARACTERISTIC
/begin CHARACTERISTIC FTCMTCS_BenchElecTorqueMaxC "FTCMTCS_BenchElecTorqueMaxC" VALUE 0x8005CB3C DATA_RECORD_FLOAT32_IEEE 3.402823466E+038 F_1_p0_2 -3.402823466E+038 3.402823466E+038 /end CHARACTERISTIC
/begin CHARACTERISTIC FTCMTCS_CutOffFreqSlideDisEnC "FTCMTCS_CutOffFreqSlideDisEnC" VALUE 0x8005CB38 DATA_RECORD_FLOAT32_IEEE 3.402823466E+038 F_1_p0_2 -3.402823466E+038 3.402823466E+038 /end CHARACTERISTIC
/begin CHARACTERISTIC FTCMTCS_CutOffFreqSlideEnC "FTCMTCS_CutOffFreqSlideEnC" VALUE 0x8005CB34 DATA_RECORD_FLOAT32_IEEE 3.402823466E+038 F_1_p0_2 -3.402823466E+038 3.402823466E+038 /end CHARACTERISTIC
/begin CHARACTERISTIC FTCMTCS_CutOffFrequencySpdRpmC "FTCMTCS_CutOffFrequencySpdRpmC" VALUE 0x8005CB30 DATA_RECORD_FLOAT32_IEEE 3.402823466E+038 F_1_p0_2 -3.402823466E+038 3.402823466E+038 /end CHARACTERISTIC
/begin CHARACTERISTIC FTCMTCS_DivideTorqMinC "FTCMTCS_DivideTorqMinC" VALUE 0x8005CB2C DATA_RECORD_FLOAT32_IEEE 3.402823466E+038 F_1_p0_2 -3.402823466E+038 3.402823466E+038 /end CHARACTERISTIC
/begin CHARACTERISTIC FTCMTCS_EntrySlideCountMaxC "FTCMTCS_EntrySlideCountMaxC" VALUE 0x8005CB28 DATA_RECORD_SLONG 4294967295 F_1_p0_2 -2147483648 2147483647 /end CHARACTERISTIC
/begin CHARACTERISTIC FTCMTCS_ExtTorqueMaxMinC "FTCMTCS_ExtTorqueMaxMinC" CURVE 0x8005CB20 DATA_RECORD_FLOAT32_IEEE 3.402823466E+038 F_1_p0_2 -3.402823466E+038 3.402823466E+038
 /begin AXIS_DESCR FIX_AXIS NO_INPUT_QUANTITY Id_0x00 2 0 1 MAX_GRAD 100.0 FIX_AXIS_PAR_DIST 0 1 2 /end AXIS_DESCR
/end CHARACTERISTIC
/begin CHARACTERISTIC FTCMTCS_FluxControllerGainC "FTCMTCS_FluxControllerGainC" VALUE 0x8005CB1C DATA_RECORD_FLOAT32_IEEE 3.402823466E+038 F_1_p0_2 -3.402823466E+038 3.402823466E+038 /end CHARACTERISTIC
/begin CHARACTERISTIC FTCMTCS_FluxControllerGainKiC "FTCMTCS_FluxControllerGainKiC" VALUE 0x8005CB18 DATA_RECORD_FLOAT32_IEEE 3.402823466E+038 F_1_p0_2 -3.402823466E+038 3.402823466E+038 /end CHARACTERISTIC
/begin CHARACTERISTIC FTCMTCS_FluxControllerGainKpC "FTCMTCS_FluxControllerGainKpC" VALUE 0x8005CB14 DATA_RECORD_FLOAT32_IEEE 3.402823466E+038 F_1_p0_2 -3.402823466E+038 3.402823466E+038 /end CHARACTERISTIC
/begin CHARACTERISTIC FTCMTCS_GainPhaseVoltagePeakC "FTCMTCS_GainPhaseVoltagePeakC" VALUE 0x8005CB10 DATA_RECORD_FLOAT32_IEEE 3.402823466E+038 F_1_p0_2 -3.402823466E+038 3.402823466E+038 /end CHARACTERISTIC
/begin CHARACTERISTIC FTCMTCS_GenTableTorqueThrdC "FTCMTCS_GenTableTorqueThrdC" VALUE 0x8005CB0C DATA_RECORD_FLOAT32_IEEE 3.402823466E+038 F_1_p0_2 -3.402823466E+038 3.402823466E+038 /end CHARACTERISTIC
/begin CHARACTERISTIC FTCMTCS_IdModeOnOffC "FTCMTCS_IdModeOnOffC" VALUE 0x8005CB08 DATA_RECORD_UBYTE 1 Bool_ON_OFF 0 1 BIT_MASK 0x01 /end CHARACTERISTIC
/begin CHARACTERISTIC FTCMTCS_IdentificationAngleDegC "FTCMTCS_IdentificationAngleDegC" VALUE 0x8005CB04 DATA_RECORD_FLOAT32_IEEE 3.402823466E+038 F_1_p0_2 -3.402823466E+038 3.402823466E+038 /end CHARACTERISTIC
/begin CHARACTERISTIC FTCMTCS_IdentificationIsTgtC "FTCMTCS_IdentificationIsTgtC" VALUE 0x8005CB00 DATA_RECORD_FLOAT32_IEEE 3.402823466E+038 F_1_p0_2 -3.402823466E+038 3.402823466E+038 /end CHARACTERISTIC
/begin CHARACTERISTIC FTCMTCS_InitTorqueMaxMinC "FTCMTCS_InitTorqueMaxMinC" CURVE 0x8005CAF8 DATA_RECORD_FLOAT32_IEEE 3.402823466E+038 F_1_p0_2 -3.402823466E+038 3.402823466E+038
 /begin AXIS_DESCR FIX_AXIS NO_INPUT_QUANTITY Id_0x00 2 0 1 MAX_GRAD 100.0 FIX_AXIS_PAR_DIST 0 1 2 /end AXIS_DESCR
/end CHARACTERISTIC
/begin CHARACTERISTIC FTCMTCS_Initi0dqTgt3C "FTCMTCS_Initi0dqTgt3C" CURVE 0x8005CAEC DATA_RECORD_FLOAT32_IEEE 3.402823466E+038 F_1_p0_2 -3.402823466E+038 3.402823466E+038
 /begin AXIS_DESCR FIX_AXIS NO_INPUT_QUANTITY Id_0x00 3 0 2 MAX_GRAD 100.0 FIX_AXIS_PAR_DIST 0 1 3 /end AXIS_DESCR
/end CHARACTERISTIC
/begin CHARACTERISTIC FTCMTCS_LowerAccPosRpmBySecondC "FTCMTCS_LowerAccPosRpmBySecondC" VALUE 0x8005CAE8 DATA_RECORD_FLOAT32_IEEE 3.402823466E+038 F_1_p0_2 -3.402823466E+038 3.402823466E+038 /end CHARACTERISTIC
/begin CHARACTERISTIC FTCMTCS_LutAntiSlideGenTrqThrC "FTCMTCS_LutAntiSlideGenTrqThrC" CURVE 0x8005CADC DATA_RECORD_FLOAT32_IEEE 3.402823466E+038 F_1_p0_2 -3.402823466E+038 3.402823466E+038
 /begin AXIS_DESCR FIX_AXIS NO_INPUT_QUANTITY Id_0x00 3 0 2 MAX_GRAD 100.0 FIX_AXIS_PAR_DIST 0 1 3 /end AXIS_DESCR
/end CHARACTERISTIC
/begin CHARACTERISTIC FTCMTCS_LutAntiSlideTorqueThrC "FTCMTCS_LutAntiSlideTorqueThrC" CURVE 0x8005CAD0 DATA_RECORD_FLOAT32_IEEE 3.402823466E+038 F_1_p0_2 -3.402823466E+038 3.402823466E+038
 /begin AXIS_DESCR FIX_AXIS NO_INPUT_QUANTITY Id_0x00 3 0 2 MAX_GRAD 100.0 FIX_AXIS_PAR_DIST 0 1 3 /end AXIS_DESCR
/end CHARACTERISTIC
/begin CHARACTERISTIC FTCMTCS_LutInAddSpeedRpmC "FTCMTCS_LutInAddSpeedRpmC" CURVE 0x8005CA9C DATA_RECORD_FLOAT32_IEEE 3.402823466E+038 F_1_p0_2 -3.402823466E+038 3.402823466E+038
 /begin AXIS_DESCR FIX_AXIS NO_INPUT_QUANTITY Id_0x00 13 0 12 MAX_GRAD 100.0 FIX_AXIS_PAR_DIST 0 1 13 /end AXIS_DESCR
/end CHARACTERISTIC
/begin CHARACTERISTIC FTCMTCS_LutInAddUbatC "FTCMTCS_LutInAddUbatC" CURVE 0x8005CA88 DATA_RECORD_FLOAT32_IEEE 3.402823466E+038 F_1_p0_2 -3.402823466E+038 3.402823466E+038
 /begin AXIS_DESCR FIX_AXIS NO_INPUT_QUANTITY Id_0x00 5 0 4 MAX_GRAD 100.0 FIX_AXIS_PAR_DIST 0 1 5 /end AXIS_DESCR
/end CHARACTERISTIC
/begin CHARACTERISTIC FTCMTCS_LutInMecaSpeedRpmC "FTCMTCS_LutInMecaSpeedRpmC" CURVE 0x8005CA20 DATA_RECORD_FLOAT32_IEEE 3.402823466E+038 F_1_p0_2 -3.402823466E+038 3.402823466E+038
 /begin AXIS_DESCR FIX_AXIS NO_INPUT_QUANTITY Id_0x00 26 0 25 MAX_GRAD 100.0 FIX_AXIS_PAR_DIST 0 1 26 /end AXIS_DESCR
/end CHARACTERISTIC
/begin CHARACTERISTIC FTCMTCS_LutInSpeedRpmC "FTCMTCS_LutInSpeedRpmC" CURVE 0x8005CA00 DATA_RECORD_FLOAT32_IEEE 3.402823466E+038 F_1_p0_2 -3.402823466E+038 3.402823466E+038
 /begin AXIS_DESCR FIX_AXIS NO_INPUT_QUANTITY Id_0x00 8 0 7 MAX_GRAD 100.0 FIX_AXIS_PAR_DIST 0 1 8 /end AXIS_DESCR
/end CHARACTERISTIC
/begin CHARACTERISTIC FTCMTCS_LutInTorqueTgtC "FTCMTCS_LutInTorqueTgtC" CURVE 0x8009A988 DATA_RECORD_FLOAT32_IEEE 3.402823466E+038 F_1_p0_2 -3.402823466E+038 3.402823466E+038
 /begin AXIS_DESCR FIX_AXIS NO_INPUT_QUANTITY Id_0x00 175 0 174 MAX_GRAD 100.0 FIX_AXIS_PAR_DIST 0 1 175 /end AXIS_DESCR
/end CHARACTERISTIC
/begin CHARACTERISTIC FTCMTCS_LutInUbatC "FTCMTCS_LutInUbatC" CURVE 0x8005C9F0 DATA_RECORD_FLOAT32_IEEE 3.402823466E+038 F_1_p0_2 -3.402823466E+038 3.402823466E+038
 /begin AXIS_DESCR FIX_AXIS NO_INPUT_QUANTITY Id_0x00 4 0 3 MAX_GRAD 100.0 FIX_AXIS_PAR_DIST 0 1 4 /end AXIS_DESCR
/end CHARACTERISTIC
/begin CHARACTERISTIC FTCMTCS_LutInUbatHVC "FTCMTCS_LutInUbatHVC" CURVE 0x8005C9D8 DATA_RECORD_FLOAT32_IEEE 3.402823466E+038 F_1_p0_2 -3.402823466E+038 3.402823466E+038
 /begin AXIS_DESCR FIX_AXIS NO_INPUT_QUANTITY Id_0x00 6 0 5 MAX_GRAD 100.0 FIX_AXIS_PAR_DIST 0 1 6 /end AXIS_DESCR
/end CHARACTERISTIC
/begin CHARACTERISTIC FTCMTCS_LutOutIdAdd0C "FTCMTCS_LutOutIdAdd0C" MAP 0x8005C8D4 DATA_RECORD_FLOAT32_IEEE 3.402823466E+038 F_1_p0_2 -3.402823466E+038 3.402823466E+038
 /begin AXIS_DESCR FIX_AXIS NO_INPUT_QUANTITY Id_0x00 5 0 4 MAX_GRAD 100.0 FIX_AXIS_PAR_DIST 0 1 5 /end AXIS_DESCR
 /begin AXIS_DESCR FIX_AXIS NO_INPUT_QUANTITY Id_0x00 13 0 12 MAX_GRAD 100.0 FIX_AXIS_PAR_DIST 0 1 13 /end AXIS_DESCR
/end CHARACTERISTIC
/begin CHARACTERISTIC FTCMTCS_LutOutIdAdd0MotC "FTCMTCS_LutOutIdAdd0MotC" MAP 0x8005C7D0 DATA_RECORD_FLOAT32_IEEE 3.402823466E+038 F_1_p0_2 -3.402823466E+038 3.402823466E+038
 /begin AXIS_DESCR FIX_AXIS NO_INPUT_QUANTITY Id_0x00 5 0 4 MAX_GRAD 100.0 FIX_AXIS_PAR_DIST 0 1 5 /end AXIS_DESCR
 /begin AXIS_DESCR FIX_AXIS NO_INPUT_QUANTITY Id_0x00 13 0 12 MAX_GRAD 100.0 FIX_AXIS_PAR_DIST 0 1 13 /end AXIS_DESCR
/end CHARACTERISTIC
/begin CHARACTERISTIC FTCMTCS_LutOutIdAddGenC "FTCMTCS_LutOutIdAddGenC" MAP 0x8005C6CC DATA_RECORD_FLOAT32_IEEE 3.402823466E+038 F_1_p0_2 -3.402823466E+038 3.402823466E+038
 /begin AXIS_DESCR FIX_AXIS NO_INPUT_QUANTITY Id_0x00 5 0 4 MAX_GRAD 100.0 FIX_AXIS_PAR_DIST 0 1 5 /end AXIS_DESCR
 /begin AXIS_DESCR FIX_AXIS NO_INPUT_QUANTITY Id_0x00 13 0 12 MAX_GRAD 100.0 FIX_AXIS_PAR_DIST 0 1 13 /end AXIS_DESCR
/end CHARACTERISTIC
/begin CHARACTERISTIC FTCMTCS_LutOutIdAddMotC "FTCMTCS_LutOutIdAddMotC" MAP 0x8005C5C8 DATA_RECORD_FLOAT32_IEEE 3.402823466E+038 F_1_p0_2 -3.402823466E+038 3.402823466E+038
 /begin AXIS_DESCR FIX_AXIS NO_INPUT_QUANTITY Id_0x00 5 0 4 MAX_GRAD 100.0 FIX_AXIS_PAR_DIST 0 1 5 /end AXIS_DESCR
 /begin AXIS_DESCR FIX_AXIS NO_INPUT_QUANTITY Id_0x00 13 0 12 MAX_GRAD 100.0 FIX_AXIS_PAR_DIST 0 1 13 /end AXIS_DESCR
/end CHARACTERISTIC
/begin CHARACTERISTIC FTCMTCS_LutOutIqAddGenC "FTCMTCS_LutOutIqAddGenC" MAP 0x8005C4C4 DATA_RECORD_FLOAT32_IEEE 3.402823466E+038 F_1_p0_2 -3.402823466E+038 3.402823466E+038
 /begin AXIS_DESCR FIX_AXIS NO_INPUT_QUANTITY Id_0x00 5 0 4 MAX_GRAD 100.0 FIX_AXIS_PAR_DIST 0 1 5 /end AXIS_DESCR
 /begin AXIS_DESCR FIX_AXIS NO_INPUT_QUANTITY Id_0x00 13 0 12 MAX_GRAD 100.0 FIX_AXIS_PAR_DIST 0 1 13 /end AXIS_DESCR
/end CHARACTERISTIC
/begin CHARACTERISTIC FTCMTCS_LutOutIqAddMotC "FTCMTCS_LutOutIqAddMotC" MAP 0x8005C3C0 DATA_RECORD_FLOAT32_IEEE 3.402823466E+038 F_1_p0_2 -3.402823466E+038 3.402823466E+038
 /begin AXIS_DESCR FIX_AXIS NO_INPUT_QUANTITY Id_0x00 5 0 4 MAX_GRAD 100.0 FIX_AXIS_PAR_DIST 0 1 5 /end AXIS_DESCR
 /begin AXIS_DESCR FIX_AXIS NO_INPUT_QUANTITY Id_0x00 13 0 12 MAX_GRAD 100.0 FIX_AXIS_PAR_DIST 0 1 13 /end AXIS_DESCR
/end CHARACTERISTIC
/begin CHARACTERISTIC FTCMTCS_LutOutTorqueMaxC "FTCMTCS_LutOutTorqueMaxC" MAP 0x8009A718 DATA_RECORD_FLOAT32_IEEE 3.402823466E+038 F_1_p0_2 -3.402823466E+038 3.402823466E+038
 /begin AXIS_DESCR FIX_AXIS NO_INPUT_QUANTITY Id_0x00 6 0 5 MAX_GRAD 100.0 FIX_AXIS_PAR_DIST 0 1 6 /end AXIS_DESCR
 /begin AXIS_DESCR FIX_AXIS NO_INPUT_QUANTITY Id_0x00 26 0 25 MAX_GRAD 100.0 FIX_AXIS_PAR_DIST 0 1 26 /end AXIS_DESCR
/end CHARACTERISTIC
/begin CHARACTERISTIC FTCMTCS_LutOutTorqueMinC "FTCMTCS_LutOutTorqueMinC" MAP 0x8009A4A8 DATA_RECORD_FLOAT32_IEEE 3.402823466E+038 F_1_p0_2 -3.402823466E+038 3.402823466E+038
 /begin AXIS_DESCR FIX_AXIS NO_INPUT_QUANTITY Id_0x00 6 0 5 MAX_GRAD 100.0 FIX_AXIS_PAR_DIST 0 1 6 /end AXIS_DESCR
 /begin AXIS_DESCR FIX_AXIS NO_INPUT_QUANTITY Id_0x00 26 0 25 MAX_GRAD 100.0 FIX_AXIS_PAR_DIST 0 1 26 /end AXIS_DESCR
/end CHARACTERISTIC
/begin CHARACTERISTIC FTCMTCS_LutOutVolMarginGenC "FTCMTCS_LutOutVolMarginGenC" MAP 0x8005C340 DATA_RECORD_FLOAT32_IEEE 3.402823466E+038 F_1_p0_2 -3.402823466E+038 3.402823466E+038
 /begin AXIS_DESCR FIX_AXIS NO_INPUT_QUANTITY Id_0x00 4 0 3 MAX_GRAD 100.0 FIX_AXIS_PAR_DIST 0 1 4 /end AXIS_DESCR
 /begin AXIS_DESCR FIX_AXIS NO_INPUT_QUANTITY Id_0x00 8 0 7 MAX_GRAD 100.0 FIX_AXIS_PAR_DIST 0 1 8 /end AXIS_DESCR
/end CHARACTERISTIC
/begin CHARACTERISTIC FTCMTCS_LutOutVolMarginMotC "FTCMTCS_LutOutVolMarginMotC" MAP 0x8005C2C0 DATA_RECORD_FLOAT32_IEEE 3.402823466E+038 F_1_p0_2 -3.402823466E+038 3.402823466E+038
 /begin AXIS_DESCR FIX_AXIS NO_INPUT_QUANTITY Id_0x00 4 0 3 MAX_GRAD 100.0 FIX_AXIS_PAR_DIST 0 1 4 /end AXIS_DESCR
 /begin AXIS_DESCR FIX_AXIS NO_INPUT_QUANTITY Id_0x00 8 0 7 MAX_GRAD 100.0 FIX_AXIS_PAR_DIST 0 1 8 /end AXIS_DESCR
/end CHARACTERISTIC
/begin CHARACTERISTIC FTCMTCS_LutSlideSpdRpmC "FTCMTCS_LutSlideSpdRpmC" CURVE 0x8005C2B8 DATA_RECORD_FLOAT32_IEEE 3.402823466E+038 F_1_p0_2 -3.402823466E+038 3.402823466E+038
 /begin AXIS_DESCR FIX_AXIS NO_INPUT_QUANTITY Id_0x00 2 0 1 MAX_GRAD 100.0 FIX_AXIS_PAR_DIST 0 1 2 /end AXIS_DESCR
/end CHARACTERISTIC
/begin CHARACTERISTIC FTCMTCS_LutTorqueGainC "FTCMTCS_LutTorqueGainC" CURVE 0x8005C2A8 DATA_RECORD_FLOAT32_IEEE 3.402823466E+038 F_1_p0_2 -3.402823466E+038 3.402823466E+038
 /begin AXIS_DESCR FIX_AXIS NO_INPUT_QUANTITY Id_0x00 4 0 3 MAX_GRAD 100.0 FIX_AXIS_PAR_DIST 0 1 4 /end AXIS_DESCR
/end CHARACTERISTIC
/begin CHARACTERISTIC FTCMTCS_LutVoltageErrorC "FTCMTCS_LutVoltageErrorC" CURVE 0x8005C298 DATA_RECORD_FLOAT32_IEEE 3.402823466E+038 F_1_p0_2 -3.402823466E+038 3.402823466E+038
 /begin AXIS_DESCR FIX_AXIS NO_INPUT_QUANTITY Id_0x00 4 0 3 MAX_GRAD 100.0 FIX_AXIS_PAR_DIST 0 1 4 /end AXIS_DESCR
/end CHARACTERISTIC
/begin CHARACTERISTIC FTCMTCS_MaxErrorFor100C "FTCMTCS_MaxErrorFor100C" VALUE 0x8005C294 DATA_RECORD_FLOAT32_IEEE 3.402823466E+038 F_1_p0_2 -3.402823466E+038 3.402823466E+038 /end CHARACTERISTIC
/begin CHARACTERISTIC FTCMTCS_NegGenTrqThrC "FTCMTCS_NegGenTrqThrC" VALUE 0x8005C290 DATA_RECORD_FLOAT32_IEEE 3.402823466E+038 F_1_p0_2 -3.402823466E+038 3.402823466E+038 /end CHARACTERISTIC
/begin CHARACTERISTIC FTCMTCS_OneSecondCntC "FTCMTCS_OneSecondCntC" VALUE 0x8005C28C DATA_RECORD_FLOAT32_IEEE 3.402823466E+038 F_1_p0_2 -3.402823466E+038 3.402823466E+038 /end CHARACTERISTIC
/begin CHARACTERISTIC FTCMTCS_ParkCurrentMaxC "FTCMTCS_ParkCurrentMaxC" VALUE 0x8005C288 DATA_RECORD_FLOAT32_IEEE 3.402823466E+038 F_1_p0_2 -3.402823466E+038 3.402823466E+038 /end CHARACTERISTIC
/begin CHARACTERISTIC FTCMTCS_SlideLutInUbatC "FTCMTCS_SlideLutInUbatC" CURVE 0x8005C280 DATA_RECORD_FLOAT32_IEEE 3.402823466E+038 F_1_p0_2 -3.402823466E+038 3.402823466E+038
 /begin AXIS_DESCR FIX_AXIS NO_INPUT_QUANTITY Id_0x00 2 0 1 MAX_GRAD 100.0 FIX_AXIS_PAR_DIST 0 1 2 /end AXIS_DESCR
/end CHARACTERISTIC
/begin CHARACTERISTIC FTCMTCS_SwitchElecTorqueRangeC "FTCMTCS_SwitchElecTorqueRangeC" VALUE 0x8005C27C DATA_RECORD_FLOAT32_IEEE 3.402823466E+038 F_1_p0_2 -3.402823466E+038 3.402823466E+038 /end CHARACTERISTIC
/begin CHARACTERISTIC FTCMTCS_SwitchElecTrqRange0C "FTCMTCS_SwitchElecTrqRange0C" VALUE 0x8005C278 DATA_RECORD_FLOAT32_IEEE 3.402823466E+038 F_1_p0_2 -3.402823466E+038 3.402823466E+038 /end CHARACTERISTIC
/begin CHARACTERISTIC FTCMTCS_VoltMarginCtrlOnOffC "FTCMTCS_VoltMarginCtrlOnOffC" VALUE 0x8005C274 DATA_RECORD_UBYTE 1 Bool_ON_OFF 0 1 BIT_MASK 0x01 /end CHARACTERISTIC
/begin CHARACTERISTIC FTCMTCS_VoltageLimiterOnOffC "FTCMTCS_VoltageLimiterOnOffC" VALUE 0x8005C270 DATA_RECORD_UBYTE 1 Bool_ON_OFF 0 1 BIT_MASK 0x01 /end CHARACTERISTIC
/begin CHARACTERISTIC FTCMTCS_VoltageMarginC "FTCMTCS_VoltageMarginC" VALUE 0x8005C26C DATA_RECORD_FLOAT32_IEEE 3.402823466E+038 F_1_p0_2 -3.402823466E+038 3.402823466E+038 /end CHARACTERISTIC
/begin CHARACTERISTIC FTCMTCS_bGenSlipEnC "FTCMTCS_bGenSlipEnC" VALUE 0x8005C268 DATA_RECORD_UBYTE 1 Bool_ON_OFF 0 1 BIT_MASK 0x01 /end CHARACTERISTIC
/begin CHARACTERISTIC FTCMTCS_deg2radC "FTCMTCS_deg2radC" VALUE 0x8005C264 DATA_RECORD_FLOAT32_IEEE 3.402823466E+038 F_1_p0_2 -3.402823466E+038 3.402823466E+038 /end CHARACTERISTIC
/begin CHARACTERISTIC FTCMTCS_iqCorEnaC "FTCMTCS_iqCorEnaC" VALUE 0x8005C260 DATA_RECORD_UBYTE 1 Bool_ON_OFF 0 1 BIT_MASK 0x01 /end CHARACTERISTIC
/begin CHARACTERISTIC FTCMTTC_48thHijActHighSpdThrMaxC "FTCMTTC_48thHijActHighSpdThrMaxC" VALUE 0x8005B568 DATA_RECORD_FLOAT32_IEEE 3.402823466E+038 F_1_p0_2 -3.402823466E+038 3.402823466E+038 /end CHARACTERISTIC
/begin CHARACTERISTIC FTCMTTC_48thHijActHighSpdThrMinC "FTCMTTC_48thHijActHighSpdThrMinC" VALUE 0x8005B564 DATA_RECORD_FLOAT32_IEEE 3.402823466E+038 F_1_p0_2 -3.402823466E+038 3.402823466E+038 /end CHARACTERISTIC
/begin CHARACTERISTIC FTCMTTC_48thHijActLowSpdThrMaxC "FTCMTTC_48thHijActLowSpdThrMaxC" VALUE 0x8005B560 DATA_RECORD_FLOAT32_IEEE 3.402823466E+038 F_1_p0_2 -3.402823466E+038 3.402823466E+038 /end CHARACTERISTIC
/begin CHARACTERISTIC FTCMTTC_48thHijActLowSpdThrMinC "FTCMTTC_48thHijActLowSpdThrMinC" VALUE 0x8005B55C DATA_RECORD_FLOAT32_IEEE 3.402823466E+038 F_1_p0_2 -3.402823466E+038 3.402823466E+038 /end CHARACTERISTIC
/begin CHARACTERISTIC FTCMTTC_48thHijActTorqueThrMaxC "FTCMTTC_48thHijActTorqueThrMaxC" VALUE 0x8005B558 DATA_RECORD_FLOAT32_IEEE 3.402823466E+038 F_1_p0_2 -3.402823466E+038 3.402823466E+038 /end CHARACTERISTIC
/begin CHARACTERISTIC FTCMTTC_48thHijActTorqueThrMinC "FTCMTTC_48thHijActTorqueThrMinC" VALUE 0x8005B554 DATA_RECORD_FLOAT32_IEEE 3.402823466E+038 F_1_p0_2 -3.402823466E+038 3.402823466E+038 /end CHARACTERISTIC
/begin CHARACTERISTIC FTCMTTC_AccPosRpmBySecondC "FTCMTTC_AccPosRpmBySecondC" VALUE 0x8005B550 DATA_RECORD_FLOAT32_IEEE 3.402823466E+038 F_1_p0_2 -3.402823466E+038 3.402823466E+038 /end CHARACTERISTIC
/begin CHARACTERISTIC FTCMTTC_AllHijOffTrqMaxC "FTCMTTC_AllHijOffTrqMaxC" VALUE 0x8005B54C DATA_RECORD_FLOAT32_IEEE 3.402823466E+038 F_1_p0_2 -3.402823466E+038 3.402823466E+038 /end CHARACTERISTIC
/begin CHARACTERISTIC FTCMTTC_AllHijOffTrqMinC "FTCMTTC_AllHijOffTrqMinC" VALUE 0x8005B548 DATA_RECORD_FLOAT32_IEEE 3.402823466E+038 F_1_p0_2 -3.402823466E+038 3.402823466E+038 /end CHARACTERISTIC
/begin CHARACTERISTIC FTCMTTC_AllHijOffUdcMaxC "FTCMTTC_AllHijOffUdcMaxC" VALUE 0x8005B544 DATA_RECORD_FLOAT32_IEEE 3.402823466E+038 F_1_p0_2 -3.402823466E+038 3.402823466E+038 /end CHARACTERISTIC
/begin CHARACTERISTIC FTCMTTC_AllHijOffUdcMinC "FTCMTTC_AllHijOffUdcMinC" VALUE 0x8005B540 DATA_RECORD_FLOAT32_IEEE 3.402823466E+038 F_1_p0_2 -3.402823466E+038 3.402823466E+038 /end CHARACTERISTIC
/begin CHARACTERISTIC FTCMTTC_AntiJerkMecaTorqueMaxC "FTCMTTC_AntiJerkMecaTorqueMaxC" VALUE 0x8005CED8 DATA_RECORD_FLOAT32_IEEE 3.402823466E+038 F_1_p0_2 -3.402823466E+038 3.402823466E+038 /end CHARACTERISTIC
/begin CHARACTERISTIC FTCMTTC_AntiJerkMecaTorqueMinC "FTCMTTC_AntiJerkMecaTorqueMinC" VALUE 0x8005CED4 DATA_RECORD_FLOAT32_IEEE 3.402823466E+038 F_1_p0_2 -3.402823466E+038 3.402823466E+038 /end CHARACTERISTIC
/begin CHARACTERISTIC FTCMTTC_BpAccHighCutOffFrequencyC "FTCMTTC_BpAccHighCutOffFrequencyC" VALUE 0x8005CED0 DATA_RECORD_FLOAT32_IEEE 0.001 F_1_p0_2 0 0.001 /end CHARACTERISTIC
/begin CHARACTERISTIC FTCMTTC_DampTorqTgtHighThdC "FTCMTTC_DampTorqTgtHighThdC" VALUE 0x8005CECC DATA_RECORD_FLOAT32_IEEE 3.402823466E+038 F_1_p0_2 -3.402823466E+038 3.402823466E+038 /end CHARACTERISTIC
/begin CHARACTERISTIC FTCMTTC_DampTorqueTargetThdC "FTCMTTC_DampTorqueTargetThdC" VALUE 0x8005CEC8 DATA_RECORD_FLOAT32_IEEE 3.402823466E+038 F_1_p0_2 -3.402823466E+038 3.402823466E+038 /end CHARACTERISTIC
/begin CHARACTERISTIC FTCMTTC_DampingEnableC "FTCMTTC_DampingEnableC" VALUE 0x8005CEC4 DATA_RECORD_UBYTE 1 Bool_ON_OFF 0 1 BIT_MASK 0x01 /end CHARACTERISTIC
/begin CHARACTERISTIC FTCMTTC_DampingSpdHighC "FTCMTTC_DampingSpdHighC" VALUE 0x8005CEC0 DATA_RECORD_FLOAT32_IEEE 3.402823466E+038 F_1_p0_2 -3.402823466E+038 3.402823466E+038 /end CHARACTERISTIC
/begin CHARACTERISTIC FTCMTTC_DampingSpdLowC "FTCMTTC_DampingSpdLowC" VALUE 0x8005CEBC DATA_RECORD_FLOAT32_IEEE 3.402823466E+038 F_1_p0_2 -3.402823466E+038 3.402823466E+038 /end CHARACTERISTIC
/begin CHARACTERISTIC FTCMTTC_HijActHighSpdThrMaxC "FTCMTTC_HijActHighSpdThrMaxC" VALUE 0x8005B53C DATA_RECORD_FLOAT32_IEEE 3.402823466E+038 F_1_p0_2 -3.402823466E+038 3.402823466E+038 /end CHARACTERISTIC
/begin CHARACTERISTIC FTCMTTC_HijActHighSpdThrMinC "FTCMTTC_HijActHighSpdThrMinC" VALUE 0x8005B538 DATA_RECORD_FLOAT32_IEEE 3.402823466E+038 F_1_p0_2 -3.402823466E+038 3.402823466E+038 /end CHARACTERISTIC
/begin CHARACTERISTIC FTCMTTC_HijActLowSpdThrMaxC "FTCMTTC_HijActLowSpdThrMaxC" VALUE 0x8005B534 DATA_RECORD_FLOAT32_IEEE 3.402823466E+038 F_1_p0_2 -3.402823466E+038 3.402823466E+038 /end CHARACTERISTIC
/begin CHARACTERISTIC FTCMTTC_HijActLowSpdThrMinC "FTCMTTC_HijActLowSpdThrMinC" VALUE 0x8005B530 DATA_RECORD_FLOAT32_IEEE 3.402823466E+038 F_1_p0_2 -3.402823466E+038 3.402823466E+038 /end CHARACTERISTIC
/begin CHARACTERISTIC FTCMTTC_HijActTorqueThrMaxC "FTCMTTC_HijActTorqueThrMaxC" VALUE 0x8005B52C DATA_RECORD_FLOAT32_IEEE 3.402823466E+038 F_1_p0_2 -3.402823466E+038 3.402823466E+038 /end CHARACTERISTIC
/begin CHARACTERISTIC FTCMTTC_HijActTorqueThrMinC "FTCMTTC_HijActTorqueThrMinC" VALUE 0x8005B528 DATA_RECORD_FLOAT32_IEEE 3.402823466E+038 F_1_p0_2 -3.402823466E+038 3.402823466E+038 /end CHARACTERISTIC
/begin CHARACTERISTIC FTCMTTC_HijEnGainFcC "FTCMTTC_HijEnGainFcC" VALUE 0x8005B524 DATA_RECORD_FLOAT32_IEEE 3.402823466E+038 F_1_p0_2 -3.402823466E+038 3.402823466E+038 /end CHARACTERISTIC
/begin CHARACTERISTIC FTCMTTC_HijSpdRpmLpfFcC "FTCMTTC_HijSpdRpmLpfFcC" VALUE 0x8005B520 DATA_RECORD_FLOAT32_IEEE 3.402823466E+038 F_1_p0_2 -3.402823466E+038 3.402823466E+038 /end CHARACTERISTIC
/begin CHARACTERISTIC FTCMTTC_HijTrqTgtLpfFcC "FTCMTTC_HijTrqTgtLpfFcC" VALUE 0x8005B51C DATA_RECORD_FLOAT32_IEEE 3.402823466E+038 F_1_p0_2 -3.402823466E+038 3.402823466E+038 /end CHARACTERISTIC
/begin CHARACTERISTIC FTCMTTC_Lut3InMecaSpeedRpmC "FTCMTTC_Lut3InMecaSpeedRpmC" CURVE 0x8005CE88 DATA_RECORD_FLOAT32_IEEE 3.402823466E+038 F_1_p0_2 -3.402823466E+038 3.402823466E+038
 /begin AXIS_DESCR FIX_AXIS NO_INPUT_QUANTITY Id_0x00 13 0 12 MAX_GRAD 100.0 FIX_AXIS_PAR_DIST 0 1 13 /end AXIS_DESCR
/end CHARACTERISTIC
/begin CHARACTERISTIC FTCMTTC_Lut3InTorqueTgtC "FTCMTTC_Lut3InTorqueTgtC" CURVE 0x8005CD14 DATA_RECORD_FLOAT32_IEEE 3.402823466E+038 F_1_p0_2 -3.402823466E+038 3.402823466E+038
 /begin AXIS_DESCR FIX_AXIS NO_INPUT_QUANTITY Id_0x00 93 0 92 MAX_GRAD 100.0 FIX_AXIS_PAR_DIST 0 1 93 /end AXIS_DESCR
/end CHARACTERISTIC
/begin CHARACTERISTIC FTCMTTC_Lut3InUbatC "FTCMTTC_Lut3InUbatC" CURVE 0x8005CD08 DATA_RECORD_FLOAT32_IEEE 3.402823466E+038 F_1_p0_2 -3.402823466E+038 3.402823466E+038
 /begin AXIS_DESCR FIX_AXIS NO_INPUT_QUANTITY Id_0x00 3 0 2 MAX_GRAD 100.0 FIX_AXIS_PAR_DIST 0 1 3 /end AXIS_DESCR
/end CHARACTERISTIC
/begin CHARACTERISTIC FTCMTTC_LutInMecaSpeedRpmC "FTCMTTC_LutInMecaSpeedRpmC" CURVE 0x8009ACEC DATA_RECORD_FLOAT32_IEEE 20000 F_1_p0_2 0 20000
 /begin AXIS_DESCR FIX_AXIS NO_INPUT_QUANTITY Id_0x00 13 0 12 MAX_GRAD 100.0 FIX_AXIS_PAR_DIST 0 1 13 /end AXIS_DESCR
/end CHARACTERISTIC
/begin CHARACTERISTIC FTCMTTC_LutInSpdRpmAtjkDeltaC "FTCMTTC_LutInSpdRpmAtjkDeltaC" CURVE 0x8005CCEC DATA_RECORD_FLOAT32_IEEE 3.402823466E+038 F_1_p0_2 -3.402823466E+038 3.402823466E+038
 /begin AXIS_DESCR FIX_AXIS NO_INPUT_QUANTITY Id_0x00 7 0 6 MAX_GRAD 100.0 FIX_AXIS_PAR_DIST 0 1 7 /end AXIS_DESCR
/end CHARACTERISTIC
/begin CHARACTERISTIC FTCMTTC_LutInSpdRpmBaseC "FTCMTTC_LutInSpdRpmBaseC" CURVE 0x8005CCD0 DATA_RECORD_FLOAT32_IEEE 3.402823466E+038 F_1_p0_2 -3.402823466E+038 3.402823466E+038
 /begin AXIS_DESCR FIX_AXIS NO_INPUT_QUANTITY Id_0x00 7 0 6 MAX_GRAD 100.0 FIX_AXIS_PAR_DIST 0 1 7 /end AXIS_DESCR
/end CHARACTERISTIC
/begin CHARACTERISTIC FTCMTTC_LutInSpeedRpmDampingC "FTCMTTC_LutInSpeedRpmDampingC" CURVE 0x8005CCBC DATA_RECORD_FLOAT32_IEEE 3.402823466E+038 F_1_p0_2 -3.402823466E+038 3.402823466E+038
 /begin AXIS_DESCR FIX_AXIS NO_INPUT_QUANTITY Id_0x00 5 0 4 MAX_GRAD 100.0 FIX_AXIS_PAR_DIST 0 1 5 /end AXIS_DESCR
/end CHARACTERISTIC
/begin CHARACTERISTIC FTCMTTC_LutInUbatC "FTCMTTC_LutInUbatC" CURVE 0x8009ACE0 DATA_RECORD_FLOAT32_IEEE 3.402823466E+038 F_1_p0_2 -3.402823466E+038 3.402823466E+038
 /begin AXIS_DESCR FIX_AXIS NO_INPUT_QUANTITY Id_0x00 3 0 2 MAX_GRAD 100.0 FIX_AXIS_PAR_DIST 0 1 3 /end AXIS_DESCR
/end CHARACTERISTIC
/begin CHARACTERISTIC FTCMTTC_LutOutAntiJerkBaseGainC "FTCMTTC_LutOutAntiJerkBaseGainC" CURVE 0x8005CCA0 DATA_RECORD_FLOAT32_IEEE 3.402823466E+038 F_1_p0_2 -3.402823466E+038 3.402823466E+038
 /begin AXIS_DESCR FIX_AXIS NO_INPUT_QUANTITY Id_0x00 7 0 6 MAX_GRAD 100.0 FIX_AXIS_PAR_DIST 0 1 7 /end AXIS_DESCR
/end CHARACTERISTIC
/begin CHARACTERISTIC FTCMTTC_LutOutAtjkDeltaGainC "FTCMTTC_LutOutAtjkDeltaGainC" CURVE 0x8005CC84 DATA_RECORD_FLOAT32_IEEE 3.402823466E+038 F_1_p0_2 -3.402823466E+038 3.402823466E+038
 /begin AXIS_DESCR FIX_AXIS NO_INPUT_QUANTITY Id_0x00 7 0 6 MAX_GRAD 100.0 FIX_AXIS_PAR_DIST 0 1 7 /end AXIS_DESCR
/end CHARACTERISTIC
/begin CHARACTERISTIC FTCMTTC_LutOutCutOffFrequencyC "FTCMTTC_LutOutCutOffFrequencyC" CURVE 0x8005CC70 DATA_RECORD_FLOAT32_IEEE 0.001 F_1_p0_2 0 0.001
 /begin AXIS_DESCR FIX_AXIS NO_INPUT_QUANTITY Id_0x00 5 0 4 MAX_GRAD 100.0 FIX_AXIS_PAR_DIST 0 1 5 /end AXIS_DESCR
/end CHARACTERISTIC
/begin CHARACTERISTIC FTCMTTC_LutOutMecaPowerC "FTCMTTC_LutOutMecaPowerC" MAP 0x8009AC44 DATA_RECORD_FLOAT32_IEEE 449999 F_1_p0_2 1 450000
 /begin AXIS_DESCR FIX_AXIS NO_INPUT_QUANTITY Id_0x00 3 0 2 MAX_GRAD 100.0 FIX_AXIS_PAR_DIST 0 1 3 /end AXIS_DESCR
 /begin AXIS_DESCR FIX_AXIS NO_INPUT_QUANTITY Id_0x00 13 0 12 MAX_GRAD 100.0 FIX_AXIS_PAR_DIST 0 1 13 /end AXIS_DESCR
/end CHARACTERISTIC
/begin CHARACTERISTIC FTCMTTC_LutOutMecaPowerMinC "FTCMTTC_LutOutMecaPowerMinC" MAP 0x8005CBD4 DATA_RECORD_FLOAT32_IEEE 450000 F_1_p0_2 -450000 0
 /begin AXIS_DESCR FIX_AXIS NO_INPUT_QUANTITY Id_0x00 3 0 2 MAX_GRAD 100.0 FIX_AXIS_PAR_DIST 0 1 3 /end AXIS_DESCR
 /begin AXIS_DESCR FIX_AXIS NO_INPUT_QUANTITY Id_0x00 13 0 12 MAX_GRAD 100.0 FIX_AXIS_PAR_DIST 0 1 13 /end AXIS_DESCR
/end CHARACTERISTIC
/begin CHARACTERISTIC FTCMTTC_MecaPowerMaxC "FTCMTTC_MecaPowerMaxC" VALUE 0x8005CBD0 DATA_RECORD_FLOAT32_IEEE 449999 F_1_p0_2 1 450000 /end CHARACTERISTIC
/begin CHARACTERISTIC FTCMTTC_MecaPowerMinC "FTCMTTC_MecaPowerMinC" VALUE 0x8005CBCC DATA_RECORD_FLOAT32_IEEE 3.402823466E+038 F_1_p0_2 -3.402823466E+038 3.402823466E+038 /end CHARACTERISTIC
/begin CHARACTERISTIC FTCMTTC_PowerLimtEnableC "FTCMTTC_PowerLimtEnableC" VALUE 0x8005CBC8 DATA_RECORD_UBYTE 1 Bool_ON_OFF 0 1 BIT_MASK 0x01 /end CHARACTERISTIC
/begin CHARACTERISTIC FTCMTTC_PreTorqSpdMaxC "FTCMTTC_PreTorqSpdMaxC" VALUE 0x8005CBC4 DATA_RECORD_FLOAT32_IEEE 3.402823466E+038 F_1_p0_2 -3.402823466E+038 3.402823466E+038 /end CHARACTERISTIC
/begin CHARACTERISTIC FTCMTTC_PreTorqSpdMinC "FTCMTTC_PreTorqSpdMinC" VALUE 0x8005CBC0 DATA_RECORD_FLOAT32_IEEE 3.402823466E+038 F_1_p0_2 -3.402823466E+038 3.402823466E+038 /end CHARACTERISTIC
/begin CHARACTERISTIC FTCMTTC_PreTorqTrasRangeC "FTCMTTC_PreTorqTrasRangeC" VALUE 0x8005CBBC DATA_RECORD_FLOAT32_IEEE 3.402823466E+038 F_1_p0_2 -3.402823466E+038 3.402823466E+038 /end CHARACTERISTIC
/begin CHARACTERISTIC FTCMTTC_PreTorqTrasStep2C "FTCMTTC_PreTorqTrasStep2C" VALUE 0x8005CBB8 DATA_RECORD_FLOAT32_IEEE 4.999999 F_1_p0_2 1E-006 5 /end CHARACTERISTIC
/begin CHARACTERISTIC FTCMTTC_PreTorqTrasStepMaxC "FTCMTTC_PreTorqTrasStepMaxC" VALUE 0x8005CBB4 DATA_RECORD_FLOAT32_IEEE 4.999999 F_1_p0_2 1E-006 5 /end CHARACTERISTIC
/begin CHARACTERISTIC FTCMTTC_PreTorqTrasStepMinC "FTCMTTC_PreTorqTrasStepMinC" VALUE 0x8005CBB0 DATA_RECORD_FLOAT32_IEEE 4.999999 F_1_p0_2 1E-006 5 /end CHARACTERISTIC
/begin CHARACTERISTIC FTCMTTC_PreTorqueC "FTCMTTC_PreTorqueC" VALUE 0x8005CBAC DATA_RECORD_FLOAT32_IEEE 49.9 F_1_p0_2 0.1 50 /end CHARACTERISTIC
/begin CHARACTERISTIC FTCMTTC_PreTorqueEnableC "FTCMTTC_PreTorqueEnableC" VALUE 0x8005CBA8 DATA_RECORD_UBYTE 1 Bool_ON_OFF 0 1 BIT_MASK 0x01 /end CHARACTERISTIC
/begin CHARACTERISTIC FTCMTTC_PreTorqueStartC "FTCMTTC_PreTorqueStartC" VALUE 0x8005CBA4 DATA_RECORD_FLOAT32_IEEE 49.9 F_1_p0_2 0.1 50 /end CHARACTERISTIC
/begin CHARACTERISTIC FTCMTTC_PreTorqueTimeC "FTCMTTC_PreTorqueTimeC" VALUE 0x8005CBA0 DATA_RECORD_UWORD 3000 F_1_p0_2 0 3000 /end CHARACTERISTIC
/begin CHARACTERISTIC FTCMTTC_Rpm2RdsC "FTCMTTC_Rpm2RdsC" VALUE 0x8005CB9C DATA_RECORD_FLOAT32_IEEE 3.402823466E+038 F_1_p0_2 -3.402823466E+038 3.402823466E+038 /end CHARACTERISTIC
/begin CHARACTERISTIC FTCMTTC_SpeedHysteresisRangeC "FTCMTTC_SpeedHysteresisRangeC" VALUE 0x8005CB98 DATA_RECORD_FLOAT32_IEEE 3.402823466E+038 F_1_p0_2 -3.402823466E+038 3.402823466E+038 /end CHARACTERISTIC
/begin CHARACTERISTIC FTCMTTC_SpeedThdC "FTCMTTC_SpeedThdC" VALUE 0x8005CB94 DATA_RECORD_FLOAT32_IEEE 3.402823466E+038 F_1_p0_2 -3.402823466E+038 3.402823466E+038 /end CHARACTERISTIC
/begin CHARACTERISTIC FTCMTTC_ToqueHpFilterSpdThrdC "FTCMTTC_ToqueHpFilterSpdThrdC" VALUE 0x8005CB90 DATA_RECORD_FLOAT32_IEEE 3.402823466E+038 F_1_p0_2 -3.402823466E+038 3.402823466E+038 /end CHARACTERISTIC
/begin CHARACTERISTIC FTCMTTC_TorMaxC "FTCMTTC_TorMaxC" VALUE 0x8005CB8C DATA_RECORD_FLOAT32_IEEE 3.402823466E+038 F_1_p0_2 -3.402823466E+038 3.402823466E+038 /end CHARACTERISTIC
/begin CHARACTERISTIC FTCMTTC_TorqCorEnableC "FTCMTTC_TorqCorEnableC" VALUE 0x8005CB88 DATA_RECORD_UBYTE 1 Bool_ON_OFF 0 1 BIT_MASK 0x01 /end CHARACTERISTIC
/begin CHARACTERISTIC FTCMTTC_TorqueBySecondNegC "FTCMTTC_TorqueBySecondNegC" VALUE 0x8005CB84 DATA_RECORD_FLOAT32_IEEE 3.402823466E+038 F_1_p0_2 -3.402823466E+038 3.402823466E+038 /end CHARACTERISTIC
/begin CHARACTERISTIC FTCMTTC_TorqueBySecondPosC "FTCMTTC_TorqueBySecondPosC" VALUE 0x8005CB80 DATA_RECORD_FLOAT32_IEEE 3.402823466E+038 F_1_p0_2 -3.402823466E+038 3.402823466E+038 /end CHARACTERISTIC
/begin CHARACTERISTIC FTCMTTC_TorqueCutOffFrequencyC "FTCMTTC_TorqueCutOffFrequencyC" VALUE 0x8005CB7C DATA_RECORD_FLOAT32_IEEE 3.402823466E+038 F_1_p0_2 -3.402823466E+038 3.402823466E+038 /end CHARACTERISTIC
/begin CHARACTERISTIC FTCMTTC_TorqueFildTrC "FTCMTTC_TorqueFildTrC" VALUE 0x8005CB78 DATA_RECORD_FLOAT32_IEEE 3.402823466E+038 F_1_p0_2 -3.402823466E+038 3.402823466E+038 /end CHARACTERISTIC
/begin CHARACTERISTIC FTCMTTC_TorqueHpFilterSpdHystRgC "FTCMTTC_TorqueHpFilterSpdHystRgC" VALUE 0x8005CB74 DATA_RECORD_FLOAT32_IEEE 3.402823466E+038 F_1_p0_2 -3.402823466E+038 3.402823466E+038 /end CHARACTERISTIC
/begin CHARACTERISTIC FTCMTTC_TotalTrqLmtFromCanEnC "FTCMTTC_TotalTrqLmtFromCanEnC" VALUE 0x8005CB70 DATA_RECORD_UBYTE 1 Bool_ON_OFF 0 1 BIT_MASK 0x01 /end CHARACTERISTIC
/begin CHARACTERISTIC FTCMTTC_TrqHpCutOffFrequencyC "FTCMTTC_TrqHpCutOffFrequencyC" VALUE 0x8005CB6C DATA_RECORD_FLOAT32_IEEE 3.402823466E+038 F_1_p0_2 -3.402823466E+038 3.402823466E+038 /end CHARACTERISTIC
/begin CHARACTERISTIC FTCMTTC_TrqSatThrdC "FTCMTTC_TrqSatThrdC" VALUE 0x8005CB68 DATA_RECORD_FLOAT32_IEEE 3.402823466E+038 F_1_p0_2 -3.402823466E+038 3.402823466E+038 /end CHARACTERISTIC
/begin CHARACTERISTIC FTDDLMP_I0LimitMaxC "The maximum current of I0 limit value in limp control mode." VALUE 0x8005CF04 DATA_RECORD_FLOAT32_IEEE 2000 F_1_p0_2 -1000 1000 /end CHARACTERISTIC
/begin MEASUREMENT FTEVEIT_PthTthS3_VL "TH junction temperature estimation from TH power losses leg_VL subsystem 3." FLOAT32_IEEE F_1_p0_2 1 2 -200 400 ECU_ADDRESS 0x70003ACC /end MEASUREMENT
/begin MEASUREMENT FTEVEIT_PthTthS3_WL "TH junction temperature estimation from TH power losses leg_WL subsystem 3." FLOAT32_IEEE F_1_p0_2 1 2 -200 400 ECU_ADDRESS 0x70003AC8 /end MEASUREMENT
/begin MEASUREMENT FTEVEIT_PthTthS4_UL "TH junction temperature estimation from TH power losses leg_UL subsystem 4." FLOAT32_IEEE F_1_p0_2 1 2 -200 400 ECU_ADDRESS 0x70003AC4 /end MEASUREMENT
/begin MEASUREMENT FTEVEIT_PthTthS4_VL "TH junction temperature estimation from TH power losses leg_VL subsystem 4." FLOAT32_IEEE F_1_p0_2 1 2 -200 400 ECU_ADDRESS 0x70003AC0 /end MEASUREMENT
/begin MEASUREMENT FTEVEIT_PthTthS4_WL "TH junction temperature estimation from TH power losses leg_WL subsystem 4." FLOAT32_IEEE F_1_p0_2 1 2 -200 400 ECU_ADDRESS 0x70003ABC /end MEASUREMENT
/begin MEASUREMENT FTEVEIT_PthTthS5_UL "TH junction temperature estimation from TH power losses leg_UL subsystem 5." FLOAT32_IEEE F_1_p0_2 1 2 -200 400 ECU_ADDRESS 0x70003AB8 /end MEASUREMENT
/begin MEASUREMENT FTEVEIT_PthTthS5_VL "TH junction temperature estimation from TH power losses leg_VL subsystem 5." FLOAT32_IEEE F_1_p0_2 1 2 -200 400 ECU_ADDRESS 0x70003AB4 /end MEASUREMENT
/begin MEASUREMENT FTEVEIT_PthTthS5_WL "TH junction temperature estimation from TH power losses leg_WL subsystem 5." FLOAT32_IEEE F_1_p0_2 1 2 -200 400 ECU_ADDRESS 0x70003AB0 /end MEASUREMENT
/begin MEASUREMENT FTEVEIT_PtlTdl_UL "DL junction temperature estimation from TL power losses leg_UL." FLOAT32_IEEE F_1_p0_2 1 2 -200 400 ECU_ADDRESS 0x70003AA0 /end MEASUREMENT
/begin MEASUREMENT FTEVEIT_PtlTdl_VL "DL junction temperature estimation from TL power losses leg_VL." FLOAT32_IEEE F_1_p0_2 1 2 -200 400 ECU_ADDRESS 0x70003A9C /end MEASUREMENT
/begin MEASUREMENT FTEVEIT_PtlTdl_WL "DL junction temperature estimation from TL power losses leg_WL." FLOAT32_IEEE F_1_p0_2 1 2 -200 400 ECU_ADDRESS 0x70003A98 /end MEASUREMENT
/begin MEASUREMENT FTEVEIT_PtlTtlS1_UL "TL junction temperature estimation from TL power losses leg_UL subsystem 1." FLOAT32_IEEE F_1_p0_2 1 2 -200 400 ECU_ADDRESS 0x70003A94 /end MEASUREMENT
/begin MEASUREMENT FTEVEIT_PtlTtlS1_VL "TL junction temperature estimation from TL power losses leg_VL subsystem 1." FLOAT32_IEEE F_1_p0_2 1 2 -200 400 ECU_ADDRESS 0x70003A90 /end MEASUREMENT
/begin MEASUREMENT FTEVEIT_PtlTtlS1_WL "TL junction temperature estimation from TL power losses leg_WL subsystem 1." FLOAT32_IEEE F_1_p0_2 1 2 -200 400 ECU_ADDRESS 0x70003A8C /end MEASUREMENT
/begin MEASUREMENT FTEVEIT_PtlTtlS2_UL "TL junction temperature estimation from TL power losses leg_UL subsystem 2." FLOAT32_IEEE F_1_p0_2 1 2 -200 400 ECU_ADDRESS 0x70003A88 /end MEASUREMENT
/begin MEASUREMENT FTEVEIT_PtlTtlS2_VL "TL junction temperature estimation from TL power losses leg_VL subsystem 2." FLOAT32_IEEE F_1_p0_2 1 2 -200 400 ECU_ADDRESS 0x70003A84 /end MEASUREMENT
/begin MEASUREMENT FTEVEIT_PtlTtlS2_WL "TL junction temperature estimation from TL power losses leg_WL subsystem 2." FLOAT32_IEEE F_1_p0_2 1 2 -200 400 ECU_ADDRESS 0x70003A80 /end MEASUREMENT
/begin MEASUREMENT FTEVEIT_PtlTtlS3_UL "TL junction temperature estimation from TL power losses leg_UL subsystem 3." FLOAT32_IEEE F_1_p0_2 1 2 -200 400 ECU_ADDRESS 0x70003A7C /end MEASUREMENT
/begin MEASUREMENT FTEVEIT_PtlTtlS3_VL "TL junction temperature estimation from TL power losses leg_VL subsystem 3." FLOAT32_IEEE F_1_p0_2 1 2 -200 400 ECU_ADDRESS 0x70003A78 /end MEASUREMENT
/begin MEASUREMENT FTEVEIT_PtlTtlS3_WL "TL junction temperature estimation from TL power losses leg_WL subsystem 3." FLOAT32_IEEE F_1_p0_2 1 2 -200 400 ECU_ADDRESS 0x70003A74 /end MEASUREMENT
/begin MEASUREMENT FTEVEIT_PtlTtlS4_UL "TL junction temperature estimation from TL power losses leg_UL subsystem 4." FLOAT32_IEEE F_1_p0_2 1 2 -200 400 ECU_ADDRESS 0x70003A70 /end MEASUREMENT
/begin MEASUREMENT FTEVEIT_PtlTtlS4_VL "TL junction temperature estimation from TL power losses leg_VL subsystem 4." FLOAT32_IEEE F_1_p0_2 1 2 -200 400 ECU_ADDRESS 0x70003A6C /end MEASUREMENT
/begin MEASUREMENT FTEVEIT_PtlTtlS4_WL "TL junction temperature estimation from TL power losses leg_WL subsystem 4." FLOAT32_IEEE F_1_p0_2 1 2 -200 400 ECU_ADDRESS 0x70003A68 /end MEASUREMENT
/begin MEASUREMENT FTEVEIT_PtlTtlS5_UL "TL junction temperature estimation from TL power losses leg_UL subsystem 5." FLOAT32_IEEE F_1_p0_2 1 2 -200 400 ECU_ADDRESS 0x70003A64 /end MEASUREMENT
/begin MEASUREMENT FTEVEIT_PtlTtlS5_VL "TL junction temperature estimation from TL power losses leg_VL subsystem 5." FLOAT32_IEEE F_1_p0_2 1 2 -200 400 ECU_ADDRESS 0x70003A60 /end MEASUREMENT
/begin MEASUREMENT FTEVEIT_PtlTtlS5_WL "TL junction temperature estimation from TL power losses leg_WL subsystem 5." FLOAT32_IEEE F_1_p0_2 1 2 -200 400 ECU_ADDRESS 0x70003A5C /end MEASUREMENT
/begin MEASUREMENT FTEVEIT_PtlTtl_UL "TL junction temperature estimation from TL power losses leg_UL." FLOAT32_IEEE F_1_p0_2 1 2 -200 400 ECU_ADDRESS 0x70003A58 /end MEASUREMENT
/begin MEASUREMENT FTEVEIT_PtlTtl_VL "TL junction temperature estimation from TL power losses leg_VL." FLOAT32_IEEE F_1_p0_2 1 2 -200 400 ECU_ADDRESS 0x70003A54 /end MEASUREMENT
/begin MEASUREMENT FTEVEIT_PtlTtl_WL "TL junction temperature estimation from TL power losses leg_WL." FLOAT32_IEEE F_1_p0_2 1 2 -200 400 ECU_ADDRESS 0x70003A50 /end MEASUREMENT
/begin MEASUREMENT FTEVEIT_TcoolingEstimation "Estimated cooling temperature." FLOAT32_IEEE F_1_p0_2 1 2 -200 200 ECU_ADDRESS 0x70003A4C /end MEASUREMENT
/begin MEASUREMENT FTEVEIT_VectEstimTempFild10Z "Previous value of the vector temperature 10th element after filtering." FLOAT32_IEEE F_1_p0_2 1 2 -40 200 ECU_ADDRESS 0x70003A18 /end MEASUREMENT
/begin MEASUREMENT FTEVEIT_VectEstimTempFild11Z "Previous value of the vector temperature 11th element after filtering." FLOAT32_IEEE F_1_p0_2 1 2 -40 200 ECU_ADDRESS 0x70003A14 /end MEASUREMENT
/begin MEASUREMENT FTEVEIT_VectEstimTempFild12Z "Previous value of the vector temperature 12th element after filtering." FLOAT32_IEEE F_1_p0_2 1 2 -40 200 ECU_ADDRESS 0x70003A10 /end MEASUREMENT
/begin MEASUREMENT FTEVEIT_VectEstimTempFild1Z "Previous value of the vector temperature 1st element after filtering." FLOAT32_IEEE F_1_p0_2 1 2 -40 200 ECU_ADDRESS 0x70003A0C /end MEASUREMENT
/begin MEASUREMENT FTEVEIT_VectEstimTempFild2Z "Previous value of the vector temperature 2nd element after filtering." FLOAT32_IEEE F_1_p0_2 1 2 -40 200 ECU_ADDRESS 0x70003A08 /end MEASUREMENT
/begin MEASUREMENT FTEVEIT_VectEstimTempFild3Z "Previous value of the vector temperature 3rd element after filtering." FLOAT32_IEEE F_1_p0_2 1 2 -40 200 ECU_ADDRESS 0x70003A04 /end MEASUREMENT
/begin MEASUREMENT FTEVEIT_VectEstimTempFild4Z "Previous value of the vector temperature 4th element after filtering." FLOAT32_IEEE F_1_p0_2 1 2 -40 200 ECU_ADDRESS 0x70003A00 /end MEASUREMENT
/begin MEASUREMENT FTEVEIT_VectEstimTempFild5Z "Previous value of the vector temperature 5th element after filtering." FLOAT32_IEEE F_1_p0_2 1 2 -40 200 ECU_ADDRESS 0x700039FC /end MEASUREMENT
/begin MEASUREMENT FTEVEIT_VectEstimTempFild6Z "Previous value of the vector temperature 6th element after filtering." FLOAT32_IEEE F_1_p0_2 1 2 -40 200 ECU_ADDRESS 0x700039F8 /end MEASUREMENT
/begin MEASUREMENT FTEVEIT_VectEstimTempFild7Z "Previous value of the vector temperature 7th element after filtering." FLOAT32_IEEE F_1_p0_2 1 2 -40 200 ECU_ADDRESS 0x700039F4 /end MEASUREMENT
/begin MEASUREMENT FTEVEIT_VectEstimTempFild8Z "Previous value of the vector temperature 8th element after filtering." FLOAT32_IEEE F_1_p0_2 1 2 -40 200 ECU_ADDRESS 0x700039F0 /end MEASUREMENT
/begin MEASUREMENT FTEVEIT_VectEstimTempFild9Z "Previous value of the vector temperature 9th element after filtering." FLOAT32_IEEE F_1_p0_2 1 2 -40 200 ECU_ADDRESS 0x700039EC /end MEASUREMENT
/begin MEASUREMENT FTEVEIT_VectEstimTempFild[0] "Current value of the vector temperature after filtering." FLOAT32_IEEE F_1_p0_2 1 2 -40 200 ECU_ADDRESS 0x70003A1C /end MEASUREMENT
/begin MEASUREMENT FTEVEIT_VectEstimTempFild[10] "Current value of the vector temperature after filtering." FLOAT32_IEEE F_1_p0_2 1 2 -40 200 ECU_ADDRESS 0x70003A44 /end MEASUREMENT
/begin MEASUREMENT FTEVEIT_VectEstimTempFild[11] "Current value of the vector temperature after filtering." FLOAT32_IEEE F_1_p0_2 1 2 -40 200 ECU_ADDRESS 0x70003A48 /end MEASUREMENT
/begin MEASUREMENT FTEVEIT_VectEstimTempFild[1] "Current value of the vector temperature after filtering." FLOAT32_IEEE F_1_p0_2 1 2 -40 200 ECU_ADDRESS 0x70003A20 /end MEASUREMENT
/begin MEASUREMENT FTEVEIT_VectEstimTempFild[2] "Current value of the vector temperature after filtering." FLOAT32_IEEE F_1_p0_2 1 2 -40 200 ECU_ADDRESS 0x70003A24 /end MEASUREMENT
/begin MEASUREMENT FTEVEIT_VectEstimTempFild[3] "Current value of the vector temperature after filtering." FLOAT32_IEEE F_1_p0_2 1 2 -40 200 ECU_ADDRESS 0x70003A28 /end MEASUREMENT
/begin MEASUREMENT FTEVEIT_VectEstimTempFild[4] "Current value of the vector temperature after filtering." FLOAT32_IEEE F_1_p0_2 1 2 -40 200 ECU_ADDRESS 0x70003A2C /end MEASUREMENT
/begin MEASUREMENT FTEVEIT_VectEstimTempFild[5] "Current value of the vector temperature after filtering." FLOAT32_IEEE F_1_p0_2 1 2 -40 200 ECU_ADDRESS 0x70003A30 /end MEASUREMENT
/begin MEASUREMENT FTEVEIT_VectEstimTempFild[6] "Current value of the vector temperature after filtering." FLOAT32_IEEE F_1_p0_2 1 2 -40 200 ECU_ADDRESS 0x70003A34 /end MEASUREMENT
/begin MEASUREMENT FTEVEIT_VectEstimTempFild[7] "Current value of the vector temperature after filtering." FLOAT32_IEEE F_1_p0_2 1 2 -40 200 ECU_ADDRESS 0x70003A38 /end MEASUREMENT
/begin MEASUREMENT FTEVEIT_VectEstimTempFild[8] "Current value of the vector temperature after filtering." FLOAT32_IEEE F_1_p0_2 1 2 -40 200 ECU_ADDRESS 0x70003A3C /end MEASUREMENT
/begin MEASUREMENT FTEVEIT_VectEstimTempFild[9] "Current value of the vector temperature after filtering." FLOAT32_IEEE F_1_p0_2 1 2 -40 200 ECU_ADDRESS 0x70003A40 /end MEASUREMENT
/begin MEASUREMENT FTMTLCS_1ByAccumulator "FTMTLCS_1ByAccumulator" FLOAT32_IEEE F_1_p0_2 1 2 -3.402823466E+038 3.402823466E+038 ECU_ADDRESS 0x70003D84 /end MEASUREMENT
/begin MEASUREMENT FTMTLCS_A2DOffsetIsuL "parameter used to correct the sensor offset error" FLOAT32_IEEE F_1_p0_2 1 2 -3.402823466E+038 3.402823466E+038 ECU_ADDRESS 0x70003D80 /end MEASUREMENT
/begin MEASUREMENT FTMTLCS_A2DOffsetIsvL "parameter used to correct the sensor offset error" FLOAT32_IEEE F_1_p0_2 1 2 -3.402823466E+038 3.402823466E+038 ECU_ADDRESS 0x70003D7C /end MEASUREMENT
/begin MEASUREMENT FTMTLCS_A2DOffsetIswL "parameter used to correct the sensor offset error" FLOAT32_IEEE F_1_p0_2 1 2 -3.402823466E+038 3.402823466E+038 ECU_ADDRESS 0x70003D78 /end MEASUREMENT
/begin MEASUREMENT FTMTLCS_A2DOffsetSumIsuLZ "sum of the current sample durring initialization" FLOAT32_IEEE F_1_p0_2 1 2 -3.402823466E+038 3.402823466E+038 ECU_ADDRESS 0x70003D74 /end MEASUREMENT
/begin MEASUREMENT FTMTLCS_A2DOffsetSumIsvLZ "sum of the current sample durring initialization" FLOAT32_IEEE F_1_p0_2 1 2 -3.402823466E+038 3.402823466E+038 ECU_ADDRESS 0x70003D70 /end MEASUREMENT
/begin MEASUREMENT FTMTLCS_A2DOffsetSumIswLZ "sum of the current sample durring initialization" FLOAT32_IEEE F_1_p0_2 1 2 -3.402823466E+038 3.402823466E+038 ECU_ADDRESS 0x70003D6C /end MEASUREMENT
/begin MEASUREMENT FTMTLCS_A2DResCorrd_IsuL "corrected ADC value of the current sensor" FLOAT32_IEEE F_1_p0_2 1 2 0 4095 ECU_ADDRESS 0x70003D68 /end MEASUREMENT
/begin MEASUREMENT FTMTLCS_A2DResCorrd_IsvL "corrected ADC value of the current sensor" FLOAT32_IEEE F_1_p0_2 1 2 0 4095 ECU_ADDRESS 0x70003D64 /end MEASUREMENT
/begin MEASUREMENT FTMTLCS_A2DResCorrd_IswL "corrected ADC value of the current sensor" FLOAT32_IEEE F_1_p0_2 1 2 0 4095 ECU_ADDRESS 0x70003D60 /end MEASUREMENT
/begin MEASUREMENT FTMTLCS_CurrentSumError "FTMTLCS_CurrentSumError" UBYTE Bool_ON_OFF 1 2 0 1 BIT_MASK 0x01 ECU_ADDRESS 0x70003D5C /end MEASUREMENT
/begin MEASUREMENT FTMTLCS_ElecSpeedRdsFildZ "FTMTLCS_ElecSpeedRdsFildZ" FLOAT32_IEEE F_1_p0_2 1 2 -3.402823466E+038 3.402823466E+038 ECU_ADDRESS 0x70003D58 /end MEASUREMENT
/begin MEASUREMENT FTMTLCS_Iu "FTMTLCS_Iu" FLOAT32_IEEE F_1_p0_2 1 2 -1000 1000 ECU_ADDRESS 0x70003D54 /end MEASUREMENT
/begin MEASUREMENT FTMTLCS_IuInput "FTMTLCS_IuInput" FLOAT32_IEEE F_1_p0_2 1 2 -3.402823466E+038 3.402823466E+038 ECU_ADDRESS 0x70003D50 /end MEASUREMENT
/begin MEASUREMENT FTMTLCS_Iu_Rms "FTMTLCS_Iu_Rms" FLOAT32_IEEE F_1_p0_2 1 2 -3.402823466E+038 3.402823466E+038 ECU_ADDRESS 0x70003D4C /end MEASUREMENT
/begin MEASUREMENT FTMTLCS_Iu_RmsSum "FTMTLCS_Iu_RmsSum" FLOAT32_IEEE F_1_p0_2 1 2 -3.402823466E+038 3.402823466E+038 ECU_ADDRESS 0x70003D48 /end MEASUREMENT
/begin MEASUREMENT FTMTLCS_Iuvw3RmsSum[0] "FTMTLCS_Iuvw3RmsSum" FLOAT32_IEEE F_1_p0_2 1 2 -3.402823466E+038 3.402823466E+038 ECU_ADDRESS 0x70003D30 /end MEASUREMENT
/begin MEASUREMENT FTMTLCS_Iuvw3RmsSum[1] "FTMTLCS_Iuvw3RmsSum" FLOAT32_IEEE F_1_p0_2 1 2 -3.402823466E+038 3.402823466E+038 ECU_ADDRESS 0x70003D34 /end MEASUREMENT
/begin MEASUREMENT FTMTLCS_Iuvw3RmsSum[2] "FTMTLCS_Iuvw3RmsSum" FLOAT32_IEEE F_1_p0_2 1 2 -3.402823466E+038 3.402823466E+038 ECU_ADDRESS 0x70003D38 /end MEASUREMENT
/begin MEASUREMENT FTMTLCS_Iuvw3[0] "FTMTLCS_Iuvw3" FLOAT32_IEEE F_1_p0_2 1 2 -3.402823466E+038 3.402823466E+038 ECU_ADDRESS 0x70003D3C /end MEASUREMENT
/begin MEASUREMENT FTMTLCS_Iuvw3[1] "FTMTLCS_Iuvw3" FLOAT32_IEEE F_1_p0_2 1 2 -3.402823466E+038 3.402823466E+038 ECU_ADDRESS 0x70003D40 /end MEASUREMENT
/begin MEASUREMENT FTMTLCS_Iuvw3[2] "FTMTLCS_Iuvw3" FLOAT32_IEEE F_1_p0_2 1 2 -3.402823466E+038 3.402823466E+038 ECU_ADDRESS 0x70003D44 /end MEASUREMENT
/begin MEASUREMENT FTMTLCS_Iuvw3_Rms[0] "FTMTLCS_Iuvw3_Rms" FLOAT32_IEEE F_1_p0_2 1 2 -3.402823466E+038 3.402823466E+038 ECU_ADDRESS 0x70003D24 /end MEASUREMENT
/begin MEASUREMENT FTMTLCS_Iuvw3_Rms[1] "FTMTLCS_Iuvw3_Rms" FLOAT32_IEEE F_1_p0_2 1 2 -3.402823466E+038 3.402823466E+038 ECU_ADDRESS 0x70003D28 /end MEASUREMENT
/begin MEASUREMENT FTMTLCS_Iuvw3_Rms[2] "FTMTLCS_Iuvw3_Rms" FLOAT32_IEEE F_1_p0_2 1 2 -3.402823466E+038 3.402823466E+038 ECU_ADDRESS 0x70003D2C /end MEASUREMENT
/begin MEASUREMENT FTMTLCS_IuvwGain3[0] "FTMTLCS_IuvwGain3" FLOAT32_IEEE F_1_p0_2 1 2 -3.402823466E+038 3.402823466E+038 ECU_ADDRESS 0x70003D18 /end MEASUREMENT
/begin MEASUREMENT FTMTLCS_IuvwGain3[1] "FTMTLCS_IuvwGain3" FLOAT32_IEEE F_1_p0_2 1 2 -3.402823466E+038 3.402823466E+038 ECU_ADDRESS 0x70003D1C /end MEASUREMENT
/begin MEASUREMENT FTMTLCS_IuvwGain3[2] "FTMTLCS_IuvwGain3" FLOAT32_IEEE F_1_p0_2 1 2 -3.402823466E+038 3.402823466E+038 ECU_ADDRESS 0x70003D20 /end MEASUREMENT
/begin MEASUREMENT FTMTLCS_Iv "FTMTLCS_Iv" FLOAT32_IEEE F_1_p0_2 1 2 -1000 1000 ECU_ADDRESS 0x70003D14 /end MEASUREMENT
/begin MEASUREMENT FTMTLCS_IvInput "FTMTLCS_IvInput" FLOAT32_IEEE F_1_p0_2 1 2 -3.402823466E+038 3.402823466E+038 ECU_ADDRESS 0x70003D10 /end MEASUREMENT
/begin MEASUREMENT FTMTLCS_Iv_Rms "FTMTLCS_Iv_Rms" FLOAT32_IEEE F_1_p0_2 1 2 -3.402823466E+038 3.402823466E+038 ECU_ADDRESS 0x70003D0C /end MEASUREMENT
/begin MEASUREMENT FTMTLCS_Iv_RmsSum "FTMTLCS_Iv_RmsSum" FLOAT32_IEEE F_1_p0_2 1 2 -3.402823466E+038 3.402823466E+038 ECU_ADDRESS 0x70003D08 /end MEASUREMENT
/begin MEASUREMENT FTMTLCS_Iw "FTMTLCS_Iw" FLOAT32_IEEE F_1_p0_2 1 2 -1000 1000 ECU_ADDRESS 0x70003D04 /end MEASUREMENT
/begin MEASUREMENT FTMTLCS_IwInput "FTMTLCS_IwInput" FLOAT32_IEEE F_1_p0_2 1 2 -3.402823466E+038 3.402823466E+038 ECU_ADDRESS 0x70003D00 /end MEASUREMENT
/begin MEASUREMENT FTMTLCS_Iw_Rms "FTMTLCS_Iw_Rms" FLOAT32_IEEE F_1_p0_2 1 2 -3.402823466E+038 3.402823466E+038 ECU_ADDRESS 0x70003CFC /end MEASUREMENT
/begin MEASUREMENT FTMTLCS_Iw_RmsSum "FTMTLCS_Iw_RmsSum" FLOAT32_IEEE F_1_p0_2 1 2 -3.402823466E+038 3.402823466E+038 ECU_ADDRESS 0x70003CF8 /end MEASUREMENT
/begin MEASUREMENT FTMTLCS_LostPhaseError "FTMTLCS_LostPhaseError" UBYTE Bool_ON_OFF 1 2 0 1 BIT_MASK 0x01 ECU_ADDRESS 0x70003CF5 /end MEASUREMENT
/begin MEASUREMENT FTMTLCS_OffsetCompOK "FTMTLCS_OffsetCompOK" UBYTE Bool_ON_OFF 1 2 0 1 BIT_MASK 0x01 ECU_ADDRESS 0x70003CF4 /end MEASUREMENT
/begin MEASUREMENT FTMTLCS_RmsNumberZ "FTMTLCS_RmsNumberZ" ULONG F_1_p0_2 1 2 0 4294967295 ECU_ADDRESS 0x70003CF0 /end MEASUREMENT
/begin MEASUREMENT FTMTLCS_RmsSumIuZ "FTMTLCS_RmsSumIuZ" FLOAT32_IEEE F_1_p0_2 1 2 -3.402823466E+038 3.402823466E+038 ECU_ADDRESS 0x70003CEC /end MEASUREMENT
/begin MEASUREMENT FTMTLCS_RmsSumIvZ "FTMTLCS_RmsSumIvZ" FLOAT32_IEEE F_1_p0_2 1 2 -3.402823466E+038 3.402823466E+038 ECU_ADDRESS 0x70003CE8 /end MEASUREMENT
/begin MEASUREMENT FTMTLCS_RmsSumIwZ "FTMTLCS_RmsSumIwZ" FLOAT32_IEEE F_1_p0_2 1 2 -3.402823466E+038 3.402823466E+038 ECU_ADDRESS 0x70003CE4 /end MEASUREMENT
/begin MEASUREMENT FTMTLCS_SampleNumberZ "number of sample since the beginning of the initialization" ULONG F_1_p0_2 1 2 0 4294967295 ECU_ADDRESS 0x70003CE0 /end MEASUREMENT
/begin MEASUREMENT FTMTLCS_Scaled_Isu "FTMTLCS_Scaled_Isu" FLOAT32_IEEE F_1_p0_2 1 2 -3.402823466E+038 3.402823466E+038 ECU_ADDRESS 0x70003CDC /end MEASUREMENT
/begin MEASUREMENT FTMTLCS_Scaled_Isv "FTMTLCS_Scaled_Isv" FLOAT32_IEEE F_1_p0_2 1 2 -3.402823466E+038 3.402823466E+038 ECU_ADDRESS 0x70003CD8 /end MEASUREMENT
/begin MEASUREMENT FTMTLCS_Scaled_Isw "FTMTLCS_Scaled_Isw" FLOAT32_IEEE F_1_p0_2 1 2 -3.402823466E+038 3.402823466E+038 ECU_ADDRESS 0x70003CD4 /end MEASUREMENT
/begin MEASUREMENT FTMTLCS_TrimIsuvw[0] "FTMTLCS_TrimIsuvw" FLOAT32_IEEE F_1_p0_2 1 2 -3.402823466E+038 3.402823466E+038 ECU_ADDRESS 0x70003CC8 /end MEASUREMENT
/begin MEASUREMENT FTMTLCS_TrimIsuvw[1] "FTMTLCS_TrimIsuvw" FLOAT32_IEEE F_1_p0_2 1 2 -3.402823466E+038 3.402823466E+038 ECU_ADDRESS 0x70003CCC /end MEASUREMENT
/begin MEASUREMENT FTMTLCS_TrimIsuvw[2] "FTMTLCS_TrimIsuvw" FLOAT32_IEEE F_1_p0_2 1 2 -3.402823466E+038 3.402823466E+038 ECU_ADDRESS 0x70003CD0 /end MEASUREMENT
/begin MEASUREMENT FTMTSEP_DelayTheta "next time step cosinus value of the electrical angle" FLOAT32_IEEE F_1_p0_2 1 2 -3.402823466E+038 3.402823466E+038 ECU_ADDRESS 0x70003DA4 /end MEASUREMENT
/begin MEASUREMENT FTMTSEP_ErrThetaComp "FTMTSEP_ErrThetaComp" FLOAT32_IEEE F_1_p0_2 1 2 -3.402823466E+038 3.402823466E+038 ECU_ADDRESS 0x70003DA0 /end MEASUREMENT
/begin MEASUREMENT FTMTSEP_NextThetaElecRd "next time step value of the electrical angle" FLOAT32_IEEE F_1_p0_2 1 2 -3.402823466E+038 3.402823466E+038 ECU_ADDRESS 0x70003D9C /end MEASUREMENT
/begin MEASUREMENT FTMTSEP_SinCosNextThetaElec[0] "next time step cosinus  and sinus values of the electrical angle" FLOAT32_IEEE F_1_p0_2 1 2 -3.402823466E+038 3.402823466E+038 ECU_ADDRESS 0x70003D94 /end MEASUREMENT
/begin MEASUREMENT FTMTSEP_SinCosNextThetaElec[1] "next time step cosinus  and sinus values of the electrical angle" FLOAT32_IEEE F_1_p0_2 1 2 -3.402823466E+038 3.402823466E+038 ECU_ADDRESS 0x70003D98 /end MEASUREMENT
/begin MEASUREMENT FTMTSEP_SinCosThetaElec[0] "cosinus  and sinus values of the electrical angle" FLOAT32_IEEE F_1_p0_2 1 2 -3.402823466E+038 3.402823466E+038 ECU_ADDRESS 0x70003D8C /end MEASUREMENT
/begin MEASUREMENT FTMTSEP_SinCosThetaElec[1] "cosinus  and sinus values of the electrical angle" FLOAT32_IEEE F_1_p0_2 1 2 -3.402823466E+038 3.402823466E+038 ECU_ADDRESS 0x70003D90 /end MEASUREMENT
/begin MEASUREMENT FTMTSEP_ThetaElecRd "value of the electrical angle" FLOAT32_IEEE F_1_p0_2 1 2 -3.402823466E+038 3.402823466E+038 ECU_ADDRESS 0x70003D88 /end MEASUREMENT
/begin MEASUREMENT FTSMACS_AclPreviousState "FTSMACS_AclPreviousState" UWORD F_1_p0_2 1 2 0 65535 ECU_ADDRESS 0x700038D4 /end MEASUREMENT
/begin MEASUREMENT FTSMACS_AclState "FTSMACS_AclState" UWORD F_1_p0_2 1 2 0 65535 ECU_ADDRESS 0x700038D2 /end MEASUREMENT
/begin MEASUREMENT FTSMACS_CmdFtShutDownRes "FTSMACS_CmdFtShutDownRes" UBYTE Bool_ON_OFF 1 2 0 1 BIT_MASK 0x01 ECU_ADDRESS 0x700038D1 /end MEASUREMENT
/begin MEASUREMENT FTSMACS_CmdFtStartRes "FTSMACS_CmdFtStartRes" UBYTE Bool_ON_OFF 1 2 0 1 BIT_MASK 0x01 ECU_ADDRESS 0x700038D0 /end MEASUREMENT
/begin MEASUREMENT FTSMACS_CmdPwmDirectReq "FTSMACS_CmdPwmDirectReq" UBYTE Bool_ON_OFF 1 2 0 1 BIT_MASK 0x01 ECU_ADDRESS 0x700038CF /end MEASUREMENT
/begin MEASUREMENT FTSMACS_CmdPwmOffReq "FTSMACS_CmdPwmOffReq" UBYTE Bool_ON_OFF 1 2 0 1 BIT_MASK 0x01 ECU_ADDRESS 0x700038CE /end MEASUREMENT
/begin MEASUREMENT FTSMACS_ReinitFault "Boolean for fault reinitialization." UBYTE Bool_ON_OFF 1 2 0 1 BIT_MASK 0x01 ECU_ADDRESS 0x700038CD /end MEASUREMENT
/begin MEASUREMENT FTSMACS_TestFault "Boolean for fault reinitialization." UBYTE Bool_ON_OFF 1 2 0 1 BIT_MASK 0x01 ECU_ADDRESS 0x700038CC /end MEASUREMENT
/begin MEASUREMENT FTSMACS_VsiTimerFreqRatioRef "Timer frequency ratio reference." FLOAT32_IEEE F_1_p0_2 1 2 0 65535 ECU_ADDRESS 0x700038C8 /end MEASUREMENT
/begin MEASUREMENT FTSMMAM_AclState "FTSMMAM_AclState" UWORD F_1_p0_2 1 2 0 65535 ECU_ADDRESS 0x700038E8 /end MEASUREMENT
/begin MEASUREMENT FTSMMAM_CMCCS_M0ConOnoff "FTSMMAM_CMCCS_M0ConOnoff" UBYTE Bool_ON_OFF 1 2 0 1 BIT_MASK 0x01 ECU_ADDRESS 0x700038E7 /end MEASUREMENT
/begin MEASUREMENT FTSMMAM_EVEIT_MainEnable "FTSMMAM_EVEIT_MainEnable" UBYTE Bool_ON_OFF 1 2 0 1 BIT_MASK 0x01 ECU_ADDRESS 0x700038E6 /end MEASUREMENT
/begin MEASUREMENT FTSMMAM_FTCIVDC_State "FTSMMAM_FTCIVDC_State" UWORD F_1_p0_2 1 2 0 65535 ECU_ADDRESS 0x700038E4 /end MEASUREMENT
/begin MEASUREMENT FTSMMAM_FTCMCCS_State "FTSMMAM_FTCMCCS_State" UWORD F_1_p0_2 1 2 0 65535 ECU_ADDRESS 0x700038E2 /end MEASUREMENT
/begin MEASUREMENT FTSMMAM_FTCMSCS_State "FTSMMAM_FTCMSCS_State" UWORD F_1_p0_2 1 2 0 65535 ECU_ADDRESS 0x700038E0 /end MEASUREMENT
/begin MEASUREMENT FTSMMAM_FTCMTCS_State "FTSMMAM_FTCMTCS_State" UWORD F_1_p0_2 1 2 0 65535 ECU_ADDRESS 0x700038DE /end MEASUREMENT
/begin MEASUREMENT FTSMMAM_FtModeReq "FTSMMAM_FtModeReq" UWORD F_1_p0_2 1 2 0 65535 ECU_ADDRESS 0x700038DC /end MEASUREMENT
/begin MEASUREMENT FTSMMAM_MTLCS_State "FTSMMAM_MTLCS_State" UWORD F_1_p0_2 1 2 0 65535 ECU_ADDRESS 0x700038DA /end MEASUREMENT
/begin MEASUREMENT FTSMMAM_MTMEP_State "FTSMMAM_MTMEP_State" UWORD F_1_p0_2 1 2 0 65535 ECU_ADDRESS 0x700038D8 /end MEASUREMENT
/begin MEASUREMENT FTSMMAM_SMREF_MainEnable "FTSMMAM_SMREF_MainEnable" UBYTE Bool_ON_OFF 1 2 0 1 BIT_MASK 0x01 ECU_ADDRESS 0x700038D6 /end MEASUREMENT
/begin MEASUREMENT FTSMREF_AngleTable "FTSMREF_AngleTable" FLOAT32_IEEE F_1_p0_2 1 2 -3.402823466E+038 3.402823466E+038 ECU_ADDRESS 0x70003920 /end MEASUREMENT
/begin MEASUREMENT FTSMREF_AutoPhaseCalLock "FTSMREF_AutoPhaseCalLock" FLOAT32_IEEE F_1_p0_2 1 2 -3.402823466E+038 3.402823466E+038 ECU_ADDRESS 0x7000391C /end MEASUREMENT
/begin MEASUREMENT FTSMREF_AutoPhasingCal "FTSMREF_AutoPhasingCal" FLOAT32_IEEE F_1_p0_2 1 2 -3.402823466E+038 3.402823466E+038 ECU_ADDRESS 0x70003918 /end MEASUREMENT
/begin MEASUREMENT FTSMREF_AutoPhasingCalRaw "FTSMREF_AutoPhasingCalRaw" FLOAT32_IEEE F_1_p0_2 1 2 -3.402823466E+038 3.402823466E+038 ECU_ADDRESS 0x70003914 /end MEASUREMENT
/begin MEASUREMENT FTSMREF_AutoPhasingCalRawZ "FTSMREF_AutoPhasingCalRawZ" FLOAT32_IEEE F_1_p0_2 1 2 -3.402823466E+038 3.402823466E+038 ECU_ADDRESS 0x70003910 /end MEASUREMENT
/begin MEASUREMENT FTSMREF_AutophasingSumZ "FTSMREF_AutophasingSumZ" FLOAT32_IEEE F_1_p0_2 1 2 -3.402823466E+038 3.402823466E+038 ECU_ADDRESS 0x7000390C /end MEASUREMENT
/begin MEASUREMENT FTSMREF_CycNum "FTSMREF_CycNum" FLOAT32_IEEE F_1_p0_2 1 2 -3.402823466E+038 3.402823466E+038 ECU_ADDRESS 0x70003908 /end MEASUREMENT
/begin MEASUREMENT FTSMREF_Cyclefinish "FTSMREF_Cyclefinish" UBYTE Bool_ON_OFF 1 2 0 1 BIT_MASK 0x01 ECU_ADDRESS 0x70003904 /end MEASUREMENT
/begin MEASUREMENT FTSMREF_I0dqRef[0] "FTSMREF_I0dqRef" FLOAT32_IEEE F_1_p0_2 1 2 -3.402823466E+038 3.402823466E+038 ECU_ADDRESS 0x700038F8 /end MEASUREMENT
/begin MEASUREMENT FTSMREF_I0dqRef[1] "FTSMREF_I0dqRef" FLOAT32_IEEE F_1_p0_2 1 2 -3.402823466E+038 3.402823466E+038 ECU_ADDRESS 0x700038FC /end MEASUREMENT
/begin MEASUREMENT FTSMREF_I0dqRef[2] "FTSMREF_I0dqRef" FLOAT32_IEEE F_1_p0_2 1 2 -3.402823466E+038 3.402823466E+038 ECU_ADDRESS 0x70003900 /end MEASUREMENT
/begin MEASUREMENT FTSMREF_IdrefTable "FTSMREF_IdrefTable" FLOAT32_IEEE F_1_p0_2 1 2 -3.402823466E+038 3.402823466E+038 ECU_ADDRESS 0x700038F4 /end MEASUREMENT
/begin MEASUREMENT FTSMREF_ImposedThetaRdSurPi "FTSMREF_ImposedThetaRdSurPi" FLOAT32_IEEE F_1_p0_2 1 2 -3.402823466E+038 3.402823466E+038 ECU_ADDRESS 0x700038F0 /end MEASUREMENT
/begin MEASUREMENT FTSMREF_RotoringCalEnable "FTSMREF_RotoringCalEnable" UBYTE Bool_ON_OFF 1 2 0 1 BIT_MASK 0x01 ECU_ADDRESS 0x700038EE /end MEASUREMENT
/begin MEASUREMENT FTSMREF_RotoringCalFinish "FTSMREF_RotoringCalFinish" UBYTE Bool_ON_OFF 1 2 0 1 BIT_MASK 0x01 ECU_ADDRESS 0x700038ED /end MEASUREMENT
/begin MEASUREMENT FTSMREF_RotoringCalStart "FTSMREF_RotoringCalStart" UBYTE Bool_ON_OFF 1 2 0 1 BIT_MASK 0x01 ECU_ADDRESS 0x700038EC /end MEASUREMENT
/begin MEASUREMENT FTSMREF_Timer1Z "FTSMREF_Timer1Z" UWORD F_1_p0_2 1 2 0 65535 ECU_ADDRESS 0x700038EA /end MEASUREMENT
/begin MEASUREMENT SDMTLCS_IuInput "SDMTLCS_IuInput" FLOAT32_IEEE F_1_p0_2 1 2 -3.402823466E+038 3.402823466E+038 ECU_ADDRESS 0x70003E04 /end MEASUREMENT
/begin MEASUREMENT SDMTLCS_Iuvw3_RmsSum[0] "SDMTLCS_Iuvw3_RmsSum" FLOAT32_IEEE F_1_p0_2 1 2 -3.402823466E+038 3.402823466E+038 ECU_ADDRESS 0x70003DF8 /end MEASUREMENT
/begin MEASUREMENT SDMTLCS_Iuvw3_RmsSum[1] "SDMTLCS_Iuvw3_RmsSum" FLOAT32_IEEE F_1_p0_2 1 2 -3.402823466E+038 3.402823466E+038 ECU_ADDRESS 0x70003DFC /end MEASUREMENT
/begin MEASUREMENT SDMTLCS_Iuvw3_RmsSum[2] "SDMTLCS_Iuvw3_RmsSum" FLOAT32_IEEE F_1_p0_2 1 2 -3.402823466E+038 3.402823466E+038 ECU_ADDRESS 0x70003E00 /end MEASUREMENT
/begin MEASUREMENT SDMTLCS_IvInput "SDMTLCS_IvInput" FLOAT32_IEEE F_1_p0_2 1 2 -3.402823466E+038 3.402823466E+038 ECU_ADDRESS 0x70003DF4 /end MEASUREMENT
/begin MEASUREMENT SDMTLCS_IwInput "SDMTLCS_IwInput" FLOAT32_IEEE F_1_p0_2 1 2 -3.402823466E+038 3.402823466E+038 ECU_ADDRESS 0x70003DF0 /end MEASUREMENT
/begin MEASUREMENT SDMTLCS_RmsNumberZ "SDMTLCS_RmsNumberZ" ULONG F_1_p0_2 1 2 0 4294967295 ECU_ADDRESS 0x70003DEC /end MEASUREMENT
/begin MEASUREMENT SDMTLCS_RmsSumIuZ "SDMTLCS_RmsSumIuZ" FLOAT32_IEEE F_1_p0_2 1 2 -3.402823466E+038 3.402823466E+038 ECU_ADDRESS 0x70003DE8 /end MEASUREMENT
/begin MEASUREMENT SDMTLCS_RmsSumIvZ "SDMTLCS_RmsSumIvZ" FLOAT32_IEEE F_1_p0_2 1 2 -3.402823466E+038 3.402823466E+038 ECU_ADDRESS 0x70003DE4 /end MEASUREMENT
/begin MEASUREMENT SDMTLCS_RmsSumIwZ "SDMTLCS_RmsSumIwZ" FLOAT32_IEEE F_1_p0_2 1 2 -3.402823466E+038 3.402823466E+038 ECU_ADDRESS 0x70003DE0 /end MEASUREMENT
/begin MEASUREMENT SDMTMEP_AutoPhase "SDMTMEP_AutoPhase" FLOAT32_IEEE F_1_p0_2 1 2 -1 1 ECU_ADDRESS 0x70003F3C /end MEASUREMENT
/begin MEASUREMENT SDMTMEP_BenchModeValueZ "Bench Mode value with 1 time delay" UBYTE Bool_ON_OFF 1 2 0 1 BIT_MASK 0x01 ECU_ADDRESS 0x70003F38 /end MEASUREMENT
/begin MEASUREMENT SDMTMEP_CosResultAvgMax "SDMTMEP_CosResultAvgMax" FLOAT32_IEEE F_1_p0_2 1 2 -3.402823466E+038 3.402823466E+038 ECU_ADDRESS 0x70003F34 /end MEASUREMENT
/begin MEASUREMENT SDMTMEP_CosResultAvgMin "SDMTMEP_CosResultAvgMin" FLOAT32_IEEE F_1_p0_2 1 2 -3.402823466E+038 3.402823466E+038 ECU_ADDRESS 0x70003F30 /end MEASUREMENT
/begin MEASUREMENT SDMTMEP_CosResultMax "SDMTMEP_CosResultMax" FLOAT32_IEEE F_1_p0_2 1 2 -3.402823466E+038 3.402823466E+038 ECU_ADDRESS 0x70003F2C /end MEASUREMENT
/begin MEASUREMENT SDMTMEP_CosResultMaxSumZ "SDMTMEP_CosResultMaxSumZ" FLOAT32_IEEE F_1_p0_2 1 2 -3.402823466E+038 3.402823466E+038 ECU_ADDRESS 0x70003F28 /end MEASUREMENT
/begin MEASUREMENT SDMTMEP_CosResultMaxZ "SDMTMEP_CosResultMaxZ" FLOAT32_IEEE F_1_p0_2 1 2 -3.402823466E+038 3.402823466E+038 ECU_ADDRESS 0x70003F24 /end MEASUREMENT
/begin MEASUREMENT SDMTMEP_CosResultMin "SDMTMEP_CosResultMin" FLOAT32_IEEE F_1_p0_2 1 2 -3.402823466E+038 3.402823466E+038 ECU_ADDRESS 0x70003F20 /end MEASUREMENT
/begin MEASUREMENT SDMTMEP_CosResultMinSumZ "SDMTMEP_CosResultMinSumZ" FLOAT32_IEEE F_1_p0_2 1 2 -3.402823466E+038 3.402823466E+038 ECU_ADDRESS 0x70003F1C /end MEASUREMENT
/begin MEASUREMENT SDMTMEP_CosResultMinZ "SDMTMEP_CosResultMinZ" FLOAT32_IEEE F_1_p0_2 1 2 -3.402823466E+038 3.402823466E+038 ECU_ADDRESS 0x70003F18 /end MEASUREMENT
/begin MEASUREMENT SDMTMEP_CosScaled "scaled value of the resolver cosinus measure" FLOAT32_IEEE F_1_p0_2 1 2 -3.402823466E+038 3.402823466E+038 ECU_ADDRESS 0x70003F14 /end MEASUREMENT
/begin MEASUREMENT SDMTMEP_CosSignSumZ "SDMTMEP_CosSignSumZ" FLOAT32_IEEE F_1_p0_2 1 2 -3.402823466E+038 3.402823466E+038 ECU_ADDRESS 0x70003F10 /end MEASUREMENT
/begin MEASUREMENT SDMTMEP_DeltaTheta "difference between resolver angle and estimated angle" FLOAT32_IEEE F_1_p0_2 1 2 -3.402823466E+038 3.402823466E+038 ECU_ADDRESS 0x70003F0C /end MEASUREMENT
/begin MEASUREMENT SDMTMEP_ElecSpeedRds "electrical speed" FLOAT32_IEEE F_1_p0_2 1 2 -3.402823466E+038 3.402823466E+038 ECU_ADDRESS 0x70003F08 /end MEASUREMENT
/begin MEASUREMENT SDMTMEP_ErrorThetaElecRdSurPi "SDMTMEP_ErrorThetaElecRdSurPi" FLOAT32_IEEE F_1_p0_2 1 2 -3.402823466E+038 3.402823466E+038 ECU_ADDRESS 0x70003F04 /end MEASUREMENT
/begin MEASUREMENT SDMTMEP_EstimatedCos "cosinus of the resolver angle estimation" FLOAT32_IEEE F_1_p0_2 1 2 -3.402823466E+038 3.402823466E+038 ECU_ADDRESS 0x70003F00 /end MEASUREMENT
/begin MEASUREMENT SDMTMEP_EstimatedSin "sinus of the resolver angle estimation" FLOAT32_IEEE F_1_p0_2 1 2 -3.402823466E+038 3.402823466E+038 ECU_ADDRESS 0x70003EFC /end MEASUREMENT
/begin MEASUREMENT SDMTMEP_Flg2BSW "Bench Mode value with 1 time delay" UBYTE Bool_ON_OFF 1 2 0 1 BIT_MASK 0x01 ECU_ADDRESS 0x70003EF8 /end MEASUREMENT
/begin MEASUREMENT SDMTMEP_Flg2BSWCntZ "SDMTMEP_Flg2BSWCntZ" FLOAT32_IEEE F_1_p0_2 1 2 -3.402823466E+038 3.402823466E+038 ECU_ADDRESS 0x70003EF4 /end MEASUREMENT
/begin MEASUREMENT SDMTMEP_ForwardDirect "SDMTMEP_ForwardDirect" SBYTE F_1_p0_2 1 2 -128 127 ECU_ADDRESS 0x70003EF0 /end MEASUREMENT
/begin MEASUREMENT SDMTMEP_GainCosSignFit "SDMTMEP_GainCosSignFit" FLOAT32_IEEE F_1_p0_2 1 2 -3.402823466E+038 3.402823466E+038 ECU_ADDRESS 0x70003EEC /end MEASUREMENT
/begin MEASUREMENT SDMTMEP_GainCosTrim "SDMTMEP_GainCosTrim" FLOAT32_IEEE F_1_p0_2 1 2 -3.402823466E+038 3.402823466E+038 ECU_ADDRESS 0x70003EE8 /end MEASUREMENT
/begin MEASUREMENT SDMTMEP_GainCosTrimCal "SDMTMEP_GainCosTrimCal" FLOAT32_IEEE F_1_p0_2 1 2 -3.402823466E+038 3.402823466E+038 ECU_ADDRESS 0x70003EE4 /end MEASUREMENT
/begin MEASUREMENT SDMTMEP_GainSinTrim "SDMTMEP_GainSinTrim" FLOAT32_IEEE F_1_p0_2 1 2 -3.402823466E+038 3.402823466E+038 ECU_ADDRESS 0x70003EE0 /end MEASUREMENT
/begin MEASUREMENT SDMTMEP_GainSinTrimCal "SDMTMEP_GainSinTrimCal" FLOAT32_IEEE F_1_p0_2 1 2 -3.402823466E+038 3.402823466E+038 ECU_ADDRESS 0x70003EDC /end MEASUREMENT
/begin MEASUREMENT SDMTMEP_HalfRdSurPiCadran2or4 "signal equal to 0.5rd/pi when the angle is in the 2 or 4 quadrant of the unit circle" UWORD F_0v0000152588_p0_39 1 2 0 0.9999847412 ECU_ADDRESS 0x70003ED8 /end MEASUREMENT
/begin MEASUREMENT SDMTMEP_IllegalResParDetn "SDMTMEP_IllegalResParDetn" UBYTE Bool_ON_OFF 1 2 0 1 BIT_MASK 0x01 ECU_ADDRESS 0x70003ED6 /end MEASUREMENT
/begin MEASUREMENT SDMTMEP_IllegalResParFlt "SDMTMEP_IllegalResParFlt" UBYTE Bool_ON_OFF 1 2 0 1 BIT_MASK 0x01 ECU_ADDRESS 0x70003ED5 /end MEASUREMENT
/begin MEASUREMENT SDMTMEP_IllegalResParFltLock "SDMTMEP_IllegalResParFltLock" UBYTE Bool_ON_OFF 1 2 0 1 BIT_MASK 0x01 ECU_ADDRESS 0x70003ED4 /end MEASUREMENT
/begin MEASUREMENT SDMTMEP_ImposedThetaZ "SDMTMEP_ImposedThetaZ" FLOAT32_IEEE F_1_p0_2 1 2 -3.402823466E+038 3.402823466E+038 ECU_ADDRESS 0x70003ED0 /end MEASUREMENT
/begin MEASUREMENT SDMTMEP_MecaSpeedRds "value of the motor mechanical speed" FLOAT32_IEEE F_1_p0_2 1 2 -3.402823466E+038 3.402823466E+038 ECU_ADDRESS 0x70003ECC /end MEASUREMENT
/begin MEASUREMENT SDMTMEP_MecaSpeedRpm "value of the motor mechanical speed" FLOAT32_IEEE F_1_p0_2 1 2 -3.402823466E+038 3.402823466E+038 ECU_ADDRESS 0x70003EC8 /end MEASUREMENT
/begin MEASUREMENT SDMTMEP_MecaSpeedRpmOc "SDMTMEP_MecaSpeedRpmOc" FLOAT32_IEEE F_1_p0_2 1 2 -3.402823466E+038 3.402823466E+038 ECU_ADDRESS 0x70003EC4 /end MEASUREMENT
/begin MEASUREMENT SDMTMEP_OcCosAdcFildZ "SDMTMEP_OcCosAdcFildZ" FLOAT32_IEEE F_1_p0_2 1 2 -3.402823466E+038 3.402823466E+038 ECU_ADDRESS 0x70003EC0 /end MEASUREMENT
/begin MEASUREMENT SDMTMEP_OcRotoringFailFlg "SDMTMEP_OcRotoringFailFlg" UBYTE Bool_ON_OFF 1 2 0 1 BIT_MASK 0x01 ECU_ADDRESS 0x70003EBD /end MEASUREMENT
/begin MEASUREMENT SDMTMEP_OcRotoringNormal "SDMTMEP_OcRotoringNormal" UBYTE Bool_ON_OFF 1 2 0 1 BIT_MASK 0x01 ECU_ADDRESS 0x70003EBC /end MEASUREMENT
/begin MEASUREMENT SDMTMEP_OcSinAdcFildZ "SDMTMEP_OcSinAdcFildZ" FLOAT32_IEEE F_1_p0_2 1 2 -3.402823466E+038 3.402823466E+038 ECU_ADDRESS 0x70003EB8 /end MEASUREMENT
/begin MEASUREMENT SDMTMEP_OffsetCosTrim "SDMTMEP_OffsetCosTrim" FLOAT32_IEEE F_1_p0_2 1 2 -3.402823466E+038 3.402823466E+038 ECU_ADDRESS 0x70003EB4 /end MEASUREMENT
/begin MEASUREMENT SDMTMEP_OffsetCosTrimCal "SDMTMEP_OffsetCosTrimCal" FLOAT32_IEEE F_1_p0_2 1 2 -3.402823466E+038 3.402823466E+038 ECU_ADDRESS 0x70003EB0 /end MEASUREMENT
/begin MEASUREMENT SDMTMEP_OffsetSinTrim "SDMTMEP_OffsetSinTrim" FLOAT32_IEEE F_1_p0_2 1 2 -3.402823466E+038 3.402823466E+038 ECU_ADDRESS 0x70003EAC /end MEASUREMENT
/begin MEASUREMENT SDMTMEP_OffsetSinTrimCal "SDMTMEP_OffsetSinTrimCal" FLOAT32_IEEE F_1_p0_2 1 2 -3.402823466E+038 3.402823466E+038 ECU_ADDRESS 0x70003EA8 /end MEASUREMENT
/begin MEASUREMENT SDMTMEP_PerdTimerZ "SDMTMEP_PerdTimerZ" UWORD F_1_p0_2 1 2 0 65535 ECU_ADDRESS 0x70003EA4 /end MEASUREMENT
/begin MEASUREMENT SDMTMEP_PosCompError "SDMTMEP_PosCompError" FLOAT32_IEEE F_1_p0_2 1 2 -3.402823466E+038 3.402823466E+038 ECU_ADDRESS 0x70003EA0 /end MEASUREMENT
/begin MEASUREMENT SDMTMEP_PrevElecSpeedRds "SDMTMEP_PrevElecSpeedRds" FLOAT32_IEEE F_1_p0_2 1 2 -3.402823466E+038 3.402823466E+038 ECU_ADDRESS 0x70003E9C /end MEASUREMENT
/begin MEASUREMENT SDMTMEP_PrevThetaElecRdSurPi "SDMTMEP_PrevThetaElecRdSurPi" FLOAT32_IEEE F_1_p0_2 1 2 -3.402823466E+038 3.402823466E+038 ECU_ADDRESS 0x70003E98 /end MEASUREMENT
/begin MEASUREMENT SDMTMEP_RecoverCntZ "SDMTMEP_RecoverCntZ" FLOAT32_IEEE F_1_p0_2 1 2 -3.402823466E+038 3.402823466E+038 ECU_ADDRESS 0x70003E94 /end MEASUREMENT
/begin MEASUREMENT SDMTMEP_RecoverFlgZ "Bench Mode value with 1 time delay" UBYTE Bool_ON_OFF 1 2 0 1 BIT_MASK 0x01 ECU_ADDRESS 0x70003E91 /end MEASUREMENT
/begin MEASUREMENT SDMTMEP_RecoverFlgZZ "Bench Mode value with 1 time delay" UBYTE Bool_ON_OFF 1 2 0 1 BIT_MASK 0x01 ECU_ADDRESS 0x70003E90 /end MEASUREMENT
/begin MEASUREMENT SDMTMEP_ResThetaRdSurPiOcZ "SDMTMEP_ResThetaRdSurPiOcZ" FLOAT32_IEEE F_1_p0_2 1 2 -3.402823466E+038 3.402823466E+038 ECU_ADDRESS 0x70003E8C /end MEASUREMENT
/begin MEASUREMENT SDMTMEP_ResolNextThetaRdByPi "next time step value of the resolver angle" FLOAT32_IEEE F_1_p0_2 1 2 -3.402823466E+038 3.402823466E+038 ECU_ADDRESS 0x70003E88 /end MEASUREMENT
/begin MEASUREMENT SDMTMEP_ResolverAbnormalFlg "SDMTMEP_ResolverAbnormalFlg" UBYTE Bool_ON_OFF 1 2 0 1 BIT_MASK 0x01 ECU_ADDRESS 0x70003E84 /end MEASUREMENT
/begin MEASUREMENT SDMTMEP_ResolverAcceleration "resolver acceleration" FLOAT32_IEEE F_1_p0_2 1 2 -3.402823466E+038 3.402823466E+038 ECU_ADDRESS 0x70003E80 /end MEASUREMENT
/begin MEASUREMENT SDMTMEP_ResolverPositionFailFlg "SDMTMEP_ResolverPositionFailFlg" UBYTE Bool_ON_OFF 1 2 0 1 BIT_MASK 0x01 ECU_ADDRESS 0x70003E7C /end MEASUREMENT
/begin MEASUREMENT SDMTMEP_ResolverSpeedRds "resolver speed" FLOAT32_IEEE F_1_p0_2 1 2 -1000000 1000000 ECU_ADDRESS 0x70003E78 /end MEASUREMENT
/begin MEASUREMENT SDMTMEP_ResolverSpeedRdsFild "resolver speed" FLOAT32_IEEE F_1_p0_2 1 2 -1000000 1000000 ECU_ADDRESS 0x70003E74 /end MEASUREMENT
/begin MEASUREMENT SDMTMEP_ResolverSpeedRdsFildOc "resolver speed" FLOAT32_IEEE F_1_p0_2 1 2 -1000000 1000000 ECU_ADDRESS 0x70003E70 /end MEASUREMENT
/begin MEASUREMENT SDMTMEP_ResolverSpeedRdsFildZ "resolver speed filtered with 1 time delay" FLOAT32_IEEE F_1_p0_2 1 2 -3.402823466E+038 3.402823466E+038 ECU_ADDRESS 0x70003E6C /end MEASUREMENT
/begin MEASUREMENT SDMTMEP_ResolverSpeedRdsOcZ "resolver speed with 1 time delay" FLOAT32_IEEE F_1_p0_2 1 2 -1000000 1000000 ECU_ADDRESS 0x70003E68 /end MEASUREMENT
/begin MEASUREMENT SDMTMEP_ResolverSpeedRdsZ "resolver speed with 1 time delay" FLOAT32_IEEE F_1_p0_2 1 2 -1000000 1000000 ECU_ADDRESS 0x70003E64 /end MEASUREMENT
/begin MEASUREMENT SDMTMEP_ResolverThetaRdSurPi "value of the resolver angle" FLOAT32_IEEE F_1_p0_2 1 2 -3.402823466E+038 3.402823466E+038 ECU_ADDRESS 0x70003E60 /end MEASUREMENT
/begin MEASUREMENT SDMTMEP_ResolverThetaRdSurPiOc "value of the resolver angle" FLOAT32_IEEE F_1_p0_2 1 2 -3.402823466E+038 3.402823466E+038 ECU_ADDRESS 0x70003E5C /end MEASUREMENT
/begin MEASUREMENT SDMTMEP_ResolverThetaRdSurPiOcZ "value of the resolver angle with 1 time delay" FLOAT32_IEEE F_1_p0_2 1 2 -3.402823466E+038 3.402823466E+038 ECU_ADDRESS 0x70003E58 /end MEASUREMENT
/begin MEASUREMENT SDMTMEP_ResolverThetaRdSurPiZ "value of the resolver angle with 1 time delay" FLOAT32_IEEE F_1_p0_2 1 2 -3.402823466E+038 3.402823466E+038 ECU_ADDRESS 0x70003E54 /end MEASUREMENT
/begin MEASUREMENT SDMTMEP_SinGndDetn "SDMTMEP_SinGndDetn" UBYTE Bool_ON_OFF 1 2 0 1 BIT_MASK 0x01 ECU_ADDRESS 0x70003E50 /end MEASUREMENT
/begin MEASUREMENT SDMTMEP_SinResultAvgMax "SDMTMEP_SinResultAvgMax" FLOAT32_IEEE F_1_p0_2 1 2 -3.402823466E+038 3.402823466E+038 ECU_ADDRESS 0x70003E4C /end MEASUREMENT
/begin MEASUREMENT SDMTMEP_SinResultAvgMin "SDMTMEP_SinResultAvgMin" FLOAT32_IEEE F_1_p0_2 1 2 -3.402823466E+038 3.402823466E+038 ECU_ADDRESS 0x70003E48 /end MEASUREMENT
/begin MEASUREMENT SDMTMEP_SinResultMax "SDMTMEP_SinResultMax" FLOAT32_IEEE F_1_p0_2 1 2 -3.402823466E+038 3.402823466E+038 ECU_ADDRESS 0x70003E44 /end MEASUREMENT
/begin MEASUREMENT SDMTMEP_SinResultMaxSumZ "SDMTMEP_SinResultMaxSumZ" FLOAT32_IEEE F_1_p0_2 1 2 -3.402823466E+038 3.402823466E+038 ECU_ADDRESS 0x70003E40 /end MEASUREMENT
/begin MEASUREMENT SDMTMEP_SinResultMaxZ "SDMTMEP_SinResultMaxZ" FLOAT32_IEEE F_1_p0_2 1 2 -3.402823466E+038 3.402823466E+038 ECU_ADDRESS 0x70003E3C /end MEASUREMENT
/begin MEASUREMENT SDMTMEP_SinResultMin "SDMTMEP_SinResultMin" FLOAT32_IEEE F_1_p0_2 1 2 -3.402823466E+038 3.402823466E+038 ECU_ADDRESS 0x70003E38 /end MEASUREMENT
/begin MEASUREMENT SDMTMEP_SinResultMinSumZ "SDMTMEP_SinResultMinSumZ" FLOAT32_IEEE F_1_p0_2 1 2 -3.402823466E+038 3.402823466E+038 ECU_ADDRESS 0x70003E34 /end MEASUREMENT
/begin MEASUREMENT SDMTMEP_SinResultMinZ "SDMTMEP_SinResultMinZ" FLOAT32_IEEE F_1_p0_2 1 2 -3.402823466E+038 3.402823466E+038 ECU_ADDRESS 0x70003E30 /end MEASUREMENT
/begin MEASUREMENT SDMTMEP_SinScaled "scaled value of the resolver sinus measure" FLOAT32_IEEE F_1_p0_2 1 2 -3.402823466E+038 3.402823466E+038 ECU_ADDRESS 0x70003E2C /end MEASUREMENT
/begin MEASUREMENT SDMTMEP_SinVccDetn "SDMTMEP_SinVccDetn" UBYTE Bool_ON_OFF 1 2 0 1 BIT_MASK 0x01 ECU_ADDRESS 0x70003E28 /end MEASUREMENT
/begin MEASUREMENT SDMTMEP_SingleConversion "Single conversion of SDMTMEP_HalfRdSurPiCadran2or4" FLOAT32_IEEE F_1_p0_2 1 2 -3.402823466E+038 3.402823466E+038 ECU_ADDRESS 0x70003E24 /end MEASUREMENT
/begin MEASUREMENT SDMTMEP_SpeedCmpFailFlg "SDMTMEP_SpeedCmpFailFlg" UBYTE Bool_ON_OFF 1 2 0 1 BIT_MASK 0x01 ECU_ADDRESS 0x70003E20 /end MEASUREMENT
/begin MEASUREMENT SDMTMEP_ThetaElecRdSurPi "value of the electrical angle" FLOAT32_IEEE F_1_p0_2 1 2 -3.402823466E+038 3.402823466E+038 ECU_ADDRESS 0x70003E1C /end MEASUREMENT
/begin MEASUREMENT SDMTMEP_ThetaInitRdSurPi "initial value of the resolver angle" FLOAT32_IEEE F_1_p0_2 1 2 -3.402823466E+038 3.402823466E+038 ECU_ADDRESS 0x70003E18 /end MEASUREMENT
/begin MEASUREMENT SDMTMEP_ThetaTempRdSurPi "intermediate angle" FLOAT32_IEEE F_1_p0_2 1 2 -3.402823466E+038 3.402823466E+038 ECU_ADDRESS 0x70003E14 /end MEASUREMENT
/begin MEASUREMENT SDMTMEP_ThetaTempRdSurPiOc "intermediate angle" FLOAT32_IEEE F_1_p0_2 1 2 -3.402823466E+038 3.402823466E+038 ECU_ADDRESS 0x70003E10 /end MEASUREMENT
/begin MEASUREMENT SDMTMEP_ThetaTempRdSurPiOcZ "intermediate angle with 1 time delay" FLOAT32_IEEE F_1_p0_2 1 2 -3.402823466E+038 3.402823466E+038 ECU_ADDRESS 0x70003E0C /end MEASUREMENT
/begin MEASUREMENT SDMTMEP_ThetaTempRdSurPiZ "intermediate angle with 1 time delay" FLOAT32_IEEE F_1_p0_2 1 2 -3.402823466E+038 3.402823466E+038 ECU_ADDRESS 0x70003E08 /end MEASUREMENT
/begin MEASUREMENT SD_AutoPhasingAngle_F32 "SD_AutoPhasingAngle_F32" FLOAT32_IEEE F_1_p0_2 1 2 -3.402823466E+038 3.402823466E+038 ECU_ADDRESS 0x70003DDC /end MEASUREMENT
/begin MEASUREMENT SD_AutophasingCal_F32 "SD_AutophasingCal_F32" FLOAT32_IEEE F_1_p0_2 1 2 -3.402823466E+038 3.402823466E+038 ECU_ADDRESS 0x70003DD8 /end MEASUREMENT
/begin MEASUREMENT SD_FtModeReq_U16 "SD_FtModeReq_U16" UWORD F_1_p0_2 1 2 0 65535 ECU_ADDRESS 0x70003DD4 /end MEASUREMENT
/begin MEASUREMENT SD_GainCosTrim_F32 "SD_GainCosTrim_F32" FLOAT32_IEEE F_1_p0_2 1 2 -3.402823466E+038 3.402823466E+038 ECU_ADDRESS 0x70003DD0 /end MEASUREMENT
/begin MEASUREMENT SD_GainSinTrim_F32 "SD_GainSinTrim_F32" FLOAT32_IEEE F_1_p0_2 1 2 -3.402823466E+038 3.402823466E+038 ECU_ADDRESS 0x70003DCC /end MEASUREMENT
/begin MEASUREMENT SD_ImposedThetaRdSurPi_F32 "SD_ImposedThetaRdSurPi_F32" FLOAT32_IEEE F_1_p0_2 1 2 -3.402823466E+038 3.402823466E+038 ECU_ADDRESS 0x70003DC8 /end MEASUREMENT
/begin MEASUREMENT SD_Iuvw3_F32[0] "SD_Iuvw3_F32" FLOAT32_IEEE F_1_p0_2 1 2 -3.402823466E+038 3.402823466E+038 ECU_ADDRESS 0x70003DBC /end MEASUREMENT
/begin MEASUREMENT SD_Iuvw3_F32[1] "SD_Iuvw3_F32" FLOAT32_IEEE F_1_p0_2 1 2 -3.402823466E+038 3.402823466E+038 ECU_ADDRESS 0x70003DC0 /end MEASUREMENT
/begin MEASUREMENT SD_Iuvw3_F32[2] "SD_Iuvw3_F32" FLOAT32_IEEE F_1_p0_2 1 2 -3.402823466E+038 3.402823466E+038 ECU_ADDRESS 0x70003DC4 /end MEASUREMENT
/begin MEASUREMENT SD_MTMEPState_U16 "SD_MTMEPState_U16" UWORD F_1_p0_2 1 2 0 65535 ECU_ADDRESS 0x70003DBA /end MEASUREMENT
/begin MEASUREMENT SD_OccycleFinish_B "SD_OccycleFinish_B" UBYTE Bool_ON_OFF 1 2 0 1 BIT_MASK 0x01 ECU_ADDRESS 0x70003DB8 /end MEASUREMENT
/begin MEASUREMENT SD_OffsetCosTrim_F32 "SD_OffsetCosTrim_F32" FLOAT32_IEEE F_1_p0_2 1 2 -3.402823466E+038 3.402823466E+038 ECU_ADDRESS 0x70003DB4 /end MEASUREMENT
/begin MEASUREMENT SD_OffsetSinTrim_F32 "SD_OffsetSinTrim_F32" FLOAT32_IEEE F_1_p0_2 1 2 -3.402823466E+038 3.402823466E+038 ECU_ADDRESS 0x70003DB0 /end MEASUREMENT
/begin MEASUREMENT SD_ResolverSinCos2_U16[0] "SD_ResolverSinCos2_U16" UWORD F_1_p0_2 1 2 0 65535 ECU_ADDRESS 0x70003DAC /end MEASUREMENT
/begin MEASUREMENT SD_ResolverSinCos2_U16[1] "SD_ResolverSinCos2_U16" UWORD F_1_p0_2 1 2 0 65535 ECU_ADDRESS 0x70003DAE /end MEASUREMENT
/begin MEASUREMENT SD_RotoringCalEnable_B "SD_RotoringCalEnable_B" UBYTE Bool_ON_OFF 1 2 0 1 BIT_MASK 0x01 ECU_ADDRESS 0x70003DAA /end MEASUREMENT
/begin MEASUREMENT SD_RotoringCalFinish_B "SD_RotoringCalFinish_B" UBYTE Bool_ON_OFF 1 2 0 1 BIT_MASK 0x01 ECU_ADDRESS 0x70003DA9 /end MEASUREMENT
/begin MEASUREMENT SD_RotoringCalStart_B "SD_RotoringCalStart_B" UBYTE Bool_ON_OFF 1 2 0 1 BIT_MASK 0x01 ECU_ADDRESS 0x70003DA8 /end MEASUREMENT
/begin COMPU_METHOD F_1_p0_2 "" RAT_FUNC "%9.2" "" COEFFS 0 1 0 0 0 1 /end COMPU_METHOD
/begin COMPU_METHOD F_0v0000152588_p0_39 "" RAT_FUNC "%9.5" "" COEFFS 0 1 0 0 0 1.52588e-005 /end COMPU_METHOD
/begin COMPU_METHOD Id_0x00 "" RAT_FUNC "%9.2" "." COEFFS 0 1 0 0 0 1 /end COMPU_METHOD
/begin COMPU_METHOD Bool_ON_OFF "" TAB_VERB "%8.4" "." COMPU_TAB_REF Bool_ON_OFF_table /end COMPU_METHOD
/begin COMPU_VTAB Bool_ON_OFF_table "" TAB_VERB 2 0 "OFF" 1 "ON" /end COMPU_VTAB
/begin FUNCTION SWC_FT ""
 /begin DEF_CHARACTERISTIC AFTASBDS_BatVoltDrtEnableC AFTASBDS_LutBatteryDeratingGainC AFTASBDS_LutBatteryVoltageC AFTASBDS_LutInMecaSpeedRpmC AFTASBDS_LutOutDeratingGainC AFTASBDS_ManualDeratingGainC AFTASBDS_MaxDeratingGainC AFTASBDS_MinDeratingGainC AFTASBDS_UbatHVNominalC AFTASDPM_I0DeratingMaxC AFTASDPM_I0DeratingMinC AFTASDPM_IdDeratingMaxC AFTASDPM_IdDeratingMinC AFTASDPM_IqDeratingMaxC AFTASDPM_IqDeratingMinC AFTASDPM_SpeedDrtMaxRpmC AFTASDPM_SpeedDrtMinRpmC AFTASETP_ControllerPmKiC AFTASETP_ControllerPmKpC AFTASETP_MaxDeratingGainC AFTASETP_MinDeratingGainC AFTASETP_PmDrtEnableC AFTASETP_PmKiMaxC AFTASETP_PmMaximalTempC AFTASMTP_ControllerWndgKiC AFTASMTP_ControllerWndgKpC AFTASMTP_MaxDeratingGainC AFTASMTP_MinDeratingGainC AFTASMTP_WndgDrtEnableC AFTASMTP_WndgKiMaxC AFTASMTP_WndgMaximalTempC AFTASOSP_LutMotDeratingGainC AFTASOSP_LutMotorSpeedC AFTASOSP_ManualDeratingGainC AFTASOSP_MaxDeratingGainC AFTASOSP_MinDeratingGainC AFTASOSP_MotorSpdDrtEnableC AFTCIVDC_AntiNarrowPulseEnC AFTCIVDC_Concordia33C AFTCIVDC_DeadComDisableIsC AFTCIVDC_DeadComEnableIsC AFTCIVDC_DeadCompCurFildNumC AFTCIVDC_DeadCompDutyFildNumC AFTCIVDC_DeadCurrentSwitchC AFTCIVDC_DeadZnCompEnaC AFTCIVDC_DeadZnCompSpeedHighC AFTCIVDC_DeadZnCompSpeedLowC AFTCIVDC_DeadZoneTimeUsC AFTCIVDC_DefaultPwmFrequencyC AFTCIVDC_DutyCycleMaxC AFTCIVDC_DutyCycleMinC AFTCIVDC_ExtPwmOnOff3C AFTCIVDC_FpgaDutyCycleMinMaxC AFTCIVDC_InitDutyCycle3C AFTCIVDC_InitPwmOnOff3C AFTCIVDC_LutMecaspeedRpmC AFTCIVDC_LutPwmFrequenceC AFTCIVDC_MecaSpdCutOffFrequencyC AFTCIVDC_NarrowPulseTimeC AFTCIVDC_OperationnalPwmOnOff3C AFTCIVDC_PwmFrequenceMaxC AFTCIVDC_PwmFrequenceMinC AFTCIVDC_PwmZeroMatchEnC AFTCIVDC_PwmZeroMatchRevC AFTCIVDC_UbatHVLowSatC AFTCIVDC_VFreqEnableC AFTCMCCS_CurrentLoopOrgEnC AFTCMCCS_EM1dOpenLoopGainC AFTCMCCS_EM1qOpenLoopGainC AFTCMCCS_GenTableTorqueThrdC AFTCMCCS_HFIAmplitudeC AFTCMCCS_HFIEnC AFTCMCCS_HFIOnePeriodPointsC AFTCMCCS_IdCurrLoopParOnOffC AFTCMCCS_iM1dTgtFildTrC AFTCMCCS_iM1qTgtFildTrC AFTCMCCS_InitU0dqTgt3C AFTCMCCS_IqCurrLoopParOnOffC AFTCMCCS_Lm0C AFTCMCCS_Lm1dC AFTCMCCS_Lm1qC AFTCMCCS_LutElecSpeedRds3C AFTCMCCS_LutInSpeedRpmC AFTCMCCS_LutInUbatC AFTCMCCS_LutM0CtrlTrC AFTCMCCS_LutOutM1dCtrlTrGC AFTCMCCS_LutOutM1dCtrlTrMC AFTCMCCS_LutOutM1qCtrlTrGC AFTCMCCS_LutOutM1qCtrlTrMC AFTCMCCS_M1dCtrlTrC AFTCMCCS_M1qCtrlTrC AFTCMCCS_PhimC AFTCMCCS_RsC AFTCMCCS_SampleTimeFactC AFTCMCCS_TransEmfM1dGainC AFTCMCCS_TransEmfM1qGainC AFTCMCCS_VariableLm1dOnOffC AFTCMCCS_VariableLm1qOnOffC AFTCMCCS_VariablePhimOnOffC AFTCMRPC_ConcordiaTrans33C AFTCMRPC_HFIEnC AFTCMRPC_HFIENSOnOffC AFTCMRPC_HFINSAddPiC AFTCMRPC_HFIPLLK1ParameterC AFTCMRPC_HFIPLLK2ParameterC AFTCMRPC_HFIPLLSpeedCutoffFrcC AFTCMRPC_HFISecondHarmonicGainC AFTCMRPC_HFISHCutOffC AFTCMRPC_i2mGainC AFTCMSCS_ClimbOverCntC AFTCMSCS_ClimbOverSpdH2OMinRateC AFTCMSCS_ClimbOverSpdRateMaxC AFTCMSCS_ClimbOverSpeedRpmC AFTCMSCS_ClimbSpdUpStepRateMinC AFTCMSCS_ClimbSpeedFailRateC AFTCMSCS_ClimbSpeedRpmUpStepC AFTCMSCS_ClimbStartCosPhiC AFTCMSCS_ClimbStartDampingKwC AFTCMSCS_ClimbStartIqC AFTCMSCS_ClimbStartKiC AFTCMSCS_ClimbStartKpC AFTCMSCS_ClimbStartMinUErrC AFTCMSCS_ClimbStartPmCutOffFreqC AFTCMSCS_ClimbStIFAdaptEnAnglC AFTCMSCS_CloseIdTgtLutInSpeedRpmC AFTCMSCS_CloseIdTgtLutOutC AFTCMSCS_CloseLoopIdTgtC AFTCMSCS_CloseLoopSpeedRpmC AFTCMSCS_CloseRunFailCntC AFTCMSCS_Dece2ZeroCntC AFTCMSCS_DecelerationIdC AFTCMSCS_DecelerationIqC AFTCMSCS_DeceSpeedRpmDownStepC AFTCMSCS_HFI2OBSCntC AFTCMSCS_HFI2OBSMecaSpdRpmRangeC AFTCMSCS_HFICloseCntC AFTCMSCS_HFICloseFailNumMaxC AFTCMSCS_HFIElecThetaCloseMaxC AFTCMSCS_HFIMecaSpdRpmCloseMaxC AFTCMSCS_HFIThetaDiffMaxC AFTCMSCS_IdTgtFildTrC AFTCMSCS_IqTgtFildTrC AFTCMSCS_KwModeC AFTCMSCS_MagneticLinkCompIqMaxC AFTCMSCS_MaIqTgtLutInSpeedRpmC AFTCMSCS_MaIqTgtLutOutC AFTCMSCS_ManCtrlKiC AFTCMSCS_ManCtrlKpC AFTCMSCS_ManualIdTgtC AFTCMSCS_ManualIqTgtTableEnC AFTCMSCS_ManualObsStateC AFTCMSCS_ManualOpenAngleStateC AFTCMSCS_MotorReverseEnC AFTCMSCS_NotStopSpeedRpmC AFTCMSCS_ObsStateByPassC AFTCMSCS_ObsStateByPassEnC AFTCMSCS_OpenAngleDeltaMinC AFTCMSCS_OverSpeedCntC AFTCMSCS_OverSpeedRpmC AFTCMSCS_PrePositionDCntC AFTCMSCS_PrePositionIdC AFTCMSCS_PrePositionIqC AFTCMSCS_PrePositionQCntC AFTCMSCS_ShiftIdIncreaseCntC AFTCMSCS_ShiftIdIncreaseStepC AFTCMSCS_ShiftIqDecreaseCntC AFTCMSCS_ShiftIqDecreaseRateC AFTCMSCS_ShiftRunIdMinC AFTCMSCS_ShiftRunIqMinC AFTCMSCS_ShiftRunTransTmsC AFTCMSCS_SpdMIqMinLutInSpdRpmC AFTCMSCS_SpdMIqMinLutOutC AFTCMSCS_SPEED_MODE AFTCMSCS_SpeedDiffCntC AFTCMSCS_SpeedDiffRateC AFTCMSCS_SpeedFilterNumC AFTCMSCS_StartFail2HFINumC AFTCMSCS_StartFailCntC AFTCMSCS_StartFailRateC AFTCMSCS_StopRunCntC AFTCMSCS_TorqueTgtMaxC AFTCMSTC_AccelRpmBySecondLutOutC AFTCMSTC_AccRpmBySecLutInSpdRpmC AFTCMTCS_BenchElecPowerMaxC AFTCMTCS_BenchElecTorqueMaxC AFTCMTCS_deg2radC AFTCMTCS_ExtTorqueMaxMinC AFTCMTCS_FluxControllerGainC AFTCMTCS_FluxControllerGainKiC AFTCMTCS_FluxControllerGainKpC AFTCMTCS_GainPhaseVoltagePeakC AFTCMTCS_GenTableTorqueThrdC AFTCMTCS_IdentificationAngleDegC AFTCMTCS_IdentificationIsTgtC AFTCMTCS_IdModeOnOffC AFTCMTCS_Initi0dqTgt3C AFTCMTCS_InitTorqueMaxMinC AFTCMTCS_iqCorEnaC AFTCMTCS_LutInSpeedRpmC AFTCMTCS_LutInUbatC AFTCMTCS_LutOutVolMarginGenC AFTCMTCS_LutOutVolMarginMotC AFTCMTCS_LutTorqueGainC AFTCMTCS_LutVoltageErrorC AFTCMTCS_MaxErrorFor100C AFTCMTCS_ParkCurrentMaxC AFTCMTCS_UbatHVLowSatC AFTCMTCS_VoltageLimiterOnOffC AFTCMTCS_VoltageMarginC AFTCMTCS_VoltMarginCtrlOnOffC AFTCMTTC_TorqueBySecondNegC AFTCMTTC_TorqueBySecondPosC AFTCMTTC_TorqueFildTrC AFTCMTTC_TrqSatThrdC AFTDDLMP_I0LimitMaxC AFTDDLMP_I0LimitMinC AFTDDLMP_IdLimitMaxC AFTDDLMP_IdLimitMinC AFTDDLMP_IqLimitMaxC AFTDDLMP_IqLimitMinC AFTDDLMP_PowerLimC AFTDDLMP_SpeedLimitMaxC AFTDDLMP_SpeedLimitMinC AFTDDLMP_TorqLimitMaxC AFTDDLMP_TorqLimitMinC AFTMTLCS_A2DGainIsuLC AFTMTLCS_A2DGainIsvLC AFTMTLCS_A2DGainIswLC AFTMTLCS_A2DHighThresholdC AFTMTLCS_A2DLowThresholdC AFTMTLCS_AD2CurrentUGainC AFTMTLCS_AD2CurrentVGainC AFTMTLCS_AD2CurrentWGainC AFTMTLCS_ContorHighThresholdC AFTMTLCS_ContorOverLoadCntC AFTMTLCS_ContorOverLoadCntMaxC AFTMTLCS_CounterInitC AFTMTLCS_CurrentCalEnableC AFTMTLCS_CurrentOffsetInitC AFTMTLCS_CurrentRmsCounterC AFTMTLCS_CurrentRmsCounterZC AFTMTLCS_CurrentRmsFTEnC AFTMTLCS_CurrentRmsSumInitC AFTMTLCS_ExtCurrentGainEnaC AFTMTLCS_ExtCurrentGainMaxC AFTMTLCS_ExtCurrentGainMinC AFTMTLCS_Init2DurationC AFTMTLCS_InitIuvw3C AFTMTLCS_IuGainC AFTMTLCS_IvGainC AFTMTLCS_IwGainC AFTMTLCS_LostPhaseDelayCntC AFTMTLCS_LostPhaseEnaEleSpdRdsC AFTMTLCS_LostPhaseMaxRateC AFTMTLCS_LostPhaseMinIRmsC AFTMTLCS_LutInCntrLoadRateC AFTMTLCS_LutInMotLoadCntC AFTMTLCS_LutInMotLoadRateC AFTMTLCS_LutOutCntrLoadCntC AFTMTLCS_MotCurrentThresholdC AFTMTLCS_MotorOverLoadCntC AFTMTLCS_MotorOverLoadCntMaxC AFTMTLCS_SpdCutOffFrequencyC AFTMTLCS_SumErrorNegThrC AFTMTLCS_SumErrorPosThrC AFTMTSEP_CurrentDelayTimeC AFTMTSEP_TimeAdvanceFactC AFTMTSEP_TimeDeltaC AFTSLOBS_CloseElecSpeedRdsC AFTSLOBS_CloseEleThetaRdC AFTSLOBS_DeltaUd_Filter_NumZC AFTSLOBS_DeltaUdKiC AFTSLOBS_DeltaUdKiOnOffC AFTSLOBS_DeltaUdKpC AFTSLOBS_ElecSpeedRds_Filter_NumZC AFTSLOBS_ElecThetaAddLutOutC AFTSLOBS_ElecThetaCloseCntC AFTSLOBS_ElecThetAddLutInSpdRdsC AFTSLOBS_ErrThetaElecMaxC AFTSLOBS_ErrThetaElecMinC AFTSLOBS_LutInSpeedRpmC AFTSLOBS_LutOutRunMinIsC AFTSLOBS_NormlizationLowC AFTSLOBS_ObsvMultSignC AFTSLOBS_pK1ParameterC AFTSLOBS_pK2ParameterC AFTSLOBS_PsiErrKpC AFTSLOBS_Rising2FastCntC AFTSLOBS_Rising2FastSpeedRdsC AFTSLOBS_RunIsLowCntC AFTSLOBS_SpdErrIqMinCntC AFTSLOBS_SpeedErrIqMinC AFTSLOBS_SwitchAtan2PllC AFTSMACS_AclSpeedThdC AFTSMACS_BenchModeC AFTSMACS_PwmOffSpeedThdC AFTSMACS_ReinitFaultC AFTSMACS_TestFaultC AFTSMACS_UbatHVMinC AFTSMACS_VsiTimerFreqRatioRefC AFTSMMAM_AclStateBypassOnOffC AFTSMMAM_AclStateBypassValueC AFTSMMAM_AftModeReqBypassOnOffC AFTSMMAM_AftModeReqBypassValueC AFTSMMAM_CMCCS_M0ConOnoffC AFTSMMAM_MTMEP_StateC FTASBDS_BatVoltDrtEnableC FTASBDS_LutBatteryDeratingGainC FTASBDS_LutBatteryVoltageC FTASBDS_LutInMecaSpeedRpmC FTASBDS_LutOutDeratingGainC FTASBDS_ManualDeratingGainC FTASBDS_MaxDeratingGainC FTASBDS_MinDeratingGainC FTASBDS_UbatHVNominalC FTASDPM_I0DeratingMaxC FTASDPM_I0DeratingMinC FTASDPM_IdDeratingMaxC FTASDPM_IdDeratingMinC FTASDPM_IqDeratingMaxC FTASDPM_IqDeratingMinC FTASDPM_SpeedDrtMaxRpmC FTASDPM_SpeedDrtMinRpmC FTASETP_ControllerEstPmKiC FTASETP_ControllerEstPmKpC FTASETP_ControllerPmKiC FTASETP_ControllerPmKpC FTASETP_EstPmDrtEnableC FTASETP_EstPmKiMaxC FTASETP_EstPmMaximalTempC FTASETP_LutInMecaSpeedRpmC FTASETP_MaxDeratingGainC FTASETP_MinDeratingGainC FTASETP_OpenLoopEstPmDrtGainC FTASETP_PmDrtEnableC FTASETP_PmKiMaxC FTASETP_PmMaximalTempC FTASMTP_ControllerWndgKiC FTASMTP_ControllerWndgKpC FTASMTP_MaxDeratingGainC FTASMTP_MinDeratingGainC FTASMTP_WndgDrtEnableC FTASMTP_WndgKiMaxC FTASMTP_WndgMaximalTempC FTASOSP_LutMotDeratingGainC FTASOSP_LutMotorSpeedC FTASOSP_ManualDeratingGainC FTASOSP_MaxDeratingGainC FTASOSP_MinDeratingGainC FTASOSP_MotorSpdDrtEnableC FTCIVDC_AntiNarrowPulseEnC FTCIVDC_Concordia33C FTCIVDC_DeadComDisableIsC FTCIVDC_DeadComEnableIsC FTCIVDC_DeadZnCompEnaC FTCIVDC_DeadZnCompSpeedHighC FTCIVDC_DeadZnCompSpeedLowC FTCIVDC_DeadZoneTimeUsC FTCIVDC_DefaultPwmFrequencyC FTCIVDC_DutyCycleMaxC FTCIVDC_DutyCycleMinC FTCIVDC_ExtPwmOnOff3C FTCIVDC_FpgaDutyCycleMinMaxC FTCIVDC_FreqRangC FTCIVDC_InitDutyCycle3C FTCIVDC_InitPwmOnOff3C FTCIVDC_LutDeadTimeCompUAngleC FTCIVDC_LutEitEstPwmRatioC FTCIVDC_LutInSpeedC FTCIVDC_LutMecaspeedRpmC FTCIVDC_LutOutDeadTimeCompGainC FTCIVDC_LutOutFreqLmtC FTCIVDC_LutPwmFrequenceC FTCIVDC_MecaSpdCutOffFrequencyC FTCIVDC_NarrowPulseTimeC FTCIVDC_OperationnalPwmOnOff3C FTCIVDC_PwmFrequenceMaxC FTCIVDC_PwmFrequenceMinC FTCIVDC_PwmZeroMatchEnC FTCIVDC_PwmZeroMatchRevC FTCIVDC_RandFreqEnC FTCIVDC_RdFreqTimeC FTCIVDC_SpdMaxC FTCIVDC_SpdMinC FTCIVDC_UbatHVLowSatC FTCIVDC_VFreqEnableC FTCMCCS_CurrentLoopOrgEnC FTCMCCS_EM1dOpenLoopGainC FTCMCCS_EM1qOpenLoopGainC FTCMCCS_GenTableTorqueThrdC FTCMCCS_IdCurrLoopParOnOffC FTCMCCS_iM1dTgtFildTr0C FTCMCCS_iM1dTgtFildTrC FTCMCCS_iM1qTgtFildTr0C FTCMCCS_iM1qTgtFildTrC FTCMCCS_InitU0dqTgt3C FTCMCCS_IqCurrLoopParOnOffC FTCMCCS_Lm0C FTCMCCS_Lm1dC FTCMCCS_Lm1qC FTCMCCS_LutElecSpeedRds3C FTCMCCS_LutInSpeedRpmC FTCMCCS_LutInUbatC FTCMCCS_LutM0CtrlTrC FTCMCCS_LutOutM1dCtrlTrGC FTCMCCS_LutOutM1dCtrlTrMC FTCMCCS_LutOutM1qCtrlTrGC FTCMCCS_LutOutM1qCtrlTrMC FTCMCCS_M1dCtrlTrC FTCMCCS_M1qCtrlTrC FTCMCCS_PhimC FTCMCCS_RsC FTCMCCS_SampleTimeFactC FTCMCCS_TransEmfM1dGainC FTCMCCS_TransEmfM1qGainC FTCMCCS_VariableLm1dOnOffC FTCMCCS_VariableLm1qOnOffC FTCMCCS_VariablePhimOnOffC FTCMCTC_CoggingCompGainC FTCMCTC_CoggingCompOnOffC FTCMCTC_CoggingPhaseRdC FTCMCTC_H3CurrentOnOffC FTCMCTC_H3CurrentRatioC FTCMCTC_LutCoggingCompGainC FTCMCTC_LutElecSpeedRds2C FTCMCTC_LutElecSpeedRdsC FTCMCTC_LutH3CompGainC FTCMHIJ_11thIdCtrlTrC FTCMHIJ_11thIqCtrlTrC FTCMHIJ_11thMtrLdqCoeffC FTCMHIJ_11thSecLpfFrqThrC FTCMHIJ_11thUsLimtC FTCMHIJ_13thIdCtrlTrC FTCMHIJ_13thMtrLdqCoeffC FTCMHIJ_13thUsLimtC FTCMHIJ_3rdSecLpfFrqThrC FTCMHIJ_48thLutInSpeedC FTCMHIJ_48thLutInTorqueGenC FTCMHIJ_48thLutInTorqueMotC FTCMHIJ_5thIdCtrlTrC FTCMHIJ_5thIqCtrlTrC FTCMHIJ_5thMtrLdCoeffC FTCMHIJ_5thMtrLqCoeffC FTCMHIJ_5thMtrRsCoeffC FTCMHIJ_5thSecLpfFrqThrC FTCMHIJ_5thUsLimtC FTCMHIJ_7thIdCtrlTrC FTCMHIJ_7thIqCtrlTrC FTCMHIJ_7thMtrLdCoeffC FTCMHIJ_7thMtrLqCoeffC FTCMHIJ_7thMtrRsCoeffC FTCMHIJ_7thSecLpfFrqThrC FTCMHIJ_7thUsLimtC FTCMHIJ_b11thHijEnC FTCMHIJ_b13thHijEnC FTCMHIJ_b5thHijEnC FTCMHIJ_b7thHijEnC FTCMHIJ_bHijUoutActiveC FTCMHIJ_HijCurrentOnOffC FTCMHIJ_HijCurTgtLpfFcC FTCMHIJ_Hmc11OrderGainC FTCMHIJ_Hmc13OrderGainC FTCMHIJ_Hmc5OrderGainC FTCMHIJ_Hmc7OrderGainC FTCMHIJ_LpfDampCoeffC FTCMHIJ_LutInSpeedC FTCMHIJ_LutInTorqueC FTCMHIJ_LutOut11thIdTgtGenC FTCMHIJ_LutOut11thIdTgtMotC FTCMHIJ_LutOut11thIqTgtGenC FTCMHIJ_LutOut11thIqTgtMotC FTCMHIJ_LutOut13thIdTgtGenC FTCMHIJ_LutOut13thIdTgtMotC FTCMHIJ_LutOut13thIqTgtGenC FTCMHIJ_LutOut13thIqTgtMotC FTCMHIJ_LutOut5thIdTgtC FTCMHIJ_LutOut5thIqTgtC FTCMHIJ_LutOut7thIdTgtC FTCMHIJ_LutOut7thIqTgtC FTCMHIJ_ThetaCompFactInvC FTCMRPC_ConcordiaTrans33C FTCMSCS_CtrlSatToC FTCMSCS_CtrlTrC FTCMSCS_fC FTCMSCS_InitalValueEnC FTCMSCS_jC FTCMSCS_SpdAccPerMsThrC FTCMSCS_SpdOvershootFaultC FTCMSCS_ZeroSpdThrC FTCMSCS_ZeroSpdTimoutC FTCMSTC_AccelNegRpmBySecondC FTCMSTC_AccelPosRpmBySecondC FTCMTCS_AccelPosRpmBySecondC FTCMTCS_AntiSlideEnableC FTCMTCS_AntiSlideEnaCountMaxC FTCMTCS_AntiSlideLutInGenMecaSpdC FTCMTCS_AntiSlideLutInMecaSpdC FTCMTCS_BenchElecPowerMaxC FTCMTCS_BenchElecTorqueMaxC FTCMTCS_bGenSlipEnC FTCMTCS_CutOffFreqSlideDisEnC FTCMTCS_CutOffFreqSlideEnC FTCMTCS_CutOffFrequencySpdRpmC FTCMTCS_deg2radC FTCMTCS_DivideTorqMinC FTCMTCS_EntrySlideCountMaxC FTCMTCS_ExtTorqueMaxMinC FTCMTCS_FluxControllerGainC FTCMTCS_FluxControllerGainKiC FTCMTCS_FluxControllerGainKpC FTCMTCS_GainPhaseVoltagePeakC FTCMTCS_GenTableTorqueThrdC FTCMTCS_IdentificationAngleDegC FTCMTCS_IdentificationIsTgtC FTCMTCS_IdModeOnOffC FTCMTCS_Initi0dqTgt3C FTCMTCS_InitTorqueMaxMinC FTCMTCS_iqCorEnaC FTCMTCS_LowerAccPosRpmBySecondC FTCMTCS_LutAntiSlideGenTrqThrC FTCMTCS_LutAntiSlideTorqueThrC FTCMTCS_LutInAddSpeedRpmC FTCMTCS_LutInAddUbatC FTCMTCS_LutInMecaSpeedRpmC FTCMTCS_LutInSpeedRpmC FTCMTCS_LutInTorqueTgtC FTCMTCS_LutInUbatC FTCMTCS_LutInUbatHVC FTCMTCS_LutOutIdAdd0C FTCMTCS_LutOutIdAdd0MotC FTCMTCS_LutOutIdAddGenC FTCMTCS_LutOutIdAddMotC FTCMTCS_LutOutIqAddGenC FTCMTCS_LutOutIqAddMotC FTCMTCS_LutOutTorqueMaxC FTCMTCS_LutOutTorqueMinC FTCMTCS_LutOutVolMarginGenC FTCMTCS_LutOutVolMarginMotC FTCMTCS_LutSlideSpdRpmC FTCMTCS_LutTorqueGainC FTCMTCS_LutVoltageErrorC FTCMTCS_MaxErrorFor100C FTCMTCS_NegGenTrqThrC FTCMTCS_OneSecondCntC FTCMTCS_ParkCurrentMaxC FTCMTCS_SlideLutInUbatC FTCMTCS_SwitchElecTorqueRangeC FTCMTCS_SwitchElecTrqRange0C FTCMTCS_VoltageLimiterOnOffC FTCMTCS_VoltageMarginC FTCMTCS_VoltMarginCtrlOnOffC FTCMTTC_48thHijActHighSpdThrMaxC FTCMTTC_48thHijActHighSpdThrMinC FTCMTTC_48thHijActLowSpdThrMaxC FTCMTTC_48thHijActLowSpdThrMinC FTCMTTC_48thHijActTorqueThrMaxC FTCMTTC_48thHijActTorqueThrMinC FTCMTTC_AccPosRpmBySecondC FTCMTTC_AllHijOffTrqMaxC FTCMTTC_AllHijOffTrqMinC FTCMTTC_AllHijOffUdcMaxC FTCMTTC_AllHijOffUdcMinC FTCMTTC_AntiJerkMecaTorqueMaxC FTCMTTC_AntiJerkMecaTorqueMinC FTCMTTC_BpAccHighCutOffFrequencyC FTCMTTC_DampingEnableC FTCMTTC_DampingSpdHighC FTCMTTC_DampingSpdLowC FTCMTTC_DampTorqTgtHighThdC FTCMTTC_DampTorqueTargetThdC FTCMTTC_HijActHighSpdThrMaxC FTCMTTC_HijActHighSpdThrMinC FTCMTTC_HijActLowSpdThrMaxC FTCMTTC_HijActLowSpdThrMinC FTCMTTC_HijActTorqueThrMaxC FTCMTTC_HijActTorqueThrMinC FTCMTTC_HijEnGainFcC FTCMTTC_HijSpdRpmLpfFcC FTCMTTC_HijTrqTgtLpfFcC FTCMTTC_Lut3InMecaSpeedRpmC FTCMTTC_Lut3InTorqueTgtC FTCMTTC_Lut3InUbatC FTCMTTC_LutInMecaSpeedRpmC FTCMTTC_LutInSpdRpmAtjkDeltaC FTCMTTC_LutInSpdRpmBaseC FTCMTTC_LutInSpeedRpmDampingC FTCMTTC_LutInUbatC FTCMTTC_LutOutAntiJerkBaseGainC FTCMTTC_LutOutAtjkDeltaGainC FTCMTTC_LutOutCutOffFrequencyC FTCMTTC_LutOutMecaPowerC FTCMTTC_LutOutMecaPowerMinC FTCMTTC_MecaPowerMaxC FTCMTTC_MecaPowerMinC FTCMTTC_PowerLimtEnableC FTCMTTC_PreTorqSpdMaxC FTCMTTC_PreTorqSpdMinC FTCMTTC_PreTorqTrasRangeC FTCMTTC_PreTorqTrasStep2C FTCMTTC_PreTorqTrasStepMaxC FTCMTTC_PreTorqTrasStepMinC FTCMTTC_PreTorqueC FTCMTTC_PreTorqueEnableC FTCMTTC_PreTorqueStartC FTCMTTC_PreTorqueTimeC FTCMTTC_Rpm2RdsC FTCMTTC_SpeedHysteresisRangeC FTCMTTC_SpeedThdC FTCMTTC_ToqueHpFilterSpdThrdC FTCMTTC_TorMaxC FTCMTTC_TorqCorEnableC FTCMTTC_TorqueBySecondNegC FTCMTTC_TorqueBySecondPosC FTCMTTC_TorqueCutOffFrequencyC FTCMTTC_TorqueFildTrC FTCMTTC_TorqueHpFilterSpdHystRgC FTCMTTC_TotalTrqLmtFromCanEnC FTCMTTC_TrqHpCutOffFrequencyC FTCMTTC_TrqSatThrdC FTDDLMP_I0LimitMaxC /end DEF_CHARACTERISTIC
 /begin OUT_MEASUREMENT FTEVEIT_PthTthS3_VL FTEVEIT_PthTthS3_WL FTEVEIT_PthTthS4_UL FTEVEIT_PthTthS4_VL FTEVEIT_PthTthS4_WL FTEVEIT_PthTthS5_UL FTEVEIT_PthTthS5_VL FTEVEIT_PthTthS5_WL FTEVEIT_PtlTdl_UL FTEVEIT_PtlTdl_VL FTEVEIT_PtlTdl_WL FTEVEIT_PtlTtl_UL FTEVEIT_PtlTtl_VL FTEVEIT_PtlTtl_WL FTEVEIT_PtlTtlS1_UL FTEVEIT_PtlTtlS1_VL FTEVEIT_PtlTtlS1_WL FTEVEIT_PtlTtlS2_UL FTEVEIT_PtlTtlS2_VL FTEVEIT_PtlTtlS2_WL FTEVEIT_PtlTtlS3_UL FTEVEIT_PtlTtlS3_VL FTEVEIT_PtlTtlS3_WL FTEVEIT_PtlTtlS4_UL FTEVEIT_PtlTtlS4_VL FTEVEIT_PtlTtlS4_WL FTEVEIT_PtlTtlS5_UL FTEVEIT_PtlTtlS5_VL FTEVEIT_PtlTtlS5_WL FTEVEIT_TcoolingEstimation FTEVEIT_VectEstimTempFild10Z FTEVEIT_VectEstimTempFild11Z FTEVEIT_VectEstimTempFild12Z FTEVEIT_VectEstimTempFild1Z FTEVEIT_VectEstimTempFild2Z FTEVEIT_VectEstimTempFild3Z FTEVEIT_VectEstimTempFild4Z FTEVEIT_VectEstimTempFild5Z FTEVEIT_VectEstimTempFild6Z FTEVEIT_VectEstimTempFild7Z FTEVEIT_VectEstimTempFild8Z FTEVEIT_VectEstimTempFild9Z FTEVEIT_VectEstimTempFild[0] FTEVEIT_VectEstimTempFild[10] FTEVEIT_VectEstimTempFild[11] FTEVEIT_VectEstimTempFild[1] FTEVEIT_VectEstimTempFild[2] FTEVEIT_VectEstimTempFild[3] FTEVEIT_VectEstimTempFild[4] FTEVEIT_VectEstimTempFild[5] FTEVEIT_VectEstimTempFild[6] FTEVEIT_VectEstimTempFild[7] FTEVEIT_VectEstimTempFild[8] FTEVEIT_VectEstimTempFild[9] FTMTLCS_1ByAccumulator FTMTLCS_A2DOffsetIsuL FTMTLCS_A2DOffsetIsvL FTMTLCS_A2DOffsetIswL FTMTLCS_A2DOffsetSumIsuLZ FTMTLCS_A2DOffsetSumIsvLZ FTMTLCS_A2DOffsetSumIswLZ FTMTLCS_A2DResCorrd_IsuL FTMTLCS_A2DResCorrd_IsvL FTMTLCS_A2DResCorrd_IswL FTMTLCS_CurrentSumError FTMTLCS_ElecSpeedRdsFildZ FTMTLCS_Iu FTMTLCS_Iu_Rms FTMTLCS_Iu_RmsSum FTMTLCS_IuInput FTMTLCS_Iuvw3[0] FTMTLCS_Iuvw3[1] FTMTLCS_Iuvw3[2] FTMTLCS_Iuvw3_Rms[0] FTMTLCS_Iuvw3_Rms[1] FTMTLCS_Iuvw3_Rms[2] FTMTLCS_Iuvw3RmsSum[0] FTMTLCS_Iuvw3RmsSum[1] FTMTLCS_Iuvw3RmsSum[2] FTMTLCS_IuvwGain3[0] FTMTLCS_IuvwGain3[1] FTMTLCS_IuvwGain3[2] FTMTLCS_Iv FTMTLCS_Iv_Rms FTMTLCS_Iv_RmsSum FTMTLCS_IvInput FTMTLCS_Iw FTMTLCS_Iw_Rms FTMTLCS_Iw_RmsSum FTMTLCS_IwInput FTMTLCS_LostPhaseError FTMTLCS_OffsetCompOK FTMTLCS_RmsNumberZ FTMTLCS_RmsSumIuZ FTMTLCS_RmsSumIvZ FTMTLCS_RmsSumIwZ FTMTLCS_SampleNumberZ FTMTLCS_Scaled_Isu FTMTLCS_Scaled_Isv FTMTLCS_Scaled_Isw FTMTLCS_TrimIsuvw[0] FTMTLCS_TrimIsuvw[1] FTMTLCS_TrimIsuvw[2] FTMTSEP_DelayTheta FTMTSEP_ErrThetaComp FTMTSEP_NextThetaElecRd FTMTSEP_SinCosNextThetaElec[0] FTMTSEP_SinCosNextThetaElec[1] FTMTSEP_SinCosThetaElec[0] FTMTSEP_SinCosThetaElec[1] FTMTSEP_ThetaElecRd FTSMACS_AclPreviousState FTSMACS_AclState FTSMACS_CmdFtShutDownRes FTSMACS_CmdFtStartRes FTSMACS_CmdPwmDirectReq FTSMACS_CmdPwmOffReq FTSMACS_ReinitFault FTSMACS_TestFault FTSMACS_VsiTimerFreqRatioRef FTSMMAM_AclState FTSMMAM_CMCCS_M0ConOnoff FTSMMAM_EVEIT_MainEnable FTSMMAM_FTCIVDC_State FTSMMAM_FTCMCCS_State FTSMMAM_FTCMSCS_State FTSMMAM_FTCMTCS_State FTSMMAM_FtModeReq FTSMMAM_MTLCS_State FTSMMAM_MTMEP_State FTSMMAM_SMREF_MainEnable FTSMREF_AngleTable FTSMREF_AutoPhaseCalLock FTSMREF_AutoPhasingCal FTSMREF_AutoPhasingCalRaw FTSMREF_AutoPhasingCalRawZ FTSMREF_AutophasingSumZ FTSMREF_Cyclefinish FTSMREF_CycNum FTSMREF_I0dqRef[0] FTSMREF_I0dqRef[1] FTSMREF_I0dqRef[2] FTSMREF_IdrefTable FTSMREF_ImposedThetaRdSurPi FTSMREF_RotoringCalEnable FTSMREF_RotoringCalFinish FTSMREF_RotoringCalStart FTSMREF_Timer1Z SD_AutoPhasingAngle_F32 SD_AutophasingCal_F32 SD_FtModeReq_U16 SD_GainCosTrim_F32 SD_GainSinTrim_F32 SD_ImposedThetaRdSurPi_F32 SD_Iuvw3_F32[0] SD_Iuvw3_F32[1] SD_Iuvw3_F32[2] SD_MTMEPState_U16 SD_OccycleFinish_B SD_OffsetCosTrim_F32 SD_OffsetSinTrim_F32 SD_ResolverSinCos2_U16[0] SD_ResolverSinCos2_U16[1] SD_RotoringCalEnable_B SD_RotoringCalFinish_B SD_RotoringCalStart_B SDMTLCS_IuInput SDMTLCS_Iuvw3_RmsSum[0] SDMTLCS_Iuvw3_RmsSum[1] SDMTLCS_Iuvw3_RmsSum[2] SDMTLCS_IvInput SDMTLCS_IwInput SDMTLCS_RmsNumberZ SDMTLCS_RmsSumIuZ SDMTLCS_RmsSumIvZ SDMTLCS_RmsSumIwZ SDMTMEP_AutoPhase SDMTMEP_BenchModeValueZ SDMTMEP_CosResultAvgMax SDMTMEP_CosResultAvgMin SDMTMEP_CosResultMax SDMTMEP_CosResultMaxSumZ SDMTMEP_CosResultMaxZ SDMTMEP_CosResultMin SDMTMEP_CosResultMinSumZ SDMTMEP_CosResultMinZ SDMTMEP_CosScaled SDMTMEP_CosSignSumZ SDMTMEP_DeltaTheta SDMTMEP_ElecSpeedRds SDMTMEP_ErrorThetaElecRdSurPi SDMTMEP_EstimatedCos SDMTMEP_EstimatedSin SDMTMEP_Flg2BSW SDMTMEP_Flg2BSWCntZ SDMTMEP_ForwardDirect SDMTMEP_GainCosSignFit SDMTMEP_GainCosTrim SDMTMEP_GainCosTrimCal SDMTMEP_GainSinTrim SDMTMEP_GainSinTrimCal SDMTMEP_HalfRdSurPiCadran2or4 SDMTMEP_IllegalResParDetn SDMTMEP_IllegalResParFlt SDMTMEP_IllegalResParFltLock SDMTMEP_ImposedThetaZ SDMTMEP_MecaSpeedRds SDMTMEP_MecaSpeedRpm SDMTMEP_MecaSpeedRpmOc SDMTMEP_OcCosAdcFildZ SDMTMEP_OcRotoringFailFlg SDMTMEP_OcRotoringNormal SDMTMEP_OcSinAdcFildZ SDMTMEP_OffsetCosTrim SDMTMEP_OffsetCosTrimCal SDMTMEP_OffsetSinTrim SDMTMEP_OffsetSinTrimCal SDMTMEP_PerdTimerZ SDMTMEP_PosCompError SDMTMEP_PrevElecSpeedRds SDMTMEP_PrevThetaElecRdSurPi SDMTMEP_RecoverCntZ SDMTMEP_RecoverFlgZ SDMTMEP_RecoverFlgZZ SDMTMEP_ResolNextThetaRdByPi SDMTMEP_ResolverAbnormalFlg SDMTMEP_ResolverAcceleration SDMTMEP_ResolverPositionFailFlg SDMTMEP_ResolverSpeedRds SDMTMEP_ResolverSpeedRdsFild SDMTMEP_ResolverSpeedRdsFildOc SDMTMEP_ResolverSpeedRdsFildZ SDMTMEP_ResolverSpeedRdsOcZ SDMTMEP_ResolverSpeedRdsZ SDMTMEP_ResolverThetaRdSurPi SDMTMEP_ResolverThetaRdSurPiOc SDMTMEP_ResolverThetaRdSurPiOcZ SDMTMEP_ResolverThetaRdSurPiZ SDMTMEP_ResThetaRdSurPiOcZ SDMTMEP_SingleConversion SDMTMEP_SinGndDetn SDMTMEP_SinResultAvgMax SDMTMEP_SinResultAvgMin SDMTMEP_SinResultMax SDMTMEP_SinResultMaxSumZ SDMTMEP_SinResultMaxZ SDMTMEP_SinResultMin SDMTMEP_SinResultMinSumZ SDMTMEP_SinResultMinZ SDMTMEP_SinScaled SDMTMEP_SinVccDetn SDMTMEP_SpeedCmpFailFlg SDMTMEP_ThetaElecRdSurPi SDMTMEP_ThetaInitRdSurPi SDMTMEP_ThetaTempRdSurPi SDMTMEP_ThetaTempRdSurPiOc SDMTMEP_ThetaTempRdSurPiOcZ SDMTMEP_ThetaTempRdSurPiZ /end OUT_MEASUREMENT
/end FUNCTION
/end MODULE
/end PROJECT
