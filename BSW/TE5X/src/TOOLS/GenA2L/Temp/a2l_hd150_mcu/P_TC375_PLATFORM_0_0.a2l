/* Genebase version 6.5.0.0 */
ASAP2_VERSION 1 3
/begin PROJECT P_TC375_PLATFORM_0_0 "P_TC375_PLATFORM_0_0"
/begin HEADER "" VERSION "5210.00" PROJECT_NO D0 /end HEADER
/begin MODULE P_TC375_PLATFORM_0_0 "Invt"
/begin MOD_PAR "CCP" USER "P_TC375_PLATFORM_0_0" ECU "P_TC375_PLATFORM_0_0"
 /begin MEMORY_SEGMENT CODE1 "FillMemory1" CODE FLASH INTERN 0x80050000 0x10000 -1 -1 -1 -1 -1 /end MEMORY_SEGMENT
 /begin MEMORY_SEGMENT DATA1 "CalibrationMemoryArea" DATA FLASH INTERN 0x80060000 0x8000 -1 -1 -1 -1 -1 /begin IF_DATA ASAP1B_CCP ADDRESS_MAPPING 0x80060000 0x80060000 0x8000 /end IF_DATA /end MEMORY_SEGMENT
 /begin MEMORY_SEGMENT CODE2 "FillMemory2" CODE FLASH INTERN 0x80068000 0x98000 -1 -1 -1 -1 -1 /end MEMORY_SEGMENT
 /begin MEMORY_SEGMENT CODE3 "CodeMemoryArea" CODE FLASH INTERN 0x80100000 0x180000 -1 -1 -1 -1 -1 /end MEMORY_SEGMENT
 /begin MEMORY_SEGMENT VARIABLES1 "DataMemory" VARIABLES RAM INTERN 0x60000000 0x18000 -1 -1 -1 -1 -1 /end MEMORY_SEGMENT
/end MOD_PAR
/begin MOD_COMMON "" DEPOSIT ABSOLUTE ALIGNMENT_BYTE 1 ALIGNMENT_WORD 2 ALIGNMENT_LONG 4 ALIGNMENT_FLOAT32_IEEE 4 ALIGNMENT_FLOAT64_IEEE 8 BYTE_ORDER MSB_LAST /end MOD_COMMON
/begin IF_DATA ASAP1B_CCP
 /begin SOURCE "1 ms" 3 1 DISPLAY_IDENTIFIER "1 ms" /begin QP_BLOB 0 LENGTH 6 CAN_ID_FIXED 0x200 RASTER 0 FIRST_PID 0x00 /end QP_BLOB /end SOURCE
 /begin SOURCE "10 ms" 4 1 DISPLAY_IDENTIFIER "10 ms" /begin QP_BLOB 1 LENGTH 28 CAN_ID_FIXED 0x201 RASTER 1 FIRST_PID 0x12 /end QP_BLOB /end SOURCE
 /begin SOURCE "5 ms" 3 5 DISPLAY_IDENTIFIER "5 ms" /begin QP_BLOB 2 LENGTH 12 CAN_ID_FIXED 0x1FF RASTER 2 FIRST_PID 0x06 /end QP_BLOB /end SOURCE
 /begin RASTER "Timer 1 ms" "1 ms" 0 3 1 /end RASTER
 /begin RASTER "Timer 10 ms" "10 ms" 1 4 1 /end RASTER
 /begin RASTER "Timer 5 ms" "5 ms" 2 3 5 /end RASTER
 /begin TP_BLOB 0x0201 0x0202 0x301 0x302 0x0209 2 STORE_SUPPORTED BAUDRATE 1000000 SAMPLE_POINT 80 SAMPLE_RATE 1 BTL_CYCLES 20 SJW 3 SYNC_EDGE 0 /begin CHECKSUM_PARAM 0x8001 0x00000200 CHECKSUM_CALCULATION ACTIVE_PAGE /end CHECKSUM_PARAM /begin DEFINED_PAGES 0 "ReferencePage" 0x0000 0x80058000 0x00010000 ROM /end DEFINED_PAGES
  /begin DEFINED_PAGES 1 "WorkingPage" 0x0000 0x60018000 0x00004000 RAM FLASH_BACK RAM_INIT_BY_ECU /end DEFINED_PAGES
  OPTIONAL_CMD 0x0C OPTIONAL_CMD 0x0D OPTIONAL_CMD 0x0E OPTIONAL_CMD 0x23 OPTIONAL_CMD 0x11 OPTIONAL_CMD 0x09 /end TP_BLOB
/end IF_DATA
/begin RECORD_LAYOUT DATA_RECORD_UBYTE FNC_VALUES 1 UBYTE ROW_DIR DIRECT /end RECORD_LAYOUT
/begin RECORD_LAYOUT DATA_RECORD_UWORD FNC_VALUES 1 UWORD ROW_DIR DIRECT /end RECORD_LAYOUT
/begin RECORD_LAYOUT DATA_RECORD_ULONG FNC_VALUES 1 ULONG ROW_DIR DIRECT /end RECORD_LAYOUT
/begin RECORD_LAYOUT DATA_RECORD_FLOAT32_IEEE FNC_VALUES 1 FLOAT32_IEEE ROW_DIR DIRECT /end RECORD_LAYOUT
/begin RECORD_LAYOUT DATA_RECORD_FLOAT64_IEEE FNC_VALUES 1 FLOAT64_IEEE ROW_DIR DIRECT /end RECORD_LAYOUT
/begin CHARACTERISTIC BSW_bIntLockDetEnaC "..." VALUE 0x80058002 DATA_RECORD_UBYTE 1 Bool_ON_OFF 0 1 BIT_MASK 0x01 /end CHARACTERISTIC
/begin CHARACTERISTIC BSW_bOBDEnaC "..." VALUE 0x80058001 DATA_RECORD_UBYTE 1 Bool_ON_OFF 0 1 BIT_MASK 0x01 /end CHARACTERISTIC
/begin CHARACTERISTIC BSW_bSPYBenchOnC "SPY activation" VALUE 0x80058000 DATA_RECORD_UBYTE 1 Bool_ON_OFF 0 1 BIT_MASK 0x01 /end CHARACTERISTIC
/begin CHARACTERISTIC BSW_ku16VSIRdyChkTimoutC "BSW_ku16VSIRdyChkTimoutC" VALUE 0x8005809A DATA_RECORD_UWORD 65535 I_1 0 65535 /end CHARACTERISTIC
/begin CHARACTERISTIC CCU6_bAlimFreqChgEnaC "..." VALUE 0x80058023 DATA_RECORD_UBYTE 1 Bool_ON_OFF 0 1 BIT_MASK 0x01 /end CHARACTERISTIC
/begin CHARACTERISTIC CCU6_bDualSmpEnaC "..." VALUE 0x80058022 DATA_RECORD_UBYTE 1 Bool_ON_OFF 0 1 BIT_MASK 0x01 /end CHARACTERISTIC
/begin CHARACTERISTIC CCU6_bHwOvcFltDetEnaC "..." VALUE 0x80058021 DATA_RECORD_UBYTE 1 Bool_ON_OFF 0 1 BIT_MASK 0x01 /end CHARACTERISTIC
/begin CHARACTERISTIC CCU6_bHwPinAscEnaC "..." VALUE 0x80058020 DATA_RECORD_UBYTE 1 Bool_ON_OFF 0 1 BIT_MASK 0x01 /end CHARACTERISTIC
/begin CHARACTERISTIC CCU6_f32DrvClkDutyThdHighC "..." VALUE 0x8005801C DATA_RECORD_FLOAT32_IEEE 3.402823466E+038 F_1_p0_5 -3.402823466E+038 3.402823466E+038 /end CHARACTERISTIC
/begin CHARACTERISTIC CCU6_f32DrvClkDutyThdLowC "..." VALUE 0x80058018 DATA_RECORD_FLOAT32_IEEE 3.402823466E+038 F_1_p0_5 -3.402823466E+038 3.402823466E+038 /end CHARACTERISTIC
/begin CHARACTERISTIC CCU6_kbDrvBdClkEnaC "..." VALUE 0x80058003 DATA_RECORD_UBYTE 1 Bool_ON_OFF 0 1 BIT_MASK 0x01 /end CHARACTERISTIC
/begin CHARACTERISTIC CCU6_kf32MidPointDutyHC "..." VALUE 0x80058014 DATA_RECORD_FLOAT32_IEEE 3.402823466E+038 F_1_p0_5 -3.402823466E+038 3.402823466E+038 /end CHARACTERISTIC
/begin CHARACTERISTIC CCU6_kf32MidPointDutyLC "..." VALUE 0x80058010 DATA_RECORD_FLOAT32_IEEE 3.402823466E+038 F_1_p0_5 -3.402823466E+038 3.402823466E+038 /end CHARACTERISTIC
/begin CHARACTERISTIC CCU6_ku16AlimDutyCycRawC "..." VALUE 0x800580A4 DATA_RECORD_UWORD 65535 F_1_p0_5 0 65535 /end CHARACTERISTIC
/begin CHARACTERISTIC CCU6_ku32AlimFreqRawC "..." VALUE 0x80058C10 DATA_RECORD_ULONG 4294967295 F_1_p0_5 0 4294967295 /end CHARACTERISTIC
/begin CHARACTERISTIC CCU6_ku8AscRecoverCntMaxC "..." VALUE 0x8005800C DATA_RECORD_UBYTE 255 F_1_p0_5 0 255 /end CHARACTERISTIC
/begin CHARACTERISTIC CCU6_ku8PwmMidPointFaultC "..." VALUE 0x80058005 DATA_RECORD_UBYTE 255 F_1_p0_5 0 255 /end CHARACTERISTIC
/begin CHARACTERISTIC CalUsr_ku32CalibUpdEnaMskA "..." VALUE 0x8005D828 DATA_RECORD_ULONG 4294967295 I_1 0 4294967295 /end CHARACTERISTIC
/begin CHARACTERISTIC CalUsr_ku32CalibUpdEnaMskB "..." VALUE 0x8005D824 DATA_RECORD_ULONG 4294967295 I_1 0 4294967295 /end CHARACTERISTIC
/begin CHARACTERISTIC ESM_u16PowerLatchTempoC "ESM_u16PowerLatchTempoC" VALUE 0x800A3042 DATA_RECORD_UWORD 327675 F_5_p0_26 0 327675 /end CHARACTERISTIC
/begin CHARACTERISTIC ESM_u8RestartDelayCntC "ESM_u8RestartDelayCntC" VALUE 0x800A3040 DATA_RECORD_UBYTE 1275 F_5_p0_26 0 1275 /end CHARACTERISTIC
/begin CHARACTERISTIC FAIL_bCanErrCheckonC "Check Can Error" VALUE 0x8005D830 DATA_RECORD_UBYTE 1 Bool_ON_OFF 0 1 BIT_MASK 0x01 /end CHARACTERISTIC
/begin CHARACTERISTIC FAIL_bHvLoopErrCheckonC "Check Can Error" VALUE 0x8005D82C DATA_RECORD_UBYTE 1 Bool_ON_OFF 0 1 BIT_MASK 0x01 /end CHARACTERISTIC
/begin CHARACTERISTIC FaultBSW_COM_BusOff_CAN1Dec "FaultBSW_COM_BusOff_CAN1Dec" VALUE 0x800A3438 DATA_RECORD_UBYTE 255 I_1 0 255 /end CHARACTERISTIC
/begin CHARACTERISTIC FaultBSW_COM_BusOff_CAN1FailMod "FaultBSW_COM_BusOff_CAN1FailMod" VALUE 0x800A3510 DATA_RECORD_UBYTE 255 I_1 0 255 /end CHARACTERISTIC
/begin CHARACTERISTIC FaultBSW_COM_BusOff_CAN1Inc "FaultBSW_COM_BusOff_CAN1Inc" VALUE 0x800A34A4 DATA_RECORD_UBYTE 255 I_1 0 255 /end CHARACTERISTIC
/begin CHARACTERISTIC FaultBSW_COM_ChecksumErrVCUDec "FaultBSW_COM_ChecksumErrVCUDec" VALUE 0x800A3439 DATA_RECORD_UBYTE 255 I_1 0 255 /end CHARACTERISTIC
/begin CHARACTERISTIC FaultBSW_COM_ChecksumErrVCUFailMod "FaultBSW_COM_ChecksumErrVCUFailMod" VALUE 0x800A3511 DATA_RECORD_UBYTE 255 I_1 0 255 /end CHARACTERISTIC
/begin CHARACTERISTIC FaultBSW_COM_ChecksumErrVCUInc "FaultBSW_COM_ChecksumErrVCUInc" VALUE 0x800A34A5 DATA_RECORD_UBYTE 255 I_1 0 255 /end CHARACTERISTIC
/begin CHARACTERISTIC FaultBSW_COM_InterFaultVCUDec "FaultBSW_COM_InterFaultVCUDec" VALUE 0x800A343A DATA_RECORD_UBYTE 255 I_1 0 255 /end CHARACTERISTIC
/begin CHARACTERISTIC FaultBSW_COM_InterFaultVCUFailMod "FaultBSW_COM_InterFaultVCUFailMod" VALUE 0x800A3512 DATA_RECORD_UBYTE 255 I_1 0 255 /end CHARACTERISTIC
/begin CHARACTERISTIC FaultBSW_COM_InterFaultVCUInc "FaultBSW_COM_InterFaultVCUInc" VALUE 0x800A34A6 DATA_RECORD_UBYTE 255 I_1 0 255 /end CHARACTERISTIC
/begin CHARACTERISTIC FaultBSW_COM_RollCntErrVCUDec "FaultBSW_COM_RollCntErrVCUDec" VALUE 0x800A343B DATA_RECORD_UBYTE 255 I_1 0 255 /end CHARACTERISTIC
/begin CHARACTERISTIC FaultBSW_COM_RollCntErrVCUFailMod "FaultBSW_COM_RollCntErrVCUFailMod" VALUE 0x800A3513 DATA_RECORD_UBYTE 255 I_1 0 255 /end CHARACTERISTIC
/begin CHARACTERISTIC FaultBSW_COM_RollCntErrVCUInc "FaultBSW_COM_RollCntErrVCUInc" VALUE 0x800A34A7 DATA_RECORD_UBYTE 255 I_1 0 255 /end CHARACTERISTIC
/begin CHARACTERISTIC FaultBSW_COM_TimoutRxBCMDec "FaultBSW_COM_TimoutRxBCMDec" VALUE 0x800A343C DATA_RECORD_UBYTE 255 I_1 0 255 /end CHARACTERISTIC
/begin CHARACTERISTIC FaultBSW_COM_TimoutRxBCMFailMod "FaultBSW_COM_TimoutRxBCMFailMod" VALUE 0x800A3514 DATA_RECORD_UBYTE 255 I_1 0 255 /end CHARACTERISTIC
/begin CHARACTERISTIC FaultBSW_COM_TimoutRxBCMInc "FaultBSW_COM_TimoutRxBCMInc" VALUE 0x800A34A8 DATA_RECORD_UBYTE 255 I_1 0 255 /end CHARACTERISTIC
/begin CHARACTERISTIC FaultBSW_COM_TimoutRxBMSHDec "FaultBSW_COM_TimoutRxBMSHDec" VALUE 0x800A343D DATA_RECORD_UBYTE 255 I_1 0 255 /end CHARACTERISTIC
/begin CHARACTERISTIC FaultBSW_COM_TimoutRxBMSHFailMod "FaultBSW_COM_TimoutRxBMSHFailMod" VALUE 0x800A3515 DATA_RECORD_UBYTE 255 I_1 0 255 /end CHARACTERISTIC
/begin CHARACTERISTIC FaultBSW_COM_TimoutRxBMSHInc "FaultBSW_COM_TimoutRxBMSHInc" VALUE 0x800A34A9 DATA_RECORD_UBYTE 255 I_1 0 255 /end CHARACTERISTIC
/begin CHARACTERISTIC FaultBSW_COM_TimoutRxEMSDec "FaultBSW_COM_TimoutRxEMSDec" VALUE 0x800A343E DATA_RECORD_UBYTE 255 I_1 0 255 /end CHARACTERISTIC
/begin CHARACTERISTIC FaultBSW_COM_TimoutRxEMSFailMod "FaultBSW_COM_TimoutRxEMSFailMod" VALUE 0x800A3516 DATA_RECORD_UBYTE 255 I_1 0 255 /end CHARACTERISTIC
/begin CHARACTERISTIC FaultBSW_COM_TimoutRxEMSInc "FaultBSW_COM_TimoutRxEMSInc" VALUE 0x800A34AA DATA_RECORD_UBYTE 255 I_1 0 255 /end CHARACTERISTIC
/begin CHARACTERISTIC FaultBSW_COM_TimoutRxGCUDec "FaultBSW_COM_TimoutRxGCUDec" VALUE 0x800A343F DATA_RECORD_UBYTE 255 I_1 0 255 /end CHARACTERISTIC
/begin CHARACTERISTIC FaultBSW_COM_TimoutRxGCUFailMod "FaultBSW_COM_TimoutRxGCUFailMod" VALUE 0x800A3517 DATA_RECORD_UBYTE 255 I_1 0 255 /end CHARACTERISTIC
/begin CHARACTERISTIC FaultBSW_COM_TimoutRxGCUInc "FaultBSW_COM_TimoutRxGCUInc" VALUE 0x800A34AB DATA_RECORD_UBYTE 255 I_1 0 255 /end CHARACTERISTIC
/begin CHARACTERISTIC FaultBSW_COM_TimoutRxIPCDec "FaultBSW_COM_TimoutRxIPCDec" VALUE 0x800A3440 DATA_RECORD_UBYTE 255 I_1 0 255 /end CHARACTERISTIC
/begin CHARACTERISTIC FaultBSW_COM_TimoutRxIPCFailMod "FaultBSW_COM_TimoutRxIPCFailMod" VALUE 0x800A3518 DATA_RECORD_UBYTE 255 I_1 0 255 /end CHARACTERISTIC
/begin CHARACTERISTIC FaultBSW_COM_TimoutRxIPCInc "FaultBSW_COM_TimoutRxIPCInc" VALUE 0x800A34AC DATA_RECORD_UBYTE 255 I_1 0 255 /end CHARACTERISTIC
/begin CHARACTERISTIC FaultBSW_COM_TimoutRxTBOXDec "FaultBSW_COM_TimoutRxTBOXDec" VALUE 0x800A3441 DATA_RECORD_UBYTE 255 I_1 0 255 /end CHARACTERISTIC
/begin CHARACTERISTIC FaultBSW_COM_TimoutRxTBOXFailMod "FaultBSW_COM_TimoutRxTBOXFailMod" VALUE 0x800A3519 DATA_RECORD_UBYTE 255 I_1 0 255 /end CHARACTERISTIC
/begin CHARACTERISTIC FaultBSW_COM_TimoutRxTBOXInc "FaultBSW_COM_TimoutRxTBOXInc" VALUE 0x800A34AD DATA_RECORD_UBYTE 255 I_1 0 255 /end CHARACTERISTIC
/begin CHARACTERISTIC FaultBSW_COM_TimoutRxVCUDec "FaultBSW_COM_TimoutRxVCUDec" VALUE 0x800A3442 DATA_RECORD_UBYTE 255 I_1 0 255 /end CHARACTERISTIC
/begin CHARACTERISTIC FaultBSW_COM_TimoutRxVCUFailMod "FaultBSW_COM_TimoutRxVCUFailMod" VALUE 0x800A351A DATA_RECORD_UBYTE 255 I_1 0 255 /end CHARACTERISTIC
/begin CHARACTERISTIC FaultBSW_COM_TimoutRxVCUInc "FaultBSW_COM_TimoutRxVCUInc" VALUE 0x800A34AE DATA_RECORD_UBYTE 255 I_1 0 255 /end CHARACTERISTIC
/begin CHARACTERISTIC FaultBSW_HW2_FPGA_OverVoltVBatDec "FaultBSW_HW2_FPGA_OverVoltVBatDec" VALUE 0x800A3443 DATA_RECORD_UBYTE 255 I_1 0 255 /end CHARACTERISTIC
/begin CHARACTERISTIC FaultBSW_HW2_FPGA_OverVoltVBatFailMod "FaultBSW_HW2_FPGA_OverVoltVBatFailMod" VALUE 0x800A351B DATA_RECORD_UBYTE 255 I_1 0 255 /end CHARACTERISTIC
/begin CHARACTERISTIC FaultBSW_HW2_FPGA_OverVoltVBatInc "FaultBSW_HW2_FPGA_OverVoltVBatInc" VALUE 0x800A34AF DATA_RECORD_UBYTE 255 I_1 0 255 /end CHARACTERISTIC
/begin CHARACTERISTIC FaultBSW_HW2_SafeTlib_PreRunDec "FaultBSW_HW2_SafeTlib_PreRunDec" VALUE 0x800A3444 DATA_RECORD_UBYTE 255 I_1 0 255 /end CHARACTERISTIC
/begin CHARACTERISTIC FaultBSW_HW2_SafeTlib_PreRunFailMod "FaultBSW_HW2_SafeTlib_PreRunFailMod" VALUE 0x800A351C DATA_RECORD_UBYTE 255 I_1 0 255 /end CHARACTERISTIC
/begin CHARACTERISTIC FaultBSW_HW2_SafeTlib_PreRunInc "FaultBSW_HW2_SafeTlib_PreRunInc" VALUE 0x800A34B0 DATA_RECORD_UBYTE 255 I_1 0 255 /end CHARACTERISTIC
/begin CHARACTERISTIC FaultBSW_HW_EasAckFailDec "FaultBSW_HW_EasAckFailDec" VALUE 0x800A3445 DATA_RECORD_UBYTE 255 I_1 0 255 /end CHARACTERISTIC
/begin CHARACTERISTIC FaultBSW_HW_EasAckFailFailMod "FaultBSW_HW_EasAckFailFailMod" VALUE 0x800A351D DATA_RECORD_UBYTE 255 I_1 0 255 /end CHARACTERISTIC
/begin CHARACTERISTIC FaultBSW_HW_EasAckFailInc "FaultBSW_HW_EasAckFailInc" VALUE 0x800A34B1 DATA_RECORD_UBYTE 255 I_1 0 255 /end CHARACTERISTIC
/begin CHARACTERISTIC FaultBSW_HW_FPGA_IGBT_HDec "FaultBSW_HW_FPGA_IGBT_HDec" VALUE 0x800A3446 DATA_RECORD_UBYTE 255 I_1 0 255 /end CHARACTERISTIC
/begin CHARACTERISTIC FaultBSW_HW_FPGA_IGBT_HFailMod "FaultBSW_HW_FPGA_IGBT_HFailMod" VALUE 0x800A351E DATA_RECORD_UBYTE 255 I_1 0 255 /end CHARACTERISTIC
/begin CHARACTERISTIC FaultBSW_HW_FPGA_IGBT_HInc "FaultBSW_HW_FPGA_IGBT_HInc" VALUE 0x800A34B2 DATA_RECORD_UBYTE 255 I_1 0 255 /end CHARACTERISTIC
/begin CHARACTERISTIC FaultBSW_HW_FPGA_IGBT_LDec "FaultBSW_HW_FPGA_IGBT_LDec" VALUE 0x800A3447 DATA_RECORD_UBYTE 255 I_1 0 255 /end CHARACTERISTIC
/begin CHARACTERISTIC FaultBSW_HW_FPGA_IGBT_LFailMod "FaultBSW_HW_FPGA_IGBT_LFailMod" VALUE 0x800A351F DATA_RECORD_UBYTE 255 I_1 0 255 /end CHARACTERISTIC
/begin CHARACTERISTIC FaultBSW_HW_FPGA_IGBT_LInc "FaultBSW_HW_FPGA_IGBT_LInc" VALUE 0x800A34B3 DATA_RECORD_UBYTE 255 I_1 0 255 /end CHARACTERISTIC
/begin CHARACTERISTIC FaultBSW_HW_FPGA_OverUnderCurUIDec "FaultBSW_HW_FPGA_OverUnderCurUIDec" VALUE 0x800A3448 DATA_RECORD_UBYTE 255 I_1 0 255 /end CHARACTERISTIC
/begin CHARACTERISTIC FaultBSW_HW_FPGA_OverUnderCurUIFailMod "FaultBSW_HW_FPGA_OverUnderCurUIFailMod" VALUE 0x800A3520 DATA_RECORD_UBYTE 255 I_1 0 255 /end CHARACTERISTIC
/begin CHARACTERISTIC FaultBSW_HW_FPGA_OverUnderCurUIInc "FaultBSW_HW_FPGA_OverUnderCurUIInc" VALUE 0x800A34B4 DATA_RECORD_UBYTE 255 I_1 0 255 /end CHARACTERISTIC
/begin CHARACTERISTIC FaultBSW_HW_FPGA_OverUnderCurVIDec "FaultBSW_HW_FPGA_OverUnderCurVIDec" VALUE 0x800A3449 DATA_RECORD_UBYTE 255 I_1 0 255 /end CHARACTERISTIC
/begin CHARACTERISTIC FaultBSW_HW_FPGA_OverUnderCurVIFailMod "FaultBSW_HW_FPGA_OverUnderCurVIFailMod" VALUE 0x800A3521 DATA_RECORD_UBYTE 255 I_1 0 255 /end CHARACTERISTIC
/begin CHARACTERISTIC FaultBSW_HW_FPGA_OverUnderCurVIInc "FaultBSW_HW_FPGA_OverUnderCurVIInc" VALUE 0x800A34B5 DATA_RECORD_UBYTE 255 I_1 0 255 /end CHARACTERISTIC
/begin CHARACTERISTIC FaultBSW_HW_FPGA_OverUnderCurWIDec "FaultBSW_HW_FPGA_OverUnderCurWIDec" VALUE 0x800A344A DATA_RECORD_UBYTE 255 I_1 0 255 /end CHARACTERISTIC
/begin CHARACTERISTIC FaultBSW_HW_FPGA_OverUnderCurWIFailMod "FaultBSW_HW_FPGA_OverUnderCurWIFailMod" VALUE 0x800A3522 DATA_RECORD_UBYTE 255 I_1 0 255 /end CHARACTERISTIC
/begin CHARACTERISTIC FaultBSW_HW_FPGA_OverUnderCurWIInc "FaultBSW_HW_FPGA_OverUnderCurWIInc" VALUE 0x800A34B6 DATA_RECORD_UBYTE 255 I_1 0 255 /end CHARACTERISTIC
/begin CHARACTERISTIC FaultBSW_HW_OCDataNotRationalDec "FaultBSW_HW_OCDataNotRationalDec" VALUE 0x800A344B DATA_RECORD_UBYTE 255 I_1 0 255 /end CHARACTERISTIC
/begin CHARACTERISTIC FaultBSW_HW_OCDataNotRationalFailMod "FaultBSW_HW_OCDataNotRationalFailMod" VALUE 0x800A3523 DATA_RECORD_UBYTE 255 I_1 0 255 /end CHARACTERISTIC
/begin CHARACTERISTIC FaultBSW_HW_OCDataNotRationalInc "FaultBSW_HW_OCDataNotRationalInc" VALUE 0x800A34B7 DATA_RECORD_UBYTE 255 I_1 0 255 /end CHARACTERISTIC
/begin CHARACTERISTIC FaultBSW_SYS_RstHotDec "FaultBSW_SYS_RstHotDec" VALUE 0x800A344C DATA_RECORD_UBYTE 255 I_1 0 255 /end CHARACTERISTIC
/begin CHARACTERISTIC FaultBSW_SYS_RstHotFailMod "FaultBSW_SYS_RstHotFailMod" VALUE 0x800A3524 DATA_RECORD_UBYTE 255 I_1 0 255 /end CHARACTERISTIC
/begin CHARACTERISTIC FaultBSW_SYS_RstHotInc "FaultBSW_SYS_RstHotInc" VALUE 0x800A34B8 DATA_RECORD_UBYTE 255 I_1 0 255 /end CHARACTERISTIC
/begin CHARACTERISTIC FaultBSW_SYS_StackOverflowDec "FaultBSW_SYS_StackOverflowDec" VALUE 0x800A344D DATA_RECORD_UBYTE 255 I_1 0 255 /end CHARACTERISTIC
/begin CHARACTERISTIC FaultBSW_SYS_StackOverflowFailMod "FaultBSW_SYS_StackOverflowFailMod" VALUE 0x800A3525 DATA_RECORD_UBYTE 255 I_1 0 255 /end CHARACTERISTIC
/begin CHARACTERISTIC FaultBSW_SYS_StackOverflowInc "FaultBSW_SYS_StackOverflowInc" VALUE 0x800A34B9 DATA_RECORD_UBYTE 255 I_1 0 255 /end CHARACTERISTIC
/begin CHARACTERISTIC FaultBSW_VSI_TimeoutTCalcDec "FaultBSW_VSI_TimeoutTCalcDec" VALUE 0x800A344E DATA_RECORD_UBYTE 255 I_1 0 255 /end CHARACTERISTIC
/begin CHARACTERISTIC FaultBSW_VSI_TimeoutTCalcFailMod "FaultBSW_VSI_TimeoutTCalcFailMod" VALUE 0x800A3526 DATA_RECORD_UBYTE 255 I_1 0 255 /end CHARACTERISTIC
/begin CHARACTERISTIC FaultBSW_VSI_TimeoutTCalcInc "FaultBSW_VSI_TimeoutTCalcInc" VALUE 0x800A34BA DATA_RECORD_UBYTE 255 I_1 0 255 /end CHARACTERISTIC
/begin CHARACTERISTIC FaultEraseRequestC "FaultEraseRequestC" VALUE 0x800580A6 DATA_RECORD_UWORD 65535 I_1 0 65535 /end CHARACTERISTIC
/begin CHARACTERISTIC FaultFSEVBHV_OverVoltageDec "FaultFSEVBHV_OverVoltageDec" VALUE 0x800A344F DATA_RECORD_UBYTE 255 I_1 0 255 /end CHARACTERISTIC
/begin CHARACTERISTIC FaultFSEVBHV_OverVoltageFailMod "FaultFSEVBHV_OverVoltageFailMod" VALUE 0x800A3527 DATA_RECORD_UBYTE 255 I_1 0 255 /end CHARACTERISTIC
/begin CHARACTERISTIC FaultFSEVBHV_OverVoltageInc "FaultFSEVBHV_OverVoltageInc" VALUE 0x800A34BB DATA_RECORD_UBYTE 255 I_1 0 255 /end CHARACTERISTIC
/begin CHARACTERISTIC FaultFSEVBHV_SampleVolOutRngHDec "FaultFSEVBHV_SampleVolOutRngHDec" VALUE 0x800A3450 DATA_RECORD_UBYTE 255 I_1 0 255 /end CHARACTERISTIC
/begin CHARACTERISTIC FaultFSEVBHV_SampleVolOutRngHFailMod "FaultFSEVBHV_SampleVolOutRngHFailMod" VALUE 0x800A3528 DATA_RECORD_UBYTE 255 I_1 0 255 /end CHARACTERISTIC
/begin CHARACTERISTIC FaultFSEVBHV_SampleVolOutRngHInc "FaultFSEVBHV_SampleVolOutRngHInc" VALUE 0x800A34BC DATA_RECORD_UBYTE 255 I_1 0 255 /end CHARACTERISTIC
/begin CHARACTERISTIC FaultFSEVBHV_SampleVolOutRngLDec "FaultFSEVBHV_SampleVolOutRngLDec" VALUE 0x800A3451 DATA_RECORD_UBYTE 255 I_1 0 255 /end CHARACTERISTIC
/begin CHARACTERISTIC FaultFSEVBHV_SampleVolOutRngLFailMod "FaultFSEVBHV_SampleVolOutRngLFailMod" VALUE 0x800A3529 DATA_RECORD_UBYTE 255 I_1 0 255 /end CHARACTERISTIC
/begin CHARACTERISTIC FaultFSEVBHV_SampleVolOutRngLInc "FaultFSEVBHV_SampleVolOutRngLInc" VALUE 0x800A34BD DATA_RECORD_UBYTE 255 I_1 0 255 /end CHARACTERISTIC
/begin CHARACTERISTIC FaultFSEVBHV_UnderVoltageDec "FaultFSEVBHV_UnderVoltageDec" VALUE 0x800A3452 DATA_RECORD_UBYTE 255 I_1 0 255 /end CHARACTERISTIC
/begin CHARACTERISTIC FaultFSEVBHV_UnderVoltageFailMod "FaultFSEVBHV_UnderVoltageFailMod" VALUE 0x800A352A DATA_RECORD_UBYTE 255 I_1 0 255 /end CHARACTERISTIC
/begin CHARACTERISTIC FaultFSEVBHV_UnderVoltageInc "FaultFSEVBHV_UnderVoltageInc" VALUE 0x800A34BE DATA_RECORD_UBYTE 255 I_1 0 255 /end CHARACTERISTIC
/begin CHARACTERISTIC FaultFSEVBHV_UnderVoltageWarnDec "FaultFSEVBHV_UnderVoltageWarnDec" VALUE 0x800A3456 DATA_RECORD_UBYTE 255 I_1 0 255 /end CHARACTERISTIC
/begin CHARACTERISTIC FaultFSEVBHV_UnderVoltageWarnFailMod "FaultFSEVBHV_UnderVoltageWarnFailMod" VALUE 0x800A352E DATA_RECORD_UBYTE 255 I_1 0 255 /end CHARACTERISTIC
/begin CHARACTERISTIC FaultFSEVBHV_UnderVoltageWarnInc "FaultFSEVBHV_UnderVoltageWarnInc" VALUE 0x800A34C2 DATA_RECORD_UBYTE 255 I_1 0 255 /end CHARACTERISTIC
/begin CHARACTERISTIC FaultFSEVBHV_VolNotRationalDec "FaultFSEVBHV_VolNotRationalDec" VALUE 0x800A3453 DATA_RECORD_UBYTE 255 I_1 0 255 /end CHARACTERISTIC
/begin CHARACTERISTIC FaultFSEVBHV_VolNotRationalFailMod "FaultFSEVBHV_VolNotRationalFailMod" VALUE 0x800A352B DATA_RECORD_UBYTE 255 I_1 0 255 /end CHARACTERISTIC
/begin CHARACTERISTIC FaultFSEVBHV_VolNotRationalInc "FaultFSEVBHV_VolNotRationalInc" VALUE 0x800A34BF DATA_RECORD_UBYTE 255 I_1 0 255 /end CHARACTERISTIC
/begin CHARACTERISTIC FaultFSEVBHV_VoltageGndDec "FaultFSEVBHV_VoltageGndDec" VALUE 0x800A3454 DATA_RECORD_UBYTE 255 I_1 0 255 /end CHARACTERISTIC
/begin CHARACTERISTIC FaultFSEVBHV_VoltageGndFailMod "FaultFSEVBHV_VoltageGndFailMod" VALUE 0x800A352C DATA_RECORD_UBYTE 255 I_1 0 255 /end CHARACTERISTIC
/begin CHARACTERISTIC FaultFSEVBHV_VoltageGndInc "FaultFSEVBHV_VoltageGndInc" VALUE 0x800A34C0 DATA_RECORD_UBYTE 255 I_1 0 255 /end CHARACTERISTIC
/begin CHARACTERISTIC FaultFSEVBHV_VoltageVccDec "FaultFSEVBHV_VoltageVccDec" VALUE 0x800A3455 DATA_RECORD_UBYTE 255 I_1 0 255 /end CHARACTERISTIC
/begin CHARACTERISTIC FaultFSEVBHV_VoltageVccFailMod "FaultFSEVBHV_VoltageVccFailMod" VALUE 0x800A352D DATA_RECORD_UBYTE 255 I_1 0 255 /end CHARACTERISTIC
/begin CHARACTERISTIC FaultFSEVBHV_VoltageVccInc "FaultFSEVBHV_VoltageVccInc" VALUE 0x800A34C1 DATA_RECORD_UBYTE 255 I_1 0 255 /end CHARACTERISTIC
/begin CHARACTERISTIC FaultFSEVBLV_OverVoltageDec "FaultFSEVBLV_OverVoltageDec" VALUE 0x800A3457 DATA_RECORD_UBYTE 255 I_1 0 255 /end CHARACTERISTIC
/begin CHARACTERISTIC FaultFSEVBLV_OverVoltageFailMod "FaultFSEVBLV_OverVoltageFailMod" VALUE 0x800A352F DATA_RECORD_UBYTE 255 I_1 0 255 /end CHARACTERISTIC
/begin CHARACTERISTIC FaultFSEVBLV_OverVoltageInc "FaultFSEVBLV_OverVoltageInc" VALUE 0x800A34C3 DATA_RECORD_UBYTE 255 I_1 0 255 /end CHARACTERISTIC
/begin CHARACTERISTIC FaultFSEVBLV_P5VRefADCFltDec "FaultFSEVBLV_P5VRefADCFltDec" VALUE 0x800A3458 DATA_RECORD_UBYTE 255 I_1 0 255 /end CHARACTERISTIC
/begin CHARACTERISTIC FaultFSEVBLV_P5VRefADCFltFailMod "FaultFSEVBLV_P5VRefADCFltFailMod" VALUE 0x800A3530 DATA_RECORD_UBYTE 255 I_1 0 255 /end CHARACTERISTIC
/begin CHARACTERISTIC FaultFSEVBLV_P5VRefADCFltInc "FaultFSEVBLV_P5VRefADCFltInc" VALUE 0x800A34C4 DATA_RECORD_UBYTE 255 I_1 0 255 /end CHARACTERISTIC
/begin CHARACTERISTIC FaultFSEVBLV_UnderVoltageDec "FaultFSEVBLV_UnderVoltageDec" VALUE 0x800A3459 DATA_RECORD_UBYTE 255 I_1 0 255 /end CHARACTERISTIC
/begin CHARACTERISTIC FaultFSEVBLV_UnderVoltageFailMod "FaultFSEVBLV_UnderVoltageFailMod" VALUE 0x800A3531 DATA_RECORD_UBYTE 255 I_1 0 255 /end CHARACTERISTIC
/begin CHARACTERISTIC FaultFSEVBLV_UnderVoltageInc "FaultFSEVBLV_UnderVoltageInc" VALUE 0x800A34C5 DATA_RECORD_UBYTE 255 I_1 0 255 /end CHARACTERISTIC
/begin CHARACTERISTIC FaultFSEVBLV_UnderVoltageWarnDec "FaultFSEVBLV_UnderVoltageWarnDec" VALUE 0x800A345C DATA_RECORD_UBYTE 255 I_1 0 255 /end CHARACTERISTIC
/begin CHARACTERISTIC FaultFSEVBLV_UnderVoltageWarnFailMod "FaultFSEVBLV_UnderVoltageWarnFailMod" VALUE 0x800A3534 DATA_RECORD_UBYTE 255 I_1 0 255 /end CHARACTERISTIC
/begin CHARACTERISTIC FaultFSEVBLV_UnderVoltageWarnInc "FaultFSEVBLV_UnderVoltageWarnInc" VALUE 0x800A34C8 DATA_RECORD_UBYTE 255 I_1 0 255 /end CHARACTERISTIC
/begin CHARACTERISTIC FaultFSEVBLV_VoltageGndDec "FaultFSEVBLV_VoltageGndDec" VALUE 0x800A345A DATA_RECORD_UBYTE 255 I_1 0 255 /end CHARACTERISTIC
/begin CHARACTERISTIC FaultFSEVBLV_VoltageGndFailMod "FaultFSEVBLV_VoltageGndFailMod" VALUE 0x800A3532 DATA_RECORD_UBYTE 255 I_1 0 255 /end CHARACTERISTIC
/begin CHARACTERISTIC FaultFSEVBLV_VoltageGndInc "FaultFSEVBLV_VoltageGndInc" VALUE 0x800A34C6 DATA_RECORD_UBYTE 255 I_1 0 255 /end CHARACTERISTIC
/begin CHARACTERISTIC FaultFSEVBLV_VoltageVccDec "FaultFSEVBLV_VoltageVccDec" VALUE 0x800A345B DATA_RECORD_UBYTE 255 I_1 0 255 /end CHARACTERISTIC
/begin CHARACTERISTIC FaultFSEVBLV_VoltageVccFailMod "FaultFSEVBLV_VoltageVccFailMod" VALUE 0x800A3533 DATA_RECORD_UBYTE 255 I_1 0 255 /end CHARACTERISTIC
/begin CHARACTERISTIC FaultFSEVBLV_VoltageVccInc "FaultFSEVBLV_VoltageVccInc" VALUE 0x800A34C7 DATA_RECORD_UBYTE 255 I_1 0 255 /end CHARACTERISTIC
/begin CHARACTERISTIC FaultFSEVETA_DrvTempRationDec "FaultFSEVETA_DrvTempRationDec" VALUE 0x800A345D DATA_RECORD_UBYTE 255 I_1 0 255 /end CHARACTERISTIC
/begin CHARACTERISTIC FaultFSEVETA_DrvTempRationFailMod "FaultFSEVETA_DrvTempRationFailMod" VALUE 0x800A3535 DATA_RECORD_UBYTE 255 I_1 0 255 /end CHARACTERISTIC
/begin CHARACTERISTIC FaultFSEVETA_DrvTempRationInc "FaultFSEVETA_DrvTempRationInc" VALUE 0x800A34C9 DATA_RECORD_UBYTE 255 I_1 0 255 /end CHARACTERISTIC
/begin CHARACTERISTIC FaultFSEVETA_IgbtTempRationalDec "FaultFSEVETA_IgbtTempRationalDec" VALUE 0x800A345E DATA_RECORD_UBYTE 255 I_1 0 255 /end CHARACTERISTIC
/begin CHARACTERISTIC FaultFSEVETA_IgbtTempRationalFailMod "FaultFSEVETA_IgbtTempRationalFailMod" VALUE 0x800A3536 DATA_RECORD_UBYTE 255 I_1 0 255 /end CHARACTERISTIC
/begin CHARACTERISTIC FaultFSEVETA_IgbtTempRationalInc "FaultFSEVETA_IgbtTempRationalInc" VALUE 0x800A34CA DATA_RECORD_UBYTE 255 I_1 0 255 /end CHARACTERISTIC
/begin CHARACTERISTIC FaultFSEVETA_OverTempDrvLeftDec "FaultFSEVETA_OverTempDrvLeftDec" VALUE 0x800A3461 DATA_RECORD_UBYTE 255 I_1 0 255 /end CHARACTERISTIC
/begin CHARACTERISTIC FaultFSEVETA_OverTempDrvLeftFailMod "FaultFSEVETA_OverTempDrvLeftFailMod" VALUE 0x800A3539 DATA_RECORD_UBYTE 255 I_1 0 255 /end CHARACTERISTIC
/begin CHARACTERISTIC FaultFSEVETA_OverTempDrvLeftInc "FaultFSEVETA_OverTempDrvLeftInc" VALUE 0x800A34CD DATA_RECORD_UBYTE 255 I_1 0 255 /end CHARACTERISTIC
/begin CHARACTERISTIC FaultFSEVETA_OverTempIgbtLeftDec "FaultFSEVETA_OverTempIgbtLeftDec" VALUE 0x800A3462 DATA_RECORD_UBYTE 255 I_1 0 255 /end CHARACTERISTIC
/begin CHARACTERISTIC FaultFSEVETA_OverTempIgbtLeftFailMod "FaultFSEVETA_OverTempIgbtLeftFailMod" VALUE 0x800A353A DATA_RECORD_UBYTE 255 I_1 0 255 /end CHARACTERISTIC
/begin CHARACTERISTIC FaultFSEVETA_OverTempIgbtLeftInc "FaultFSEVETA_OverTempIgbtLeftInc" VALUE 0x800A34CE DATA_RECORD_UBYTE 255 I_1 0 255 /end CHARACTERISTIC
/begin CHARACTERISTIC FaultFSEVETA_OverTempNTC1CmdBoardDec "FaultFSEVETA_OverTempNTC1CmdBoardDec" VALUE 0x800A3463 DATA_RECORD_UBYTE 255 I_1 0 255 /end CHARACTERISTIC
/begin CHARACTERISTIC FaultFSEVETA_OverTempNTC1CmdBoardFailMod "FaultFSEVETA_OverTempNTC1CmdBoardFailMod" VALUE 0x800A353B DATA_RECORD_UBYTE 255 I_1 0 255 /end CHARACTERISTIC
/begin CHARACTERISTIC FaultFSEVETA_OverTempNTC1CmdBoardInc "FaultFSEVETA_OverTempNTC1CmdBoardInc" VALUE 0x800A34CF DATA_RECORD_UBYTE 255 I_1 0 255 /end CHARACTERISTIC
/begin CHARACTERISTIC FaultFSEVETA_SampleIgbtTempOutRngHDec "FaultFSEVETA_SampleIgbtTempOutRngHDec" VALUE 0x800A345F DATA_RECORD_UBYTE 255 I_1 0 255 /end CHARACTERISTIC
/begin CHARACTERISTIC FaultFSEVETA_SampleIgbtTempOutRngHFailMod "FaultFSEVETA_SampleIgbtTempOutRngHFailMod" VALUE 0x800A3537 DATA_RECORD_UBYTE 255 I_1 0 255 /end CHARACTERISTIC
/begin CHARACTERISTIC FaultFSEVETA_SampleIgbtTempOutRngHInc "FaultFSEVETA_SampleIgbtTempOutRngHInc" VALUE 0x800A34CB DATA_RECORD_UBYTE 255 I_1 0 255 /end CHARACTERISTIC
/begin CHARACTERISTIC FaultFSEVETA_SampleIgbtTempOutRngLDec "FaultFSEVETA_SampleIgbtTempOutRngLDec" VALUE 0x800A3460 DATA_RECORD_UBYTE 255 I_1 0 255 /end CHARACTERISTIC
/begin CHARACTERISTIC FaultFSEVETA_SampleIgbtTempOutRngLFailMod "FaultFSEVETA_SampleIgbtTempOutRngLFailMod" VALUE 0x800A3538 DATA_RECORD_UBYTE 255 I_1 0 255 /end CHARACTERISTIC
/begin CHARACTERISTIC FaultFSEVETA_SampleIgbtTempOutRngLInc "FaultFSEVETA_SampleIgbtTempOutRngLInc" VALUE 0x800A34CC DATA_RECORD_UBYTE 255 I_1 0 255 /end CHARACTERISTIC
/begin CHARACTERISTIC FaultFSEVETA_TempDrvBoardLeftGndDec "FaultFSEVETA_TempDrvBoardLeftGndDec" VALUE 0x800A3464 DATA_RECORD_UBYTE 255 I_1 0 255 /end CHARACTERISTIC
/begin CHARACTERISTIC FaultFSEVETA_TempDrvBoardLeftGndFailMod "FaultFSEVETA_TempDrvBoardLeftGndFailMod" VALUE 0x800A353C DATA_RECORD_UBYTE 255 I_1 0 255 /end CHARACTERISTIC
/begin CHARACTERISTIC FaultFSEVETA_TempDrvBoardLeftGndInc "FaultFSEVETA_TempDrvBoardLeftGndInc" VALUE 0x800A34D0 DATA_RECORD_UBYTE 255 I_1 0 255 /end CHARACTERISTIC
/begin CHARACTERISTIC FaultFSEVETA_TempDrvBoardLeftVccDec "FaultFSEVETA_TempDrvBoardLeftVccDec" VALUE 0x800A3465 DATA_RECORD_UBYTE 255 I_1 0 255 /end CHARACTERISTIC
/begin CHARACTERISTIC FaultFSEVETA_TempDrvBoardLeftVccFailMod "FaultFSEVETA_TempDrvBoardLeftVccFailMod" VALUE 0x800A353D DATA_RECORD_UBYTE 255 I_1 0 255 /end CHARACTERISTIC
/begin CHARACTERISTIC FaultFSEVETA_TempDrvBoardLeftVccInc "FaultFSEVETA_TempDrvBoardLeftVccInc" VALUE 0x800A34D1 DATA_RECORD_UBYTE 255 I_1 0 255 /end CHARACTERISTIC
/begin CHARACTERISTIC FaultFSEVETA_TempIgbtLeftGndDec "FaultFSEVETA_TempIgbtLeftGndDec" VALUE 0x800A3466 DATA_RECORD_UBYTE 255 I_1 0 255 /end CHARACTERISTIC
/begin CHARACTERISTIC FaultFSEVETA_TempIgbtLeftGndFailMod "FaultFSEVETA_TempIgbtLeftGndFailMod" VALUE 0x800A353E DATA_RECORD_UBYTE 255 I_1 0 255 /end CHARACTERISTIC
/begin CHARACTERISTIC FaultFSEVETA_TempIgbtLeftGndInc "FaultFSEVETA_TempIgbtLeftGndInc" VALUE 0x800A34D2 DATA_RECORD_UBYTE 255 I_1 0 255 /end CHARACTERISTIC
/begin CHARACTERISTIC FaultFSEVETA_TempIgbtLeftVccDec "FaultFSEVETA_TempIgbtLeftVccDec" VALUE 0x800A3467 DATA_RECORD_UBYTE 255 I_1 0 255 /end CHARACTERISTIC
/begin CHARACTERISTIC FaultFSEVETA_TempIgbtLeftVccFailMod "FaultFSEVETA_TempIgbtLeftVccFailMod" VALUE 0x800A353F DATA_RECORD_UBYTE 255 I_1 0 255 /end CHARACTERISTIC
/begin CHARACTERISTIC FaultFSEVETA_TempIgbtLeftVccInc "FaultFSEVETA_TempIgbtLeftVccInc" VALUE 0x800A34D3 DATA_RECORD_UBYTE 255 I_1 0 255 /end CHARACTERISTIC
/begin CHARACTERISTIC FaultFSEVETA_TempNTC1CmdBoardGndDec "FaultFSEVETA_TempNTC1CmdBoardGndDec" VALUE 0x800A3468 DATA_RECORD_UBYTE 255 I_1 0 255 /end CHARACTERISTIC
/begin CHARACTERISTIC FaultFSEVETA_TempNTC1CmdBoardGndFailMod "FaultFSEVETA_TempNTC1CmdBoardGndFailMod" VALUE 0x800A3540 DATA_RECORD_UBYTE 255 I_1 0 255 /end CHARACTERISTIC
/begin CHARACTERISTIC FaultFSEVETA_TempNTC1CmdBoardGndInc "FaultFSEVETA_TempNTC1CmdBoardGndInc" VALUE 0x800A34D4 DATA_RECORD_UBYTE 255 I_1 0 255 /end CHARACTERISTIC
/begin CHARACTERISTIC FaultFSEVETA_TempNTC1CmdBoardVccDec "FaultFSEVETA_TempNTC1CmdBoardVccDec" VALUE 0x800A3469 DATA_RECORD_UBYTE 255 I_1 0 255 /end CHARACTERISTIC
/begin CHARACTERISTIC FaultFSEVETA_TempNTC1CmdBoardVccFailMod "FaultFSEVETA_TempNTC1CmdBoardVccFailMod" VALUE 0x800A3541 DATA_RECORD_UBYTE 255 I_1 0 255 /end CHARACTERISTIC
/begin CHARACTERISTIC FaultFSEVETA_TempNTC1CmdBoardVccInc "FaultFSEVETA_TempNTC1CmdBoardVccInc" VALUE 0x800A34D5 DATA_RECORD_UBYTE 255 I_1 0 255 /end CHARACTERISTIC
/begin CHARACTERISTIC FaultFSEVETA_UnderTempDrvLeftDec "FaultFSEVETA_UnderTempDrvLeftDec" VALUE 0x800A346A DATA_RECORD_UBYTE 255 I_1 0 255 /end CHARACTERISTIC
/begin CHARACTERISTIC FaultFSEVETA_UnderTempDrvLeftFailMod "FaultFSEVETA_UnderTempDrvLeftFailMod" VALUE 0x800A3542 DATA_RECORD_UBYTE 255 I_1 0 255 /end CHARACTERISTIC
/begin CHARACTERISTIC FaultFSEVETA_UnderTempDrvLeftInc "FaultFSEVETA_UnderTempDrvLeftInc" VALUE 0x800A34D6 DATA_RECORD_UBYTE 255 I_1 0 255 /end CHARACTERISTIC
/begin CHARACTERISTIC FaultFSEVETA_UnderTempIgbtLeftDec "FaultFSEVETA_UnderTempIgbtLeftDec" VALUE 0x800A346B DATA_RECORD_UBYTE 255 I_1 0 255 /end CHARACTERISTIC
/begin CHARACTERISTIC FaultFSEVETA_UnderTempIgbtLeftFailMod "FaultFSEVETA_UnderTempIgbtLeftFailMod" VALUE 0x800A3543 DATA_RECORD_UBYTE 255 I_1 0 255 /end CHARACTERISTIC
/begin CHARACTERISTIC FaultFSEVETA_UnderTempIgbtLeftInc "FaultFSEVETA_UnderTempIgbtLeftInc" VALUE 0x800A34D7 DATA_RECORD_UBYTE 255 I_1 0 255 /end CHARACTERISTIC
/begin CHARACTERISTIC FaultFSEVETA_UnderTempNTC1CmdBoardDec "FaultFSEVETA_UnderTempNTC1CmdBoardDec" VALUE 0x800A346C DATA_RECORD_UBYTE 255 I_1 0 255 /end CHARACTERISTIC
/begin CHARACTERISTIC FaultFSEVETA_UnderTempNTC1CmdBoardFailMod "FaultFSEVETA_UnderTempNTC1CmdBoardFailMod" VALUE 0x800A3544 DATA_RECORD_UBYTE 255 I_1 0 255 /end CHARACTERISTIC
/begin MEASUREMENT ASWNM_bBusSleep "Shutdown request" UBYTE Bool_ON_OFF 1 2 0 1 BIT_MASK 0x01 ECU_ADDRESS 0x700015C4 /end MEASUREMENT
/begin MEASUREMENT ASWNM_bStayAwake "Shutdown request" UBYTE Bool_ON_OFF 1 2 0 1 BIT_MASK 0x01 ECU_ADDRESS 0x700015C0 /end MEASUREMENT
/begin MEASUREMENT ASWNM_u16AfterRunDelayTimes "ASWNM_u16AfterRunDelayTimes" UWORD I_1 1 2 0 65535 ECU_ADDRESS 0x700015BE /end MEASUREMENT
/begin MEASUREMENT ASWNM_u16Kl15Sts "ASWNM_u16Kl15Sts" UWORD I_1 1 2 0 65535 ECU_ADDRESS 0x700015C2 /end MEASUREMENT
/begin MEASUREMENT BSW_bAppMsgTxEna "Flag to enable App message transmission" UBYTE Bool_ON_OFF 1 2 0 1 BIT_MASK 0x01 ECU_ADDRESS 0x7000572E /end MEASUREMENT
/begin MEASUREMENT BSW_bCAN0BusOff "BSW_bCAN0BusOff" UBYTE Bool_ON_OFF 1 2 0 1 BIT_MASK 0x01 ECU_ADDRESS 0x7000572D /end MEASUREMENT
/begin MEASUREMENT BSW_bCAN1BusOff "BSW_bCAN1BusOff" UBYTE Bool_ON_OFF 1 2 0 1 BIT_MASK 0x01 ECU_ADDRESS 0x7000572C /end MEASUREMENT
/begin MEASUREMENT BSW_bCbkRxTOutFlag_SGBCM_pepsReq "..." UBYTE Bool_ON_OFF 1 2 0 1 BIT_MASK 0x01 ECU_ADDRESS 0x70005726 /end MEASUREMENT
/begin MEASUREMENT BSW_bCbkRxTOutFlag_SGRx10Req "..." UBYTE Bool_ON_OFF 1 2 0 1 BIT_MASK 0x01 ECU_ADDRESS 0x7000574D /end MEASUREMENT
/begin MEASUREMENT BSW_bCbkRxTOutFlag_SGRx11Req "..." UBYTE Bool_ON_OFF 1 2 0 1 BIT_MASK 0x01 ECU_ADDRESS 0x7000574C /end MEASUREMENT
/begin MEASUREMENT BSW_bCbkRxTOutFlag_SGRx12Req "..." UBYTE Bool_ON_OFF 1 2 0 1 BIT_MASK 0x01 ECU_ADDRESS 0x7000574B /end MEASUREMENT
/begin MEASUREMENT BSW_bCbkRxTOutFlag_SGRx13Req "..." UBYTE Bool_ON_OFF 1 2 0 1 BIT_MASK 0x01 ECU_ADDRESS 0x7000574A /end MEASUREMENT
/begin MEASUREMENT BSW_bCbkRxTOutFlag_SGRx14Req "..." UBYTE Bool_ON_OFF 1 2 0 1 BIT_MASK 0x01 ECU_ADDRESS 0x70005749 /end MEASUREMENT
/begin MEASUREMENT BSW_bCbkRxTOutFlag_SGRx15Req "..." UBYTE Bool_ON_OFF 1 2 0 1 BIT_MASK 0x01 ECU_ADDRESS 0x70005748 /end MEASUREMENT
/begin MEASUREMENT BSW_bCbkRxTOutFlag_SGRx16Req "..." UBYTE Bool_ON_OFF 1 2 0 1 BIT_MASK 0x01 ECU_ADDRESS 0x70005747 /end MEASUREMENT
/begin MEASUREMENT BSW_bCbkRxTOutFlag_SGRx17Req "..." UBYTE Bool_ON_OFF 1 2 0 1 BIT_MASK 0x01 ECU_ADDRESS 0x70005746 /end MEASUREMENT
/begin MEASUREMENT BSW_bCbkRxTOutFlag_SGRx18Req "..." UBYTE Bool_ON_OFF 1 2 0 1 BIT_MASK 0x01 ECU_ADDRESS 0x70005745 /end MEASUREMENT
/begin MEASUREMENT BSW_bCbkRxTOutFlag_SGRx19Req "..." UBYTE Bool_ON_OFF 1 2 0 1 BIT_MASK 0x01 ECU_ADDRESS 0x70005744 /end MEASUREMENT
/begin MEASUREMENT BSW_bCbkRxTOutFlag_SGRx1Req "..." UBYTE Bool_ON_OFF 1 2 0 1 BIT_MASK 0x01 ECU_ADDRESS 0x70005756 /end MEASUREMENT
/begin MEASUREMENT BSW_bCbkRxTOutFlag_SGRx20Req "..." UBYTE Bool_ON_OFF 1 2 0 1 BIT_MASK 0x01 ECU_ADDRESS 0x70005743 /end MEASUREMENT
/begin MEASUREMENT BSW_bCbkRxTOutFlag_SGRx21Req "..." UBYTE Bool_ON_OFF 1 2 0 1 BIT_MASK 0x01 ECU_ADDRESS 0x70005742 /end MEASUREMENT
/begin MEASUREMENT BSW_bCbkRxTOutFlag_SGRx22Req "..." UBYTE Bool_ON_OFF 1 2 0 1 BIT_MASK 0x01 ECU_ADDRESS 0x70005741 /end MEASUREMENT
/begin MEASUREMENT BSW_bCbkRxTOutFlag_SGRx23Req "..." UBYTE Bool_ON_OFF 1 2 0 1 BIT_MASK 0x01 ECU_ADDRESS 0x70005740 /end MEASUREMENT
/begin MEASUREMENT BSW_bCbkRxTOutFlag_SGRx24Req "..." UBYTE Bool_ON_OFF 1 2 0 1 BIT_MASK 0x01 ECU_ADDRESS 0x7000573F /end MEASUREMENT
/begin MEASUREMENT BSW_bCbkRxTOutFlag_SGRx25Req "..." UBYTE Bool_ON_OFF 1 2 0 1 BIT_MASK 0x01 ECU_ADDRESS 0x7000573E /end MEASUREMENT
/begin MEASUREMENT BSW_bCbkRxTOutFlag_SGRx26Req "..." UBYTE Bool_ON_OFF 1 2 0 1 BIT_MASK 0x01 ECU_ADDRESS 0x7000573D /end MEASUREMENT
/begin MEASUREMENT BSW_bCbkRxTOutFlag_SGRx2Req "..." UBYTE Bool_ON_OFF 1 2 0 1 BIT_MASK 0x01 ECU_ADDRESS 0x70005755 /end MEASUREMENT
/begin MEASUREMENT BSW_bCbkRxTOutFlag_SGRx3Req "..." UBYTE Bool_ON_OFF 1 2 0 1 BIT_MASK 0x01 ECU_ADDRESS 0x70005754 /end MEASUREMENT
/begin MEASUREMENT BSW_bCbkRxTOutFlag_SGRx4Req "..." UBYTE Bool_ON_OFF 1 2 0 1 BIT_MASK 0x01 ECU_ADDRESS 0x70005753 /end MEASUREMENT
/begin MEASUREMENT BSW_bCbkRxTOutFlag_SGRx5Req "..." UBYTE Bool_ON_OFF 1 2 0 1 BIT_MASK 0x01 ECU_ADDRESS 0x70005752 /end MEASUREMENT
/begin MEASUREMENT BSW_bCbkRxTOutFlag_SGRx6Req "..." UBYTE Bool_ON_OFF 1 2 0 1 BIT_MASK 0x01 ECU_ADDRESS 0x70005751 /end MEASUREMENT
/begin MEASUREMENT BSW_bCbkRxTOutFlag_SGRx7Req "..." UBYTE Bool_ON_OFF 1 2 0 1 BIT_MASK 0x01 ECU_ADDRESS 0x70005750 /end MEASUREMENT
/begin MEASUREMENT BSW_bCbkRxTOutFlag_SGRx8Req "..." UBYTE Bool_ON_OFF 1 2 0 1 BIT_MASK 0x01 ECU_ADDRESS 0x7000574F /end MEASUREMENT
/begin MEASUREMENT BSW_bCbkRxTOutFlag_SGRx9Req "..." UBYTE Bool_ON_OFF 1 2 0 1 BIT_MASK 0x01 ECU_ADDRESS 0x7000574E /end MEASUREMENT
/begin MEASUREMENT BSW_bCsumErrFlag_SGRx1Req "..." UBYTE Bool_ON_OFF 1 2 0 1 BIT_MASK 0x01 ECU_ADDRESS 0x7000573C /end MEASUREMENT
/begin MEASUREMENT BSW_bCsumErrFlag_SGRx2Req "..." UBYTE Bool_ON_OFF 1 2 0 1 BIT_MASK 0x01 ECU_ADDRESS 0x7000573B /end MEASUREMENT
/begin MEASUREMENT BSW_bCsumErrFlag_SGRx3Req "..." UBYTE Bool_ON_OFF 1 2 0 1 BIT_MASK 0x01 ECU_ADDRESS 0x7000573A /end MEASUREMENT
/begin MEASUREMENT BSW_bCsumErrFlag_SGRx5Req "..." UBYTE Bool_ON_OFF 1 2 0 1 BIT_MASK 0x01 ECU_ADDRESS 0x70005738 /end MEASUREMENT
/begin MEASUREMENT BSW_bEnableCalcWriteNvMMaxTime "Enable Calc Write NvM Max Time" UBYTE Bool_ON_OFF 1 2 0 1 BIT_MASK 0x01 ECU_ADDRESS 0x70005725 /end MEASUREMENT
/begin MEASUREMENT BSW_bIntLockDetEna "..." UBYTE Bool_ON_OFF 1 2 0 1 BIT_MASK 0x01 ECU_ADDRESS 0x70005724 /end MEASUREMENT
/begin MEASUREMENT BSW_bIntLockOccurFlg "..." UBYTE Bool_ON_OFF 1 2 0 1 BIT_MASK 0x01 ECU_ADDRESS 0x70005723 /end MEASUREMENT
/begin MEASUREMENT BSW_bMKeyOnStatus "..." UBYTE Bool_ON_OFF 1 2 0 1 BIT_MASK 0x01 ECU_ADDRESS 0x70005722 /end MEASUREMENT
/begin MEASUREMENT BSW_bMSGTrigTxFlag_Mcu7Req "..." UBYTE Bool_ON_OFF 1 2 0 1 BIT_MASK 0x01 ECU_ADDRESS 0x70005721 /end MEASUREMENT
/begin MEASUREMENT BSW_bNvmWrTrig "..." UBYTE Bool_ON_OFF 1 2 0 1 BIT_MASK 0x01 ECU_ADDRESS 0x70005720 /end MEASUREMENT
/begin MEASUREMENT BSW_bOCDataNotRation "..." UBYTE Bool_ON_OFF 1 2 0 1 BIT_MASK 0x01 ECU_ADDRESS 0x7000571F /end MEASUREMENT
/begin MEASUREMENT BSW_bRcErrFlag_SGRx1Req "..." UBYTE Bool_ON_OFF 1 2 0 1 BIT_MASK 0x01 ECU_ADDRESS 0x70005735 /end MEASUREMENT
/begin MEASUREMENT BSW_bRcErrFlag_SGRx2Req "..." UBYTE Bool_ON_OFF 1 2 0 1 BIT_MASK 0x01 ECU_ADDRESS 0x70005734 /end MEASUREMENT
/begin MEASUREMENT BSW_bRcErrFlag_SGRx3Req "..." UBYTE Bool_ON_OFF 1 2 0 1 BIT_MASK 0x01 ECU_ADDRESS 0x70005733 /end MEASUREMENT
/begin MEASUREMENT BSW_bRcErrFlag_SGRx5Req "..." UBYTE Bool_ON_OFF 1 2 0 1 BIT_MASK 0x01 ECU_ADDRESS 0x70005731 /end MEASUREMENT
/begin MEASUREMENT BSW_bStackOverflowWarning "Stack overflow warning" UBYTE Bool_ON_OFF 1 2 0 1 BIT_MASK 0x01 ECU_ADDRESS 0x7000571B /end MEASUREMENT
/begin MEASUREMENT BSW_bUdsFunctionReqFlg "..." UBYTE Bool_ON_OFF 1 2 0 1 BIT_MASK 0x01 ECU_ADDRESS 0x7000571A /end MEASUREMENT
/begin MEASUREMENT BSW_bVsiReadySts "...." UBYTE Bool_ON_OFF 1 2 0 1 BIT_MASK 0x01 ECU_ADDRESS 0x70005719 /end MEASUREMENT
/begin MEASUREMENT BSW_u16CurWriteNvMTime "Current Write NvM Time" UWORD F_0v001_p0_21 1 2 0 65.535 ECU_ADDRESS 0x70005692 /end MEASUREMENT
/begin MEASUREMENT BSW_u16IntLockDelayTim "..." UWORD I_1 1 2 0 65535 ECU_ADDRESS 0x70005690 /end MEASUREMENT
/begin MEASUREMENT BSW_u16NvMWriteCmd "BSW_u16NvMWriteCmd" UBYTE I_1 1 2 0 255 ECU_ADDRESS 0x7000568C /end MEASUREMENT
/begin MEASUREMENT BSW_u16NvmStoreDelay "...." UWORD I_1 1 2 0 65535 ECU_ADDRESS 0x7000568E /end MEASUREMENT
/begin MEASUREMENT BSW_u16RawVolMonCurOcpH "BSW_u16RawVolMonCurOcpH" UWORD F_0v0012210012_p0_22 1 2 0 80.01831502 ECU_ADDRESS 0x7000568A /end MEASUREMENT
/begin MEASUREMENT BSW_u16RawVolMonCurOcpL "BSW_u16RawVolMonCurOcpL" UWORD F_0v0012210012_p0_22 1 2 0 80.01831502 ECU_ADDRESS 0x70005688 /end MEASUREMENT
/begin MEASUREMENT BSW_u16RawVolMonDcOvpSele "BSW_u16RawVolMonDcOvpSele" UWORD F_0v0012210012_p0_22 1 2 0 80.01831502 ECU_ADDRESS 0x70005686 /end MEASUREMENT
/begin MEASUREMENT BSW_u16RawVolP16VMulti "BSW_u16RawVolP16VMulti" UWORD F_0v0012210012_p0_22 1 2 0 80.01831502 ECU_ADDRESS 0x70005684 /end MEASUREMENT
/begin MEASUREMENT BSW_u16RawVolP5VHS "BSW_u16RawVolP5VHS" UWORD F_0v0012210012_p0_22 1 2 0 80.01831502 ECU_ADDRESS 0x70005682 /end MEASUREMENT
/begin MEASUREMENT BSW_u16RawVolP5VHsREF "BSW_u16RawVolP5VHsREF" UWORD F_0v0012210012_p0_22 1 2 0 80.01831502 ECU_ADDRESS 0x70005680 /end MEASUREMENT
/begin MEASUREMENT BSW_u16RawVolP5VLS "BSW_u16RawVolP5VLS" UWORD F_0v0012210012_p0_22 1 2 0 80.01831502 ECU_ADDRESS 0x7000567E /end MEASUREMENT
/begin MEASUREMENT BSW_u16RawVolP5VLsREF "BSW_u16RawVolP5VLsREF" UWORD F_0v0012210012_p0_22 1 2 0 80.01831502 ECU_ADDRESS 0x7000567C /end MEASUREMENT
/begin MEASUREMENT BSW_u16RawVolP5VREF "BSW_u16RawVolP5VREF" UWORD F_0v0012210012_p0_22 1 2 0 80.01831502 ECU_ADDRESS 0x7000567A /end MEASUREMENT
/begin MEASUREMENT BSW_u16RawVolt15VRdc "BSW_u16RawVolt15VRdc" UWORD F_0v0012210012_p0_22 1 2 0 80.01831502 ECU_ADDRESS 0x70005678 /end MEASUREMENT
/begin MEASUREMENT BSW_u16RawVoltDclinkFIL "BSW_u16RawVoltDclinkFIL" UWORD F_0v0012210012_p0_22 1 2 0 80.01831502 ECU_ADDRESS 0x70005676 /end MEASUREMENT
/begin MEASUREMENT BSW_u16SelfChkDelay "...." UWORD I_1 1 2 0 65535 ECU_ADDRESS 0x70005674 /end MEASUREMENT
/begin MEASUREMENT BSW_u16Var1 "BSW_u16Var1" UWORD I_1 1 2 0 65535 ECU_ADDRESS 0x70005672 /end MEASUREMENT
/begin MEASUREMENT BSW_u16VsiReadyDelay "...." UWORD I_1 1 2 0 65535 ECU_ADDRESS 0x70005670 /end MEASUREMENT
/begin MEASUREMENT BSW_u16WriteNvMMaxTime "Write NvM Max Time" UWORD F_0v001_p0_21 1 2 0 65.535 ECU_ADDRESS 0x7000566E /end MEASUREMENT
/begin MEASUREMENT BSW_u32CbkRxAckCntSGPepsMsgSts "..." ULONG I_1 1 2 0 4294967295 ECU_ADDRESS 0x70005714 /end MEASUREMENT
/begin MEASUREMENT BSW_u32CbkRxAckCntSGRx2Msg_Count "..." ULONG I_1 1 2 0 4294967295 ECU_ADDRESS 0x70005728 /end MEASUREMENT
/begin MEASUREMENT BSW_u32FeeNextFreePageAddr "Fee Next Free Page Addr" ULONG I_1 1 2 0 4294967295 ECU_ADDRESS 0x70005708 /end MEASUREMENT
/begin MEASUREMENT BSW_u32RcvUdsCanId "..." ULONG I_1 1 2 0 4294967295 ECU_ADDRESS 0x70005704 /end MEASUREMENT
/begin MEASUREMENT BSW_u32StackUsed "Stack used (bytes)" ULONG F_4_p0_23 1 2 0 1.717986918E+010 ECU_ADDRESS 0x70005700 /end MEASUREMENT
/begin MEASUREMENT BSW_u32VSICounterCkreq "..." ULONG I_1 1 2 0 4294967295 ECU_ADDRESS 0x700056FC /end MEASUREMENT
/begin MEASUREMENT BSW_u32VSICounterSafeCkreq "..." ULONG I_1 1 2 0 4294967295 ECU_ADDRESS 0x700056F4 /end MEASUREMENT
/begin MEASUREMENT BSW_u32VSICounterTimeoutCs "..." ULONG I_1 1 2 0 4294967295 ECU_ADDRESS 0x700056F0 /end MEASUREMENT
/begin MEASUREMENT BSW_u32VSICounterTimeoutFrame "..." ULONG I_1 1 2 0 4294967295 ECU_ADDRESS 0x700056EC /end MEASUREMENT
/begin MEASUREMENT BSW_u32VSICounterTimeoutSafeTCalc "..." ULONG I_1 1 2 0 4294967295 ECU_ADDRESS 0x700056E8 /end MEASUREMENT
/begin MEASUREMENT BSW_u32VSICounterTimeoutSyncPos "..." ULONG I_1 1 2 0 4294967295 ECU_ADDRESS 0x700056E4 /end MEASUREMENT
/begin MEASUREMENT BSW_u32VSICounterTimeoutTCalc "..." ULONG I_1 1 2 0 4294967295 ECU_ADDRESS 0x700056E0 /end MEASUREMENT
/begin MEASUREMENT BSW_u32VSISafeTimeDuration "..." ULONG F_0v01_p0_16 1 2 0 42949672.95 ECU_ADDRESS 0x700056DC /end MEASUREMENT
/begin MEASUREMENT BSW_u32VSISafeTimeDurationMax "..." ULONG F_0v01_p0_16 1 2 0 42949672.95 ECU_ADDRESS 0x700056D8 /end MEASUREMENT
/begin MEASUREMENT BSW_u32VSISafeTimeDurationMin "..." ULONG F_0v01_p0_16 1 2 0 42949672.95 ECU_ADDRESS 0x700056D4 /end MEASUREMENT
/begin MEASUREMENT BSW_u32VSITimeDuration "..." ULONG F_0v01_p0_16 1 2 0 42949672.95 ECU_ADDRESS 0x700056D0 /end MEASUREMENT
/begin MEASUREMENT BSW_u32VSITimeDurationMax "..." ULONG F_0v01_p0_16 1 2 0 42949672.95 ECU_ADDRESS 0x700056CC /end MEASUREMENT
/begin MEASUREMENT BSW_u32VSITimeDurationMin "..." ULONG F_0v01_p0_16 1 2 0 42949672.95 ECU_ADDRESS 0x700056C8 /end MEASUREMENT
/begin MEASUREMENT BSW_u8CAN0BusOffCounter "..." ULONG I_1 1 2 0 4294967295 ECU_ADDRESS 0x700056C4 /end MEASUREMENT
/begin MEASUREMENT BSW_u8CAN1BusOffCounter "..." ULONG I_1 1 2 0 4294967295 ECU_ADDRESS 0x700056C0 /end MEASUREMENT
/begin MEASUREMENT BSW_u8FeeCurSector "Fee Current Sector" UBYTE I_1 1 2 0 255 ECU_ADDRESS 0x700056B9 /end MEASUREMENT
/begin MEASUREMENT BSW_u8FeeSectorChangeCnt "Fee Sector change count" UBYTE I_1 1 2 0 255 ECU_ADDRESS 0x700056B8 /end MEASUREMENT
/begin MEASUREMENT BSW_u8IntLockErrCnt "..." UBYTE I_1 1 2 0 255 ECU_ADDRESS 0x700056B7 /end MEASUREMENT
/begin MEASUREMENT BSW_u8McuMotTrqRollCnt "..." UBYTE I_1 1 2 0 255 ECU_ADDRESS 0x700056B6 /end MEASUREMENT
/begin MEASUREMENT BSW_u8McuStsRollCnt "..." UBYTE I_1 1 2 0 255 ECU_ADDRESS 0x700056B5 /end MEASUREMENT
/begin MEASUREMENT BSW_u8NvMReturnResult "NvM Return Result" UBYTE I_1 1 2 0 255 ECU_ADDRESS 0x700056B3 /end MEASUREMENT
/begin MEASUREMENT BSW_u8NvmMngStt "..." UBYTE I_1 1 2 0 255 ECU_ADDRESS 0x700056B4 /end MEASUREMENT
/begin MEASUREMENT BSW_u8Rx1CsumErrCnt "..." UBYTE I_1 1 2 0 255 ECU_ADDRESS 0x700056AB /end MEASUREMENT
/begin MEASUREMENT BSW_u8Rx1RcErrCnt "..." UBYTE I_1 1 2 0 255 ECU_ADDRESS 0x700056A9 /end MEASUREMENT
/begin MEASUREMENT BSW_u8Rx1RcLast "..." UBYTE I_1 1 2 0 255 ECU_ADDRESS 0x700056AA /end MEASUREMENT
/begin MEASUREMENT BSW_u8Rx1RcUnchangedErrCnt "..." UBYTE I_1 1 2 0 255 ECU_ADDRESS 0x700056A8 /end MEASUREMENT
/begin MEASUREMENT BSW_u8Rx2CsumErrCnt "..." UBYTE I_1 1 2 0 255 ECU_ADDRESS 0x700056A7 /end MEASUREMENT
/begin MEASUREMENT BSW_u8Rx2RcErrCnt "..." UBYTE I_1 1 2 0 255 ECU_ADDRESS 0x700056A5 /end MEASUREMENT
/begin MEASUREMENT BSW_u8Rx2RcLast "..." UBYTE I_1 1 2 0 255 ECU_ADDRESS 0x700056A6 /end MEASUREMENT
/begin MEASUREMENT BSW_u8Rx2RcUnchangedErrCnt "..." UBYTE I_1 1 2 0 255 ECU_ADDRESS 0x700056A4 /end MEASUREMENT
/begin MEASUREMENT BSW_u8Rx3CsumErrCnt "..." UBYTE I_1 1 2 0 255 ECU_ADDRESS 0x700056A3 /end MEASUREMENT
/begin MEASUREMENT BSW_u8Rx3RcErrCnt "..." UBYTE I_1 1 2 0 255 ECU_ADDRESS 0x700056A1 /end MEASUREMENT
/begin MEASUREMENT BSW_u8Rx3RcLast "..." UBYTE I_1 1 2 0 255 ECU_ADDRESS 0x700056A2 /end MEASUREMENT
/begin MEASUREMENT BSW_u8Rx3RcUnchangedErrCnt "..." UBYTE I_1 1 2 0 255 ECU_ADDRESS 0x700056A0 /end MEASUREMENT
/begin MEASUREMENT BSW_u8Rx5CsumErrCnt "..." UBYTE I_1 1 2 0 255 ECU_ADDRESS 0x7000569F /end MEASUREMENT
/begin MEASUREMENT BSW_u8Rx5RcErrCnt "..." UBYTE I_1 1 2 0 255 ECU_ADDRESS 0x7000569D /end MEASUREMENT
/begin MEASUREMENT BSW_u8Rx5RcLast "..." UBYTE I_1 1 2 0 255 ECU_ADDRESS 0x7000569E /end MEASUREMENT
/begin MEASUREMENT BSW_u8Rx5RcUnchangedErrCnt "..." UBYTE I_1 1 2 0 255 ECU_ADDRESS 0x7000569C /end MEASUREMENT
/begin MEASUREMENT BSW_u8SelfChkErr "..." UBYTE I_1 1 2 0 255 ECU_ADDRESS 0x700056AF /end MEASUREMENT
/begin MEASUREMENT CCU6_au32PWMOnTime "." ULONG F_1_p0_5 1 2 0 4294967295 MATRIX_DIM 3 1 1 ECU_ADDRESS 0x7000595C /end MEASUREMENT
/begin MEASUREMENT CCU6_au32PWMOnTime[0] "CCU6_au32PWMOnTime[0]" ULONG F_1_p0_5 1 2 0 4294967295 ECU_ADDRESS 0x7000595C /end MEASUREMENT
/begin MEASUREMENT CCU6_au32PWMOnTime[1] "CCU6_au32PWMOnTime[1]" ULONG F_1_p0_5 1 2 0 4294967295 ECU_ADDRESS 0x70005960 /end MEASUREMENT
/begin MEASUREMENT CCU6_au32PWMOnTime[2] "CCU6_au32PWMOnTime[2]" ULONG F_1_p0_5 1 2 0 4294967295 ECU_ADDRESS 0x70005964 /end MEASUREMENT
/begin MEASUREMENT CCU6_bAkdAfterAscReq "..." UBYTE Bool_ON_OFF 1 2 0 1 BIT_MASK 0x01 ECU_ADDRESS 0x70005996 /end MEASUREMENT
/begin MEASUREMENT CCU6_bClrTrapReq "..." UBYTE Bool_ON_OFF 1 2 0 1 BIT_MASK 0x01 ECU_ADDRESS 0x70005995 /end MEASUREMENT
/begin MEASUREMENT CCU6_bHwFaultDcOvVolt "..." UBYTE Bool_ON_OFF 1 2 0 1 BIT_MASK 0x01 ECU_ADDRESS 0x70005994 /end MEASUREMENT
/begin MEASUREMENT CCU6_bHwFaultIgbtH "..." UBYTE Bool_ON_OFF 1 2 0 1 BIT_MASK 0x01 ECU_ADDRESS 0x70005993 /end MEASUREMENT
/begin MEASUREMENT CCU6_bHwFaultIgbtL "..." UBYTE Bool_ON_OFF 1 2 0 1 BIT_MASK 0x01 ECU_ADDRESS 0x70005992 /end MEASUREMENT
/begin MEASUREMENT CCU6_bHwFaultOvcU "..." UBYTE Bool_ON_OFF 1 2 0 1 BIT_MASK 0x01 ECU_ADDRESS 0x70005991 /end MEASUREMENT
/begin MEASUREMENT CCU6_bHwFaultOvcV "..." UBYTE Bool_ON_OFF 1 2 0 1 BIT_MASK 0x01 ECU_ADDRESS 0x70005990 /end MEASUREMENT
/begin MEASUREMENT CCU6_bHwFaultOvcW "..." UBYTE Bool_ON_OFF 1 2 0 1 BIT_MASK 0x01 ECU_ADDRESS 0x7000598F /end MEASUREMENT
/begin MEASUREMENT CCU6_bIgbtHighSideShort "..." UBYTE Bool_ON_OFF 1 2 0 1 BIT_MASK 0x01 ECU_ADDRESS 0x7000598E /end MEASUREMENT
/begin MEASUREMENT CCU6_bIgbtLowSideShort "..." UBYTE Bool_ON_OFF 1 2 0 1 BIT_MASK 0x01 ECU_ADDRESS 0x7000598D /end MEASUREMENT
/begin MEASUREMENT CCU6_bIsCCU6Start "..." UBYTE Bool_ON_OFF 1 2 0 1 BIT_MASK 0x01 ECU_ADDRESS 0x7000598C /end MEASUREMENT
/begin MEASUREMENT CCU6_bIuvwCompReq "..." UBYTE Bool_ON_OFF 1 2 0 1 BIT_MASK 0x01 ECU_ADDRESS 0x7000598B /end MEASUREMENT
/begin MEASUREMENT CCU6_bMotorSpdRdy "..." UBYTE Bool_ON_OFF 1 2 0 1 BIT_MASK 0x01 ECU_ADDRESS 0x7000598A /end MEASUREMENT
/begin MEASUREMENT CCU6_bP5VDiagReinitCmd "..." UBYTE Bool_ON_OFF 1 2 0 1 BIT_MASK 0x01 ECU_ADDRESS 0x70005989 /end MEASUREMENT
/begin MEASUREMENT CCU6_bP5VHSFltFlg "..." UBYTE Bool_ON_OFF 1 2 0 1 BIT_MASK 0x01 ECU_ADDRESS 0x70005988 /end MEASUREMENT
/begin MEASUREMENT CCU6_bP5VLSFltFlg "..." UBYTE Bool_ON_OFF 1 2 0 1 BIT_MASK 0x01 ECU_ADDRESS 0x70005987 /end MEASUREMENT
/begin MEASUREMENT CCU6_bPwmMidPointU "..." UBYTE Bool_ON_OFF 1 2 0 1 BIT_MASK 0x01 ECU_ADDRESS 0x70005986 /end MEASUREMENT
/begin MEASUREMENT CCU6_bPwmMidPointV "..." UBYTE Bool_ON_OFF 1 2 0 1 BIT_MASK 0x01 ECU_ADDRESS 0x70005985 /end MEASUREMENT
/begin MEASUREMENT CCU6_bPwmMidPointW "..." UBYTE Bool_ON_OFF 1 2 0 1 BIT_MASK 0x01 ECU_ADDRESS 0x70005984 /end MEASUREMENT
/begin MEASUREMENT CCU6_bPwmOnGoingFlg "..." UBYTE Bool_ON_OFF 1 2 0 1 BIT_MASK 0x01 ECU_ADDRESS 0x70005983 /end MEASUREMENT
/begin MEASUREMENT CCU6_bT12ZeroMatchFlg "..." UBYTE Bool_ON_OFF 1 2 0 1 BIT_MASK 0x01 ECU_ADDRESS 0x70005982 /end MEASUREMENT
/begin MEASUREMENT CCU6_bTrapTrigger "..." UBYTE Bool_ON_OFF 1 2 0 1 BIT_MASK 0x01 ECU_ADDRESS 0x70005981 /end MEASUREMENT
/begin MEASUREMENT CCU6_f32DrvClkHsDuty "..." FLOAT32_IEEE I_1 1 2 -3.402823466E+038 3.402823466E+038 ECU_ADDRESS 0x7000597C /end MEASUREMENT
/begin MEASUREMENT CCU6_f32DrvClkLsDuty "..." FLOAT32_IEEE I_1 1 2 -3.402823466E+038 3.402823466E+038 ECU_ADDRESS 0x70005978 /end MEASUREMENT
/begin MEASUREMENT CCU6_f32HighVolPhys "..." FLOAT32_IEEE I_1 1 2 -3.402823466E+038 3.402823466E+038 ECU_ADDRESS 0x70005974 /end MEASUREMENT
/begin MEASUREMENT CCU6_f32PwmDutyPhysUZ "..." FLOAT32_IEEE I_1 1 2 -3.402823466E+038 3.402823466E+038 ECU_ADDRESS 0x70005970 /end MEASUREMENT
/begin MEASUREMENT CCU6_f32PwmDutyPhysVZ "..." FLOAT32_IEEE I_1 1 2 -3.402823466E+038 3.402823466E+038 ECU_ADDRESS 0x7000596C /end MEASUREMENT
/begin MEASUREMENT CCU6_f32PwmDutyPhysWZ "..." FLOAT32_IEEE I_1 1 2 -3.402823466E+038 3.402823466E+038 ECU_ADDRESS 0x70005968 /end MEASUREMENT
/begin MEASUREMENT CCU6_u16AlimPowerOnDelay "..." UWORD I_1 1 2 0 65535 ECU_ADDRESS 0x7000593A /end MEASUREMENT
/begin MEASUREMENT CCU6_u16CCU6T13CmpVal "PWM duty of CCU6" UWORD I_1 1 2 0 65535 ECU_ADDRESS 0x70000C5E /end MEASUREMENT
/begin MEASUREMENT CCU6_u16HighVolAdc "..." UWORD I_1 1 2 0 65535 ECU_ADDRESS 0x70005936 /end MEASUREMENT
/begin MEASUREMENT CCU6_u16McuAscSttDelay "..." UWORD I_1 1 2 0 65535 ECU_ADDRESS 0x70005934 /end MEASUREMENT
/begin MEASUREMENT CCU6_u16P5VHSAdc "..." UWORD I_3 1 2 0 65535 ECU_ADDRESS 0x70005932 /end MEASUREMENT
/begin MEASUREMENT CCU6_u16PowerOnDelay "..." UWORD I_1 1 2 0 65535 ECU_ADDRESS 0x70005930 /end MEASUREMENT
/begin MEASUREMENT CCU6_u16PwmMaxDutyCyc "..." UWORD I_1 1 2 0 65535 ECU_ADDRESS 0x7000592E /end MEASUREMENT
/begin MEASUREMENT CCU6_u16PwmMidPointErrCnt "..." UWORD I_1 1 2 0 65535 ECU_ADDRESS 0x7000592C /end MEASUREMENT
/begin MEASUREMENT CCU6_u16PwmMinDutyCyc "..." UWORD I_1 1 2 0 65535 ECU_ADDRESS 0x7000592A /end MEASUREMENT
/begin MEASUREMENT CCU6_u16PwmModReq "..." UWORD I_1 1 2 0 65535 ECU_ADDRESS 0x70005928 /end MEASUREMENT
/begin MEASUREMENT CCU6_u16T12CntVal "..." UWORD I_1 1 2 0 65535 ECU_ADDRESS 0x70005926 /end MEASUREMENT
/begin MEASUREMENT CCU6_u16T12PeriodVal "..." UWORD I_1 1 2 0 65535 ECU_ADDRESS 0x70000C5C /end MEASUREMENT
/begin MEASUREMENT CCU6_u16T13PeriodVal "..." UWORD I_1 1 2 0 65535 ECU_ADDRESS 0x70005924 /end MEASUREMENT
/begin MEASUREMENT CCU6_u32DrvClkHsDutyRaw "..." ULONG I_1 1 2 0 4294967295 ECU_ADDRESS 0x70005958 /end MEASUREMENT
/begin MEASUREMENT CCU6_u32DrvClkHsPerdRaw "..." ULONG I_1 1 2 0 4294967295 ECU_ADDRESS 0x70005954 /end MEASUREMENT
/begin MEASUREMENT CCU6_u32DrvClkLsDutyRaw "..." ULONG I_1 1 2 0 4294967295 ECU_ADDRESS 0x70005950 /end MEASUREMENT
/begin MEASUREMENT CCU6_u32DrvClkLsPerdRaw "..." ULONG I_1 1 2 0 4294967295 ECU_ADDRESS 0x7000594C /end MEASUREMENT
/begin MEASUREMENT CCU6_u32TrapCreq "..." ULONG I_1 1 2 0 4294967295 ECU_ADDRESS 0x70005948 /end MEASUREMENT
/begin MEASUREMENT CCU6_u8AscRecoverCnt "CCU6 State" UBYTE I_1 1 2 0 255 ECU_ADDRESS 0x70005946 /end MEASUREMENT
/begin MEASUREMENT CCU6_u8McuAscSttStep "CCU6 State" UBYTE I_1 1 2 0 255 ECU_ADDRESS 0x70005944 /end MEASUREMENT
/begin MEASUREMENT CCU6_u8McuAscType "CCU6 ASC Type" UBYTE I_1 1 2 0 255 ECU_ADDRESS 0x70005943 /end MEASUREMENT
/begin MEASUREMENT CCU6_u8P5VHSFltCnt "..." UBYTE I_1 1 2 0 255 ECU_ADDRESS 0x70005942 /end MEASUREMENT
/begin MEASUREMENT CCU6_u8P5VLSFltCnt "..." UBYTE I_1 1 2 0 255 ECU_ADDRESS 0x70005941 /end MEASUREMENT
/begin MEASUREMENT CCU6_u8P5VPowerMngStt "..." UBYTE I_1 1 2 0 255 ECU_ADDRESS 0x70005940 /end MEASUREMENT
/begin MEASUREMENT CCU6_u8P5VSelfTstTimCnt "..." UBYTE I_1 1 2 0 255 ECU_ADDRESS 0x7000593F /end MEASUREMENT
/begin MEASUREMENT CCU6_u8PreTestStep "..." UBYTE I_1 1 2 0 255 ECU_ADDRESS 0x7000593D /end MEASUREMENT
/begin MEASUREMENT CCU6_u8PwmState "CCU6 State" UBYTE I_1 1 2 0 255 ECU_ADDRESS 0x7000593C /end MEASUREMENT
/begin MEASUREMENT CalUsr_bIsCalibUpdEna "Check whether OC enabled" UBYTE Bool_ON_OFF 1 2 0 1 BIT_MASK 0x01 ECU_ADDRESS 0x70005768 /end MEASUREMENT
/begin MEASUREMENT CalUsr_u32ChkDataCrc "." ULONG I_1 1 2 0 4294967295 ECU_ADDRESS 0x70005764 /end MEASUREMENT
/begin MEASUREMENT CalUsr_u32POCalibDnEnaMskA "." ULONG I_1 1 2 0 4294967295 ECU_ADDRESS 0x70005760 /end MEASUREMENT
/begin MEASUREMENT CalUsr_u32POCalibDnEnaMskB "." ULONG I_1 1 2 0 4294967295 ECU_ADDRESS 0x7000575C /end MEASUREMENT
/begin MEASUREMENT CalUsr_u32PODataCRC "." ULONG I_1 1 2 0 4294967295 ECU_ADDRESS 0x70005758 /end MEASUREMENT
/begin MEASUREMENT DEVHAL_u8CheckEngineState "DEVHAL_u8CheckEngineState" UBYTE I_1 1 2 0 255 ECU_ADDRESS 0x70008D95 /end MEASUREMENT
/begin MEASUREMENT DSM_DtcNumber "DSM_DtcNumber" ULONG I_1 1 2 0 4294967295 MATRIX_DIM 10 1 1 ECU_ADDRESS 0x70008F90 /end MEASUREMENT
/begin MEASUREMENT DSM_DtcNumber[0] "DSM_DtcNumber[0]" ULONG I_1 1 2 0 4294967295 ECU_ADDRESS 0x70008F90 /end MEASUREMENT
/begin MEASUREMENT DSM_DtcNumber[1] "DSM_DtcNumber[1]" ULONG I_1 1 2 0 4294967295 ECU_ADDRESS 0x70008F94 /end MEASUREMENT
/begin MEASUREMENT DSM_DtcNumber[2] "DSM_DtcNumber[2]" ULONG I_1 1 2 0 4294967295 ECU_ADDRESS 0x70008F98 /end MEASUREMENT
/begin MEASUREMENT DSM_DtcNumber[3] "DSM_DtcNumber[3]" ULONG I_1 1 2 0 4294967295 ECU_ADDRESS 0x70008F9C /end MEASUREMENT
/begin MEASUREMENT DSM_DtcNumber[4] "DSM_DtcNumber[4]" ULONG I_1 1 2 0 4294967295 ECU_ADDRESS 0x70008FA0 /end MEASUREMENT
/begin MEASUREMENT DSM_DtcNumber[5] "DSM_DtcNumber[5]" ULONG I_1 1 2 0 4294967295 ECU_ADDRESS 0x70008FA4 /end MEASUREMENT
/begin MEASUREMENT DSM_DtcNumber[6] "DSM_DtcNumber[6]" ULONG I_1 1 2 0 4294967295 ECU_ADDRESS 0x70008FA8 /end MEASUREMENT
/begin MEASUREMENT DSM_DtcNumber[7] "DSM_DtcNumber[7]" ULONG I_1 1 2 0 4294967295 ECU_ADDRESS 0x70008FAC /end MEASUREMENT
/begin MEASUREMENT DSM_DtcNumber[8] "DSM_DtcNumber[8]" ULONG I_1 1 2 0 4294967295 ECU_ADDRESS 0x70008FB0 /end MEASUREMENT
/begin MEASUREMENT DSM_DtcNumber[9] "DSM_DtcNumber[9]" ULONG I_1 1 2 0 4294967295 ECU_ADDRESS 0x70008FB4 /end MEASUREMENT
/begin MEASUREMENT DSM_DtcStatusNvm "DID 120 -> DTC Setting Control" UBYTE F_1_p0_5 1 2 0 255 MATRIX_DIM 10 1 1 ECU_ADDRESS 0x700098A0 /end MEASUREMENT
/begin MEASUREMENT DSM_DtcStatusNvm[0] "DSM_DtcStatusNvm[0]" UBYTE F_1_p0_5 1 2 0 255 ECU_ADDRESS 0x700098A0 /end MEASUREMENT
/begin MEASUREMENT DSM_DtcStatusNvm[1] "DSM_DtcStatusNvm[1]" UBYTE F_1_p0_5 1 2 0 255 ECU_ADDRESS 0x700098A1 /end MEASUREMENT
/begin MEASUREMENT DSM_DtcStatusNvm[2] "DSM_DtcStatusNvm[2]" UBYTE F_1_p0_5 1 2 0 255 ECU_ADDRESS 0x700098A2 /end MEASUREMENT
/begin MEASUREMENT DSM_DtcStatusNvm[3] "DSM_DtcStatusNvm[3]" UBYTE F_1_p0_5 1 2 0 255 ECU_ADDRESS 0x700098A3 /end MEASUREMENT
/begin MEASUREMENT DSM_DtcStatusNvm[4] "DSM_DtcStatusNvm[4]" UBYTE F_1_p0_5 1 2 0 255 ECU_ADDRESS 0x700098A4 /end MEASUREMENT
/begin MEASUREMENT DSM_DtcStatusNvm[5] "DSM_DtcStatusNvm[5]" UBYTE F_1_p0_5 1 2 0 255 ECU_ADDRESS 0x700098A5 /end MEASUREMENT
/begin MEASUREMENT DSM_DtcStatusNvm[6] "DSM_DtcStatusNvm[6]" UBYTE F_1_p0_5 1 2 0 255 ECU_ADDRESS 0x700098A6 /end MEASUREMENT
/begin MEASUREMENT DSM_DtcStatusNvm[7] "DSM_DtcStatusNvm[7]" UBYTE F_1_p0_5 1 2 0 255 ECU_ADDRESS 0x700098A7 /end MEASUREMENT
/begin MEASUREMENT DSM_DtcStatusNvm[8] "DSM_DtcStatusNvm[8]" UBYTE F_1_p0_5 1 2 0 255 ECU_ADDRESS 0x700098A8 /end MEASUREMENT
/begin MEASUREMENT DSM_DtcStatusNvm[9] "DSM_DtcStatusNvm[9]" UBYTE F_1_p0_5 1 2 0 255 ECU_ADDRESS 0x700098A9 /end MEASUREMENT
/begin MEASUREMENT DSM_FaultFailureLevel "DSM_FaultFailureLevel" UBYTE I_25 1 2 0 255 MATRIX_DIM 2 1 1 ECU_ADDRESS 0x70008F8A /end MEASUREMENT
/begin MEASUREMENT DSM_FaultFailureLevel[0] "DSM_FaultFailureLevel[0]" UBYTE I_25 1 2 0 255 ECU_ADDRESS 0x70008F8A /end MEASUREMENT
/begin MEASUREMENT DSM_FaultFailureLevel[1] "DSM_FaultFailureLevel[1]" UBYTE I_25 1 2 0 255 ECU_ADDRESS 0x70008F8B /end MEASUREMENT
/begin MEASUREMENT ESM_EcuState "ESM_EcuState" UBYTE I_1 1 2 0 255 ECU_ADDRESS 0x70009966 /end MEASUREMENT
/begin MEASUREMENT ESM_OPERATIONAL_MODE "ESM_OPERATIONAL_MODE" UBYTE Bool_ON_OFF 1 2 0 1 BIT_MASK 0x04 ECU_ADDRESS 0x70009966 /end MEASUREMENT
/begin MEASUREMENT ESM_POWERLATCH_MODE "ESM_POWERLATCH_MODE" UBYTE Bool_ON_OFF 1 2 0 1 BIT_MASK 0x08 ECU_ADDRESS 0x70009966 /end MEASUREMENT
/begin MEASUREMENT ESM_POWER_OFF_MODE "ESM_POWER_OFF_MODE" UBYTE Bool_ON_OFF 1 2 0 1 BIT_MASK 0x10 ECU_ADDRESS 0x70009966 /end MEASUREMENT
/begin MEASUREMENT ESM_STARTUP_II_MODE "ESM_STARTUP_II_MODE" UBYTE Bool_ON_OFF 1 2 0 1 BIT_MASK 0x02 ECU_ADDRESS 0x70009966 /end MEASUREMENT
/begin MEASUREMENT ESM_STARTUP_I_MODE "ESM_STARTUP_I_MODE" UBYTE Bool_ON_OFF 1 2 0 1 BIT_MASK 0x01 ECU_ADDRESS 0x70009966 /end MEASUREMENT
/begin MEASUREMENT ESM_u16PowerLatchTempo "ESM_u16PowerLatchTempo" UWORD F_5_p0_26 1 2 0 327675 ECU_ADDRESS 0x70009964 /end MEASUREMENT
/begin MEASUREMENT FAIL_bCanErrChkDisabled "Indicates if CAN error check is disabled" UBYTE Bool_ON_OFF 1 2 0 1 BIT_MASK 0x01 ECU_ADDRESS 0x70009988 /end MEASUREMENT
/begin MEASUREMENT FAIL_bComLostDiagTEna "Indicates if external CAN communication started" UBYTE Bool_ON_OFF 1 2 0 1 BIT_MASK 0x01 ECU_ADDRESS 0x70009987 /end MEASUREMENT
/begin MEASUREMENT FAIL_bComLostDiagVEna "Indicates if external CAN communication started" UBYTE Bool_ON_OFF 1 2 0 1 BIT_MASK 0x01 ECU_ADDRESS 0x70009986 /end MEASUREMENT
/begin MEASUREMENT FAIL_bComLostDiagVHigh "Indicates if external CAN communication started" UBYTE Bool_ON_OFF 1 2 0 1 BIT_MASK 0x01 ECU_ADDRESS 0x70009985 /end MEASUREMENT
/begin MEASUREMENT FAIL_bComLostDiagVLow "Indicates if external CAN communication started" UBYTE Bool_ON_OFF 1 2 0 1 BIT_MASK 0x01 ECU_ADDRESS 0x70009984 /end MEASUREMENT
/begin MEASUREMENT FAIL_bDebug1 "FAIL_bDebug1" UBYTE Bool_ON_OFF 1 2 0 1 BIT_MASK 0x01 ECU_ADDRESS 0x70009983 /end MEASUREMENT
/begin MEASUREMENT FAIL_bRstHotFlag "Detection power off without OS TASK_POWER_DOWN activation" UBYTE Bool_ON_OFF 1 2 0 1 BIT_MASK 0x01 ECU_ADDRESS 0x70009982 /end MEASUREMENT
/begin MEASUREMENT FAIL_bRstHotFlagNvm "Flag to detect power off without OS TASK_POWER_DOWN activation (stored into NVM)" UBYTE Bool_ON_OFF 1 2 0 1 BIT_MASK 0x01 ECU_ADDRESS 0x70009998 /end MEASUREMENT
/begin MEASUREMENT FAIL_u16ComLostDiagEnaCnt "ECU communication lost detection delay count" UWORD F_10_p0_27 1 2 0 655350 ECU_ADDRESS 0x7000997E /end MEASUREMENT
/begin MEASUREMENT FAIL_u16ComLostDiagVRecCnt "ECU communication lost detection delay count" UWORD F_10_p0_27 1 2 0 655350 ECU_ADDRESS 0x7000997C /end MEASUREMENT
/begin MEASUREMENT FAIL_u16KeyOnDelay "..." UWORD Id_0x00 1 2 0 65535 ECU_ADDRESS 0x7000997A /end MEASUREMENT
/begin MEASUREMENT FAIL_u16KeyOnValue "ECU communication lost detection delay count" UWORD I_1 1 2 0 65535 ECU_ADDRESS 0x70009978 /end MEASUREMENT
/begin MEASUREMENT FAIL_u16LvBatVoltRaw "ECU communication lost detection delay count" UWORD F_0v0128205128_p0_28 1 2 0 840.1923077 ECU_ADDRESS 0x70009976 /end MEASUREMENT
/begin MEASUREMENT FAIL_u16RstHotCntNvm "Number of detection power off without OS TASK_POWER_DOWN activation (stored into NVM)" UWORD I_1 1 2 0 65535 ECU_ADDRESS 0x7000999A /end MEASUREMENT
/begin MEASUREMENT FAIL_u16RstStartUpCntNvm "Number of power off detected with OS TASK_POWER_DOWN activation (stored into NVM)" UWORD I_1 1 2 0 65535 ECU_ADDRESS 0x7000999C /end MEASUREMENT
/begin MEASUREMENT FAIL_u16TimestampIgnNvm "Inverter Ignition time stamp (s)" UWORD I_1 1 2 0 65535 ECU_ADDRESS 0x7000998A /end MEASUREMENT
/begin MEASUREMENT FAIL_u16hvloopflag "..." UWORD Id_0x00 1 2 0 65535 ECU_ADDRESS 0x70009974 /end MEASUREMENT
/begin MEASUREMENT FAIL_u32TimestampLifeNvm "Inverter life time stamp (s)" ULONG I_1 1 2 0 4294967295 ECU_ADDRESS 0x7000998C /end MEASUREMENT
/begin MEASUREMENT FAIL_u8CCP_FaultLevel "..." UBYTE I_1 1 2 0 255 ECU_ADDRESS 0x70009980 /end MEASUREMENT
/begin MEASUREMENT FaultBSW_COM_BusOff_CAN1Aut "FaultBSW_COM_BusOff_CAN1Aut" UBYTE Bool_ON_OFF 1 2 0 1 BIT_MASK 0x01 ECU_ADDRESS 0x70009A0E /end MEASUREMENT
/begin MEASUREMENT FaultBSW_COM_BusOff_CAN1Detected "FaultBSW_COM_BusOff_CAN1Detected" UBYTE Bool_ON_OFF 1 2 0 1 BIT_MASK 0x01 ECU_ADDRESS 0x70009ACA /end MEASUREMENT
/begin MEASUREMENT FaultBSW_COM_BusOff_CAN1Logged "FaultBSW_COM_BusOff_CAN1Logged" UBYTE Bool_ON_OFF 1 2 0 1 BIT_MASK 0x01 ECU_ADDRESS 0x70009A6C /end MEASUREMENT
/begin MEASUREMENT FaultBSW_COM_ChecksumErrVCUAut "FaultBSW_COM_ChecksumErrVCUAut" UBYTE Bool_ON_OFF 1 2 0 1 BIT_MASK 0x02 ECU_ADDRESS 0x70009A0E /end MEASUREMENT
/begin MEASUREMENT FaultBSW_COM_ChecksumErrVCUDetected "FaultBSW_COM_ChecksumErrVCUDetected" UBYTE Bool_ON_OFF 1 2 0 1 BIT_MASK 0x02 ECU_ADDRESS 0x70009ACA /end MEASUREMENT
/begin MEASUREMENT FaultBSW_COM_ChecksumErrVCULogged "FaultBSW_COM_ChecksumErrVCULogged" UBYTE Bool_ON_OFF 1 2 0 1 BIT_MASK 0x02 ECU_ADDRESS 0x70009A6C /end MEASUREMENT
/begin MEASUREMENT FaultBSW_COM_Detected "FaultBSW_COM_Detected" UWORD I_1 1 2 0 65535 ECU_ADDRESS 0x70009ACA /end MEASUREMENT
/begin MEASUREMENT FaultBSW_COM_InterFaultVCUAut "FaultBSW_COM_InterFaultVCUAut" UBYTE Bool_ON_OFF 1 2 0 1 BIT_MASK 0x04 ECU_ADDRESS 0x70009A0E /end MEASUREMENT
/begin MEASUREMENT FaultBSW_COM_InterFaultVCUDetected "FaultBSW_COM_InterFaultVCUDetected" UBYTE Bool_ON_OFF 1 2 0 1 BIT_MASK 0x04 ECU_ADDRESS 0x70009ACA /end MEASUREMENT
/begin MEASUREMENT FaultBSW_COM_InterFaultVCULogged "FaultBSW_COM_InterFaultVCULogged" UBYTE Bool_ON_OFF 1 2 0 1 BIT_MASK 0x04 ECU_ADDRESS 0x70009A6C /end MEASUREMENT
/begin MEASUREMENT FaultBSW_COM_Logged "FaultBSW_COM_Logged" UWORD I_1 1 2 0 65535 ECU_ADDRESS 0x70009A6C /end MEASUREMENT
/begin MEASUREMENT FaultBSW_COM_RollCntErrVCUAut "FaultBSW_COM_RollCntErrVCUAut" UBYTE Bool_ON_OFF 1 2 0 1 BIT_MASK 0x08 ECU_ADDRESS 0x70009A0E /end MEASUREMENT
/begin MEASUREMENT FaultBSW_COM_RollCntErrVCUDetected "FaultBSW_COM_RollCntErrVCUDetected" UBYTE Bool_ON_OFF 1 2 0 1 BIT_MASK 0x08 ECU_ADDRESS 0x70009ACA /end MEASUREMENT
/begin MEASUREMENT FaultBSW_COM_RollCntErrVCULogged "FaultBSW_COM_RollCntErrVCULogged" UBYTE Bool_ON_OFF 1 2 0 1 BIT_MASK 0x08 ECU_ADDRESS 0x70009A6C /end MEASUREMENT
/begin MEASUREMENT FaultBSW_COM_TimoutRxBCMAut "FaultBSW_COM_TimoutRxBCMAut" UBYTE Bool_ON_OFF 1 2 0 1 BIT_MASK 0x10 ECU_ADDRESS 0x70009A0E /end MEASUREMENT
/begin MEASUREMENT FaultBSW_COM_TimoutRxBCMDetected "FaultBSW_COM_TimoutRxBCMDetected" UBYTE Bool_ON_OFF 1 2 0 1 BIT_MASK 0x10 ECU_ADDRESS 0x70009ACA /end MEASUREMENT
/begin MEASUREMENT FaultBSW_COM_TimoutRxBCMLogged "FaultBSW_COM_TimoutRxBCMLogged" UBYTE Bool_ON_OFF 1 2 0 1 BIT_MASK 0x10 ECU_ADDRESS 0x70009A6C /end MEASUREMENT
/begin MEASUREMENT FaultBSW_COM_TimoutRxBMSHAut "FaultBSW_COM_TimoutRxBMSHAut" UBYTE Bool_ON_OFF 1 2 0 1 BIT_MASK 0x20 ECU_ADDRESS 0x70009A0E /end MEASUREMENT
/begin MEASUREMENT FaultBSW_COM_TimoutRxBMSHDetected "FaultBSW_COM_TimoutRxBMSHDetected" UBYTE Bool_ON_OFF 1 2 0 1 BIT_MASK 0x20 ECU_ADDRESS 0x70009ACA /end MEASUREMENT
/begin MEASUREMENT FaultBSW_COM_TimoutRxBMSHLogged "FaultBSW_COM_TimoutRxBMSHLogged" UBYTE Bool_ON_OFF 1 2 0 1 BIT_MASK 0x20 ECU_ADDRESS 0x70009A6C /end MEASUREMENT
/begin MEASUREMENT FaultBSW_COM_TimoutRxEMSAut "FaultBSW_COM_TimoutRxEMSAut" UBYTE Bool_ON_OFF 1 2 0 1 BIT_MASK 0x40 ECU_ADDRESS 0x70009A0E /end MEASUREMENT
/begin MEASUREMENT FaultBSW_COM_TimoutRxEMSDetected "FaultBSW_COM_TimoutRxEMSDetected" UBYTE Bool_ON_OFF 1 2 0 1 BIT_MASK 0x40 ECU_ADDRESS 0x70009ACA /end MEASUREMENT
/begin MEASUREMENT FaultBSW_COM_TimoutRxEMSLogged "FaultBSW_COM_TimoutRxEMSLogged" UBYTE Bool_ON_OFF 1 2 0 1 BIT_MASK 0x40 ECU_ADDRESS 0x70009A6C /end MEASUREMENT
/begin MEASUREMENT FaultBSW_COM_TimoutRxGCUAut "FaultBSW_COM_TimoutRxGCUAut" UBYTE Bool_ON_OFF 1 2 0 1 BIT_MASK 0x80 ECU_ADDRESS 0x70009A0E /end MEASUREMENT
/begin MEASUREMENT FaultBSW_COM_TimoutRxGCUDetected "FaultBSW_COM_TimoutRxGCUDetected" UBYTE Bool_ON_OFF 1 2 0 1 BIT_MASK 0x80 ECU_ADDRESS 0x70009ACA /end MEASUREMENT
/begin MEASUREMENT FaultBSW_COM_TimoutRxGCULogged "FaultBSW_COM_TimoutRxGCULogged" UBYTE Bool_ON_OFF 1 2 0 1 BIT_MASK 0x80 ECU_ADDRESS 0x70009A6C /end MEASUREMENT
/begin MEASUREMENT FaultBSW_COM_TimoutRxIPCAut "FaultBSW_COM_TimoutRxIPCAut" UBYTE Bool_ON_OFF 1 2 0 1 BIT_MASK 0x01 ECU_ADDRESS 0x70009A0F /end MEASUREMENT
/begin MEASUREMENT FaultBSW_COM_TimoutRxIPCDetected "FaultBSW_COM_TimoutRxIPCDetected" UBYTE Bool_ON_OFF 1 2 0 1 BIT_MASK 0x01 ECU_ADDRESS 0x70009ACB /end MEASUREMENT
/begin MEASUREMENT FaultBSW_COM_TimoutRxIPCLogged "FaultBSW_COM_TimoutRxIPCLogged" UBYTE Bool_ON_OFF 1 2 0 1 BIT_MASK 0x01 ECU_ADDRESS 0x70009A6D /end MEASUREMENT
/begin MEASUREMENT FaultBSW_COM_TimoutRxTBOXAut "FaultBSW_COM_TimoutRxTBOXAut" UBYTE Bool_ON_OFF 1 2 0 1 BIT_MASK 0x02 ECU_ADDRESS 0x70009A0F /end MEASUREMENT
/begin MEASUREMENT FaultBSW_COM_TimoutRxTBOXDetected "FaultBSW_COM_TimoutRxTBOXDetected" UBYTE Bool_ON_OFF 1 2 0 1 BIT_MASK 0x02 ECU_ADDRESS 0x70009ACB /end MEASUREMENT
/begin MEASUREMENT FaultBSW_COM_TimoutRxTBOXLogged "FaultBSW_COM_TimoutRxTBOXLogged" UBYTE Bool_ON_OFF 1 2 0 1 BIT_MASK 0x02 ECU_ADDRESS 0x70009A6D /end MEASUREMENT
/begin MEASUREMENT FaultBSW_COM_TimoutRxVCUAut "FaultBSW_COM_TimoutRxVCUAut" UBYTE Bool_ON_OFF 1 2 0 1 BIT_MASK 0x04 ECU_ADDRESS 0x70009A0F /end MEASUREMENT
/begin MEASUREMENT FaultBSW_COM_TimoutRxVCUDetected "FaultBSW_COM_TimoutRxVCUDetected" UBYTE Bool_ON_OFF 1 2 0 1 BIT_MASK 0x04 ECU_ADDRESS 0x70009ACB /end MEASUREMENT
/begin MEASUREMENT FaultBSW_COM_TimoutRxVCULogged "FaultBSW_COM_TimoutRxVCULogged" UBYTE Bool_ON_OFF 1 2 0 1 BIT_MASK 0x04 ECU_ADDRESS 0x70009A6D /end MEASUREMENT
/begin MEASUREMENT FaultBSW_HW2_Detected "FaultBSW_HW2_Detected" UWORD I_1 1 2 0 65535 ECU_ADDRESS 0x70009ACC /end MEASUREMENT
/begin MEASUREMENT FaultBSW_HW2_FPGA_OverVoltVBatAut "FaultBSW_HW2_FPGA_OverVoltVBatAut" UBYTE Bool_ON_OFF 1 2 0 1 BIT_MASK 0x01 ECU_ADDRESS 0x70009A10 /end MEASUREMENT
/begin MEASUREMENT FaultBSW_HW2_FPGA_OverVoltVBatDetected "FaultBSW_HW2_FPGA_OverVoltVBatDetected" UBYTE Bool_ON_OFF 1 2 0 1 BIT_MASK 0x01 ECU_ADDRESS 0x70009ACC /end MEASUREMENT
/begin MEASUREMENT FaultBSW_HW2_FPGA_OverVoltVBatLogged "FaultBSW_HW2_FPGA_OverVoltVBatLogged" UBYTE Bool_ON_OFF 1 2 0 1 BIT_MASK 0x01 ECU_ADDRESS 0x70009A6E /end MEASUREMENT
/begin MEASUREMENT FaultBSW_HW2_Logged "FaultBSW_HW2_Logged" UWORD I_1 1 2 0 65535 ECU_ADDRESS 0x70009A6E /end MEASUREMENT
/begin MEASUREMENT FaultBSW_HW2_SafeTlib_PreRunAut "FaultBSW_HW2_SafeTlib_PreRunAut" UBYTE Bool_ON_OFF 1 2 0 1 BIT_MASK 0x02 ECU_ADDRESS 0x70009A10 /end MEASUREMENT
/begin MEASUREMENT FaultBSW_HW2_SafeTlib_PreRunDetected "FaultBSW_HW2_SafeTlib_PreRunDetected" UBYTE Bool_ON_OFF 1 2 0 1 BIT_MASK 0x02 ECU_ADDRESS 0x70009ACC /end MEASUREMENT
/begin MEASUREMENT FaultBSW_HW2_SafeTlib_PreRunLogged "FaultBSW_HW2_SafeTlib_PreRunLogged" UBYTE Bool_ON_OFF 1 2 0 1 BIT_MASK 0x02 ECU_ADDRESS 0x70009A6E /end MEASUREMENT
/begin MEASUREMENT FaultBSW_HW_Detected "FaultBSW_HW_Detected" UWORD I_1 1 2 0 65535 ECU_ADDRESS 0x70009ACE /end MEASUREMENT
/begin MEASUREMENT FaultBSW_HW_EasAckFailAut "FaultBSW_HW_EasAckFailAut" UBYTE Bool_ON_OFF 1 2 0 1 BIT_MASK 0x01 ECU_ADDRESS 0x70009A12 /end MEASUREMENT
/begin MEASUREMENT FaultBSW_HW_EasAckFailDetected "FaultBSW_HW_EasAckFailDetected" UBYTE Bool_ON_OFF 1 2 0 1 BIT_MASK 0x01 ECU_ADDRESS 0x70009ACE /end MEASUREMENT
/begin MEASUREMENT FaultBSW_HW_EasAckFailLogged "FaultBSW_HW_EasAckFailLogged" UBYTE Bool_ON_OFF 1 2 0 1 BIT_MASK 0x01 ECU_ADDRESS 0x70009A70 /end MEASUREMENT
/begin MEASUREMENT FaultBSW_HW_FPGA_IGBT_HAut "FaultBSW_HW_FPGA_IGBT_HAut" UBYTE Bool_ON_OFF 1 2 0 1 BIT_MASK 0x02 ECU_ADDRESS 0x70009A12 /end MEASUREMENT
/begin MEASUREMENT FaultBSW_HW_FPGA_IGBT_HDetected "FaultBSW_HW_FPGA_IGBT_HDetected" UBYTE Bool_ON_OFF 1 2 0 1 BIT_MASK 0x02 ECU_ADDRESS 0x70009ACE /end MEASUREMENT
/begin MEASUREMENT FaultBSW_HW_FPGA_IGBT_HLogged "FaultBSW_HW_FPGA_IGBT_HLogged" UBYTE Bool_ON_OFF 1 2 0 1 BIT_MASK 0x02 ECU_ADDRESS 0x70009A70 /end MEASUREMENT
/begin MEASUREMENT FaultBSW_HW_FPGA_IGBT_LAut "FaultBSW_HW_FPGA_IGBT_LAut" UBYTE Bool_ON_OFF 1 2 0 1 BIT_MASK 0x04 ECU_ADDRESS 0x70009A12 /end MEASUREMENT
/begin MEASUREMENT FaultBSW_HW_FPGA_IGBT_LDetected "FaultBSW_HW_FPGA_IGBT_LDetected" UBYTE Bool_ON_OFF 1 2 0 1 BIT_MASK 0x04 ECU_ADDRESS 0x70009ACE /end MEASUREMENT
/begin MEASUREMENT FaultBSW_HW_FPGA_IGBT_LLogged "FaultBSW_HW_FPGA_IGBT_LLogged" UBYTE Bool_ON_OFF 1 2 0 1 BIT_MASK 0x04 ECU_ADDRESS 0x70009A70 /end MEASUREMENT
/begin MEASUREMENT FaultBSW_HW_FPGA_OverUnderCurUIAut "FaultBSW_HW_FPGA_OverUnderCurUIAut" UBYTE Bool_ON_OFF 1 2 0 1 BIT_MASK 0x08 ECU_ADDRESS 0x70009A12 /end MEASUREMENT
/begin MEASUREMENT FaultBSW_HW_FPGA_OverUnderCurUIDetected "FaultBSW_HW_FPGA_OverUnderCurUIDetected" UBYTE Bool_ON_OFF 1 2 0 1 BIT_MASK 0x08 ECU_ADDRESS 0x70009ACE /end MEASUREMENT
/begin MEASUREMENT FaultBSW_HW_FPGA_OverUnderCurUILogged "FaultBSW_HW_FPGA_OverUnderCurUILogged" UBYTE Bool_ON_OFF 1 2 0 1 BIT_MASK 0x08 ECU_ADDRESS 0x70009A70 /end MEASUREMENT
/begin MEASUREMENT FaultBSW_HW_FPGA_OverUnderCurVIAut "FaultBSW_HW_FPGA_OverUnderCurVIAut" UBYTE Bool_ON_OFF 1 2 0 1 BIT_MASK 0x10 ECU_ADDRESS 0x70009A12 /end MEASUREMENT
/begin MEASUREMENT FaultBSW_HW_FPGA_OverUnderCurVIDetected "FaultBSW_HW_FPGA_OverUnderCurVIDetected" UBYTE Bool_ON_OFF 1 2 0 1 BIT_MASK 0x10 ECU_ADDRESS 0x70009ACE /end MEASUREMENT
/begin MEASUREMENT FaultBSW_HW_FPGA_OverUnderCurVILogged "FaultBSW_HW_FPGA_OverUnderCurVILogged" UBYTE Bool_ON_OFF 1 2 0 1 BIT_MASK 0x10 ECU_ADDRESS 0x70009A70 /end MEASUREMENT
/begin MEASUREMENT FaultBSW_HW_FPGA_OverUnderCurWIAut "FaultBSW_HW_FPGA_OverUnderCurWIAut" UBYTE Bool_ON_OFF 1 2 0 1 BIT_MASK 0x20 ECU_ADDRESS 0x70009A12 /end MEASUREMENT
/begin MEASUREMENT FaultBSW_HW_FPGA_OverUnderCurWIDetected "FaultBSW_HW_FPGA_OverUnderCurWIDetected" UBYTE Bool_ON_OFF 1 2 0 1 BIT_MASK 0x20 ECU_ADDRESS 0x70009ACE /end MEASUREMENT
/begin MEASUREMENT FaultBSW_HW_FPGA_OverUnderCurWILogged "FaultBSW_HW_FPGA_OverUnderCurWILogged" UBYTE Bool_ON_OFF 1 2 0 1 BIT_MASK 0x20 ECU_ADDRESS 0x70009A70 /end MEASUREMENT
/begin MEASUREMENT FaultBSW_HW_Logged "FaultBSW_HW_Logged" UWORD I_1 1 2 0 65535 ECU_ADDRESS 0x70009A70 /end MEASUREMENT
/begin MEASUREMENT FaultBSW_HW_OCDataNotRationalAut "FaultBSW_HW_OCDataNotRationalAut" UBYTE Bool_ON_OFF 1 2 0 1 BIT_MASK 0x40 ECU_ADDRESS 0x70009A12 /end MEASUREMENT
/begin MEASUREMENT FaultBSW_HW_OCDataNotRationalDetected "FaultBSW_HW_OCDataNotRationalDetected" UBYTE Bool_ON_OFF 1 2 0 1 BIT_MASK 0x40 ECU_ADDRESS 0x70009ACE /end MEASUREMENT
/begin MEASUREMENT FaultBSW_HW_OCDataNotRationalLogged "FaultBSW_HW_OCDataNotRationalLogged" UBYTE Bool_ON_OFF 1 2 0 1 BIT_MASK 0x40 ECU_ADDRESS 0x70009A70 /end MEASUREMENT
/begin MEASUREMENT FaultBSW_SYS_Detected "FaultBSW_SYS_Detected" UWORD I_1 1 2 0 65535 ECU_ADDRESS 0x70009AD0 /end MEASUREMENT
/begin MEASUREMENT FaultBSW_SYS_Logged "FaultBSW_SYS_Logged" UWORD I_1 1 2 0 65535 ECU_ADDRESS 0x70009A72 /end MEASUREMENT
/begin MEASUREMENT FaultBSW_SYS_RstHotAut "FaultBSW_SYS_RstHotAut" UBYTE Bool_ON_OFF 1 2 0 1 BIT_MASK 0x01 ECU_ADDRESS 0x70009A14 /end MEASUREMENT
/begin MEASUREMENT FaultBSW_SYS_RstHotDetected "FaultBSW_SYS_RstHotDetected" UBYTE Bool_ON_OFF 1 2 0 1 BIT_MASK 0x01 ECU_ADDRESS 0x70009AD0 /end MEASUREMENT
/begin MEASUREMENT FaultBSW_SYS_RstHotLogged "FaultBSW_SYS_RstHotLogged" UBYTE Bool_ON_OFF 1 2 0 1 BIT_MASK 0x01 ECU_ADDRESS 0x70009A72 /end MEASUREMENT
/begin MEASUREMENT FaultBSW_SYS_StackOverflowAut "FaultBSW_SYS_StackOverflowAut" UBYTE Bool_ON_OFF 1 2 0 1 BIT_MASK 0x02 ECU_ADDRESS 0x70009A14 /end MEASUREMENT
/begin MEASUREMENT FaultBSW_SYS_StackOverflowDetected "FaultBSW_SYS_StackOverflowDetected" UBYTE Bool_ON_OFF 1 2 0 1 BIT_MASK 0x02 ECU_ADDRESS 0x70009AD0 /end MEASUREMENT
/begin MEASUREMENT FaultBSW_SYS_StackOverflowLogged "FaultBSW_SYS_StackOverflowLogged" UBYTE Bool_ON_OFF 1 2 0 1 BIT_MASK 0x02 ECU_ADDRESS 0x70009A72 /end MEASUREMENT
/begin MEASUREMENT FaultBSW_VSI_Detected "FaultBSW_VSI_Detected" UWORD I_1 1 2 0 65535 ECU_ADDRESS 0x70009AD2 /end MEASUREMENT
/begin MEASUREMENT FaultBSW_VSI_Logged "FaultBSW_VSI_Logged" UWORD I_1 1 2 0 65535 ECU_ADDRESS 0x70009A74 /end MEASUREMENT
/begin MEASUREMENT FaultBSW_VSI_TimeoutTCalcAut "FaultBSW_VSI_TimeoutTCalcAut" UBYTE Bool_ON_OFF 1 2 0 1 BIT_MASK 0x01 ECU_ADDRESS 0x70009A16 /end MEASUREMENT
/begin MEASUREMENT FaultBSW_VSI_TimeoutTCalcDetected "FaultBSW_VSI_TimeoutTCalcDetected" UBYTE Bool_ON_OFF 1 2 0 1 BIT_MASK 0x01 ECU_ADDRESS 0x70009AD2 /end MEASUREMENT
/begin MEASUREMENT FaultBSW_VSI_TimeoutTCalcLogged "FaultBSW_VSI_TimeoutTCalcLogged" UBYTE Bool_ON_OFF 1 2 0 1 BIT_MASK 0x01 ECU_ADDRESS 0x70009A74 /end MEASUREMENT
/begin MEASUREMENT FaultEraseRequest "FaultEraseRequest" UWORD I_1 1 2 0 65535 ECU_ADDRESS 0x70008F88 /end MEASUREMENT
/begin MEASUREMENT FaultFSEVBHV_Detected "FaultFSEVBHV_Detected" UWORD I_1 1 2 0 65535 ECU_ADDRESS 0x70009AD4 /end MEASUREMENT
/begin MEASUREMENT FaultFSEVBHV_Logged "FaultFSEVBHV_Logged" UWORD I_1 1 2 0 65535 ECU_ADDRESS 0x70009A76 /end MEASUREMENT
/begin MEASUREMENT FaultFSEVBHV_OverVoltageAut "FaultFSEVBHV_OverVoltageAut" UBYTE Bool_ON_OFF 1 2 0 1 BIT_MASK 0x01 ECU_ADDRESS 0x70009A18 /end MEASUREMENT
/begin MEASUREMENT FaultFSEVBHV_OverVoltageDetected "FaultFSEVBHV_OverVoltageDetected" UBYTE Bool_ON_OFF 1 2 0 1 BIT_MASK 0x01 ECU_ADDRESS 0x70009AD4 /end MEASUREMENT
/begin MEASUREMENT FaultFSEVBHV_OverVoltageLogged "FaultFSEVBHV_OverVoltageLogged" UBYTE Bool_ON_OFF 1 2 0 1 BIT_MASK 0x01 ECU_ADDRESS 0x70009A76 /end MEASUREMENT
/begin MEASUREMENT FaultFSEVBHV_SampleVolOutRngHAut "FaultFSEVBHV_SampleVolOutRngHAut" UBYTE Bool_ON_OFF 1 2 0 1 BIT_MASK 0x02 ECU_ADDRESS 0x70009A18 /end MEASUREMENT
/begin MEASUREMENT FaultFSEVBHV_SampleVolOutRngHDetected "FaultFSEVBHV_SampleVolOutRngHDetected" UBYTE Bool_ON_OFF 1 2 0 1 BIT_MASK 0x02 ECU_ADDRESS 0x70009AD4 /end MEASUREMENT
/begin MEASUREMENT FaultFSEVBHV_SampleVolOutRngHLogged "FaultFSEVBHV_SampleVolOutRngHLogged" UBYTE Bool_ON_OFF 1 2 0 1 BIT_MASK 0x02 ECU_ADDRESS 0x70009A76 /end MEASUREMENT
/begin MEASUREMENT FaultFSEVBHV_SampleVolOutRngLAut "FaultFSEVBHV_SampleVolOutRngLAut" UBYTE Bool_ON_OFF 1 2 0 1 BIT_MASK 0x04 ECU_ADDRESS 0x70009A18 /end MEASUREMENT
/begin MEASUREMENT FaultFSEVBHV_SampleVolOutRngLDetected "FaultFSEVBHV_SampleVolOutRngLDetected" UBYTE Bool_ON_OFF 1 2 0 1 BIT_MASK 0x04 ECU_ADDRESS 0x70009AD4 /end MEASUREMENT
/begin MEASUREMENT FaultFSEVBHV_SampleVolOutRngLLogged "FaultFSEVBHV_SampleVolOutRngLLogged" UBYTE Bool_ON_OFF 1 2 0 1 BIT_MASK 0x04 ECU_ADDRESS 0x70009A76 /end MEASUREMENT
/begin MEASUREMENT FaultFSEVBHV_UnderDetected "FaultFSEVBHV_UnderDetected" UWORD I_1 1 2 0 65535 ECU_ADDRESS 0x70009AD6 /end MEASUREMENT
/begin MEASUREMENT FaultFSEVBHV_UnderLogged "FaultFSEVBHV_UnderLogged" UWORD I_1 1 2 0 65535 ECU_ADDRESS 0x70009A78 /end MEASUREMENT
/begin MEASUREMENT FaultFSEVBHV_UnderVoltageAut "FaultFSEVBHV_UnderVoltageAut" UBYTE Bool_ON_OFF 1 2 0 1 BIT_MASK 0x08 ECU_ADDRESS 0x70009A18 /end MEASUREMENT
/begin MEASUREMENT FaultFSEVBHV_UnderVoltageDetected "FaultFSEVBHV_UnderVoltageDetected" UBYTE Bool_ON_OFF 1 2 0 1 BIT_MASK 0x08 ECU_ADDRESS 0x70009AD4 /end MEASUREMENT
/begin MEASUREMENT FaultFSEVBHV_UnderVoltageLogged "FaultFSEVBHV_UnderVoltageLogged" UBYTE Bool_ON_OFF 1 2 0 1 BIT_MASK 0x08 ECU_ADDRESS 0x70009A76 /end MEASUREMENT
/begin MEASUREMENT FaultFSEVBHV_UnderVoltageWarnAut "FaultFSEVBHV_UnderVoltageWarnAut" UBYTE Bool_ON_OFF 1 2 0 1 BIT_MASK 0x01 ECU_ADDRESS 0x70009A1A /end MEASUREMENT
/begin MEASUREMENT FaultFSEVBHV_UnderVoltageWarnDetected "FaultFSEVBHV_UnderVoltageWarnDetected" UBYTE Bool_ON_OFF 1 2 0 1 BIT_MASK 0x01 ECU_ADDRESS 0x70009AD6 /end MEASUREMENT
/begin MEASUREMENT FaultFSEVBHV_UnderVoltageWarnLogged "FaultFSEVBHV_UnderVoltageWarnLogged" UBYTE Bool_ON_OFF 1 2 0 1 BIT_MASK 0x01 ECU_ADDRESS 0x70009A78 /end MEASUREMENT
/begin MEASUREMENT FaultFSEVBHV_VolNotRationalAut "FaultFSEVBHV_VolNotRationalAut" UBYTE Bool_ON_OFF 1 2 0 1 BIT_MASK 0x10 ECU_ADDRESS 0x70009A18 /end MEASUREMENT
/begin MEASUREMENT FaultFSEVBHV_VolNotRationalDetected "FaultFSEVBHV_VolNotRationalDetected" UBYTE Bool_ON_OFF 1 2 0 1 BIT_MASK 0x10 ECU_ADDRESS 0x70009AD4 /end MEASUREMENT
/begin MEASUREMENT FaultFSEVBHV_VolNotRationalLogged "FaultFSEVBHV_VolNotRationalLogged" UBYTE Bool_ON_OFF 1 2 0 1 BIT_MASK 0x10 ECU_ADDRESS 0x70009A76 /end MEASUREMENT
/begin MEASUREMENT FaultFSEVBHV_VoltageGndAut "FaultFSEVBHV_VoltageGndAut" UBYTE Bool_ON_OFF 1 2 0 1 BIT_MASK 0x20 ECU_ADDRESS 0x70009A18 /end MEASUREMENT
/begin MEASUREMENT FaultFSEVBHV_VoltageGndDetected "FaultFSEVBHV_VoltageGndDetected" UBYTE Bool_ON_OFF 1 2 0 1 BIT_MASK 0x20 ECU_ADDRESS 0x70009AD4 /end MEASUREMENT
/begin MEASUREMENT FaultFSEVBHV_VoltageGndLogged "FaultFSEVBHV_VoltageGndLogged" UBYTE Bool_ON_OFF 1 2 0 1 BIT_MASK 0x20 ECU_ADDRESS 0x70009A76 /end MEASUREMENT
/begin MEASUREMENT FaultFSEVBHV_VoltageVccAut "FaultFSEVBHV_VoltageVccAut" UBYTE Bool_ON_OFF 1 2 0 1 BIT_MASK 0x40 ECU_ADDRESS 0x70009A18 /end MEASUREMENT
/begin MEASUREMENT FaultFSEVBHV_VoltageVccDetected "FaultFSEVBHV_VoltageVccDetected" UBYTE Bool_ON_OFF 1 2 0 1 BIT_MASK 0x40 ECU_ADDRESS 0x70009AD4 /end MEASUREMENT
/begin MEASUREMENT FaultFSEVBHV_VoltageVccLogged "FaultFSEVBHV_VoltageVccLogged" UBYTE Bool_ON_OFF 1 2 0 1 BIT_MASK 0x40 ECU_ADDRESS 0x70009A76 /end MEASUREMENT
/begin MEASUREMENT FaultFSEVBLV_Detected "FaultFSEVBLV_Detected" UWORD I_1 1 2 0 65535 ECU_ADDRESS 0x70009AD8 /end MEASUREMENT
/begin MEASUREMENT FaultFSEVBLV_Logged "FaultFSEVBLV_Logged" UWORD I_1 1 2 0 65535 ECU_ADDRESS 0x70009A7A /end MEASUREMENT
/begin MEASUREMENT FaultFSEVBLV_OverVoltageAut "FaultFSEVBLV_OverVoltageAut" UBYTE Bool_ON_OFF 1 2 0 1 BIT_MASK 0x01 ECU_ADDRESS 0x70009A1C /end MEASUREMENT
/begin MEASUREMENT FaultFSEVBLV_OverVoltageDetected "FaultFSEVBLV_OverVoltageDetected" UBYTE Bool_ON_OFF 1 2 0 1 BIT_MASK 0x01 ECU_ADDRESS 0x70009AD8 /end MEASUREMENT
/begin MEASUREMENT FaultFSEVBLV_OverVoltageLogged "FaultFSEVBLV_OverVoltageLogged" UBYTE Bool_ON_OFF 1 2 0 1 BIT_MASK 0x01 ECU_ADDRESS 0x70009A7A /end MEASUREMENT
/begin MEASUREMENT FaultFSEVBLV_P5VRefADCFltAut "FaultFSEVBLV_P5VRefADCFltAut" UBYTE Bool_ON_OFF 1 2 0 1 BIT_MASK 0x02 ECU_ADDRESS 0x70009A1C /end MEASUREMENT
/begin MEASUREMENT FaultFSEVBLV_P5VRefADCFltDetected "FaultFSEVBLV_P5VRefADCFltDetected" UBYTE Bool_ON_OFF 1 2 0 1 BIT_MASK 0x02 ECU_ADDRESS 0x70009AD8 /end MEASUREMENT
/begin MEASUREMENT FaultFSEVBLV_P5VRefADCFltLogged "FaultFSEVBLV_P5VRefADCFltLogged" UBYTE Bool_ON_OFF 1 2 0 1 BIT_MASK 0x02 ECU_ADDRESS 0x70009A7A /end MEASUREMENT
/begin MEASUREMENT FaultFSEVBLV_UnderDetected "FaultFSEVBLV_UnderDetected" UWORD I_1 1 2 0 65535 ECU_ADDRESS 0x70009ADA /end MEASUREMENT
/begin MEASUREMENT FaultFSEVBLV_UnderLogged "FaultFSEVBLV_UnderLogged" UWORD I_1 1 2 0 65535 ECU_ADDRESS 0x70009A7C /end MEASUREMENT
/begin MEASUREMENT FaultFSEVBLV_UnderVoltageAut "FaultFSEVBLV_UnderVoltageAut" UBYTE Bool_ON_OFF 1 2 0 1 BIT_MASK 0x04 ECU_ADDRESS 0x70009A1C /end MEASUREMENT
/begin MEASUREMENT FaultFSEVBLV_UnderVoltageDetected "FaultFSEVBLV_UnderVoltageDetected" UBYTE Bool_ON_OFF 1 2 0 1 BIT_MASK 0x04 ECU_ADDRESS 0x70009AD8 /end MEASUREMENT
/begin MEASUREMENT FaultFSEVBLV_UnderVoltageLogged "FaultFSEVBLV_UnderVoltageLogged" UBYTE Bool_ON_OFF 1 2 0 1 BIT_MASK 0x04 ECU_ADDRESS 0x70009A7A /end MEASUREMENT
/begin MEASUREMENT FaultFSEVBLV_UnderVoltageWarnAut "FaultFSEVBLV_UnderVoltageWarnAut" UBYTE Bool_ON_OFF 1 2 0 1 BIT_MASK 0x01 ECU_ADDRESS 0x70009A1E /end MEASUREMENT
/begin MEASUREMENT FaultFSEVBLV_UnderVoltageWarnDetected "FaultFSEVBLV_UnderVoltageWarnDetected" UBYTE Bool_ON_OFF 1 2 0 1 BIT_MASK 0x01 ECU_ADDRESS 0x70009ADA /end MEASUREMENT
/begin MEASUREMENT FaultFSEVBLV_UnderVoltageWarnLogged "FaultFSEVBLV_UnderVoltageWarnLogged" UBYTE Bool_ON_OFF 1 2 0 1 BIT_MASK 0x01 ECU_ADDRESS 0x70009A7C /end MEASUREMENT
/begin MEASUREMENT FaultFSEVBLV_VoltageGndAut "FaultFSEVBLV_VoltageGndAut" UBYTE Bool_ON_OFF 1 2 0 1 BIT_MASK 0x08 ECU_ADDRESS 0x70009A1C /end MEASUREMENT
/begin MEASUREMENT FaultFSEVBLV_VoltageGndDetected "FaultFSEVBLV_VoltageGndDetected" UBYTE Bool_ON_OFF 1 2 0 1 BIT_MASK 0x08 ECU_ADDRESS 0x70009AD8 /end MEASUREMENT
/begin MEASUREMENT FaultFSEVBLV_VoltageGndLogged "FaultFSEVBLV_VoltageGndLogged" UBYTE Bool_ON_OFF 1 2 0 1 BIT_MASK 0x08 ECU_ADDRESS 0x70009A7A /end MEASUREMENT
/begin MEASUREMENT FaultFSEVBLV_VoltageVccAut "FaultFSEVBLV_VoltageVccAut" UBYTE Bool_ON_OFF 1 2 0 1 BIT_MASK 0x10 ECU_ADDRESS 0x70009A1C /end MEASUREMENT
/begin MEASUREMENT FaultFSEVBLV_VoltageVccDetected "FaultFSEVBLV_VoltageVccDetected" UBYTE Bool_ON_OFF 1 2 0 1 BIT_MASK 0x10 ECU_ADDRESS 0x70009AD8 /end MEASUREMENT
/begin MEASUREMENT FaultFSEVBLV_VoltageVccLogged "FaultFSEVBLV_VoltageVccLogged" UBYTE Bool_ON_OFF 1 2 0 1 BIT_MASK 0x10 ECU_ADDRESS 0x70009A7A /end MEASUREMENT
/begin MEASUREMENT FaultFSEVETA_Detected "FaultFSEVETA_Detected" UWORD I_1 1 2 0 65535 ECU_ADDRESS 0x70009ADC /end MEASUREMENT
/begin MEASUREMENT FaultFSEVETA_DrvTempRationAut "FaultFSEVETA_DrvTempRationAut" UBYTE Bool_ON_OFF 1 2 0 1 BIT_MASK 0x01 ECU_ADDRESS 0x70009A20 /end MEASUREMENT
/begin MEASUREMENT FaultFSEVETA_DrvTempRationDetected "FaultFSEVETA_DrvTempRationDetected" UBYTE Bool_ON_OFF 1 2 0 1 BIT_MASK 0x01 ECU_ADDRESS 0x70009ADC /end MEASUREMENT
/begin MEASUREMENT FaultFSEVETA_DrvTempRationLogged "FaultFSEVETA_DrvTempRationLogged" UBYTE Bool_ON_OFF 1 2 0 1 BIT_MASK 0x01 ECU_ADDRESS 0x70009A7E /end MEASUREMENT
/begin MEASUREMENT FaultFSEVETA_IgbtTempRationalAut "FaultFSEVETA_IgbtTempRationalAut" UBYTE Bool_ON_OFF 1 2 0 1 BIT_MASK 0x02 ECU_ADDRESS 0x70009A20 /end MEASUREMENT
/begin MEASUREMENT FaultFSEVETA_IgbtTempRationalDetected "FaultFSEVETA_IgbtTempRationalDetected" UBYTE Bool_ON_OFF 1 2 0 1 BIT_MASK 0x02 ECU_ADDRESS 0x70009ADC /end MEASUREMENT
/begin MEASUREMENT FaultFSEVETA_IgbtTempRationalLogged "FaultFSEVETA_IgbtTempRationalLogged" UBYTE Bool_ON_OFF 1 2 0 1 BIT_MASK 0x02 ECU_ADDRESS 0x70009A7E /end MEASUREMENT
/begin MEASUREMENT FaultFSEVETA_Logged "FaultFSEVETA_Logged" UWORD I_1 1 2 0 65535 ECU_ADDRESS 0x70009A7E /end MEASUREMENT
/begin MEASUREMENT FaultFSEVETA_OverDetected "FaultFSEVETA_OverDetected" UWORD I_1 1 2 0 65535 ECU_ADDRESS 0x70009ADE /end MEASUREMENT
/begin MEASUREMENT FaultFSEVETA_OverLogged "FaultFSEVETA_OverLogged" UWORD I_1 1 2 0 65535 ECU_ADDRESS 0x70009A80 /end MEASUREMENT
/begin MEASUREMENT FaultFSEVETA_OverTempDrvLeftAut "FaultFSEVETA_OverTempDrvLeftAut" UBYTE Bool_ON_OFF 1 2 0 1 BIT_MASK 0x01 ECU_ADDRESS 0x70009A22 /end MEASUREMENT
/begin MEASUREMENT FaultFSEVETA_OverTempDrvLeftDetected "FaultFSEVETA_OverTempDrvLeftDetected" UBYTE Bool_ON_OFF 1 2 0 1 BIT_MASK 0x01 ECU_ADDRESS 0x70009ADE /end MEASUREMENT
/begin MEASUREMENT FaultFSEVETA_OverTempDrvLeftLogged "FaultFSEVETA_OverTempDrvLeftLogged" UBYTE Bool_ON_OFF 1 2 0 1 BIT_MASK 0x01 ECU_ADDRESS 0x70009A80 /end MEASUREMENT
/begin MEASUREMENT FaultFSEVETA_OverTempIgbtLeftAut "FaultFSEVETA_OverTempIgbtLeftAut" UBYTE Bool_ON_OFF 1 2 0 1 BIT_MASK 0x02 ECU_ADDRESS 0x70009A22 /end MEASUREMENT
/begin MEASUREMENT FaultFSEVETA_OverTempIgbtLeftDetected "FaultFSEVETA_OverTempIgbtLeftDetected" UBYTE Bool_ON_OFF 1 2 0 1 BIT_MASK 0x02 ECU_ADDRESS 0x70009ADE /end MEASUREMENT
/begin MEASUREMENT FaultFSEVETA_OverTempIgbtLeftLogged "FaultFSEVETA_OverTempIgbtLeftLogged" UBYTE Bool_ON_OFF 1 2 0 1 BIT_MASK 0x02 ECU_ADDRESS 0x70009A80 /end MEASUREMENT
/begin MEASUREMENT FaultFSEVETA_OverTempNTC1CmdBoardAut "FaultFSEVETA_OverTempNTC1CmdBoardAut" UBYTE Bool_ON_OFF 1 2 0 1 BIT_MASK 0x04 ECU_ADDRESS 0x70009A22 /end MEASUREMENT
/begin MEASUREMENT FaultFSEVETA_OverTempNTC1CmdBoardDetected "FaultFSEVETA_OverTempNTC1CmdBoardDetected" UBYTE Bool_ON_OFF 1 2 0 1 BIT_MASK 0x04 ECU_ADDRESS 0x70009ADE /end MEASUREMENT
/begin MEASUREMENT FaultFSEVETA_OverTempNTC1CmdBoardLogged "FaultFSEVETA_OverTempNTC1CmdBoardLogged" UBYTE Bool_ON_OFF 1 2 0 1 BIT_MASK 0x04 ECU_ADDRESS 0x70009A80 /end MEASUREMENT
/begin MEASUREMENT FaultFSEVETA_SampleIgbtTempOutRngHAut "FaultFSEVETA_SampleIgbtTempOutRngHAut" UBYTE Bool_ON_OFF 1 2 0 1 BIT_MASK 0x04 ECU_ADDRESS 0x70009A20 /end MEASUREMENT
/begin MEASUREMENT FaultFSEVETA_SampleIgbtTempOutRngHDetected "FaultFSEVETA_SampleIgbtTempOutRngHDetected" UBYTE Bool_ON_OFF 1 2 0 1 BIT_MASK 0x04 ECU_ADDRESS 0x70009ADC /end MEASUREMENT
/begin MEASUREMENT FaultFSEVETA_SampleIgbtTempOutRngHLogged "FaultFSEVETA_SampleIgbtTempOutRngHLogged" UBYTE Bool_ON_OFF 1 2 0 1 BIT_MASK 0x04 ECU_ADDRESS 0x70009A7E /end MEASUREMENT
/begin MEASUREMENT FaultFSEVETA_SampleIgbtTempOutRngLAut "FaultFSEVETA_SampleIgbtTempOutRngLAut" UBYTE Bool_ON_OFF 1 2 0 1 BIT_MASK 0x08 ECU_ADDRESS 0x70009A20 /end MEASUREMENT
/begin MEASUREMENT FaultFSEVETA_SampleIgbtTempOutRngLDetected "FaultFSEVETA_SampleIgbtTempOutRngLDetected" UBYTE Bool_ON_OFF 1 2 0 1 BIT_MASK 0x08 ECU_ADDRESS 0x70009ADC /end MEASUREMENT
/begin MEASUREMENT FaultFSEVETA_SampleIgbtTempOutRngLLogged "FaultFSEVETA_SampleIgbtTempOutRngLLogged" UBYTE Bool_ON_OFF 1 2 0 1 BIT_MASK 0x08 ECU_ADDRESS 0x70009A7E /end MEASUREMENT
/begin MEASUREMENT FaultFSEVETA_TempDetected "FaultFSEVETA_TempDetected" UWORD I_1 1 2 0 65535 ECU_ADDRESS 0x70009AE0 /end MEASUREMENT
/begin MEASUREMENT FaultFSEVETA_TempDrvBoardLeftGndAut "FaultFSEVETA_TempDrvBoardLeftGndAut" UBYTE Bool_ON_OFF 1 2 0 1 BIT_MASK 0x01 ECU_ADDRESS 0x70009A24 /end MEASUREMENT
/begin MEASUREMENT FaultFSEVETA_TempDrvBoardLeftGndDetected "FaultFSEVETA_TempDrvBoardLeftGndDetected" UBYTE Bool_ON_OFF 1 2 0 1 BIT_MASK 0x01 ECU_ADDRESS 0x70009AE0 /end MEASUREMENT
/begin MEASUREMENT FaultFSEVETA_TempDrvBoardLeftGndLogged "FaultFSEVETA_TempDrvBoardLeftGndLogged" UBYTE Bool_ON_OFF 1 2 0 1 BIT_MASK 0x01 ECU_ADDRESS 0x70009A82 /end MEASUREMENT
/begin MEASUREMENT FaultFSEVETA_TempDrvBoardLeftVccAut "FaultFSEVETA_TempDrvBoardLeftVccAut" UBYTE Bool_ON_OFF 1 2 0 1 BIT_MASK 0x02 ECU_ADDRESS 0x70009A24 /end MEASUREMENT
/begin MEASUREMENT FaultFSEVETA_TempDrvBoardLeftVccDetected "FaultFSEVETA_TempDrvBoardLeftVccDetected" UBYTE Bool_ON_OFF 1 2 0 1 BIT_MASK 0x02 ECU_ADDRESS 0x70009AE0 /end MEASUREMENT
/begin MEASUREMENT FaultFSEVETA_TempDrvBoardLeftVccLogged "FaultFSEVETA_TempDrvBoardLeftVccLogged" UBYTE Bool_ON_OFF 1 2 0 1 BIT_MASK 0x02 ECU_ADDRESS 0x70009A82 /end MEASUREMENT
/begin MEASUREMENT FaultFSEVETA_TempIgbtLeftGndAut "FaultFSEVETA_TempIgbtLeftGndAut" UBYTE Bool_ON_OFF 1 2 0 1 BIT_MASK 0x04 ECU_ADDRESS 0x70009A24 /end MEASUREMENT
/begin MEASUREMENT FaultFSEVETA_TempIgbtLeftGndDetected "FaultFSEVETA_TempIgbtLeftGndDetected" UBYTE Bool_ON_OFF 1 2 0 1 BIT_MASK 0x04 ECU_ADDRESS 0x70009AE0 /end MEASUREMENT
/begin MEASUREMENT FaultFSEVETA_TempIgbtLeftGndLogged "FaultFSEVETA_TempIgbtLeftGndLogged" UBYTE Bool_ON_OFF 1 2 0 1 BIT_MASK 0x04 ECU_ADDRESS 0x70009A82 /end MEASUREMENT
/begin MEASUREMENT FaultFSEVETA_TempIgbtLeftVccAut "FaultFSEVETA_TempIgbtLeftVccAut" UBYTE Bool_ON_OFF 1 2 0 1 BIT_MASK 0x08 ECU_ADDRESS 0x70009A24 /end MEASUREMENT
/begin MEASUREMENT FaultFSEVETA_TempIgbtLeftVccDetected "FaultFSEVETA_TempIgbtLeftVccDetected" UBYTE Bool_ON_OFF 1 2 0 1 BIT_MASK 0x08 ECU_ADDRESS 0x70009AE0 /end MEASUREMENT
/begin MEASUREMENT FaultFSEVETA_TempIgbtLeftVccLogged "FaultFSEVETA_TempIgbtLeftVccLogged" UBYTE Bool_ON_OFF 1 2 0 1 BIT_MASK 0x08 ECU_ADDRESS 0x70009A82 /end MEASUREMENT
/begin MEASUREMENT FaultFSEVETA_TempLogged "FaultFSEVETA_TempLogged" UWORD I_1 1 2 0 65535 ECU_ADDRESS 0x70009A82 /end MEASUREMENT
/begin MEASUREMENT FaultFSEVETA_TempNTC1CmdBoardGndAut "FaultFSEVETA_TempNTC1CmdBoardGndAut" UBYTE Bool_ON_OFF 1 2 0 1 BIT_MASK 0x10 ECU_ADDRESS 0x70009A24 /end MEASUREMENT
/begin MEASUREMENT FaultFSEVETA_TempNTC1CmdBoardGndDetected "FaultFSEVETA_TempNTC1CmdBoardGndDetected" UBYTE Bool_ON_OFF 1 2 0 1 BIT_MASK 0x10 ECU_ADDRESS 0x70009AE0 /end MEASUREMENT
/begin MEASUREMENT FaultFSEVETA_TempNTC1CmdBoardGndLogged "FaultFSEVETA_TempNTC1CmdBoardGndLogged" UBYTE Bool_ON_OFF 1 2 0 1 BIT_MASK 0x10 ECU_ADDRESS 0x70009A82 /end MEASUREMENT
/begin MEASUREMENT FaultFSEVETA_TempNTC1CmdBoardVccAut "FaultFSEVETA_TempNTC1CmdBoardVccAut" UBYTE Bool_ON_OFF 1 2 0 1 BIT_MASK 0x20 ECU_ADDRESS 0x70009A24 /end MEASUREMENT
/begin MEASUREMENT FaultFSEVETA_TempNTC1CmdBoardVccDetected "FaultFSEVETA_TempNTC1CmdBoardVccDetected" UBYTE Bool_ON_OFF 1 2 0 1 BIT_MASK 0x20 ECU_ADDRESS 0x70009AE0 /end MEASUREMENT
/begin MEASUREMENT FaultFSEVETA_TempNTC1CmdBoardVccLogged "FaultFSEVETA_TempNTC1CmdBoardVccLogged" UBYTE Bool_ON_OFF 1 2 0 1 BIT_MASK 0x20 ECU_ADDRESS 0x70009A82 /end MEASUREMENT
/begin MEASUREMENT FaultFSEVETA_UnderDetected "FaultFSEVETA_UnderDetected" UWORD I_1 1 2 0 65535 ECU_ADDRESS 0x70009AE2 /end MEASUREMENT
/begin MEASUREMENT FaultFSEVETA_UnderLogged "FaultFSEVETA_UnderLogged" UWORD I_1 1 2 0 65535 ECU_ADDRESS 0x70009A84 /end MEASUREMENT
/begin MEASUREMENT FaultFSEVETA_UnderTempDrvLeftAut "FaultFSEVETA_UnderTempDrvLeftAut" UBYTE Bool_ON_OFF 1 2 0 1 BIT_MASK 0x01 ECU_ADDRESS 0x70009A26 /end MEASUREMENT
/begin MEASUREMENT FaultFSEVETA_UnderTempDrvLeftDetected "FaultFSEVETA_UnderTempDrvLeftDetected" UBYTE Bool_ON_OFF 1 2 0 1 BIT_MASK 0x01 ECU_ADDRESS 0x70009AE2 /end MEASUREMENT
/begin MEASUREMENT FaultFSEVETA_UnderTempDrvLeftLogged "FaultFSEVETA_UnderTempDrvLeftLogged" UBYTE Bool_ON_OFF 1 2 0 1 BIT_MASK 0x01 ECU_ADDRESS 0x70009A84 /end MEASUREMENT
/begin MEASUREMENT FaultFSEVETA_UnderTempIgbtLeftAut "FaultFSEVETA_UnderTempIgbtLeftAut" UBYTE Bool_ON_OFF 1 2 0 1 BIT_MASK 0x02 ECU_ADDRESS 0x70009A26 /end MEASUREMENT
/begin MEASUREMENT FaultFSEVETA_UnderTempIgbtLeftDetected "FaultFSEVETA_UnderTempIgbtLeftDetected" UBYTE Bool_ON_OFF 1 2 0 1 BIT_MASK 0x02 ECU_ADDRESS 0x70009AE2 /end MEASUREMENT
/begin MEASUREMENT FaultFSEVETA_UnderTempIgbtLeftLogged "FaultFSEVETA_UnderTempIgbtLeftLogged" UBYTE Bool_ON_OFF 1 2 0 1 BIT_MASK 0x02 ECU_ADDRESS 0x70009A84 /end MEASUREMENT
/begin MEASUREMENT FaultFSEVETA_UnderTempNTC1CmdBoardAut "FaultFSEVETA_UnderTempNTC1CmdBoardAut" UBYTE Bool_ON_OFF 1 2 0 1 BIT_MASK 0x04 ECU_ADDRESS 0x70009A26 /end MEASUREMENT
/begin MEASUREMENT FaultFSEVETA_UnderTempNTC1CmdBoardDetected "FaultFSEVETA_UnderTempNTC1CmdBoardDetected" UBYTE Bool_ON_OFF 1 2 0 1 BIT_MASK 0x04 ECU_ADDRESS 0x70009AE2 /end MEASUREMENT
/begin MEASUREMENT FaultFSEVETA_UnderTempNTC1CmdBoardLogged "FaultFSEVETA_UnderTempNTC1CmdBoardLogged" UBYTE Bool_ON_OFF 1 2 0 1 BIT_MASK 0x04 ECU_ADDRESS 0x70009A84 /end MEASUREMENT
/begin MEASUREMENT FaultFSMTMTA_OverDetected "FaultFSMTMTA_OverDetected" UWORD I_1 1 2 0 65535 ECU_ADDRESS 0x70009AE4 /end MEASUREMENT
/begin MEASUREMENT FaultFSMTMTA_OverLogged "FaultFSMTMTA_OverLogged" UWORD I_1 1 2 0 65535 ECU_ADDRESS 0x70009A86 /end MEASUREMENT
/begin MEASUREMENT FaultFSMTMTA_OverTempWdgHead1Aut "FaultFSMTMTA_OverTempWdgHead1Aut" UBYTE Bool_ON_OFF 1 2 0 1 BIT_MASK 0x01 ECU_ADDRESS 0x70009A28 /end MEASUREMENT
/begin MEASUREMENT FaultFSMTMTA_OverTempWdgHead1Detected "FaultFSMTMTA_OverTempWdgHead1Detected" UBYTE Bool_ON_OFF 1 2 0 1 BIT_MASK 0x01 ECU_ADDRESS 0x70009AE4 /end MEASUREMENT
/begin MEASUREMENT FaultFSMTMTA_OverTempWdgHead1Logged "FaultFSMTMTA_OverTempWdgHead1Logged" UBYTE Bool_ON_OFF 1 2 0 1 BIT_MASK 0x01 ECU_ADDRESS 0x70009A86 /end MEASUREMENT
/begin MEASUREMENT FaultFSMTMTA_TempDetected "FaultFSMTMTA_TempDetected" UWORD I_1 1 2 0 65535 ECU_ADDRESS 0x70009AE6 /end MEASUREMENT
/begin MEASUREMENT FaultFSMTMTA_TempLogged "FaultFSMTMTA_TempLogged" UWORD I_1 1 2 0 65535 ECU_ADDRESS 0x70009A88 /end MEASUREMENT
/begin MEASUREMENT FaultFSMTMTA_TempWindHead1OutRngHAut "FaultFSMTMTA_TempWindHead1OutRngHAut" UBYTE Bool_ON_OFF 1 2 0 1 BIT_MASK 0x01 ECU_ADDRESS 0x70009A2A /end MEASUREMENT
/begin MEASUREMENT FaultFSMTMTA_TempWindHead1OutRngHDetected "FaultFSMTMTA_TempWindHead1OutRngHDetected" UBYTE Bool_ON_OFF 1 2 0 1 BIT_MASK 0x01 ECU_ADDRESS 0x70009AE6 /end MEASUREMENT
/begin MEASUREMENT FaultFSMTMTA_TempWindHead1OutRngHLogged "FaultFSMTMTA_TempWindHead1OutRngHLogged" UBYTE Bool_ON_OFF 1 2 0 1 BIT_MASK 0x01 ECU_ADDRESS 0x70009A88 /end MEASUREMENT
/begin MEASUREMENT FaultFSMTMTA_TempWindHead1OutRngLAut "FaultFSMTMTA_TempWindHead1OutRngLAut" UBYTE Bool_ON_OFF 1 2 0 1 BIT_MASK 0x02 ECU_ADDRESS 0x70009A2A /end MEASUREMENT
/begin MEASUREMENT FaultFSMTMTA_TempWindHead1OutRngLDetected "FaultFSMTMTA_TempWindHead1OutRngLDetected" UBYTE Bool_ON_OFF 1 2 0 1 BIT_MASK 0x02 ECU_ADDRESS 0x70009AE6 /end MEASUREMENT
/begin MEASUREMENT FaultFSMTMTA_TempWindHead1OutRngLLogged "FaultFSMTMTA_TempWindHead1OutRngLLogged" UBYTE Bool_ON_OFF 1 2 0 1 BIT_MASK 0x02 ECU_ADDRESS 0x70009A88 /end MEASUREMENT
/begin MEASUREMENT FaultFSMTMTA_TempWindingHead1GndAut "FaultFSMTMTA_TempWindingHead1GndAut" UBYTE Bool_ON_OFF 1 2 0 1 BIT_MASK 0x04 ECU_ADDRESS 0x70009A2A /end MEASUREMENT
/begin MEASUREMENT FaultFSMTMTA_TempWindingHead1GndDetected "FaultFSMTMTA_TempWindingHead1GndDetected" UBYTE Bool_ON_OFF 1 2 0 1 BIT_MASK 0x04 ECU_ADDRESS 0x70009AE6 /end MEASUREMENT
/begin MEASUREMENT FaultFSMTMTA_TempWindingHead1GndLogged "FaultFSMTMTA_TempWindingHead1GndLogged" UBYTE Bool_ON_OFF 1 2 0 1 BIT_MASK 0x04 ECU_ADDRESS 0x70009A88 /end MEASUREMENT
/begin MEASUREMENT FaultFSMTMTA_TempWindingHead1VccAut "FaultFSMTMTA_TempWindingHead1VccAut" UBYTE Bool_ON_OFF 1 2 0 1 BIT_MASK 0x08 ECU_ADDRESS 0x70009A2A /end MEASUREMENT
/begin MEASUREMENT FaultFSMTMTA_TempWindingHead1VccDetected "FaultFSMTMTA_TempWindingHead1VccDetected" UBYTE Bool_ON_OFF 1 2 0 1 BIT_MASK 0x08 ECU_ADDRESS 0x70009AE6 /end MEASUREMENT
/begin MEASUREMENT FaultFSMTMTA_TempWindingHead1VccLogged "FaultFSMTMTA_TempWindingHead1VccLogged" UBYTE Bool_ON_OFF 1 2 0 1 BIT_MASK 0x08 ECU_ADDRESS 0x70009A88 /end MEASUREMENT
/begin MEASUREMENT FaultFSMTMTA_UnderDetected "FaultFSMTMTA_UnderDetected" UWORD I_1 1 2 0 65535 ECU_ADDRESS 0x70009AE8 /end MEASUREMENT
/begin MEASUREMENT FaultFSMTMTA_UnderLogged "FaultFSMTMTA_UnderLogged" UWORD I_1 1 2 0 65535 ECU_ADDRESS 0x70009A8A /end MEASUREMENT
/begin MEASUREMENT FaultFSMTMTA_UnderTempWdgHead1Aut "FaultFSMTMTA_UnderTempWdgHead1Aut" UBYTE Bool_ON_OFF 1 2 0 1 BIT_MASK 0x01 ECU_ADDRESS 0x70009A2C /end MEASUREMENT
/begin MEASUREMENT FaultFSMTMTA_UnderTempWdgHead1Detected "FaultFSMTMTA_UnderTempWdgHead1Detected" UBYTE Bool_ON_OFF 1 2 0 1 BIT_MASK 0x01 ECU_ADDRESS 0x70009AE8 /end MEASUREMENT
/begin MEASUREMENT FaultFSMTMTA_UnderTempWdgHead1Logged "FaultFSMTMTA_UnderTempWdgHead1Logged" UBYTE Bool_ON_OFF 1 2 0 1 BIT_MASK 0x01 ECU_ADDRESS 0x70009A8A /end MEASUREMENT
/begin MEASUREMENT FaultFSMTRDG_Detected "FaultFSMTRDG_Detected" UWORD I_1 1 2 0 65535 ECU_ADDRESS 0x70009AEA /end MEASUREMENT
/begin MEASUREMENT FaultFSMTRDG_ExcGenerationAut "FaultFSMTRDG_ExcGenerationAut" UBYTE Bool_ON_OFF 1 2 0 1 BIT_MASK 0x01 ECU_ADDRESS 0x70009A2E /end MEASUREMENT
/begin MEASUREMENT FaultFSMTRDG_ExcGenerationDetected "FaultFSMTRDG_ExcGenerationDetected" UBYTE Bool_ON_OFF 1 2 0 1 BIT_MASK 0x01 ECU_ADDRESS 0x70009AEA /end MEASUREMENT
/begin MEASUREMENT FaultFSMTRDG_ExcGenerationLogged "FaultFSMTRDG_ExcGenerationLogged" UBYTE Bool_ON_OFF 1 2 0 1 BIT_MASK 0x01 ECU_ADDRESS 0x70009A8C /end MEASUREMENT
/begin MEASUREMENT FaultFSMTRDG_ExcSignalGNDAut "FaultFSMTRDG_ExcSignalGNDAut" UBYTE Bool_ON_OFF 1 2 0 1 BIT_MASK 0x02 ECU_ADDRESS 0x70009A2E /end MEASUREMENT
/begin MEASUREMENT FaultFSMTRDG_ExcSignalGNDDetected "FaultFSMTRDG_ExcSignalGNDDetected" UBYTE Bool_ON_OFF 1 2 0 1 BIT_MASK 0x02 ECU_ADDRESS 0x70009AEA /end MEASUREMENT
/begin MEASUREMENT FaultFSMTRDG_ExcSignalGNDLogged "FaultFSMTRDG_ExcSignalGNDLogged" UBYTE Bool_ON_OFF 1 2 0 1 BIT_MASK 0x02 ECU_ADDRESS 0x70009A8C /end MEASUREMENT
/begin MEASUREMENT FaultFSMTRDG_ExcSignalVCCAut "FaultFSMTRDG_ExcSignalVCCAut" UBYTE Bool_ON_OFF 1 2 0 1 BIT_MASK 0x04 ECU_ADDRESS 0x70009A2E /end MEASUREMENT
/begin MEASUREMENT FaultFSMTRDG_ExcSignalVCCDetected "FaultFSMTRDG_ExcSignalVCCDetected" UBYTE Bool_ON_OFF 1 2 0 1 BIT_MASK 0x04 ECU_ADDRESS 0x70009AEA /end MEASUREMENT
/begin MEASUREMENT FaultFSMTRDG_ExcSignalVCCLogged "FaultFSMTRDG_ExcSignalVCCLogged" UBYTE Bool_ON_OFF 1 2 0 1 BIT_MASK 0x04 ECU_ADDRESS 0x70009A8C /end MEASUREMENT
/begin MEASUREMENT FaultFSMTRDG_Logged "FaultFSMTRDG_Logged" UWORD I_1 1 2 0 65535 ECU_ADDRESS 0x70009A8C /end MEASUREMENT
/begin MEASUREMENT FaultFSMTRDG_SinCosHLGndAut "FaultFSMTRDG_SinCosHLGndAut" UBYTE Bool_ON_OFF 1 2 0 1 BIT_MASK 0x08 ECU_ADDRESS 0x70009A2E /end MEASUREMENT
/begin MEASUREMENT FaultFSMTRDG_SinCosHLGndDetected "FaultFSMTRDG_SinCosHLGndDetected" UBYTE Bool_ON_OFF 1 2 0 1 BIT_MASK 0x08 ECU_ADDRESS 0x70009AEA /end MEASUREMENT
/begin MEASUREMENT FaultFSMTRDG_SinCosHLGndLogged "FaultFSMTRDG_SinCosHLGndLogged" UBYTE Bool_ON_OFF 1 2 0 1 BIT_MASK 0x08 ECU_ADDRESS 0x70009A8C /end MEASUREMENT
/begin MEASUREMENT FaultFSMTRDG_SinCosHLOpenAut "FaultFSMTRDG_SinCosHLOpenAut" UBYTE Bool_ON_OFF 1 2 0 1 BIT_MASK 0x10 ECU_ADDRESS 0x70009A2E /end MEASUREMENT
/begin MEASUREMENT FaultFSMTRDG_SinCosHLOpenDetected "FaultFSMTRDG_SinCosHLOpenDetected" UBYTE Bool_ON_OFF 1 2 0 1 BIT_MASK 0x10 ECU_ADDRESS 0x70009AEA /end MEASUREMENT
/begin MEASUREMENT FaultFSMTRDG_SinCosHLOpenLogged "FaultFSMTRDG_SinCosHLOpenLogged" UBYTE Bool_ON_OFF 1 2 0 1 BIT_MASK 0x10 ECU_ADDRESS 0x70009A8C /end MEASUREMENT
/begin MEASUREMENT FaultFSMTRDG_SinCosHLVccAut "FaultFSMTRDG_SinCosHLVccAut" UBYTE Bool_ON_OFF 1 2 0 1 BIT_MASK 0x20 ECU_ADDRESS 0x70009A2E /end MEASUREMENT
/begin MEASUREMENT FaultFSMTRDG_SinCosHLVccDetected "FaultFSMTRDG_SinCosHLVccDetected" UBYTE Bool_ON_OFF 1 2 0 1 BIT_MASK 0x20 ECU_ADDRESS 0x70009AEA /end MEASUREMENT
/begin MEASUREMENT FaultFSMTRDG_SinCosHLVccLogged "FaultFSMTRDG_SinCosHLVccLogged" UBYTE Bool_ON_OFF 1 2 0 1 BIT_MASK 0x20 ECU_ADDRESS 0x70009A8C /end MEASUREMENT
/begin MEASUREMENT FaultFSSMACS_AkdFailFlagAut "FaultFSSMACS_AkdFailFlagAut" UBYTE Bool_ON_OFF 1 2 0 1 BIT_MASK 0x01 ECU_ADDRESS 0x70009A30 /end MEASUREMENT
/begin MEASUREMENT FaultFSSMACS_AkdFailFlagDetected "FaultFSSMACS_AkdFailFlagDetected" UBYTE Bool_ON_OFF 1 2 0 1 BIT_MASK 0x01 ECU_ADDRESS 0x70009AEC /end MEASUREMENT
/begin MEASUREMENT FaultFSSMACS_AkdFailFlagLogged "FaultFSSMACS_AkdFailFlagLogged" UBYTE Bool_ON_OFF 1 2 0 1 BIT_MASK 0x01 ECU_ADDRESS 0x70009A8E /end MEASUREMENT
/begin MEASUREMENT FaultFSSMACS_Detected "FaultFSSMACS_Detected" UWORD I_1 1 2 0 65535 ECU_ADDRESS 0x70009AEC /end MEASUREMENT
/begin MEASUREMENT FaultFSSMACS_Logged "FaultFSSMACS_Logged" UWORD I_1 1 2 0 65535 ECU_ADDRESS 0x70009A8E /end MEASUREMENT
/begin MEASUREMENT FaultFTASBDS_BattVoltDeratingActAut "FaultFTASBDS_BattVoltDeratingActAut" UBYTE Bool_ON_OFF 1 2 0 1 BIT_MASK 0x01 ECU_ADDRESS 0x70009A32 /end MEASUREMENT
/begin MEASUREMENT FaultFTASBDS_BattVoltDeratingActDetected "FaultFTASBDS_BattVoltDeratingActDetected" UBYTE Bool_ON_OFF 1 2 0 1 BIT_MASK 0x01 ECU_ADDRESS 0x70009AEE /end MEASUREMENT
/begin MEASUREMENT FaultFTASBDS_BattVoltDeratingActLogged "FaultFTASBDS_BattVoltDeratingActLogged" UBYTE Bool_ON_OFF 1 2 0 1 BIT_MASK 0x01 ECU_ADDRESS 0x70009A90 /end MEASUREMENT
/begin MEASUREMENT FaultFTASBDS_Detected "FaultFTASBDS_Detected" UWORD I_1 1 2 0 65535 ECU_ADDRESS 0x70009AEE /end MEASUREMENT
/begin MEASUREMENT FaultFTASBDS_Logged "FaultFTASBDS_Logged" UWORD I_1 1 2 0 65535 ECU_ADDRESS 0x70009A90 /end MEASUREMENT
/begin MEASUREMENT FaultFTASETP_Detected "FaultFTASETP_Detected" UWORD I_1 1 2 0 65535 ECU_ADDRESS 0x70009AF0 /end MEASUREMENT
/begin MEASUREMENT FaultFTASETP_EstPmDeratingActAut "FaultFTASETP_EstPmDeratingActAut" UBYTE Bool_ON_OFF 1 2 0 1 BIT_MASK 0x01 ECU_ADDRESS 0x70009A34 /end MEASUREMENT
/begin MEASUREMENT FaultFTASETP_EstPmDeratingActDetected "FaultFTASETP_EstPmDeratingActDetected" UBYTE Bool_ON_OFF 1 2 0 1 BIT_MASK 0x01 ECU_ADDRESS 0x70009AF0 /end MEASUREMENT
/begin MEASUREMENT FaultFTASETP_EstPmDeratingActLogged "FaultFTASETP_EstPmDeratingActLogged" UBYTE Bool_ON_OFF 1 2 0 1 BIT_MASK 0x01 ECU_ADDRESS 0x70009A92 /end MEASUREMENT
/begin MEASUREMENT FaultFTASETP_Logged "FaultFTASETP_Logged" UWORD I_1 1 2 0 65535 ECU_ADDRESS 0x70009A92 /end MEASUREMENT
/begin MEASUREMENT FaultFTASETP_PmDeratingActAut "FaultFTASETP_PmDeratingActAut" UBYTE Bool_ON_OFF 1 2 0 1 BIT_MASK 0x02 ECU_ADDRESS 0x70009A34 /end MEASUREMENT
/begin MEASUREMENT FaultFTASETP_PmDeratingActDetected "FaultFTASETP_PmDeratingActDetected" UBYTE Bool_ON_OFF 1 2 0 1 BIT_MASK 0x02 ECU_ADDRESS 0x70009AF0 /end MEASUREMENT
/begin MEASUREMENT FaultFTASETP_PmDeratingActLogged "FaultFTASETP_PmDeratingActLogged" UBYTE Bool_ON_OFF 1 2 0 1 BIT_MASK 0x02 ECU_ADDRESS 0x70009A92 /end MEASUREMENT
/begin MEASUREMENT FaultFTASMTP_Detected "FaultFTASMTP_Detected" UWORD I_1 1 2 0 65535 ECU_ADDRESS 0x70009AF2 /end MEASUREMENT
/begin MEASUREMENT FaultFTASMTP_Logged "FaultFTASMTP_Logged" UWORD I_1 1 2 0 65535 ECU_ADDRESS 0x70009A94 /end MEASUREMENT
/begin MEASUREMENT FaultFTASMTP_Wndg1DeratingActAut "FaultFTASMTP_Wndg1DeratingActAut" UBYTE Bool_ON_OFF 1 2 0 1 BIT_MASK 0x01 ECU_ADDRESS 0x70009A36 /end MEASUREMENT
/begin MEASUREMENT FaultFTASMTP_Wndg1DeratingActDetected "FaultFTASMTP_Wndg1DeratingActDetected" UBYTE Bool_ON_OFF 1 2 0 1 BIT_MASK 0x01 ECU_ADDRESS 0x70009AF2 /end MEASUREMENT
/begin MEASUREMENT FaultFTASMTP_Wndg1DeratingActLogged "FaultFTASMTP_Wndg1DeratingActLogged" UBYTE Bool_ON_OFF 1 2 0 1 BIT_MASK 0x01 ECU_ADDRESS 0x70009A94 /end MEASUREMENT
/begin MEASUREMENT FaultFTASOSP_Detected "FaultFTASOSP_Detected" UWORD I_1 1 2 0 65535 ECU_ADDRESS 0x70009AF4 /end MEASUREMENT
/begin MEASUREMENT FaultFTASOSP_Logged "FaultFTASOSP_Logged" UWORD I_1 1 2 0 65535 ECU_ADDRESS 0x70009A96 /end MEASUREMENT
/begin MEASUREMENT FaultFTASOSP_MotorSpdDeratingActAut "FaultFTASOSP_MotorSpdDeratingActAut" UBYTE Bool_ON_OFF 1 2 0 1 BIT_MASK 0x01 ECU_ADDRESS 0x70009A38 /end MEASUREMENT
/begin MEASUREMENT FaultFTASOSP_MotorSpdDeratingActDetected "FaultFTASOSP_MotorSpdDeratingActDetected" UBYTE Bool_ON_OFF 1 2 0 1 BIT_MASK 0x01 ECU_ADDRESS 0x70009AF4 /end MEASUREMENT
/begin MEASUREMENT FaultFTASOSP_MotorSpdDeratingActLogged "FaultFTASOSP_MotorSpdDeratingActLogged" UBYTE Bool_ON_OFF 1 2 0 1 BIT_MASK 0x01 ECU_ADDRESS 0x70009A96 /end MEASUREMENT
/begin MEASUREMENT FaultFTCMSCS_CtrlSatTimoutAut "FaultFTCMSCS_CtrlSatTimoutAut" UBYTE Bool_ON_OFF 1 2 0 1 BIT_MASK 0x01 ECU_ADDRESS 0x70009A3A /end MEASUREMENT
/begin MEASUREMENT FaultFTCMSCS_CtrlSatTimoutDetected "FaultFTCMSCS_CtrlSatTimoutDetected" UBYTE Bool_ON_OFF 1 2 0 1 BIT_MASK 0x01 ECU_ADDRESS 0x70009AF6 /end MEASUREMENT
/begin MEASUREMENT FaultFTCMSCS_CtrlSatTimoutLogged "FaultFTCMSCS_CtrlSatTimoutLogged" UBYTE Bool_ON_OFF 1 2 0 1 BIT_MASK 0x01 ECU_ADDRESS 0x70009A98 /end MEASUREMENT
/begin MEASUREMENT FaultFTCMSCS_Detected "FaultFTCMSCS_Detected" UWORD I_1 1 2 0 65535 ECU_ADDRESS 0x70009AF6 /end MEASUREMENT
/begin MEASUREMENT FaultFTCMSCS_Logged "FaultFTCMSCS_Logged" UWORD I_1 1 2 0 65535 ECU_ADDRESS 0x70009A98 /end MEASUREMENT
/begin MEASUREMENT FaultFTCMSCS_SpdOvershootAut "FaultFTCMSCS_SpdOvershootAut" UBYTE Bool_ON_OFF 1 2 0 1 BIT_MASK 0x02 ECU_ADDRESS 0x70009A3A /end MEASUREMENT
/begin MEASUREMENT FaultFTCMSCS_SpdOvershootDetected "FaultFTCMSCS_SpdOvershootDetected" UBYTE Bool_ON_OFF 1 2 0 1 BIT_MASK 0x02 ECU_ADDRESS 0x70009AF6 /end MEASUREMENT
/begin MEASUREMENT FaultFTCMSCS_SpdOvershootLogged "FaultFTCMSCS_SpdOvershootLogged" UBYTE Bool_ON_OFF 1 2 0 1 BIT_MASK 0x02 ECU_ADDRESS 0x70009A98 /end MEASUREMENT
/begin MEASUREMENT FaultFTCMSCS_ZeroSpeedTimoutAut "FaultFTCMSCS_ZeroSpeedTimoutAut" UBYTE Bool_ON_OFF 1 2 0 1 BIT_MASK 0x04 ECU_ADDRESS 0x70009A3A /end MEASUREMENT
/begin MEASUREMENT FaultFTCMSCS_ZeroSpeedTimoutDetected "FaultFTCMSCS_ZeroSpeedTimoutDetected" UBYTE Bool_ON_OFF 1 2 0 1 BIT_MASK 0x04 ECU_ADDRESS 0x70009AF6 /end MEASUREMENT
/begin MEASUREMENT FaultFTCMSCS_ZeroSpeedTimoutLogged "FaultFTCMSCS_ZeroSpeedTimoutLogged" UBYTE Bool_ON_OFF 1 2 0 1 BIT_MASK 0x04 ECU_ADDRESS 0x70009A98 /end MEASUREMENT
/begin MEASUREMENT FaultFTCMTCS_Detected "FaultFTCMTCS_Detected" UWORD I_1 1 2 0 65535 ECU_ADDRESS 0x70009AF8 /end MEASUREMENT
/begin MEASUREMENT FaultFTCMTCS_Logged "FaultFTCMTCS_Logged" UWORD I_1 1 2 0 65535 ECU_ADDRESS 0x70009A9A /end MEASUREMENT
/begin MEASUREMENT FaultFTCMTCS_VoltageMarginLowAut "FaultFTCMTCS_VoltageMarginLowAut" UBYTE Bool_ON_OFF 1 2 0 1 BIT_MASK 0x01 ECU_ADDRESS 0x70009A3C /end MEASUREMENT
/begin MEASUREMENT FaultFTCMTCS_VoltageMarginLowDetected "FaultFTCMTCS_VoltageMarginLowDetected" UBYTE Bool_ON_OFF 1 2 0 1 BIT_MASK 0x01 ECU_ADDRESS 0x70009AF8 /end MEASUREMENT
/begin MEASUREMENT FaultFTCMTCS_VoltageMarginLowLogged "FaultFTCMTCS_VoltageMarginLowLogged" UBYTE Bool_ON_OFF 1 2 0 1 BIT_MASK 0x01 ECU_ADDRESS 0x70009A9A /end MEASUREMENT
/begin MEASUREMENT FaultFTEVEIT_Detected "FaultFTEVEIT_Detected" UWORD I_1 1 2 0 65535 ECU_ADDRESS 0x70009AFA /end MEASUREMENT
/begin MEASUREMENT FaultFTEVEIT_EstOverTempAut "FaultFTEVEIT_EstOverTempAut" UBYTE Bool_ON_OFF 1 2 0 1 BIT_MASK 0x01 ECU_ADDRESS 0x70009A3E /end MEASUREMENT
/begin MEASUREMENT FaultFTEVEIT_EstOverTempDetected "FaultFTEVEIT_EstOverTempDetected" UBYTE Bool_ON_OFF 1 2 0 1 BIT_MASK 0x01 ECU_ADDRESS 0x70009AFA /end MEASUREMENT
/begin MEASUREMENT FaultFTEVEIT_EstOverTempLogged "FaultFTEVEIT_EstOverTempLogged" UBYTE Bool_ON_OFF 1 2 0 1 BIT_MASK 0x01 ECU_ADDRESS 0x70009A9C /end MEASUREMENT
/begin MEASUREMENT FaultFTEVEIT_Logged "FaultFTEVEIT_Logged" UWORD I_1 1 2 0 65535 ECU_ADDRESS 0x70009A9C /end MEASUREMENT
/begin MEASUREMENT FaultFTMTLCS_CurSenrPhaU_GNDAut "FaultFTMTLCS_CurSenrPhaU_GNDAut" UBYTE Bool_ON_OFF 1 2 0 1 BIT_MASK 0x02 ECU_ADDRESS 0x70009A40 /end MEASUREMENT
/begin MEASUREMENT FaultFTMTLCS_CurSenrPhaU_GNDDetected "FaultFTMTLCS_CurSenrPhaU_GNDDetected" UBYTE Bool_ON_OFF 1 2 0 1 BIT_MASK 0x02 ECU_ADDRESS 0x70009AFC /end MEASUREMENT
/begin MEASUREMENT FaultFTMTLCS_CurSenrPhaU_GNDLogged "FaultFTMTLCS_CurSenrPhaU_GNDLogged" UBYTE Bool_ON_OFF 1 2 0 1 BIT_MASK 0x02 ECU_ADDRESS 0x70009A9E /end MEASUREMENT
/begin MEASUREMENT FaultFTMTLCS_CurSenrPhaU_OutRngHAut "FaultFTMTLCS_CurSenrPhaU_OutRngHAut" UBYTE Bool_ON_OFF 1 2 0 1 BIT_MASK 0x04 ECU_ADDRESS 0x70009A40 /end MEASUREMENT
/begin MEASUREMENT FaultFTMTLCS_CurSenrPhaU_OutRngHDetected "FaultFTMTLCS_CurSenrPhaU_OutRngHDetected" UBYTE Bool_ON_OFF 1 2 0 1 BIT_MASK 0x04 ECU_ADDRESS 0x70009AFC /end MEASUREMENT
/begin MEASUREMENT FaultFTMTLCS_CurSenrPhaU_OutRngHLogged "FaultFTMTLCS_CurSenrPhaU_OutRngHLogged" UBYTE Bool_ON_OFF 1 2 0 1 BIT_MASK 0x04 ECU_ADDRESS 0x70009A9E /end MEASUREMENT
/begin MEASUREMENT FaultFTMTLCS_CurSenrPhaU_OutRngLAut "FaultFTMTLCS_CurSenrPhaU_OutRngLAut" UBYTE Bool_ON_OFF 1 2 0 1 BIT_MASK 0x08 ECU_ADDRESS 0x70009A40 /end MEASUREMENT
/begin MEASUREMENT FaultFTMTLCS_CurSenrPhaU_OutRngLDetected "FaultFTMTLCS_CurSenrPhaU_OutRngLDetected" UBYTE Bool_ON_OFF 1 2 0 1 BIT_MASK 0x08 ECU_ADDRESS 0x70009AFC /end MEASUREMENT
/begin MEASUREMENT FaultFTMTLCS_CurSenrPhaU_OutRngLLogged "FaultFTMTLCS_CurSenrPhaU_OutRngLLogged" UBYTE Bool_ON_OFF 1 2 0 1 BIT_MASK 0x08 ECU_ADDRESS 0x70009A9E /end MEASUREMENT
/begin MEASUREMENT FaultFTMTLCS_CurSenrPhaU_VCCAut "FaultFTMTLCS_CurSenrPhaU_VCCAut" UBYTE Bool_ON_OFF 1 2 0 1 BIT_MASK 0x10 ECU_ADDRESS 0x70009A40 /end MEASUREMENT
/begin MEASUREMENT FaultFTMTLCS_CurSenrPhaU_VCCDetected "FaultFTMTLCS_CurSenrPhaU_VCCDetected" UBYTE Bool_ON_OFF 1 2 0 1 BIT_MASK 0x10 ECU_ADDRESS 0x70009AFC /end MEASUREMENT
/begin MEASUREMENT FaultFTMTLCS_CurSenrPhaU_VCCLogged "FaultFTMTLCS_CurSenrPhaU_VCCLogged" UBYTE Bool_ON_OFF 1 2 0 1 BIT_MASK 0x10 ECU_ADDRESS 0x70009A9E /end MEASUREMENT
/begin MEASUREMENT FaultFTMTLCS_CurSenrPhaV_GNDAut "FaultFTMTLCS_CurSenrPhaV_GNDAut" UBYTE Bool_ON_OFF 1 2 0 1 BIT_MASK 0x20 ECU_ADDRESS 0x70009A40 /end MEASUREMENT
/begin MEASUREMENT FaultFTMTLCS_CurSenrPhaV_GNDDetected "FaultFTMTLCS_CurSenrPhaV_GNDDetected" UBYTE Bool_ON_OFF 1 2 0 1 BIT_MASK 0x20 ECU_ADDRESS 0x70009AFC /end MEASUREMENT
/begin MEASUREMENT FaultFTMTLCS_CurSenrPhaV_GNDLogged "FaultFTMTLCS_CurSenrPhaV_GNDLogged" UBYTE Bool_ON_OFF 1 2 0 1 BIT_MASK 0x20 ECU_ADDRESS 0x70009A9E /end MEASUREMENT
/begin MEASUREMENT FaultFTMTLCS_CurSenrPhaV_OutRngHAut "FaultFTMTLCS_CurSenrPhaV_OutRngHAut" UBYTE Bool_ON_OFF 1 2 0 1 BIT_MASK 0x40 ECU_ADDRESS 0x70009A40 /end MEASUREMENT
/begin MEASUREMENT FaultFTMTLCS_CurSenrPhaV_OutRngHDetected "FaultFTMTLCS_CurSenrPhaV_OutRngHDetected" UBYTE Bool_ON_OFF 1 2 0 1 BIT_MASK 0x40 ECU_ADDRESS 0x70009AFC /end MEASUREMENT
/begin MEASUREMENT FaultFTMTLCS_CurSenrPhaV_OutRngHLogged "FaultFTMTLCS_CurSenrPhaV_OutRngHLogged" UBYTE Bool_ON_OFF 1 2 0 1 BIT_MASK 0x40 ECU_ADDRESS 0x70009A9E /end MEASUREMENT
/begin MEASUREMENT FaultFTMTLCS_CurSenrPhaV_OutRngLAut "FaultFTMTLCS_CurSenrPhaV_OutRngLAut" UBYTE Bool_ON_OFF 1 2 0 1 BIT_MASK 0x80 ECU_ADDRESS 0x70009A40 /end MEASUREMENT
/begin MEASUREMENT FaultFTMTLCS_CurSenrPhaV_OutRngLDetected "FaultFTMTLCS_CurSenrPhaV_OutRngLDetected" UBYTE Bool_ON_OFF 1 2 0 1 BIT_MASK 0x80 ECU_ADDRESS 0x70009AFC /end MEASUREMENT
/begin MEASUREMENT FaultFTMTLCS_CurSenrPhaV_OutRngLLogged "FaultFTMTLCS_CurSenrPhaV_OutRngLLogged" UBYTE Bool_ON_OFF 1 2 0 1 BIT_MASK 0x80 ECU_ADDRESS 0x70009A9E /end MEASUREMENT
/begin MEASUREMENT FaultFTMTLCS_CurSenrPhaV_VCCAut "FaultFTMTLCS_CurSenrPhaV_VCCAut" UBYTE Bool_ON_OFF 1 2 0 1 BIT_MASK 0x01 ECU_ADDRESS 0x70009A41 /end MEASUREMENT
/begin MEASUREMENT FaultFTMTLCS_CurSenrPhaV_VCCDetected "FaultFTMTLCS_CurSenrPhaV_VCCDetected" UBYTE Bool_ON_OFF 1 2 0 1 BIT_MASK 0x01 ECU_ADDRESS 0x70009AFD /end MEASUREMENT
/begin MEASUREMENT FaultFTMTLCS_CurSenrPhaV_VCCLogged "FaultFTMTLCS_CurSenrPhaV_VCCLogged" UBYTE Bool_ON_OFF 1 2 0 1 BIT_MASK 0x01 ECU_ADDRESS 0x70009A9F /end MEASUREMENT
/begin MEASUREMENT FaultFTMTLCS_CurSenrPhaW_GNDAut "FaultFTMTLCS_CurSenrPhaW_GNDAut" UBYTE Bool_ON_OFF 1 2 0 1 BIT_MASK 0x02 ECU_ADDRESS 0x70009A41 /end MEASUREMENT
/begin MEASUREMENT FaultFTMTLCS_CurSenrPhaW_GNDDetected "FaultFTMTLCS_CurSenrPhaW_GNDDetected" UBYTE Bool_ON_OFF 1 2 0 1 BIT_MASK 0x02 ECU_ADDRESS 0x70009AFD /end MEASUREMENT
/begin MEASUREMENT FaultFTMTLCS_CurSenrPhaW_GNDLogged "FaultFTMTLCS_CurSenrPhaW_GNDLogged" UBYTE Bool_ON_OFF 1 2 0 1 BIT_MASK 0x02 ECU_ADDRESS 0x70009A9F /end MEASUREMENT
/begin MEASUREMENT FaultFTMTLCS_CurSenrPhaW_OutRngHAut "FaultFTMTLCS_CurSenrPhaW_OutRngHAut" UBYTE Bool_ON_OFF 1 2 0 1 BIT_MASK 0x04 ECU_ADDRESS 0x70009A41 /end MEASUREMENT
/begin MEASUREMENT FaultFTMTLCS_CurSenrPhaW_OutRngHDetected "FaultFTMTLCS_CurSenrPhaW_OutRngHDetected" UBYTE Bool_ON_OFF 1 2 0 1 BIT_MASK 0x04 ECU_ADDRESS 0x70009AFD /end MEASUREMENT
/begin MEASUREMENT FaultFTMTLCS_CurSenrPhaW_OutRngHLogged "FaultFTMTLCS_CurSenrPhaW_OutRngHLogged" UBYTE Bool_ON_OFF 1 2 0 1 BIT_MASK 0x04 ECU_ADDRESS 0x70009A9F /end MEASUREMENT
/begin MEASUREMENT FaultFTMTLCS_CurSenrPhaW_OutRngLAut "FaultFTMTLCS_CurSenrPhaW_OutRngLAut" UBYTE Bool_ON_OFF 1 2 0 1 BIT_MASK 0x08 ECU_ADDRESS 0x70009A41 /end MEASUREMENT
/begin MEASUREMENT FaultFTMTLCS_CurSenrPhaW_OutRngLDetected "FaultFTMTLCS_CurSenrPhaW_OutRngLDetected" UBYTE Bool_ON_OFF 1 2 0 1 BIT_MASK 0x08 ECU_ADDRESS 0x70009AFD /end MEASUREMENT
/begin MEASUREMENT FaultFTMTLCS_CurSenrPhaW_OutRngLLogged "FaultFTMTLCS_CurSenrPhaW_OutRngLLogged" UBYTE Bool_ON_OFF 1 2 0 1 BIT_MASK 0x08 ECU_ADDRESS 0x70009A9F /end MEASUREMENT
/begin MEASUREMENT FaultFTMTLCS_CurSenrPhaW_VCCAut "FaultFTMTLCS_CurSenrPhaW_VCCAut" UBYTE Bool_ON_OFF 1 2 0 1 BIT_MASK 0x10 ECU_ADDRESS 0x70009A41 /end MEASUREMENT
/begin MEASUREMENT FaultFTMTLCS_CurSenrPhaW_VCCDetected "FaultFTMTLCS_CurSenrPhaW_VCCDetected" UBYTE Bool_ON_OFF 1 2 0 1 BIT_MASK 0x10 ECU_ADDRESS 0x70009AFD /end MEASUREMENT
/begin MEASUREMENT FaultFTMTLCS_CurSenrPhaW_VCCLogged "FaultFTMTLCS_CurSenrPhaW_VCCLogged" UBYTE Bool_ON_OFF 1 2 0 1 BIT_MASK 0x10 ECU_ADDRESS 0x70009A9F /end MEASUREMENT
/begin MEASUREMENT FaultFTMTLCS_CurrentSumErrorAut "FaultFTMTLCS_CurrentSumErrorAut" UBYTE Bool_ON_OFF 1 2 0 1 BIT_MASK 0x01 ECU_ADDRESS 0x70009A40 /end MEASUREMENT
/begin MEASUREMENT FaultFTMTLCS_CurrentSumErrorDetected "FaultFTMTLCS_CurrentSumErrorDetected" UBYTE Bool_ON_OFF 1 2 0 1 BIT_MASK 0x01 ECU_ADDRESS 0x70009AFC /end MEASUREMENT
/begin MEASUREMENT FaultFTMTLCS_CurrentSumErrorLogged "FaultFTMTLCS_CurrentSumErrorLogged" UBYTE Bool_ON_OFF 1 2 0 1 BIT_MASK 0x01 ECU_ADDRESS 0x70009A9E /end MEASUREMENT
/begin MEASUREMENT FaultFTMTLCS_Detected "FaultFTMTLCS_Detected" UWORD I_1 1 2 0 65535 ECU_ADDRESS 0x70009AFC /end MEASUREMENT
/begin MEASUREMENT FaultFTMTLCS_Logged "FaultFTMTLCS_Logged" UWORD I_1 1 2 0 65535 ECU_ADDRESS 0x70009A9E /end MEASUREMENT
/begin MEASUREMENT FaultFailureLevel "FaultFailureLevel" UBYTE I_1 1 2 0 255 ECU_ADDRESS 0x70008F8D /end MEASUREMENT
/begin MEASUREMENT FaultFunctionTypeDetectedArray "FaultFunctionTypeDetectedArray" UWORD I_1 1 2 0 65535 MATRIX_DIM 30 1 1 ECU_ADDRESS 0x70009ACA /end MEASUREMENT
/begin MEASUREMENT FaultFunctionTypeDetectedArray[0] "FaultFunctionTypeDetectedArray[0]" UWORD I_1 1 2 0 65535 ECU_ADDRESS 0x70009ACA /end MEASUREMENT
/begin MEASUREMENT FaultFunctionTypeDetectedArray[10] "FaultFunctionTypeDetectedArray[10]" UWORD I_1 1 2 0 65535 ECU_ADDRESS 0x70009ADE /end MEASUREMENT
/begin MEASUREMENT FaultFunctionTypeDetectedArray[11] "FaultFunctionTypeDetectedArray[11]" UWORD I_1 1 2 0 65535 ECU_ADDRESS 0x70009AE0 /end MEASUREMENT
/begin MEASUREMENT FaultFunctionTypeDetectedArray[12] "FaultFunctionTypeDetectedArray[12]" UWORD I_1 1 2 0 65535 ECU_ADDRESS 0x70009AE2 /end MEASUREMENT
/begin MEASUREMENT FaultFunctionTypeDetectedArray[13] "FaultFunctionTypeDetectedArray[13]" UWORD I_1 1 2 0 65535 ECU_ADDRESS 0x70009AE4 /end MEASUREMENT
/begin MEASUREMENT FaultFunctionTypeDetectedArray[14] "FaultFunctionTypeDetectedArray[14]" UWORD I_1 1 2 0 65535 ECU_ADDRESS 0x70009AE6 /end MEASUREMENT
/begin MEASUREMENT FaultFunctionTypeDetectedArray[15] "FaultFunctionTypeDetectedArray[15]" UWORD I_1 1 2 0 65535 ECU_ADDRESS 0x70009AE8 /end MEASUREMENT
/begin MEASUREMENT FaultFunctionTypeDetectedArray[16] "FaultFunctionTypeDetectedArray[16]" UWORD I_1 1 2 0 65535 ECU_ADDRESS 0x70009AEA /end MEASUREMENT
/begin MEASUREMENT FaultFunctionTypeDetectedArray[17] "FaultFunctionTypeDetectedArray[17]" UWORD I_1 1 2 0 65535 ECU_ADDRESS 0x70009AEC /end MEASUREMENT
/begin MEASUREMENT FaultFunctionTypeDetectedArray[18] "FaultFunctionTypeDetectedArray[18]" UWORD I_1 1 2 0 65535 ECU_ADDRESS 0x70009AEE /end MEASUREMENT
/begin MEASUREMENT FaultFunctionTypeDetectedArray[19] "FaultFunctionTypeDetectedArray[19]" UWORD I_1 1 2 0 65535 ECU_ADDRESS 0x70009AF0 /end MEASUREMENT
/begin MEASUREMENT FaultFunctionTypeDetectedArray[1] "FaultFunctionTypeDetectedArray[1]" UWORD I_1 1 2 0 65535 ECU_ADDRESS 0x70009ACC /end MEASUREMENT
/begin MEASUREMENT FaultFunctionTypeDetectedArray[20] "FaultFunctionTypeDetectedArray[20]" UWORD I_1 1 2 0 65535 ECU_ADDRESS 0x70009AF2 /end MEASUREMENT
/begin MEASUREMENT FaultFunctionTypeDetectedArray[21] "FaultFunctionTypeDetectedArray[21]" UWORD I_1 1 2 0 65535 ECU_ADDRESS 0x70009AF4 /end MEASUREMENT
/begin MEASUREMENT FaultFunctionTypeDetectedArray[22] "FaultFunctionTypeDetectedArray[22]" UWORD I_1 1 2 0 65535 ECU_ADDRESS 0x70009AF6 /end MEASUREMENT
/begin MEASUREMENT FaultFunctionTypeDetectedArray[23] "FaultFunctionTypeDetectedArray[23]" UWORD I_1 1 2 0 65535 ECU_ADDRESS 0x70009AF8 /end MEASUREMENT
/begin MEASUREMENT FaultFunctionTypeDetectedArray[24] "FaultFunctionTypeDetectedArray[24]" UWORD I_1 1 2 0 65535 ECU_ADDRESS 0x70009AFA /end MEASUREMENT
/begin MEASUREMENT FaultFunctionTypeDetectedArray[25] "FaultFunctionTypeDetectedArray[25]" UWORD I_1 1 2 0 65535 ECU_ADDRESS 0x70009AFC /end MEASUREMENT
/begin MEASUREMENT FaultFunctionTypeDetectedArray[26] "FaultFunctionTypeDetectedArray[26]" UWORD I_1 1 2 0 65535 ECU_ADDRESS 0x70009AFE /end MEASUREMENT
/begin MEASUREMENT FaultFunctionTypeDetectedArray[27] "FaultFunctionTypeDetectedArray[27]" UWORD I_1 1 2 0 65535 ECU_ADDRESS 0x70009B00 /end MEASUREMENT
/begin MEASUREMENT FaultFunctionTypeDetectedArray[28] "FaultFunctionTypeDetectedArray[28]" UWORD I_1 1 2 0 65535 ECU_ADDRESS 0x70009B02 /end MEASUREMENT
/begin MEASUREMENT FaultFunctionTypeDetectedArray[29] "FaultFunctionTypeDetectedArray[29]" UWORD I_1 1 2 0 65535 ECU_ADDRESS 0x70009B04 /end MEASUREMENT
/begin MEASUREMENT FaultFunctionTypeDetectedArray[2] "FaultFunctionTypeDetectedArray[2]" UWORD I_1 1 2 0 65535 ECU_ADDRESS 0x70009ACE /end MEASUREMENT
/begin MEASUREMENT FaultFunctionTypeDetectedArray[3] "FaultFunctionTypeDetectedArray[3]" UWORD I_1 1 2 0 65535 ECU_ADDRESS 0x70009AD0 /end MEASUREMENT
/begin MEASUREMENT FaultFunctionTypeDetectedArray[4] "FaultFunctionTypeDetectedArray[4]" UWORD I_1 1 2 0 65535 ECU_ADDRESS 0x70009AD2 /end MEASUREMENT
/begin MEASUREMENT FaultFunctionTypeDetectedArray[5] "FaultFunctionTypeDetectedArray[5]" UWORD I_1 1 2 0 65535 ECU_ADDRESS 0x70009AD4 /end MEASUREMENT
/begin MEASUREMENT FaultFunctionTypeDetectedArray[6] "FaultFunctionTypeDetectedArray[6]" UWORD I_1 1 2 0 65535 ECU_ADDRESS 0x70009AD6 /end MEASUREMENT
/begin MEASUREMENT FaultFunctionTypeDetectedArray[7] "FaultFunctionTypeDetectedArray[7]" UWORD I_1 1 2 0 65535 ECU_ADDRESS 0x70009AD8 /end MEASUREMENT
/begin MEASUREMENT FaultFunctionTypeDetectedArray[8] "FaultFunctionTypeDetectedArray[8]" UWORD I_1 1 2 0 65535 ECU_ADDRESS 0x70009ADA /end MEASUREMENT
/begin MEASUREMENT FaultFunctionTypeDetectedArray[9] "FaultFunctionTypeDetectedArray[9]" UWORD I_1 1 2 0 65535 ECU_ADDRESS 0x70009ADC /end MEASUREMENT
/begin MEASUREMENT FaultFunctionTypeLoggedArray "FaultFunctionTypeLoggedArray" UWORD I_1 1 2 0 65535 MATRIX_DIM 30 1 1 ECU_ADDRESS 0x70009A6C /end MEASUREMENT
/begin MEASUREMENT FaultFunctionTypeLoggedArray[0] "FaultFunctionTypeLoggedArray[0]" UWORD I_1 1 2 0 65535 ECU_ADDRESS 0x70009A6C /end MEASUREMENT
/begin MEASUREMENT FaultFunctionTypeLoggedArray[10] "FaultFunctionTypeLoggedArray[10]" UWORD I_1 1 2 0 65535 ECU_ADDRESS 0x70009A80 /end MEASUREMENT
/begin MEASUREMENT FaultFunctionTypeLoggedArray[11] "FaultFunctionTypeLoggedArray[11]" UWORD I_1 1 2 0 65535 ECU_ADDRESS 0x70009A82 /end MEASUREMENT
/begin MEASUREMENT FaultFunctionTypeLoggedArray[12] "FaultFunctionTypeLoggedArray[12]" UWORD I_1 1 2 0 65535 ECU_ADDRESS 0x70009A84 /end MEASUREMENT
/begin MEASUREMENT FaultFunctionTypeLoggedArray[13] "FaultFunctionTypeLoggedArray[13]" UWORD I_1 1 2 0 65535 ECU_ADDRESS 0x70009A86 /end MEASUREMENT
/begin MEASUREMENT FaultFunctionTypeLoggedArray[14] "FaultFunctionTypeLoggedArray[14]" UWORD I_1 1 2 0 65535 ECU_ADDRESS 0x70009A88 /end MEASUREMENT
/begin MEASUREMENT FaultFunctionTypeLoggedArray[15] "FaultFunctionTypeLoggedArray[15]" UWORD I_1 1 2 0 65535 ECU_ADDRESS 0x70009A8A /end MEASUREMENT
/begin MEASUREMENT FaultFunctionTypeLoggedArray[16] "FaultFunctionTypeLoggedArray[16]" UWORD I_1 1 2 0 65535 ECU_ADDRESS 0x70009A8C /end MEASUREMENT
/begin MEASUREMENT FaultFunctionTypeLoggedArray[17] "FaultFunctionTypeLoggedArray[17]" UWORD I_1 1 2 0 65535 ECU_ADDRESS 0x70009A8E /end MEASUREMENT
/begin MEASUREMENT FaultFunctionTypeLoggedArray[18] "FaultFunctionTypeLoggedArray[18]" UWORD I_1 1 2 0 65535 ECU_ADDRESS 0x70009A90 /end MEASUREMENT
/begin MEASUREMENT FaultFunctionTypeLoggedArray[19] "FaultFunctionTypeLoggedArray[19]" UWORD I_1 1 2 0 65535 ECU_ADDRESS 0x70009A92 /end MEASUREMENT
/begin MEASUREMENT FaultFunctionTypeLoggedArray[1] "FaultFunctionTypeLoggedArray[1]" UWORD I_1 1 2 0 65535 ECU_ADDRESS 0x70009A6E /end MEASUREMENT
/begin MEASUREMENT FaultFunctionTypeLoggedArray[20] "FaultFunctionTypeLoggedArray[20]" UWORD I_1 1 2 0 65535 ECU_ADDRESS 0x70009A94 /end MEASUREMENT
/begin MEASUREMENT FaultFunctionTypeLoggedArray[21] "FaultFunctionTypeLoggedArray[21]" UWORD I_1 1 2 0 65535 ECU_ADDRESS 0x70009A96 /end MEASUREMENT
/begin MEASUREMENT FaultFunctionTypeLoggedArray[22] "FaultFunctionTypeLoggedArray[22]" UWORD I_1 1 2 0 65535 ECU_ADDRESS 0x70009A98 /end MEASUREMENT
/begin MEASUREMENT FaultFunctionTypeLoggedArray[23] "FaultFunctionTypeLoggedArray[23]" UWORD I_1 1 2 0 65535 ECU_ADDRESS 0x70009A9A /end MEASUREMENT
/begin MEASUREMENT FaultFunctionTypeLoggedArray[24] "FaultFunctionTypeLoggedArray[24]" UWORD I_1 1 2 0 65535 ECU_ADDRESS 0x70009A9C /end MEASUREMENT
/begin MEASUREMENT FaultFunctionTypeLoggedArray[25] "FaultFunctionTypeLoggedArray[25]" UWORD I_1 1 2 0 65535 ECU_ADDRESS 0x70009A9E /end MEASUREMENT
/begin MEASUREMENT FaultFunctionTypeLoggedArray[26] "FaultFunctionTypeLoggedArray[26]" UWORD I_1 1 2 0 65535 ECU_ADDRESS 0x70009AA0 /end MEASUREMENT
/begin MEASUREMENT FaultFunctionTypeLoggedArray[27] "FaultFunctionTypeLoggedArray[27]" UWORD I_1 1 2 0 65535 ECU_ADDRESS 0x70009AA2 /end MEASUREMENT
/begin MEASUREMENT FaultFunctionTypeLoggedArray[28] "FaultFunctionTypeLoggedArray[28]" UWORD I_1 1 2 0 65535 ECU_ADDRESS 0x70009AA4 /end MEASUREMENT
/begin MEASUREMENT FaultFunctionTypeLoggedArray[29] "FaultFunctionTypeLoggedArray[29]" UWORD I_1 1 2 0 65535 ECU_ADDRESS 0x70009AA6 /end MEASUREMENT
/begin MEASUREMENT FaultFunctionTypeLoggedArray[2] "FaultFunctionTypeLoggedArray[2]" UWORD I_1 1 2 0 65535 ECU_ADDRESS 0x70009A70 /end MEASUREMENT
/begin MEASUREMENT FaultFunctionTypeLoggedArray[3] "FaultFunctionTypeLoggedArray[3]" UWORD I_1 1 2 0 65535 ECU_ADDRESS 0x70009A72 /end MEASUREMENT
/begin MEASUREMENT FaultFunctionTypeLoggedArray[4] "FaultFunctionTypeLoggedArray[4]" UWORD I_1 1 2 0 65535 ECU_ADDRESS 0x70009A74 /end MEASUREMENT
/begin MEASUREMENT FaultFunctionTypeLoggedArray[5] "FaultFunctionTypeLoggedArray[5]" UWORD I_1 1 2 0 65535 ECU_ADDRESS 0x70009A76 /end MEASUREMENT
/begin MEASUREMENT FaultFunctionTypeLoggedArray[6] "FaultFunctionTypeLoggedArray[6]" UWORD I_1 1 2 0 65535 ECU_ADDRESS 0x70009A78 /end MEASUREMENT
/begin MEASUREMENT FaultFunctionTypeLoggedArray[7] "FaultFunctionTypeLoggedArray[7]" UWORD I_1 1 2 0 65535 ECU_ADDRESS 0x70009A7A /end MEASUREMENT
/begin MEASUREMENT FaultFunctionTypeLoggedArray[8] "FaultFunctionTypeLoggedArray[8]" UWORD I_1 1 2 0 65535 ECU_ADDRESS 0x70009A7C /end MEASUREMENT
/begin MEASUREMENT FaultFunctionTypeLoggedArray[9] "FaultFunctionTypeLoggedArray[9]" UWORD I_1 1 2 0 65535 ECU_ADDRESS 0x70009A7E /end MEASUREMENT
/begin MEASUREMENT FaultSDMTMEP_CosGndAut "FaultSDMTMEP_CosGndAut" UBYTE Bool_ON_OFF 1 2 0 1 BIT_MASK 0x01 ECU_ADDRESS 0x70009A42 /end MEASUREMENT
/begin MEASUREMENT FaultSDMTMEP_CosGndDetected "FaultSDMTMEP_CosGndDetected" UBYTE Bool_ON_OFF 1 2 0 1 BIT_MASK 0x01 ECU_ADDRESS 0x70009AFE /end MEASUREMENT
/begin MEASUREMENT FaultSDMTMEP_CosGndLogged "FaultSDMTMEP_CosGndLogged" UBYTE Bool_ON_OFF 1 2 0 1 BIT_MASK 0x01 ECU_ADDRESS 0x70009AA0 /end MEASUREMENT
/begin MEASUREMENT FaultSDMTMEP_CosOutRangeHighAut "FaultSDMTMEP_CosOutRangeHighAut" UBYTE Bool_ON_OFF 1 2 0 1 BIT_MASK 0x02 ECU_ADDRESS 0x70009A42 /end MEASUREMENT
/begin MEASUREMENT FaultSDMTMEP_CosOutRangeHighDetected "FaultSDMTMEP_CosOutRangeHighDetected" UBYTE Bool_ON_OFF 1 2 0 1 BIT_MASK 0x02 ECU_ADDRESS 0x70009AFE /end MEASUREMENT
/begin MEASUREMENT FaultSDMTMEP_CosOutRangeHighLogged "FaultSDMTMEP_CosOutRangeHighLogged" UBYTE Bool_ON_OFF 1 2 0 1 BIT_MASK 0x02 ECU_ADDRESS 0x70009AA0 /end MEASUREMENT
/begin MEASUREMENT FaultSDMTMEP_CosOutRangeLowAut "FaultSDMTMEP_CosOutRangeLowAut" UBYTE Bool_ON_OFF 1 2 0 1 BIT_MASK 0x04 ECU_ADDRESS 0x70009A42 /end MEASUREMENT
/begin MEASUREMENT FaultSDMTMEP_CosOutRangeLowDetected "FaultSDMTMEP_CosOutRangeLowDetected" UBYTE Bool_ON_OFF 1 2 0 1 BIT_MASK 0x04 ECU_ADDRESS 0x70009AFE /end MEASUREMENT
/begin MEASUREMENT FaultSDMTMEP_CosOutRangeLowLogged "FaultSDMTMEP_CosOutRangeLowLogged" UBYTE Bool_ON_OFF 1 2 0 1 BIT_MASK 0x04 ECU_ADDRESS 0x70009AA0 /end MEASUREMENT
/begin MEASUREMENT FaultSDMTMEP_CosVccAut "FaultSDMTMEP_CosVccAut" UBYTE Bool_ON_OFF 1 2 0 1 BIT_MASK 0x08 ECU_ADDRESS 0x70009A42 /end MEASUREMENT
/begin MEASUREMENT FaultSDMTMEP_CosVccDetected "FaultSDMTMEP_CosVccDetected" UBYTE Bool_ON_OFF 1 2 0 1 BIT_MASK 0x08 ECU_ADDRESS 0x70009AFE /end MEASUREMENT
/begin MEASUREMENT FaultSDMTMEP_CosVccLogged "FaultSDMTMEP_CosVccLogged" UBYTE Bool_ON_OFF 1 2 0 1 BIT_MASK 0x08 ECU_ADDRESS 0x70009AA0 /end MEASUREMENT
/begin MEASUREMENT FaultSDMTMEP_Detected "FaultSDMTMEP_Detected" UWORD I_1 1 2 0 65535 ECU_ADDRESS 0x70009AFE /end MEASUREMENT
/begin MEASUREMENT FaultSDMTMEP_Logged "FaultSDMTMEP_Logged" UWORD I_1 1 2 0 65535 ECU_ADDRESS 0x70009AA0 /end MEASUREMENT
/begin MEASUREMENT FaultSDMTMEP_OverSpeedAut "FaultSDMTMEP_OverSpeedAut" UBYTE Bool_ON_OFF 1 2 0 1 BIT_MASK 0x10 ECU_ADDRESS 0x70009A42 /end MEASUREMENT
/begin MEASUREMENT FaultSDMTMEP_OverSpeedDetected "FaultSDMTMEP_OverSpeedDetected" UBYTE Bool_ON_OFF 1 2 0 1 BIT_MASK 0x10 ECU_ADDRESS 0x70009AFE /end MEASUREMENT
/begin MEASUREMENT FaultSDMTMEP_OverSpeedLogged "FaultSDMTMEP_OverSpeedLogged" UBYTE Bool_ON_OFF 1 2 0 1 BIT_MASK 0x10 ECU_ADDRESS 0x70009AA0 /end MEASUREMENT
/begin MEASUREMENT FaultSDMTMEP_ResSquaSumErrByFTAut "FaultSDMTMEP_ResSquaSumErrByFTAut" UBYTE Bool_ON_OFF 1 2 0 1 BIT_MASK 0x20 ECU_ADDRESS 0x70009A42 /end MEASUREMENT
/begin MEASUREMENT FaultSDMTMEP_ResSquaSumErrByFTDetected "FaultSDMTMEP_ResSquaSumErrByFTDetected" UBYTE Bool_ON_OFF 1 2 0 1 BIT_MASK 0x20 ECU_ADDRESS 0x70009AFE /end MEASUREMENT
/begin MEASUREMENT FaultSDMTMEP_ResSquaSumErrByFTLogged "FaultSDMTMEP_ResSquaSumErrByFTLogged" UBYTE Bool_ON_OFF 1 2 0 1 BIT_MASK 0x20 ECU_ADDRESS 0x70009AA0 /end MEASUREMENT
/begin MEASUREMENT FaultSDMTMEP_SinGndAut "FaultSDMTMEP_SinGndAut" UBYTE Bool_ON_OFF 1 2 0 1 BIT_MASK 0x40 ECU_ADDRESS 0x70009A42 /end MEASUREMENT
/begin MEASUREMENT FaultSDMTMEP_SinGndDetected "FaultSDMTMEP_SinGndDetected" UBYTE Bool_ON_OFF 1 2 0 1 BIT_MASK 0x40 ECU_ADDRESS 0x70009AFE /end MEASUREMENT
/begin MEASUREMENT FaultSDMTMEP_SinGndLogged "FaultSDMTMEP_SinGndLogged" UBYTE Bool_ON_OFF 1 2 0 1 BIT_MASK 0x40 ECU_ADDRESS 0x70009AA0 /end MEASUREMENT
/begin MEASUREMENT FaultSDMTMEP_SinOutRangeHighAut "FaultSDMTMEP_SinOutRangeHighAut" UBYTE Bool_ON_OFF 1 2 0 1 BIT_MASK 0x80 ECU_ADDRESS 0x70009A42 /end MEASUREMENT
/begin MEASUREMENT FaultSDMTMEP_SinOutRangeHighDetected "FaultSDMTMEP_SinOutRangeHighDetected" UBYTE Bool_ON_OFF 1 2 0 1 BIT_MASK 0x80 ECU_ADDRESS 0x70009AFE /end MEASUREMENT
/begin MEASUREMENT FaultSDMTMEP_SinOutRangeHighLogged "FaultSDMTMEP_SinOutRangeHighLogged" UBYTE Bool_ON_OFF 1 2 0 1 BIT_MASK 0x80 ECU_ADDRESS 0x70009AA0 /end MEASUREMENT
/begin MEASUREMENT FaultSDMTMEP_SinOutRangeLowAut "FaultSDMTMEP_SinOutRangeLowAut" UBYTE Bool_ON_OFF 1 2 0 1 BIT_MASK 0x01 ECU_ADDRESS 0x70009A43 /end MEASUREMENT
/begin MEASUREMENT FaultSDMTMEP_SinOutRangeLowDetected "FaultSDMTMEP_SinOutRangeLowDetected" UBYTE Bool_ON_OFF 1 2 0 1 BIT_MASK 0x01 ECU_ADDRESS 0x70009AFF /end MEASUREMENT
/begin MEASUREMENT FaultSDMTMEP_SinOutRangeLowLogged "FaultSDMTMEP_SinOutRangeLowLogged" UBYTE Bool_ON_OFF 1 2 0 1 BIT_MASK 0x01 ECU_ADDRESS 0x70009AA1 /end MEASUREMENT
/begin MEASUREMENT FaultSDMTMEP_SinVccAut "FaultSDMTMEP_SinVccAut" UBYTE Bool_ON_OFF 1 2 0 1 BIT_MASK 0x02 ECU_ADDRESS 0x70009A43 /end MEASUREMENT
/begin MEASUREMENT FaultSDMTMEP_SinVccDetected "FaultSDMTMEP_SinVccDetected" UBYTE Bool_ON_OFF 1 2 0 1 BIT_MASK 0x02 ECU_ADDRESS 0x70009AFF /end MEASUREMENT
/begin MEASUREMENT FaultSDMTMEP_SinVccLogged "FaultSDMTMEP_SinVccLogged" UBYTE Bool_ON_OFF 1 2 0 1 BIT_MASK 0x02 ECU_ADDRESS 0x70009AA1 /end MEASUREMENT
/begin MEASUREMENT FaultSDMTMEP_UnderSpeedAut "FaultSDMTMEP_UnderSpeedAut" UBYTE Bool_ON_OFF 1 2 0 1 BIT_MASK 0x04 ECU_ADDRESS 0x70009A43 /end MEASUREMENT
/begin MEASUREMENT FaultSDMTMEP_UnderSpeedDetected "FaultSDMTMEP_UnderSpeedDetected" UBYTE Bool_ON_OFF 1 2 0 1 BIT_MASK 0x04 ECU_ADDRESS 0x70009AFF /end MEASUREMENT
/begin MEASUREMENT FaultSDMTMEP_UnderSpeedLogged "FaultSDMTMEP_UnderSpeedLogged" UBYTE Bool_ON_OFF 1 2 0 1 BIT_MASK 0x04 ECU_ADDRESS 0x70009AA1 /end MEASUREMENT
/begin MEASUREMENT FaultTCUCAP0_CAPPressureHAut "FaultTCUCAP0_CAPPressureHAut" UBYTE Bool_ON_OFF 1 2 0 1 BIT_MASK 0x01 ECU_ADDRESS 0x70009A44 /end MEASUREMENT
/begin MEASUREMENT FaultTCUCAP0_CAPPressureHDetected "FaultTCUCAP0_CAPPressureHDetected" UBYTE Bool_ON_OFF 1 2 0 1 BIT_MASK 0x01 ECU_ADDRESS 0x70009B00 /end MEASUREMENT
/begin MEASUREMENT FaultTCUCAP0_CAPPressureHLogged "FaultTCUCAP0_CAPPressureHLogged" UBYTE Bool_ON_OFF 1 2 0 1 BIT_MASK 0x01 ECU_ADDRESS 0x70009AA2 /end MEASUREMENT
/begin MEASUREMENT FaultTCUCAP0_CAPPressureLAut "FaultTCUCAP0_CAPPressureLAut" UBYTE Bool_ON_OFF 1 2 0 1 BIT_MASK 0x02 ECU_ADDRESS 0x70009A44 /end MEASUREMENT
/begin MEASUREMENT FaultTCUCAP0_CAPPressureLDetected "FaultTCUCAP0_CAPPressureLDetected" UBYTE Bool_ON_OFF 1 2 0 1 BIT_MASK 0x02 ECU_ADDRESS 0x70009B00 /end MEASUREMENT
/begin MEASUREMENT FaultTCUCAP0_CAPPressureLLogged "FaultTCUCAP0_CAPPressureLLogged" UBYTE Bool_ON_OFF 1 2 0 1 BIT_MASK 0x02 ECU_ADDRESS 0x70009AA2 /end MEASUREMENT
/begin MEASUREMENT FaultTCUCAP0_CAPPressureOverHAut "FaultTCUCAP0_CAPPressureOverHAut" UBYTE Bool_ON_OFF 1 2 0 1 BIT_MASK 0x04 ECU_ADDRESS 0x70009A44 /end MEASUREMENT
/begin MEASUREMENT FaultTCUCAP0_CAPPressureOverHDetected "FaultTCUCAP0_CAPPressureOverHDetected" UBYTE Bool_ON_OFF 1 2 0 1 BIT_MASK 0x04 ECU_ADDRESS 0x70009B00 /end MEASUREMENT
/begin MEASUREMENT FaultTCUCAP0_CAPPressureOverHLogged "FaultTCUCAP0_CAPPressureOverHLogged" UBYTE Bool_ON_OFF 1 2 0 1 BIT_MASK 0x04 ECU_ADDRESS 0x70009AA2 /end MEASUREMENT
/begin MEASUREMENT FaultTCUCAP0_CAPSlipAut "FaultTCUCAP0_CAPSlipAut" UBYTE Bool_ON_OFF 1 2 0 1 BIT_MASK 0x08 ECU_ADDRESS 0x70009A44 /end MEASUREMENT
/begin MEASUREMENT FaultTCUCAP0_CAPSlipDetected "FaultTCUCAP0_CAPSlipDetected" UBYTE Bool_ON_OFF 1 2 0 1 BIT_MASK 0x08 ECU_ADDRESS 0x70009B00 /end MEASUREMENT
/begin MEASUREMENT FaultTCUCAP0_CAPSlipLogged "FaultTCUCAP0_CAPSlipLogged" UBYTE Bool_ON_OFF 1 2 0 1 BIT_MASK 0x08 ECU_ADDRESS 0x70009AA2 /end MEASUREMENT
/begin MEASUREMENT FaultTCUCAP0_Detected "FaultTCUCAP0_Detected" UWORD I_1 1 2 0 65535 ECU_ADDRESS 0x70009B00 /end MEASUREMENT
/begin MEASUREMENT FaultTCUCAP0_DragMomentHAut "FaultTCUCAP0_DragMomentHAut" UBYTE Bool_ON_OFF 1 2 0 1 BIT_MASK 0x10 ECU_ADDRESS 0x70009A44 /end MEASUREMENT
/begin MEASUREMENT FaultTCUCAP0_DragMomentHDetected "FaultTCUCAP0_DragMomentHDetected" UBYTE Bool_ON_OFF 1 2 0 1 BIT_MASK 0x10 ECU_ADDRESS 0x70009B00 /end MEASUREMENT
/begin MEASUREMENT FaultTCUCAP0_DragMomentHLogged "FaultTCUCAP0_DragMomentHLogged" UBYTE Bool_ON_OFF 1 2 0 1 BIT_MASK 0x10 ECU_ADDRESS 0x70009AA2 /end MEASUREMENT
/begin MEASUREMENT FaultTCUCAP0_HLSinInvalidAut "FaultTCUCAP0_HLSinInvalidAut" UBYTE Bool_ON_OFF 1 2 0 1 BIT_MASK 0x20 ECU_ADDRESS 0x70009A44 /end MEASUREMENT
/begin MEASUREMENT FaultTCUCAP0_HLSinInvalidDetected "FaultTCUCAP0_HLSinInvalidDetected" UBYTE Bool_ON_OFF 1 2 0 1 BIT_MASK 0x20 ECU_ADDRESS 0x70009B00 /end MEASUREMENT
/begin MEASUREMENT FaultTCUCAP0_HLSinInvalidLogged "FaultTCUCAP0_HLSinInvalidLogged" UBYTE Bool_ON_OFF 1 2 0 1 BIT_MASK 0x20 ECU_ADDRESS 0x70009AA2 /end MEASUREMENT
/begin MEASUREMENT FaultTCUCAP0_HLSinUndefineAut "FaultTCUCAP0_HLSinUndefineAut" UBYTE Bool_ON_OFF 1 2 0 1 BIT_MASK 0x40 ECU_ADDRESS 0x70009A44 /end MEASUREMENT
/begin MEASUREMENT FaultTCUCAP0_HLSinUndefineDetected "FaultTCUCAP0_HLSinUndefineDetected" UBYTE Bool_ON_OFF 1 2 0 1 BIT_MASK 0x40 ECU_ADDRESS 0x70009B00 /end MEASUREMENT
/begin MEASUREMENT FaultTCUCAP0_HLSinUndefineLogged "FaultTCUCAP0_HLSinUndefineLogged" UBYTE Bool_ON_OFF 1 2 0 1 BIT_MASK 0x40 ECU_ADDRESS 0x70009AA2 /end MEASUREMENT
/begin MEASUREMENT FaultTCUCAP0_HLSupplyHAut "FaultTCUCAP0_HLSupplyHAut" UBYTE Bool_ON_OFF 1 2 0 1 BIT_MASK 0x80 ECU_ADDRESS 0x70009A44 /end MEASUREMENT
/begin MEASUREMENT FaultTCUCAP0_HLSupplyHDetected "FaultTCUCAP0_HLSupplyHDetected" UBYTE Bool_ON_OFF 1 2 0 1 BIT_MASK 0x80 ECU_ADDRESS 0x70009B00 /end MEASUREMENT
/begin MEASUREMENT FaultTCUCAP0_HLSupplyHLogged "FaultTCUCAP0_HLSupplyHLogged" UBYTE Bool_ON_OFF 1 2 0 1 BIT_MASK 0x80 ECU_ADDRESS 0x70009AA2 /end MEASUREMENT
/begin MEASUREMENT FaultTCUCAP0_HLSupplyLAut "FaultTCUCAP0_HLSupplyLAut" UBYTE Bool_ON_OFF 1 2 0 1 BIT_MASK 0x01 ECU_ADDRESS 0x70009A45 /end MEASUREMENT
/begin MEASUREMENT FaultTCUCAP0_HLSupplyLDetected "FaultTCUCAP0_HLSupplyLDetected" UBYTE Bool_ON_OFF 1 2 0 1 BIT_MASK 0x01 ECU_ADDRESS 0x70009B01 /end MEASUREMENT
/begin MEASUREMENT FaultTCUCAP0_HLSupplyLLogged "FaultTCUCAP0_HLSupplyLLogged" UBYTE Bool_ON_OFF 1 2 0 1 BIT_MASK 0x01 ECU_ADDRESS 0x70009AA3 /end MEASUREMENT
/begin MEASUREMENT FaultTCUCAP0_Logged "FaultTCUCAP0_Logged" UWORD I_1 1 2 0 65535 ECU_ADDRESS 0x70009AA2 /end MEASUREMENT
/begin MEASUREMENT FaultTCUCAP0_MotorPhaseVolHAut "FaultTCUCAP0_MotorPhaseVolHAut" UBYTE Bool_ON_OFF 1 2 0 1 BIT_MASK 0x02 ECU_ADDRESS 0x70009A45 /end MEASUREMENT
/begin MEASUREMENT FaultTCUCAP0_MotorPhaseVolHDetected "FaultTCUCAP0_MotorPhaseVolHDetected" UBYTE Bool_ON_OFF 1 2 0 1 BIT_MASK 0x02 ECU_ADDRESS 0x70009B01 /end MEASUREMENT
/begin MEASUREMENT FaultTCUCAP0_MotorPhaseVolHLogged "FaultTCUCAP0_MotorPhaseVolHLogged" UBYTE Bool_ON_OFF 1 2 0 1 BIT_MASK 0x02 ECU_ADDRESS 0x70009AA3 /end MEASUREMENT
/begin MEASUREMENT FaultTCUCAP0_PressureRationalAut "FaultTCUCAP0_PressureRationalAut" UBYTE Bool_ON_OFF 1 2 0 1 BIT_MASK 0x04 ECU_ADDRESS 0x70009A45 /end MEASUREMENT
/begin MEASUREMENT FaultTCUCAP0_PressureRationalDetected "FaultTCUCAP0_PressureRationalDetected" UBYTE Bool_ON_OFF 1 2 0 1 BIT_MASK 0x04 ECU_ADDRESS 0x70009B01 /end MEASUREMENT
/begin MEASUREMENT FaultTCUCAP0_PressureRationalLogged "FaultTCUCAP0_PressureRationalLogged" UBYTE Bool_ON_OFF 1 2 0 1 BIT_MASK 0x04 ECU_ADDRESS 0x70009AA3 /end MEASUREMENT
/begin MEASUREMENT FaultTCUCAP0_SenSigOpenOrGNDAut "FaultTCUCAP0_SenSigOpenOrGNDAut" UBYTE Bool_ON_OFF 1 2 0 1 BIT_MASK 0x08 ECU_ADDRESS 0x70009A45 /end MEASUREMENT
/begin MEASUREMENT FaultTCUCAP0_SenSigOpenOrGNDDetected "FaultTCUCAP0_SenSigOpenOrGNDDetected" UBYTE Bool_ON_OFF 1 2 0 1 BIT_MASK 0x08 ECU_ADDRESS 0x70009B01 /end MEASUREMENT
/begin MEASUREMENT FaultTCUCAP0_SenSigOpenOrGNDLogged "FaultTCUCAP0_SenSigOpenOrGNDLogged" UBYTE Bool_ON_OFF 1 2 0 1 BIT_MASK 0x08 ECU_ADDRESS 0x70009AA3 /end MEASUREMENT
/begin MEASUREMENT FaultTCUCAP0_SenSigVCCAut "FaultTCUCAP0_SenSigVCCAut" UBYTE Bool_ON_OFF 1 2 0 1 BIT_MASK 0x10 ECU_ADDRESS 0x70009A45 /end MEASUREMENT
/begin MEASUREMENT FaultTCUCAP0_SenSigVCCDetected "FaultTCUCAP0_SenSigVCCDetected" UBYTE Bool_ON_OFF 1 2 0 1 BIT_MASK 0x10 ECU_ADDRESS 0x70009B01 /end MEASUREMENT
/begin MEASUREMENT FaultTCUCAP0_SenSigVCCLogged "FaultTCUCAP0_SenSigVCCLogged" UBYTE Bool_ON_OFF 1 2 0 1 BIT_MASK 0x10 ECU_ADDRESS 0x70009AA3 /end MEASUREMENT
/begin MEASUREMENT FaultTCUCAP0_SensorPerforErrAut "FaultTCUCAP0_SensorPerforErrAut" UBYTE Bool_ON_OFF 1 2 0 1 BIT_MASK 0x20 ECU_ADDRESS 0x70009A45 /end MEASUREMENT
/begin MEASUREMENT FaultTCUCAP0_SensorPerforErrDetected "FaultTCUCAP0_SensorPerforErrDetected" UBYTE Bool_ON_OFF 1 2 0 1 BIT_MASK 0x20 ECU_ADDRESS 0x70009B01 /end MEASUREMENT
/begin MEASUREMENT FaultTCUCAP0_SensorPerforErrLogged "FaultTCUCAP0_SensorPerforErrLogged" UBYTE Bool_ON_OFF 1 2 0 1 BIT_MASK 0x20 ECU_ADDRESS 0x70009AA3 /end MEASUREMENT
/begin MEASUREMENT FaultTCUCAP1_COM_GCUAut "FaultTCUCAP1_COM_GCUAut" UBYTE Bool_ON_OFF 1 2 0 1 BIT_MASK 0x01 ECU_ADDRESS 0x70009A46 /end MEASUREMENT
/begin MEASUREMENT FaultTCUCAP1_COM_GCUDetected "FaultTCUCAP1_COM_GCUDetected" UBYTE Bool_ON_OFF 1 2 0 1 BIT_MASK 0x01 ECU_ADDRESS 0x70009B02 /end MEASUREMENT
/begin MEASUREMENT FaultTCUCAP1_COM_GCULogged "FaultTCUCAP1_COM_GCULogged" UBYTE Bool_ON_OFF 1 2 0 1 BIT_MASK 0x01 ECU_ADDRESS 0x70009AA4 /end MEASUREMENT
/begin MEASUREMENT FaultTCUCAP1_Detected "FaultTCUCAP1_Detected" UWORD I_1 1 2 0 65535 ECU_ADDRESS 0x70009B02 /end MEASUREMENT
/begin MEASUREMENT FaultTCUCAP1_DriverTempHAut "FaultTCUCAP1_DriverTempHAut" UBYTE Bool_ON_OFF 1 2 0 1 BIT_MASK 0x02 ECU_ADDRESS 0x70009A46 /end MEASUREMENT
/begin MEASUREMENT FaultTCUCAP1_DriverTempHDetected "FaultTCUCAP1_DriverTempHDetected" UBYTE Bool_ON_OFF 1 2 0 1 BIT_MASK 0x02 ECU_ADDRESS 0x70009B02 /end MEASUREMENT
/begin MEASUREMENT FaultTCUCAP1_DriverTempHLogged "FaultTCUCAP1_DriverTempHLogged" UBYTE Bool_ON_OFF 1 2 0 1 BIT_MASK 0x02 ECU_ADDRESS 0x70009AA4 /end MEASUREMENT
/begin MEASUREMENT FaultTCUCAP1_FETShortAut "FaultTCUCAP1_FETShortAut" UBYTE Bool_ON_OFF 1 2 0 1 BIT_MASK 0x04 ECU_ADDRESS 0x70009A46 /end MEASUREMENT
/begin MEASUREMENT FaultTCUCAP1_FETShortDetected "FaultTCUCAP1_FETShortDetected" UBYTE Bool_ON_OFF 1 2 0 1 BIT_MASK 0x04 ECU_ADDRESS 0x70009B02 /end MEASUREMENT
/begin MEASUREMENT FaultTCUCAP1_FETShortLogged "FaultTCUCAP1_FETShortLogged" UBYTE Bool_ON_OFF 1 2 0 1 BIT_MASK 0x04 ECU_ADDRESS 0x70009AA4 /end MEASUREMENT
/begin MEASUREMENT FaultTCUCAP1_HWOverCurAut "FaultTCUCAP1_HWOverCurAut" UBYTE Bool_ON_OFF 1 2 0 1 BIT_MASK 0x08 ECU_ADDRESS 0x70009A46 /end MEASUREMENT
/begin MEASUREMENT FaultTCUCAP1_HWOverCurDetected "FaultTCUCAP1_HWOverCurDetected" UBYTE Bool_ON_OFF 1 2 0 1 BIT_MASK 0x08 ECU_ADDRESS 0x70009B02 /end MEASUREMENT
/begin MEASUREMENT FaultTCUCAP1_HWOverCurLogged "FaultTCUCAP1_HWOverCurLogged" UBYTE Bool_ON_OFF 1 2 0 1 BIT_MASK 0x08 ECU_ADDRESS 0x70009AA4 /end MEASUREMENT
/begin MEASUREMENT FaultTCUCAP1_Logged "FaultTCUCAP1_Logged" UWORD I_1 1 2 0 65535 ECU_ADDRESS 0x70009AA4 /end MEASUREMENT
/begin MEASUREMENT FaultTCUCAP1_MotorPhaseDriveErrAut "FaultTCUCAP1_MotorPhaseDriveErrAut" UBYTE Bool_ON_OFF 1 2 0 1 BIT_MASK 0x10 ECU_ADDRESS 0x70009A46 /end MEASUREMENT
/begin MEASUREMENT FaultTCUCAP1_MotorPhaseDriveErrDetected "FaultTCUCAP1_MotorPhaseDriveErrDetected" UBYTE Bool_ON_OFF 1 2 0 1 BIT_MASK 0x10 ECU_ADDRESS 0x70009B02 /end MEASUREMENT
/begin MEASUREMENT FaultTCUCAP1_MotorPhaseDriveErrLogged "FaultTCUCAP1_MotorPhaseDriveErrLogged" UBYTE Bool_ON_OFF 1 2 0 1 BIT_MASK 0x10 ECU_ADDRESS 0x70009AA4 /end MEASUREMENT
/begin MEASUREMENT FaultTCUCAP1_MotorStallAut "FaultTCUCAP1_MotorStallAut" UBYTE Bool_ON_OFF 1 2 0 1 BIT_MASK 0x20 ECU_ADDRESS 0x70009A46 /end MEASUREMENT
/begin MEASUREMENT FaultTCUCAP1_MotorStallDetected "FaultTCUCAP1_MotorStallDetected" UBYTE Bool_ON_OFF 1 2 0 1 BIT_MASK 0x20 ECU_ADDRESS 0x70009B02 /end MEASUREMENT
/begin MEASUREMENT FaultTCUCAP1_MotorStallLogged "FaultTCUCAP1_MotorStallLogged" UBYTE Bool_ON_OFF 1 2 0 1 BIT_MASK 0x20 ECU_ADDRESS 0x70009AA4 /end MEASUREMENT
/begin MEASUREMENT FaultTCUCAP1_OverVoltageAut "FaultTCUCAP1_OverVoltageAut" UBYTE Bool_ON_OFF 1 2 0 1 BIT_MASK 0x40 ECU_ADDRESS 0x70009A46 /end MEASUREMENT
/begin MEASUREMENT FaultTCUCAP1_OverVoltageDetected "FaultTCUCAP1_OverVoltageDetected" UBYTE Bool_ON_OFF 1 2 0 1 BIT_MASK 0x40 ECU_ADDRESS 0x70009B02 /end MEASUREMENT
/begin MEASUREMENT FaultTCUCAP1_OverVoltageLogged "FaultTCUCAP1_OverVoltageLogged" UBYTE Bool_ON_OFF 1 2 0 1 BIT_MASK 0x40 ECU_ADDRESS 0x70009AA4 /end MEASUREMENT
/begin MEASUREMENT FaultTCUCAP1_PhaseDetectGNDAut "FaultTCUCAP1_PhaseDetectGNDAut" UBYTE Bool_ON_OFF 1 2 0 1 BIT_MASK 0x80 ECU_ADDRESS 0x70009A46 /end MEASUREMENT
/begin MEASUREMENT FaultTCUCAP1_PhaseDetectGNDDetected "FaultTCUCAP1_PhaseDetectGNDDetected" UBYTE Bool_ON_OFF 1 2 0 1 BIT_MASK 0x80 ECU_ADDRESS 0x70009B02 /end MEASUREMENT
/begin MEASUREMENT FaultTCUCAP1_PhaseDetectGNDLogged "FaultTCUCAP1_PhaseDetectGNDLogged" UBYTE Bool_ON_OFF 1 2 0 1 BIT_MASK 0x80 ECU_ADDRESS 0x70009AA4 /end MEASUREMENT
/begin MEASUREMENT FaultTCUCAP1_PhaseDetectVCCAut "FaultTCUCAP1_PhaseDetectVCCAut" UBYTE Bool_ON_OFF 1 2 0 1 BIT_MASK 0x01 ECU_ADDRESS 0x70009A47 /end MEASUREMENT
/begin MEASUREMENT FaultTCUCAP1_PhaseDetectVCCDetected "FaultTCUCAP1_PhaseDetectVCCDetected" UBYTE Bool_ON_OFF 1 2 0 1 BIT_MASK 0x01 ECU_ADDRESS 0x70009B03 /end MEASUREMENT
/begin MEASUREMENT FaultTCUCAP1_PhaseDetectVCCLogged "FaultTCUCAP1_PhaseDetectVCCLogged" UBYTE Bool_ON_OFF 1 2 0 1 BIT_MASK 0x01 ECU_ADDRESS 0x70009AA5 /end MEASUREMENT
/begin MEASUREMENT FaultTCUCAP1_SWOverCurAut "FaultTCUCAP1_SWOverCurAut" UBYTE Bool_ON_OFF 1 2 0 1 BIT_MASK 0x02 ECU_ADDRESS 0x70009A47 /end MEASUREMENT
/begin MEASUREMENT FaultTCUCAP1_SWOverCurDetected "FaultTCUCAP1_SWOverCurDetected" UBYTE Bool_ON_OFF 1 2 0 1 BIT_MASK 0x02 ECU_ADDRESS 0x70009B03 /end MEASUREMENT
/begin MEASUREMENT FaultTCUCAP1_SWOverCurLogged "FaultTCUCAP1_SWOverCurLogged" UBYTE Bool_ON_OFF 1 2 0 1 BIT_MASK 0x02 ECU_ADDRESS 0x70009AA5 /end MEASUREMENT
/begin MEASUREMENT FaultTCUCAP1_ThermalShutDownAut "FaultTCUCAP1_ThermalShutDownAut" UBYTE Bool_ON_OFF 1 2 0 1 BIT_MASK 0x04 ECU_ADDRESS 0x70009A47 /end MEASUREMENT
/begin MEASUREMENT FaultTCUCAP1_ThermalShutDownDetected "FaultTCUCAP1_ThermalShutDownDetected" UBYTE Bool_ON_OFF 1 2 0 1 BIT_MASK 0x04 ECU_ADDRESS 0x70009B03 /end MEASUREMENT
/begin MEASUREMENT FaultTCUCAP1_ThermalShutDownLogged "FaultTCUCAP1_ThermalShutDownLogged" UBYTE Bool_ON_OFF 1 2 0 1 BIT_MASK 0x04 ECU_ADDRESS 0x70009AA5 /end MEASUREMENT
/begin MEASUREMENT FaultTCUCAP1_ThermalWarningAut "FaultTCUCAP1_ThermalWarningAut" UBYTE Bool_ON_OFF 1 2 0 1 BIT_MASK 0x08 ECU_ADDRESS 0x70009A47 /end MEASUREMENT
/begin MEASUREMENT FaultTCUCAP1_ThermalWarningDetected "FaultTCUCAP1_ThermalWarningDetected" UBYTE Bool_ON_OFF 1 2 0 1 BIT_MASK 0x08 ECU_ADDRESS 0x70009B03 /end MEASUREMENT
/begin MEASUREMENT FaultTCUCAP1_ThermalWarningLogged "FaultTCUCAP1_ThermalWarningLogged" UBYTE Bool_ON_OFF 1 2 0 1 BIT_MASK 0x08 ECU_ADDRESS 0x70009AA5 /end MEASUREMENT
/begin MEASUREMENT FaultTCUCAP1_UnderVoltageAut "FaultTCUCAP1_UnderVoltageAut" UBYTE Bool_ON_OFF 1 2 0 1 BIT_MASK 0x10 ECU_ADDRESS 0x70009A47 /end MEASUREMENT
/begin MEASUREMENT FaultTCUCAP1_UnderVoltageDetected "FaultTCUCAP1_UnderVoltageDetected" UBYTE Bool_ON_OFF 1 2 0 1 BIT_MASK 0x10 ECU_ADDRESS 0x70009B03 /end MEASUREMENT
/begin MEASUREMENT FaultTCUCAP1_UnderVoltageLogged "FaultTCUCAP1_UnderVoltageLogged" UBYTE Bool_ON_OFF 1 2 0 1 BIT_MASK 0x10 ECU_ADDRESS 0x70009AA5 /end MEASUREMENT
/begin MEASUREMENT FaultTCUCCP_Detected "FaultTCUCCP_Detected" UWORD I_1 1 2 0 65535 ECU_ADDRESS 0x70009B04 /end MEASUREMENT
/begin MEASUREMENT FaultTCUCCP_Logged "FaultTCUCCP_Logged" UWORD I_1 1 2 0 65535 ECU_ADDRESS 0x70009AA6 /end MEASUREMENT
/begin MEASUREMENT FaultTCUCCP_OilMotorRationalAut "FaultTCUCCP_OilMotorRationalAut" UBYTE Bool_ON_OFF 1 2 0 1 BIT_MASK 0x01 ECU_ADDRESS 0x70009A48 /end MEASUREMENT
/begin MEASUREMENT FaultTCUCCP_OilMotorRationalDetected "FaultTCUCCP_OilMotorRationalDetected" UBYTE Bool_ON_OFF 1 2 0 1 BIT_MASK 0x01 ECU_ADDRESS 0x70009B04 /end MEASUREMENT
/begin MEASUREMENT FaultTCUCCP_OilMotorRationalLogged "FaultTCUCCP_OilMotorRationalLogged" UBYTE Bool_ON_OFF 1 2 0 1 BIT_MASK 0x01 ECU_ADDRESS 0x70009AA6 /end MEASUREMENT
/begin MEASUREMENT FaultTCUCCP_OilMotorStallAut "FaultTCUCCP_OilMotorStallAut" UBYTE Bool_ON_OFF 1 2 0 1 BIT_MASK 0x02 ECU_ADDRESS 0x70009A48 /end MEASUREMENT
/begin MEASUREMENT FaultTCUCCP_OilMotorStallDetected "FaultTCUCCP_OilMotorStallDetected" UBYTE Bool_ON_OFF 1 2 0 1 BIT_MASK 0x02 ECU_ADDRESS 0x70009B04 /end MEASUREMENT
/begin MEASUREMENT FaultTCUCCP_OilMotorStallLogged "FaultTCUCCP_OilMotorStallLogged" UBYTE Bool_ON_OFF 1 2 0 1 BIT_MASK 0x02 ECU_ADDRESS 0x70009AA6 /end MEASUREMENT
/begin MEASUREMENT FaultTCUCCP_OilSenRationalL1Aut "FaultTCUCCP_OilSenRationalL1Aut" UBYTE Bool_ON_OFF 1 2 0 1 BIT_MASK 0x04 ECU_ADDRESS 0x70009A48 /end MEASUREMENT
/begin MEASUREMENT FaultTCUCCP_OilSenRationalL1Detected "FaultTCUCCP_OilSenRationalL1Detected" UBYTE Bool_ON_OFF 1 2 0 1 BIT_MASK 0x04 ECU_ADDRESS 0x70009B04 /end MEASUREMENT
/begin MEASUREMENT FaultTCUCCP_OilSenRationalL1Logged "FaultTCUCCP_OilSenRationalL1Logged" UBYTE Bool_ON_OFF 1 2 0 1 BIT_MASK 0x04 ECU_ADDRESS 0x70009AA6 /end MEASUREMENT
/begin MEASUREMENT FaultTCUCCP_OilSenRationalL2Aut "FaultTCUCCP_OilSenRationalL2Aut" UBYTE Bool_ON_OFF 1 2 0 1 BIT_MASK 0x08 ECU_ADDRESS 0x70009A48 /end MEASUREMENT
/begin MEASUREMENT FaultTCUCCP_OilSenRationalL2Detected "FaultTCUCCP_OilSenRationalL2Detected" UBYTE Bool_ON_OFF 1 2 0 1 BIT_MASK 0x08 ECU_ADDRESS 0x70009B04 /end MEASUREMENT
/begin MEASUREMENT FaultTCUCCP_OilSenRationalL2Logged "FaultTCUCCP_OilSenRationalL2Logged" UBYTE Bool_ON_OFF 1 2 0 1 BIT_MASK 0x08 ECU_ADDRESS 0x70009AA6 /end MEASUREMENT
/begin MEASUREMENT FaultTCUCCP_OilTempRationalHAut "FaultTCUCCP_OilTempRationalHAut" UBYTE Bool_ON_OFF 1 2 0 1 BIT_MASK 0x10 ECU_ADDRESS 0x70009A48 /end MEASUREMENT
/begin MEASUREMENT FaultTCUCCP_OilTempRationalHDetected "FaultTCUCCP_OilTempRationalHDetected" UBYTE Bool_ON_OFF 1 2 0 1 BIT_MASK 0x10 ECU_ADDRESS 0x70009B04 /end MEASUREMENT
/begin MEASUREMENT FaultTCUCCP_OilTempRationalHLogged "FaultTCUCCP_OilTempRationalHLogged" UBYTE Bool_ON_OFF 1 2 0 1 BIT_MASK 0x10 ECU_ADDRESS 0x70009AA6 /end MEASUREMENT
/begin MEASUREMENT FaultTCUCCP_OilTempRationalLAut "FaultTCUCCP_OilTempRationalLAut" UBYTE Bool_ON_OFF 1 2 0 1 BIT_MASK 0x20 ECU_ADDRESS 0x70009A48 /end MEASUREMENT
/begin MEASUREMENT FaultTCUCCP_OilTempRationalLDetected "FaultTCUCCP_OilTempRationalLDetected" UBYTE Bool_ON_OFF 1 2 0 1 BIT_MASK 0x20 ECU_ADDRESS 0x70009B04 /end MEASUREMENT
/begin MEASUREMENT FaultTCUCCP_OilTempRationalLLogged "FaultTCUCCP_OilTempRationalLLogged" UBYTE Bool_ON_OFF 1 2 0 1 BIT_MASK 0x20 ECU_ADDRESS 0x70009AA6 /end MEASUREMENT
/begin MEASUREMENT FaultTableFuncTypeCounter1 "FaultTableFuncTypeCounter1" UBYTE I_1 1 2 0 255 MATRIX_DIM 133 1 1 ECU_ADDRESS 0x70009B28 /end MEASUREMENT
/begin MEASUREMENT FaultTableFuncTypeCounter1[0] "FaultTableFuncTypeCounter1[0]" UBYTE I_1 1 2 0 255 ECU_ADDRESS 0x70009B28 /end MEASUREMENT
/begin MEASUREMENT FaultTableFuncTypeCounter1[100] "FaultTableFuncTypeCounter1[100]" UBYTE I_1 1 2 0 255 ECU_ADDRESS 0x70009B8C /end MEASUREMENT
/begin MEASUREMENT FaultTableFuncTypeCounter1[101] "FaultTableFuncTypeCounter1[101]" UBYTE I_1 1 2 0 255 ECU_ADDRESS 0x70009B8D /end MEASUREMENT
/begin MEASUREMENT FaultTableFuncTypeCounter1[102] "FaultTableFuncTypeCounter1[102]" UBYTE I_1 1 2 0 255 ECU_ADDRESS 0x70009B8E /end MEASUREMENT
/begin MEASUREMENT FaultTableFuncTypeCounter1[103] "FaultTableFuncTypeCounter1[103]" UBYTE I_1 1 2 0 255 ECU_ADDRESS 0x70009B8F /end MEASUREMENT
/begin MEASUREMENT FaultTableFuncTypeCounter1[104] "FaultTableFuncTypeCounter1[104]" UBYTE I_1 1 2 0 255 ECU_ADDRESS 0x70009B90 /end MEASUREMENT
/begin MEASUREMENT FaultTableFuncTypeCounter1[105] "FaultTableFuncTypeCounter1[105]" UBYTE I_1 1 2 0 255 ECU_ADDRESS 0x70009B91 /end MEASUREMENT
/begin MEASUREMENT FaultTableFuncTypeCounter1[106] "FaultTableFuncTypeCounter1[106]" UBYTE I_1 1 2 0 255 ECU_ADDRESS 0x70009B92 /end MEASUREMENT
/begin MEASUREMENT FaultTableFuncTypeCounter1[107] "FaultTableFuncTypeCounter1[107]" UBYTE I_1 1 2 0 255 ECU_ADDRESS 0x70009B93 /end MEASUREMENT
/begin MEASUREMENT FaultTableFuncTypeCounter1[108] "FaultTableFuncTypeCounter1[108]" UBYTE I_1 1 2 0 255 ECU_ADDRESS 0x70009B94 /end MEASUREMENT
/begin MEASUREMENT FaultTableFuncTypeCounter1[109] "FaultTableFuncTypeCounter1[109]" UBYTE I_1 1 2 0 255 ECU_ADDRESS 0x70009B95 /end MEASUREMENT
/begin MEASUREMENT FaultTableFuncTypeCounter1[10] "FaultTableFuncTypeCounter1[10]" UBYTE I_1 1 2 0 255 ECU_ADDRESS 0x70009B32 /end MEASUREMENT
/begin MEASUREMENT FaultTableFuncTypeCounter1[110] "FaultTableFuncTypeCounter1[110]" UBYTE I_1 1 2 0 255 ECU_ADDRESS 0x70009B96 /end MEASUREMENT
/begin MEASUREMENT FaultTableFuncTypeCounter1[111] "FaultTableFuncTypeCounter1[111]" UBYTE I_1 1 2 0 255 ECU_ADDRESS 0x70009B97 /end MEASUREMENT
/begin MEASUREMENT FaultTableFuncTypeCounter1[112] "FaultTableFuncTypeCounter1[112]" UBYTE I_1 1 2 0 255 ECU_ADDRESS 0x70009B98 /end MEASUREMENT
/begin MEASUREMENT FaultTableFuncTypeCounter1[113] "FaultTableFuncTypeCounter1[113]" UBYTE I_1 1 2 0 255 ECU_ADDRESS 0x70009B99 /end MEASUREMENT
/begin MEASUREMENT FaultTableFuncTypeCounter1[114] "FaultTableFuncTypeCounter1[114]" UBYTE I_1 1 2 0 255 ECU_ADDRESS 0x70009B9A /end MEASUREMENT
/begin MEASUREMENT FaultTableFuncTypeCounter1[115] "FaultTableFuncTypeCounter1[115]" UBYTE I_1 1 2 0 255 ECU_ADDRESS 0x70009B9B /end MEASUREMENT
/begin MEASUREMENT FaultTableFuncTypeCounter1[116] "FaultTableFuncTypeCounter1[116]" UBYTE I_1 1 2 0 255 ECU_ADDRESS 0x70009B9C /end MEASUREMENT
/begin MEASUREMENT FaultTableFuncTypeCounter1[117] "FaultTableFuncTypeCounter1[117]" UBYTE I_1 1 2 0 255 ECU_ADDRESS 0x70009B9D /end MEASUREMENT
/begin MEASUREMENT FaultTableFuncTypeCounter1[118] "FaultTableFuncTypeCounter1[118]" UBYTE I_1 1 2 0 255 ECU_ADDRESS 0x70009B9E /end MEASUREMENT
/begin MEASUREMENT FaultTableFuncTypeCounter1[119] "FaultTableFuncTypeCounter1[119]" UBYTE I_1 1 2 0 255 ECU_ADDRESS 0x70009B9F /end MEASUREMENT
/begin MEASUREMENT FaultTableFuncTypeCounter1[11] "FaultTableFuncTypeCounter1[11]" UBYTE I_1 1 2 0 255 ECU_ADDRESS 0x70009B33 /end MEASUREMENT
/begin MEASUREMENT FaultTableFuncTypeCounter1[120] "FaultTableFuncTypeCounter1[120]" UBYTE I_1 1 2 0 255 ECU_ADDRESS 0x70009BA0 /end MEASUREMENT
/begin MEASUREMENT FaultTableFuncTypeCounter1[121] "FaultTableFuncTypeCounter1[121]" UBYTE I_1 1 2 0 255 ECU_ADDRESS 0x70009BA1 /end MEASUREMENT
/begin MEASUREMENT FaultTableFuncTypeCounter1[122] "FaultTableFuncTypeCounter1[122]" UBYTE I_1 1 2 0 255 ECU_ADDRESS 0x70009BA2 /end MEASUREMENT
/begin MEASUREMENT FaultTableFuncTypeCounter1[123] "FaultTableFuncTypeCounter1[123]" UBYTE I_1 1 2 0 255 ECU_ADDRESS 0x70009BA3 /end MEASUREMENT
/begin MEASUREMENT FaultTableFuncTypeCounter1[124] "FaultTableFuncTypeCounter1[124]" UBYTE I_1 1 2 0 255 ECU_ADDRESS 0x70009BA4 /end MEASUREMENT
/begin MEASUREMENT FaultTableFuncTypeCounter1[125] "FaultTableFuncTypeCounter1[125]" UBYTE I_1 1 2 0 255 ECU_ADDRESS 0x70009BA5 /end MEASUREMENT
/begin MEASUREMENT FaultTableFuncTypeCounter1[126] "FaultTableFuncTypeCounter1[126]" UBYTE I_1 1 2 0 255 ECU_ADDRESS 0x70009BA6 /end MEASUREMENT
/begin MEASUREMENT FaultTableFuncTypeCounter1[127] "FaultTableFuncTypeCounter1[127]" UBYTE I_1 1 2 0 255 ECU_ADDRESS 0x70009BA7 /end MEASUREMENT
/begin MEASUREMENT FaultTableFuncTypeCounter1[128] "FaultTableFuncTypeCounter1[128]" UBYTE I_1 1 2 0 255 ECU_ADDRESS 0x70009BA8 /end MEASUREMENT
/begin MEASUREMENT FaultTableFuncTypeCounter1[129] "FaultTableFuncTypeCounter1[129]" UBYTE I_1 1 2 0 255 ECU_ADDRESS 0x70009BA9 /end MEASUREMENT
/begin MEASUREMENT FaultTableFuncTypeCounter1[12] "FaultTableFuncTypeCounter1[12]" UBYTE I_1 1 2 0 255 ECU_ADDRESS 0x70009B34 /end MEASUREMENT
/begin MEASUREMENT FaultTableFuncTypeCounter1[130] "FaultTableFuncTypeCounter1[130]" UBYTE I_1 1 2 0 255 ECU_ADDRESS 0x70009BAA /end MEASUREMENT
/begin MEASUREMENT FaultTableFuncTypeCounter1[131] "FaultTableFuncTypeCounter1[131]" UBYTE I_1 1 2 0 255 ECU_ADDRESS 0x70009BAB /end MEASUREMENT
/begin MEASUREMENT FaultTableFuncTypeCounter1[132] "FaultTableFuncTypeCounter1[132]" UBYTE I_1 1 2 0 255 ECU_ADDRESS 0x70009BAC /end MEASUREMENT
/begin MEASUREMENT FaultTableFuncTypeCounter1[13] "FaultTableFuncTypeCounter1[13]" UBYTE I_1 1 2 0 255 ECU_ADDRESS 0x70009B35 /end MEASUREMENT
/begin MEASUREMENT FaultTableFuncTypeCounter1[14] "FaultTableFuncTypeCounter1[14]" UBYTE I_1 1 2 0 255 ECU_ADDRESS 0x70009B36 /end MEASUREMENT
/begin MEASUREMENT FaultTableFuncTypeCounter1[15] "FaultTableFuncTypeCounter1[15]" UBYTE I_1 1 2 0 255 ECU_ADDRESS 0x70009B37 /end MEASUREMENT
/begin MEASUREMENT FaultTableFuncTypeCounter1[16] "FaultTableFuncTypeCounter1[16]" UBYTE I_1 1 2 0 255 ECU_ADDRESS 0x70009B38 /end MEASUREMENT
/begin MEASUREMENT FaultTableFuncTypeCounter1[17] "FaultTableFuncTypeCounter1[17]" UBYTE I_1 1 2 0 255 ECU_ADDRESS 0x70009B39 /end MEASUREMENT
/begin MEASUREMENT FaultTableFuncTypeCounter1[18] "FaultTableFuncTypeCounter1[18]" UBYTE I_1 1 2 0 255 ECU_ADDRESS 0x70009B3A /end MEASUREMENT
/begin MEASUREMENT FaultTableFuncTypeCounter1[19] "FaultTableFuncTypeCounter1[19]" UBYTE I_1 1 2 0 255 ECU_ADDRESS 0x70009B3B /end MEASUREMENT
/begin MEASUREMENT FaultTableFuncTypeCounter1[1] "FaultTableFuncTypeCounter1[1]" UBYTE I_1 1 2 0 255 ECU_ADDRESS 0x70009B29 /end MEASUREMENT
/begin MEASUREMENT FaultTableFuncTypeCounter1[20] "FaultTableFuncTypeCounter1[20]" UBYTE I_1 1 2 0 255 ECU_ADDRESS 0x70009B3C /end MEASUREMENT
/begin MEASUREMENT FaultTableFuncTypeCounter1[21] "FaultTableFuncTypeCounter1[21]" UBYTE I_1 1 2 0 255 ECU_ADDRESS 0x70009B3D /end MEASUREMENT
/begin MEASUREMENT FaultTableFuncTypeCounter1[22] "FaultTableFuncTypeCounter1[22]" UBYTE I_1 1 2 0 255 ECU_ADDRESS 0x70009B3E /end MEASUREMENT
/begin MEASUREMENT FaultTableFuncTypeCounter1[23] "FaultTableFuncTypeCounter1[23]" UBYTE I_1 1 2 0 255 ECU_ADDRESS 0x70009B3F /end MEASUREMENT
/begin MEASUREMENT FaultTableFuncTypeCounter1[24] "FaultTableFuncTypeCounter1[24]" UBYTE I_1 1 2 0 255 ECU_ADDRESS 0x70009B40 /end MEASUREMENT
/begin MEASUREMENT FaultTableFuncTypeCounter1[25] "FaultTableFuncTypeCounter1[25]" UBYTE I_1 1 2 0 255 ECU_ADDRESS 0x70009B41 /end MEASUREMENT
/begin MEASUREMENT FaultTableFuncTypeCounter1[26] "FaultTableFuncTypeCounter1[26]" UBYTE I_1 1 2 0 255 ECU_ADDRESS 0x70009B42 /end MEASUREMENT
/begin MEASUREMENT FaultTableFuncTypeCounter1[27] "FaultTableFuncTypeCounter1[27]" UBYTE I_1 1 2 0 255 ECU_ADDRESS 0x70009B43 /end MEASUREMENT
/begin MEASUREMENT FaultTableFuncTypeCounter1[28] "FaultTableFuncTypeCounter1[28]" UBYTE I_1 1 2 0 255 ECU_ADDRESS 0x70009B44 /end MEASUREMENT
/begin MEASUREMENT FaultTableFuncTypeCounter1[29] "FaultTableFuncTypeCounter1[29]" UBYTE I_1 1 2 0 255 ECU_ADDRESS 0x70009B45 /end MEASUREMENT
/begin MEASUREMENT FaultTableFuncTypeCounter1[2] "FaultTableFuncTypeCounter1[2]" UBYTE I_1 1 2 0 255 ECU_ADDRESS 0x70009B2A /end MEASUREMENT
/begin MEASUREMENT FaultTableFuncTypeCounter1[30] "FaultTableFuncTypeCounter1[30]" UBYTE I_1 1 2 0 255 ECU_ADDRESS 0x70009B46 /end MEASUREMENT
/begin MEASUREMENT FaultTableFuncTypeCounter1[31] "FaultTableFuncTypeCounter1[31]" UBYTE I_1 1 2 0 255 ECU_ADDRESS 0x70009B47 /end MEASUREMENT
/begin MEASUREMENT FaultTableFuncTypeCounter1[32] "FaultTableFuncTypeCounter1[32]" UBYTE I_1 1 2 0 255 ECU_ADDRESS 0x70009B48 /end MEASUREMENT
/begin MEASUREMENT FaultTableFuncTypeCounter1[33] "FaultTableFuncTypeCounter1[33]" UBYTE I_1 1 2 0 255 ECU_ADDRESS 0x70009B49 /end MEASUREMENT
/begin MEASUREMENT FaultTableFuncTypeCounter1[34] "FaultTableFuncTypeCounter1[34]" UBYTE I_1 1 2 0 255 ECU_ADDRESS 0x70009B4A /end MEASUREMENT
/begin MEASUREMENT FaultTableFuncTypeCounter1[35] "FaultTableFuncTypeCounter1[35]" UBYTE I_1 1 2 0 255 ECU_ADDRESS 0x70009B4B /end MEASUREMENT
/begin MEASUREMENT FaultTableFuncTypeCounter1[36] "FaultTableFuncTypeCounter1[36]" UBYTE I_1 1 2 0 255 ECU_ADDRESS 0x70009B4C /end MEASUREMENT
/begin MEASUREMENT FaultTableFuncTypeCounter1[37] "FaultTableFuncTypeCounter1[37]" UBYTE I_1 1 2 0 255 ECU_ADDRESS 0x70009B4D /end MEASUREMENT
/begin MEASUREMENT FaultTableFuncTypeCounter1[38] "FaultTableFuncTypeCounter1[38]" UBYTE I_1 1 2 0 255 ECU_ADDRESS 0x70009B4E /end MEASUREMENT
/begin MEASUREMENT FaultTableFuncTypeCounter1[39] "FaultTableFuncTypeCounter1[39]" UBYTE I_1 1 2 0 255 ECU_ADDRESS 0x70009B4F /end MEASUREMENT
/begin MEASUREMENT FaultTableFuncTypeCounter1[3] "FaultTableFuncTypeCounter1[3]" UBYTE I_1 1 2 0 255 ECU_ADDRESS 0x70009B2B /end MEASUREMENT
/begin MEASUREMENT FaultTableFuncTypeCounter1[40] "FaultTableFuncTypeCounter1[40]" UBYTE I_1 1 2 0 255 ECU_ADDRESS 0x70009B50 /end MEASUREMENT
/begin MEASUREMENT FaultTableFuncTypeCounter1[41] "FaultTableFuncTypeCounter1[41]" UBYTE I_1 1 2 0 255 ECU_ADDRESS 0x70009B51 /end MEASUREMENT
/begin MEASUREMENT FaultTableFuncTypeCounter1[42] "FaultTableFuncTypeCounter1[42]" UBYTE I_1 1 2 0 255 ECU_ADDRESS 0x70009B52 /end MEASUREMENT
/begin MEASUREMENT FaultTableFuncTypeCounter1[43] "FaultTableFuncTypeCounter1[43]" UBYTE I_1 1 2 0 255 ECU_ADDRESS 0x70009B53 /end MEASUREMENT
/begin MEASUREMENT FaultTableFuncTypeCounter1[44] "FaultTableFuncTypeCounter1[44]" UBYTE I_1 1 2 0 255 ECU_ADDRESS 0x70009B54 /end MEASUREMENT
/begin MEASUREMENT FaultTableFuncTypeCounter1[45] "FaultTableFuncTypeCounter1[45]" UBYTE I_1 1 2 0 255 ECU_ADDRESS 0x70009B55 /end MEASUREMENT
/begin MEASUREMENT FaultTableFuncTypeCounter1[46] "FaultTableFuncTypeCounter1[46]" UBYTE I_1 1 2 0 255 ECU_ADDRESS 0x70009B56 /end MEASUREMENT
/begin MEASUREMENT FaultTableFuncTypeCounter1[47] "FaultTableFuncTypeCounter1[47]" UBYTE I_1 1 2 0 255 ECU_ADDRESS 0x70009B57 /end MEASUREMENT
/begin MEASUREMENT FaultTableFuncTypeCounter1[48] "FaultTableFuncTypeCounter1[48]" UBYTE I_1 1 2 0 255 ECU_ADDRESS 0x70009B58 /end MEASUREMENT
/begin MEASUREMENT FaultTableFuncTypeCounter1[49] "FaultTableFuncTypeCounter1[49]" UBYTE I_1 1 2 0 255 ECU_ADDRESS 0x70009B59 /end MEASUREMENT
/begin MEASUREMENT FaultTableFuncTypeCounter1[4] "FaultTableFuncTypeCounter1[4]" UBYTE I_1 1 2 0 255 ECU_ADDRESS 0x70009B2C /end MEASUREMENT
/begin MEASUREMENT FaultTableFuncTypeCounter1[50] "FaultTableFuncTypeCounter1[50]" UBYTE I_1 1 2 0 255 ECU_ADDRESS 0x70009B5A /end MEASUREMENT
/begin MEASUREMENT FaultTableFuncTypeCounter1[51] "FaultTableFuncTypeCounter1[51]" UBYTE I_1 1 2 0 255 ECU_ADDRESS 0x70009B5B /end MEASUREMENT
/begin MEASUREMENT FaultTableFuncTypeCounter1[52] "FaultTableFuncTypeCounter1[52]" UBYTE I_1 1 2 0 255 ECU_ADDRESS 0x70009B5C /end MEASUREMENT
/begin MEASUREMENT FaultTableFuncTypeCounter1[53] "FaultTableFuncTypeCounter1[53]" UBYTE I_1 1 2 0 255 ECU_ADDRESS 0x70009B5D /end MEASUREMENT
/begin MEASUREMENT FaultTableFuncTypeCounter1[54] "FaultTableFuncTypeCounter1[54]" UBYTE I_1 1 2 0 255 ECU_ADDRESS 0x70009B5E /end MEASUREMENT
/begin MEASUREMENT FaultTableFuncTypeCounter1[55] "FaultTableFuncTypeCounter1[55]" UBYTE I_1 1 2 0 255 ECU_ADDRESS 0x70009B5F /end MEASUREMENT
/begin MEASUREMENT FaultTableFuncTypeCounter1[56] "FaultTableFuncTypeCounter1[56]" UBYTE I_1 1 2 0 255 ECU_ADDRESS 0x70009B60 /end MEASUREMENT
/begin MEASUREMENT FaultTableFuncTypeCounter1[57] "FaultTableFuncTypeCounter1[57]" UBYTE I_1 1 2 0 255 ECU_ADDRESS 0x70009B61 /end MEASUREMENT
/begin MEASUREMENT FaultTableFuncTypeCounter1[58] "FaultTableFuncTypeCounter1[58]" UBYTE I_1 1 2 0 255 ECU_ADDRESS 0x70009B62 /end MEASUREMENT
/begin MEASUREMENT FaultTableFuncTypeCounter1[59] "FaultTableFuncTypeCounter1[59]" UBYTE I_1 1 2 0 255 ECU_ADDRESS 0x70009B63 /end MEASUREMENT
/begin MEASUREMENT FaultTableFuncTypeCounter1[5] "FaultTableFuncTypeCounter1[5]" UBYTE I_1 1 2 0 255 ECU_ADDRESS 0x70009B2D /end MEASUREMENT
/begin MEASUREMENT FaultTableFuncTypeCounter1[60] "FaultTableFuncTypeCounter1[60]" UBYTE I_1 1 2 0 255 ECU_ADDRESS 0x70009B64 /end MEASUREMENT
/begin MEASUREMENT FaultTableFuncTypeCounter1[61] "FaultTableFuncTypeCounter1[61]" UBYTE I_1 1 2 0 255 ECU_ADDRESS 0x70009B65 /end MEASUREMENT
/begin MEASUREMENT FaultTableFuncTypeCounter1[62] "FaultTableFuncTypeCounter1[62]" UBYTE I_1 1 2 0 255 ECU_ADDRESS 0x70009B66 /end MEASUREMENT
/begin MEASUREMENT FaultTableFuncTypeCounter1[63] "FaultTableFuncTypeCounter1[63]" UBYTE I_1 1 2 0 255 ECU_ADDRESS 0x70009B67 /end MEASUREMENT
/begin MEASUREMENT FaultTableFuncTypeCounter1[64] "FaultTableFuncTypeCounter1[64]" UBYTE I_1 1 2 0 255 ECU_ADDRESS 0x70009B68 /end MEASUREMENT
/begin MEASUREMENT FaultTableFuncTypeCounter1[65] "FaultTableFuncTypeCounter1[65]" UBYTE I_1 1 2 0 255 ECU_ADDRESS 0x70009B69 /end MEASUREMENT
/begin MEASUREMENT FaultTableFuncTypeCounter1[66] "FaultTableFuncTypeCounter1[66]" UBYTE I_1 1 2 0 255 ECU_ADDRESS 0x70009B6A /end MEASUREMENT
/begin MEASUREMENT FaultTableFuncTypeCounter1[67] "FaultTableFuncTypeCounter1[67]" UBYTE I_1 1 2 0 255 ECU_ADDRESS 0x70009B6B /end MEASUREMENT
/begin MEASUREMENT FaultTableFuncTypeCounter1[68] "FaultTableFuncTypeCounter1[68]" UBYTE I_1 1 2 0 255 ECU_ADDRESS 0x70009B6C /end MEASUREMENT
/begin MEASUREMENT FaultTableFuncTypeCounter1[69] "FaultTableFuncTypeCounter1[69]" UBYTE I_1 1 2 0 255 ECU_ADDRESS 0x70009B6D /end MEASUREMENT
/begin MEASUREMENT FaultTableFuncTypeCounter1[6] "FaultTableFuncTypeCounter1[6]" UBYTE I_1 1 2 0 255 ECU_ADDRESS 0x70009B2E /end MEASUREMENT
/begin MEASUREMENT FaultTableFuncTypeCounter1[70] "FaultTableFuncTypeCounter1[70]" UBYTE I_1 1 2 0 255 ECU_ADDRESS 0x70009B6E /end MEASUREMENT
/begin MEASUREMENT FaultTableFuncTypeCounter1[71] "FaultTableFuncTypeCounter1[71]" UBYTE I_1 1 2 0 255 ECU_ADDRESS 0x70009B6F /end MEASUREMENT
/begin MEASUREMENT FaultTableFuncTypeCounter1[72] "FaultTableFuncTypeCounter1[72]" UBYTE I_1 1 2 0 255 ECU_ADDRESS 0x70009B70 /end MEASUREMENT
/begin MEASUREMENT FaultTableFuncTypeCounter1[73] "FaultTableFuncTypeCounter1[73]" UBYTE I_1 1 2 0 255 ECU_ADDRESS 0x70009B71 /end MEASUREMENT
/begin MEASUREMENT FaultTableFuncTypeCounter1[74] "FaultTableFuncTypeCounter1[74]" UBYTE I_1 1 2 0 255 ECU_ADDRESS 0x70009B72 /end MEASUREMENT
/begin MEASUREMENT FaultTableFuncTypeCounter1[75] "FaultTableFuncTypeCounter1[75]" UBYTE I_1 1 2 0 255 ECU_ADDRESS 0x70009B73 /end MEASUREMENT
/begin MEASUREMENT FaultTableFuncTypeCounter1[76] "FaultTableFuncTypeCounter1[76]" UBYTE I_1 1 2 0 255 ECU_ADDRESS 0x70009B74 /end MEASUREMENT
/begin MEASUREMENT FaultTableFuncTypeCounter1[77] "FaultTableFuncTypeCounter1[77]" UBYTE I_1 1 2 0 255 ECU_ADDRESS 0x70009B75 /end MEASUREMENT
/begin MEASUREMENT FaultTableFuncTypeCounter1[78] "FaultTableFuncTypeCounter1[78]" UBYTE I_1 1 2 0 255 ECU_ADDRESS 0x70009B76 /end MEASUREMENT
/begin MEASUREMENT FaultTableFuncTypeCounter1[79] "FaultTableFuncTypeCounter1[79]" UBYTE I_1 1 2 0 255 ECU_ADDRESS 0x70009B77 /end MEASUREMENT
/begin MEASUREMENT FaultTableFuncTypeCounter1[7] "FaultTableFuncTypeCounter1[7]" UBYTE I_1 1 2 0 255 ECU_ADDRESS 0x70009B2F /end MEASUREMENT
/begin MEASUREMENT FaultTableFuncTypeCounter1[80] "FaultTableFuncTypeCounter1[80]" UBYTE I_1 1 2 0 255 ECU_ADDRESS 0x70009B78 /end MEASUREMENT
/begin MEASUREMENT FaultTableFuncTypeCounter1[81] "FaultTableFuncTypeCounter1[81]" UBYTE I_1 1 2 0 255 ECU_ADDRESS 0x70009B79 /end MEASUREMENT
/begin MEASUREMENT FaultTableFuncTypeCounter1[82] "FaultTableFuncTypeCounter1[82]" UBYTE I_1 1 2 0 255 ECU_ADDRESS 0x70009B7A /end MEASUREMENT
/begin MEASUREMENT FaultTableFuncTypeCounter1[83] "FaultTableFuncTypeCounter1[83]" UBYTE I_1 1 2 0 255 ECU_ADDRESS 0x70009B7B /end MEASUREMENT
/begin MEASUREMENT FaultTableFuncTypeCounter1[84] "FaultTableFuncTypeCounter1[84]" UBYTE I_1 1 2 0 255 ECU_ADDRESS 0x70009B7C /end MEASUREMENT
/begin MEASUREMENT FaultTableFuncTypeCounter1[85] "FaultTableFuncTypeCounter1[85]" UBYTE I_1 1 2 0 255 ECU_ADDRESS 0x70009B7D /end MEASUREMENT
/begin MEASUREMENT FaultTableFuncTypeCounter1[86] "FaultTableFuncTypeCounter1[86]" UBYTE I_1 1 2 0 255 ECU_ADDRESS 0x70009B7E /end MEASUREMENT
/begin MEASUREMENT FaultTableFuncTypeCounter1[87] "FaultTableFuncTypeCounter1[87]" UBYTE I_1 1 2 0 255 ECU_ADDRESS 0x70009B7F /end MEASUREMENT
/begin MEASUREMENT FaultTableFuncTypeCounter1[88] "FaultTableFuncTypeCounter1[88]" UBYTE I_1 1 2 0 255 ECU_ADDRESS 0x70009B80 /end MEASUREMENT
/begin MEASUREMENT FaultTableFuncTypeCounter1[89] "FaultTableFuncTypeCounter1[89]" UBYTE I_1 1 2 0 255 ECU_ADDRESS 0x70009B81 /end MEASUREMENT
/begin MEASUREMENT FaultTableFuncTypeCounter1[8] "FaultTableFuncTypeCounter1[8]" UBYTE I_1 1 2 0 255 ECU_ADDRESS 0x70009B30 /end MEASUREMENT
/begin MEASUREMENT FaultTableFuncTypeCounter1[90] "FaultTableFuncTypeCounter1[90]" UBYTE I_1 1 2 0 255 ECU_ADDRESS 0x70009B82 /end MEASUREMENT
/begin MEASUREMENT FaultTableFuncTypeCounter1[91] "FaultTableFuncTypeCounter1[91]" UBYTE I_1 1 2 0 255 ECU_ADDRESS 0x70009B83 /end MEASUREMENT
/begin MEASUREMENT FaultTableFuncTypeCounter1[92] "FaultTableFuncTypeCounter1[92]" UBYTE I_1 1 2 0 255 ECU_ADDRESS 0x70009B84 /end MEASUREMENT
/begin MEASUREMENT FaultTableFuncTypeCounter1[93] "FaultTableFuncTypeCounter1[93]" UBYTE I_1 1 2 0 255 ECU_ADDRESS 0x70009B85 /end MEASUREMENT
/begin MEASUREMENT FaultTableFuncTypeCounter1[94] "FaultTableFuncTypeCounter1[94]" UBYTE I_1 1 2 0 255 ECU_ADDRESS 0x70009B86 /end MEASUREMENT
/begin MEASUREMENT FaultTableFuncTypeCounter1[95] "FaultTableFuncTypeCounter1[95]" UBYTE I_1 1 2 0 255 ECU_ADDRESS 0x70009B87 /end MEASUREMENT
/begin MEASUREMENT FaultTableFuncTypeCounter1[96] "FaultTableFuncTypeCounter1[96]" UBYTE I_1 1 2 0 255 ECU_ADDRESS 0x70009B88 /end MEASUREMENT
/begin MEASUREMENT FaultTableFuncTypeCounter1[97] "FaultTableFuncTypeCounter1[97]" UBYTE I_1 1 2 0 255 ECU_ADDRESS 0x70009B89 /end MEASUREMENT
/begin MEASUREMENT FaultTableFuncTypeCounter1[98] "FaultTableFuncTypeCounter1[98]" UBYTE I_1 1 2 0 255 ECU_ADDRESS 0x70009B8A /end MEASUREMENT
/begin MEASUREMENT FaultTableFuncTypeCounter1[99] "FaultTableFuncTypeCounter1[99]" UBYTE I_1 1 2 0 255 ECU_ADDRESS 0x70009B8B /end MEASUREMENT
/begin MEASUREMENT FaultTableFuncTypeCounter1[9] "FaultTableFuncTypeCounter1[9]" UBYTE I_1 1 2 0 255 ECU_ADDRESS 0x70009B31 /end MEASUREMENT
/begin MEASUREMENT GBSW_bOCDataNotRation "..." UBYTE Bool_ON_OFF 1 2 0 1 BIT_MASK 0x01 ECU_ADDRESS 0x7000571E /end MEASUREMENT
/begin MEASUREMENT GBSW_u32VSICounterCkreq "..." ULONG I_1 1 2 0 4294967295 ECU_ADDRESS 0x700056F8 /end MEASUREMENT
/begin MEASUREMENT Presence_devaid "Presence_devaid" UWORD I_1 1 2 0 65535 ECU_ADDRESS 0x7000566A /end MEASUREMENT
/begin COMPU_METHOD I_1 "" RAT_FUNC "%9.2" "-" COEFFS 0 1 0 0 0 1 /end COMPU_METHOD
/begin COMPU_METHOD I_3 "" RAT_FUNC "%9.2" "V" COEFFS 0 1 0 0 0 1 /end COMPU_METHOD
/begin COMPU_METHOD F_1_p0_5 "" RAT_FUNC "%9.2" "-" COEFFS 0 1 0 0 0 1 /end COMPU_METHOD
/begin COMPU_METHOD F_0v01_p0_16 "" RAT_FUNC "%9.2" "ï¿½s" COEFFS 0 1 0 0 0 0.01 /end COMPU_METHOD
/begin COMPU_METHOD F_0v001_p0_21 "" RAT_FUNC "%9.3" "s" COEFFS 0 1 0 0 0 0.001 /end COMPU_METHOD
/begin COMPU_METHOD F_0v0012210012_p0_22 "" RAT_FUNC "%9.3" "V" COEFFS 0 1 0 0 0 0.001221 /end COMPU_METHOD
/begin COMPU_METHOD F_4_p0_23 "" RAT_FUNC "%9.2" "Bytes" COEFFS 0 1 0 0 0 4 /end COMPU_METHOD
/begin COMPU_METHOD I_25 "" RAT_FUNC "%9.2" "uint8" COEFFS 0 1 0 0 0 1 /end COMPU_METHOD
/begin COMPU_METHOD F_5_p0_26 "" RAT_FUNC "%9.2" "ms" COEFFS 0 1 0 0 0 5 /end COMPU_METHOD
/begin COMPU_METHOD F_10_p0_27 "" RAT_FUNC "%9.2" "ms" COEFFS 0 1 0 0 0 10 /end COMPU_METHOD
/begin COMPU_METHOD F_0v0128205128_p0_28 "" RAT_FUNC "%9.2" "V" COEFFS 0 1 0 0 0 0.0128205 /end COMPU_METHOD
/begin COMPU_METHOD Id_0x00 "" RAT_FUNC "%9.2" "." COEFFS 0 1 0 0 0 1 /end COMPU_METHOD
/begin COMPU_METHOD Bool_ON_OFF "" TAB_VERB "%8.4" "." COMPU_TAB_REF Bool_ON_OFF_table /end COMPU_METHOD
/begin COMPU_VTAB Bool_ON_OFF_table "" TAB_VERB 2 0 "OFF" 1 "ON" /end COMPU_VTAB
/begin FUNCTION BSW ""
 /begin DEF_CHARACTERISTIC BSW_bIntLockDetEnaC BSW_bOBDEnaC BSW_bSPYBenchOnC BSW_ku16VSIRdyChkTimoutC /end DEF_CHARACTERISTIC
 /begin OUT_MEASUREMENT BSW_bAppMsgTxEna BSW_bCAN0BusOff BSW_bCAN1BusOff BSW_bCbkRxTOutFlag_SGBCM_pepsReq BSW_bCbkRxTOutFlag_SGRx10Req BSW_bCbkRxTOutFlag_SGRx11Req BSW_bCbkRxTOutFlag_SGRx12Req BSW_bCbkRxTOutFlag_SGRx13Req BSW_bCbkRxTOutFlag_SGRx14Req BSW_bCbkRxTOutFlag_SGRx15Req BSW_bCbkRxTOutFlag_SGRx16Req BSW_bCbkRxTOutFlag_SGRx17Req BSW_bCbkRxTOutFlag_SGRx18Req BSW_bCbkRxTOutFlag_SGRx19Req BSW_bCbkRxTOutFlag_SGRx1Req BSW_bCbkRxTOutFlag_SGRx20Req BSW_bCbkRxTOutFlag_SGRx21Req BSW_bCbkRxTOutFlag_SGRx22Req BSW_bCbkRxTOutFlag_SGRx23Req BSW_bCbkRxTOutFlag_SGRx24Req BSW_bCbkRxTOutFlag_SGRx25Req BSW_bCbkRxTOutFlag_SGRx26Req BSW_bCbkRxTOutFlag_SGRx2Req BSW_bCbkRxTOutFlag_SGRx3Req BSW_bCbkRxTOutFlag_SGRx4Req BSW_bCbkRxTOutFlag_SGRx5Req BSW_bCbkRxTOutFlag_SGRx6Req BSW_bCbkRxTOutFlag_SGRx7Req BSW_bCbkRxTOutFlag_SGRx8Req BSW_bCbkRxTOutFlag_SGRx9Req BSW_bCsumErrFlag_SGRx1Req BSW_bCsumErrFlag_SGRx2Req BSW_bCsumErrFlag_SGRx3Req BSW_bCsumErrFlag_SGRx5Req BSW_bEnableCalcWriteNvMMaxTime BSW_bIntLockDetEna BSW_bIntLockOccurFlg BSW_bMKeyOnStatus BSW_bMSGTrigTxFlag_Mcu7Req BSW_bNvmWrTrig BSW_bOCDataNotRation BSW_bRcErrFlag_SGRx1Req BSW_bRcErrFlag_SGRx2Req BSW_bRcErrFlag_SGRx3Req BSW_bRcErrFlag_SGRx5Req BSW_bStackOverflowWarning BSW_bUdsFunctionReqFlg BSW_bVsiReadySts BSW_u16CurWriteNvMTime BSW_u16IntLockDelayTim BSW_u16NvmStoreDelay BSW_u16NvMWriteCmd BSW_u16RawVolMonCurOcpH BSW_u16RawVolMonCurOcpL BSW_u16RawVolMonDcOvpSele BSW_u16RawVolP16VMulti BSW_u16RawVolP5VHS BSW_u16RawVolP5VHsREF BSW_u16RawVolP5VLS BSW_u16RawVolP5VLsREF BSW_u16RawVolP5VREF BSW_u16RawVolt15VRdc BSW_u16RawVoltDclinkFIL BSW_u16SelfChkDelay BSW_u16Var1 BSW_u16VsiReadyDelay BSW_u16WriteNvMMaxTime BSW_u32CbkRxAckCntSGPepsMsgSts BSW_u32CbkRxAckCntSGRx2Msg_Count BSW_u32FeeNextFreePageAddr BSW_u32RcvUdsCanId BSW_u32StackUsed BSW_u32VSICounterCkreq BSW_u32VSICounterSafeCkreq BSW_u32VSICounterTimeoutCs BSW_u32VSICounterTimeoutFrame BSW_u32VSICounterTimeoutSafeTCalc BSW_u32VSICounterTimeoutSyncPos BSW_u32VSICounterTimeoutTCalc BSW_u32VSISafeTimeDuration BSW_u32VSISafeTimeDurationMax BSW_u32VSISafeTimeDurationMin BSW_u32VSITimeDuration BSW_u32VSITimeDurationMax BSW_u32VSITimeDurationMin BSW_u8CAN0BusOffCounter BSW_u8CAN1BusOffCounter BSW_u8FeeCurSector BSW_u8FeeSectorChangeCnt BSW_u8IntLockErrCnt BSW_u8McuMotTrqRollCnt BSW_u8McuStsRollCnt BSW_u8NvmMngStt BSW_u8NvMReturnResult BSW_u8Rx1CsumErrCnt BSW_u8Rx1RcErrCnt BSW_u8Rx1RcLast BSW_u8Rx1RcUnchangedErrCnt BSW_u8Rx2CsumErrCnt BSW_u8Rx2RcErrCnt BSW_u8Rx2RcLast BSW_u8Rx2RcUnchangedErrCnt BSW_u8Rx3CsumErrCnt BSW_u8Rx3RcErrCnt BSW_u8Rx3RcLast BSW_u8Rx3RcUnchangedErrCnt BSW_u8Rx5CsumErrCnt BSW_u8Rx5RcErrCnt BSW_u8Rx5RcLast BSW_u8Rx5RcUnchangedErrCnt BSW_u8SelfChkErr GBSW_bOCDataNotRation GBSW_u32VSICounterCkreq Presence_devaid /end OUT_MEASUREMENT
/end FUNCTION
/begin FUNCTION CALUSR "" /begin DEF_CHARACTERISTIC CalUsr_ku32CalibUpdEnaMskA CalUsr_ku32CalibUpdEnaMskB /end DEF_CHARACTERISTIC
 /begin OUT_MEASUREMENT CalUsr_bIsCalibUpdEna CalUsr_u32ChkDataCrc CalUsr_u32POCalibDnEnaMskA CalUsr_u32POCalibDnEnaMskB CalUsr_u32PODataCRC /end OUT_MEASUREMENT
/end FUNCTION
/begin FUNCTION CCU6 ""
 /begin DEF_CHARACTERISTIC CCU6_bAlimFreqChgEnaC CCU6_bDualSmpEnaC CCU6_bHwOvcFltDetEnaC CCU6_bHwPinAscEnaC CCU6_f32DrvClkDutyThdHighC CCU6_f32DrvClkDutyThdLowC CCU6_kbDrvBdClkEnaC CCU6_kf32MidPointDutyHC CCU6_kf32MidPointDutyLC CCU6_ku16AlimDutyCycRawC CCU6_ku32AlimFreqRawC CCU6_ku8AscRecoverCntMaxC CCU6_ku8PwmMidPointFaultC /end DEF_CHARACTERISTIC
 /begin OUT_MEASUREMENT CCU6_au32PWMOnTime CCU6_au32PWMOnTime[0] CCU6_au32PWMOnTime[1] CCU6_au32PWMOnTime[2] CCU6_bAkdAfterAscReq CCU6_bClrTrapReq CCU6_bHwFaultDcOvVolt CCU6_bHwFaultIgbtH CCU6_bHwFaultIgbtL CCU6_bHwFaultOvcU CCU6_bHwFaultOvcV CCU6_bHwFaultOvcW CCU6_bIgbtHighSideShort CCU6_bIgbtLowSideShort CCU6_bIsCCU6Start CCU6_bIuvwCompReq CCU6_bMotorSpdRdy CCU6_bP5VDiagReinitCmd CCU6_bP5VHSFltFlg CCU6_bP5VLSFltFlg CCU6_bPwmMidPointU CCU6_bPwmMidPointV CCU6_bPwmMidPointW CCU6_bPwmOnGoingFlg CCU6_bT12ZeroMatchFlg CCU6_bTrapTrigger CCU6_f32DrvClkHsDuty CCU6_f32DrvClkLsDuty CCU6_f32HighVolPhys CCU6_f32PwmDutyPhysUZ CCU6_f32PwmDutyPhysVZ CCU6_f32PwmDutyPhysWZ CCU6_u16AlimPowerOnDelay CCU6_u16CCU6T13CmpVal CCU6_u16HighVolAdc CCU6_u16McuAscSttDelay CCU6_u16P5VHSAdc CCU6_u16PowerOnDelay CCU6_u16PwmMaxDutyCyc CCU6_u16PwmMidPointErrCnt CCU6_u16PwmMinDutyCyc CCU6_u16PwmModReq CCU6_u16T12CntVal CCU6_u16T12PeriodVal CCU6_u16T13PeriodVal CCU6_u32DrvClkHsDutyRaw CCU6_u32DrvClkHsPerdRaw CCU6_u32DrvClkLsDutyRaw CCU6_u32DrvClkLsPerdRaw CCU6_u32TrapCreq CCU6_u8AscRecoverCnt CCU6_u8McuAscSttStep CCU6_u8McuAscType CCU6_u8P5VHSFltCnt CCU6_u8P5VLSFltCnt CCU6_u8P5VPowerMngStt CCU6_u8P5VSelfTstTimCnt CCU6_u8PreTestStep CCU6_u8PwmState /end OUT_MEASUREMENT
/end FUNCTION
/begin FUNCTION COMMUSR ""
 /begin OUT_MEASUREMENT ASWNM_bBusSleep ASWNM_bStayAwake ASWNM_u16AfterRunDelayTimes ASWNM_u16Kl15Sts /end OUT_MEASUREMENT
/end FUNCTION
/begin FUNCTION DEVHAL "" /begin OUT_MEASUREMENT DEVHAL_u8CheckEngineState /end OUT_MEASUREMENT /end FUNCTION
/begin FUNCTION DSM "" /begin DEF_CHARACTERISTIC FaultEraseRequestC /end DEF_CHARACTERISTIC
 /begin OUT_MEASUREMENT DSM_DtcNumber DSM_DtcNumber[0] DSM_DtcNumber[1] DSM_DtcNumber[2] DSM_DtcNumber[3] DSM_DtcNumber[4] DSM_DtcNumber[5] DSM_DtcNumber[6] DSM_DtcNumber[7] DSM_DtcNumber[8] DSM_DtcNumber[9] DSM_DtcStatusNvm DSM_DtcStatusNvm[0] DSM_DtcStatusNvm[1] DSM_DtcStatusNvm[2] DSM_DtcStatusNvm[3] DSM_DtcStatusNvm[4] DSM_DtcStatusNvm[5] DSM_DtcStatusNvm[6] DSM_DtcStatusNvm[7] DSM_DtcStatusNvm[8] DSM_DtcStatusNvm[9] DSM_FaultFailureLevel DSM_FaultFailureLevel[0] DSM_FaultFailureLevel[1] FaultEraseRequest FaultFailureLevel /end OUT_MEASUREMENT
/end FUNCTION
/begin FUNCTION ESM "" /begin DEF_CHARACTERISTIC ESM_u16PowerLatchTempoC ESM_u8RestartDelayCntC /end DEF_CHARACTERISTIC
 /begin OUT_MEASUREMENT ESM_EcuState ESM_OPERATIONAL_MODE ESM_POWER_OFF_MODE ESM_POWERLATCH_MODE ESM_STARTUP_I_MODE ESM_STARTUP_II_MODE ESM_u16PowerLatchTempo /end OUT_MEASUREMENT
/end FUNCTION
/begin FUNCTION FAIL "" /begin DEF_CHARACTERISTIC FAIL_bCanErrCheckonC FAIL_bHvLoopErrCheckonC /end DEF_CHARACTERISTIC
 /begin OUT_MEASUREMENT FAIL_bCanErrChkDisabled FAIL_bComLostDiagTEna FAIL_bComLostDiagVEna FAIL_bComLostDiagVHigh FAIL_bComLostDiagVLow FAIL_bDebug1 FAIL_bRstHotFlag FAIL_bRstHotFlagNvm FAIL_u16ComLostDiagEnaCnt FAIL_u16ComLostDiagVRecCnt FAIL_u16hvloopflag FAIL_u16KeyOnDelay FAIL_u16KeyOnValue FAIL_u16LvBatVoltRaw FAIL_u16RstHotCntNvm FAIL_u16RstStartUpCntNvm FAIL_u16TimestampIgnNvm FAIL_u32TimestampLifeNvm FAIL_u8CCP_FaultLevel /end OUT_MEASUREMENT
/end FUNCTION
/begin FUNCTION FAULT ""
 /begin DEF_CHARACTERISTIC FaultBSW_COM_BusOff_CAN1Dec FaultBSW_COM_BusOff_CAN1FailMod FaultBSW_COM_BusOff_CAN1Inc FaultBSW_COM_ChecksumErrVCUDec FaultBSW_COM_ChecksumErrVCUFailMod FaultBSW_COM_ChecksumErrVCUInc FaultBSW_COM_InterFaultVCUDec FaultBSW_COM_InterFaultVCUFailMod FaultBSW_COM_InterFaultVCUInc FaultBSW_COM_RollCntErrVCUDec FaultBSW_COM_RollCntErrVCUFailMod FaultBSW_COM_RollCntErrVCUInc FaultBSW_COM_TimoutRxBCMDec FaultBSW_COM_TimoutRxBCMFailMod FaultBSW_COM_TimoutRxBCMInc FaultBSW_COM_TimoutRxBMSHDec FaultBSW_COM_TimoutRxBMSHFailMod FaultBSW_COM_TimoutRxBMSHInc FaultBSW_COM_TimoutRxEMSDec FaultBSW_COM_TimoutRxEMSFailMod FaultBSW_COM_TimoutRxEMSInc FaultBSW_COM_TimoutRxGCUDec FaultBSW_COM_TimoutRxGCUFailMod FaultBSW_COM_TimoutRxGCUInc FaultBSW_COM_TimoutRxIPCDec FaultBSW_COM_TimoutRxIPCFailMod FaultBSW_COM_TimoutRxIPCInc FaultBSW_COM_TimoutRxTBOXDec FaultBSW_COM_TimoutRxTBOXFailMod FaultBSW_COM_TimoutRxTBOXInc FaultBSW_COM_TimoutRxVCUDec FaultBSW_COM_TimoutRxVCUFailMod FaultBSW_COM_TimoutRxVCUInc FaultBSW_HW2_FPGA_OverVoltVBatDec FaultBSW_HW2_FPGA_OverVoltVBatFailMod FaultBSW_HW2_FPGA_OverVoltVBatInc FaultBSW_HW2_SafeTlib_PreRunDec FaultBSW_HW2_SafeTlib_PreRunFailMod FaultBSW_HW2_SafeTlib_PreRunInc FaultBSW_HW_EasAckFailDec FaultBSW_HW_EasAckFailFailMod FaultBSW_HW_EasAckFailInc FaultBSW_HW_FPGA_IGBT_HDec FaultBSW_HW_FPGA_IGBT_HFailMod FaultBSW_HW_FPGA_IGBT_HInc FaultBSW_HW_FPGA_IGBT_LDec FaultBSW_HW_FPGA_IGBT_LFailMod FaultBSW_HW_FPGA_IGBT_LInc FaultBSW_HW_FPGA_OverUnderCurUIDec FaultBSW_HW_FPGA_OverUnderCurUIFailMod FaultBSW_HW_FPGA_OverUnderCurUIInc FaultBSW_HW_FPGA_OverUnderCurVIDec FaultBSW_HW_FPGA_OverUnderCurVIFailMod FaultBSW_HW_FPGA_OverUnderCurVIInc FaultBSW_HW_FPGA_OverUnderCurWIDec FaultBSW_HW_FPGA_OverUnderCurWIFailMod FaultBSW_HW_FPGA_OverUnderCurWIInc FaultBSW_HW_OCDataNotRationalDec FaultBSW_HW_OCDataNotRationalFailMod FaultBSW_HW_OCDataNotRationalInc FaultBSW_SYS_RstHotDec FaultBSW_SYS_RstHotFailMod FaultBSW_SYS_RstHotInc FaultBSW_SYS_StackOverflowDec FaultBSW_SYS_StackOverflowFailMod FaultBSW_SYS_StackOverflowInc FaultBSW_VSI_TimeoutTCalcDec FaultBSW_VSI_TimeoutTCalcFailMod FaultBSW_VSI_TimeoutTCalcInc FaultFSEVBHV_OverVoltageDec FaultFSEVBHV_OverVoltageFailMod FaultFSEVBHV_OverVoltageInc FaultFSEVBHV_SampleVolOutRngHDec FaultFSEVBHV_SampleVolOutRngHFailMod FaultFSEVBHV_SampleVolOutRngHInc FaultFSEVBHV_SampleVolOutRngLDec FaultFSEVBHV_SampleVolOutRngLFailMod FaultFSEVBHV_SampleVolOutRngLInc FaultFSEVBHV_UnderVoltageDec FaultFSEVBHV_UnderVoltageFailMod FaultFSEVBHV_UnderVoltageInc FaultFSEVBHV_UnderVoltageWarnDec FaultFSEVBHV_UnderVoltageWarnFailMod FaultFSEVBHV_UnderVoltageWarnInc FaultFSEVBHV_VolNotRationalDec FaultFSEVBHV_VolNotRationalFailMod FaultFSEVBHV_VolNotRationalInc FaultFSEVBHV_VoltageGndDec FaultFSEVBHV_VoltageGndFailMod FaultFSEVBHV_VoltageGndInc FaultFSEVBHV_VoltageVccDec FaultFSEVBHV_VoltageVccFailMod FaultFSEVBHV_VoltageVccInc FaultFSEVBLV_OverVoltageDec FaultFSEVBLV_OverVoltageFailMod FaultFSEVBLV_OverVoltageInc FaultFSEVBLV_P5VRefADCFltDec FaultFSEVBLV_P5VRefADCFltFailMod FaultFSEVBLV_P5VRefADCFltInc FaultFSEVBLV_UnderVoltageDec FaultFSEVBLV_UnderVoltageFailMod FaultFSEVBLV_UnderVoltageInc FaultFSEVBLV_UnderVoltageWarnDec FaultFSEVBLV_UnderVoltageWarnFailMod FaultFSEVBLV_UnderVoltageWarnInc FaultFSEVBLV_VoltageGndDec FaultFSEVBLV_VoltageGndFailMod FaultFSEVBLV_VoltageGndInc FaultFSEVBLV_VoltageVccDec FaultFSEVBLV_VoltageVccFailMod FaultFSEVBLV_VoltageVccInc FaultFSEVETA_DrvTempRationDec FaultFSEVETA_DrvTempRationFailMod FaultFSEVETA_DrvTempRationInc FaultFSEVETA_IgbtTempRationalDec FaultFSEVETA_IgbtTempRationalFailMod FaultFSEVETA_IgbtTempRationalInc FaultFSEVETA_OverTempDrvLeftDec FaultFSEVETA_OverTempDrvLeftFailMod FaultFSEVETA_OverTempDrvLeftInc FaultFSEVETA_OverTempIgbtLeftDec FaultFSEVETA_OverTempIgbtLeftFailMod FaultFSEVETA_OverTempIgbtLeftInc FaultFSEVETA_OverTempNTC1CmdBoardDec FaultFSEVETA_OverTempNTC1CmdBoardFailMod FaultFSEVETA_OverTempNTC1CmdBoardInc FaultFSEVETA_SampleIgbtTempOutRngHDec FaultFSEVETA_SampleIgbtTempOutRngHFailMod FaultFSEVETA_SampleIgbtTempOutRngHInc FaultFSEVETA_SampleIgbtTempOutRngLDec FaultFSEVETA_SampleIgbtTempOutRngLFailMod FaultFSEVETA_SampleIgbtTempOutRngLInc FaultFSEVETA_TempDrvBoardLeftGndDec FaultFSEVETA_TempDrvBoardLeftGndFailMod FaultFSEVETA_TempDrvBoardLeftGndInc FaultFSEVETA_TempDrvBoardLeftVccDec FaultFSEVETA_TempDrvBoardLeftVccFailMod FaultFSEVETA_TempDrvBoardLeftVccInc FaultFSEVETA_TempIgbtLeftGndDec FaultFSEVETA_TempIgbtLeftGndFailMod FaultFSEVETA_TempIgbtLeftGndInc FaultFSEVETA_TempIgbtLeftVccDec FaultFSEVETA_TempIgbtLeftVccFailMod FaultFSEVETA_TempIgbtLeftVccInc FaultFSEVETA_TempNTC1CmdBoardGndDec FaultFSEVETA_TempNTC1CmdBoardGndFailMod FaultFSEVETA_TempNTC1CmdBoardGndInc FaultFSEVETA_TempNTC1CmdBoardVccDec FaultFSEVETA_TempNTC1CmdBoardVccFailMod FaultFSEVETA_TempNTC1CmdBoardVccInc FaultFSEVETA_UnderTempDrvLeftDec FaultFSEVETA_UnderTempDrvLeftFailMod FaultFSEVETA_UnderTempDrvLeftInc FaultFSEVETA_UnderTempIgbtLeftDec FaultFSEVETA_UnderTempIgbtLeftFailMod FaultFSEVETA_UnderTempIgbtLeftInc FaultFSEVETA_UnderTempNTC1CmdBoardDec FaultFSEVETA_UnderTempNTC1CmdBoardFailMod /end DEF_CHARACTERISTIC
 /begin OUT_MEASUREMENT FaultBSW_COM_BusOff_CAN1Aut FaultBSW_COM_BusOff_CAN1Detected FaultBSW_COM_BusOff_CAN1Logged FaultBSW_COM_ChecksumErrVCUAut FaultBSW_COM_ChecksumErrVCUDetected FaultBSW_COM_ChecksumErrVCULogged FaultBSW_COM_Detected FaultBSW_COM_InterFaultVCUAut FaultBSW_COM_InterFaultVCUDetected FaultBSW_COM_InterFaultVCULogged FaultBSW_COM_Logged FaultBSW_COM_RollCntErrVCUAut FaultBSW_COM_RollCntErrVCUDetected FaultBSW_COM_RollCntErrVCULogged FaultBSW_COM_TimoutRxBCMAut FaultBSW_COM_TimoutRxBCMDetected FaultBSW_COM_TimoutRxBCMLogged FaultBSW_COM_TimoutRxBMSHAut FaultBSW_COM_TimoutRxBMSHDetected FaultBSW_COM_TimoutRxBMSHLogged FaultBSW_COM_TimoutRxEMSAut FaultBSW_COM_TimoutRxEMSDetected FaultBSW_COM_TimoutRxEMSLogged FaultBSW_COM_TimoutRxGCUAut FaultBSW_COM_TimoutRxGCUDetected FaultBSW_COM_TimoutRxGCULogged FaultBSW_COM_TimoutRxIPCAut FaultBSW_COM_TimoutRxIPCDetected FaultBSW_COM_TimoutRxIPCLogged FaultBSW_COM_TimoutRxTBOXAut FaultBSW_COM_TimoutRxTBOXDetected FaultBSW_COM_TimoutRxTBOXLogged FaultBSW_COM_TimoutRxVCUAut FaultBSW_COM_TimoutRxVCUDetected FaultBSW_COM_TimoutRxVCULogged FaultBSW_HW2_Detected FaultBSW_HW2_FPGA_OverVoltVBatAut FaultBSW_HW2_FPGA_OverVoltVBatDetected FaultBSW_HW2_FPGA_OverVoltVBatLogged FaultBSW_HW2_Logged FaultBSW_HW2_SafeTlib_PreRunAut FaultBSW_HW2_SafeTlib_PreRunDetected FaultBSW_HW2_SafeTlib_PreRunLogged FaultBSW_HW_Detected FaultBSW_HW_EasAckFailAut FaultBSW_HW_EasAckFailDetected FaultBSW_HW_EasAckFailLogged FaultBSW_HW_FPGA_IGBT_HAut FaultBSW_HW_FPGA_IGBT_HDetected FaultBSW_HW_FPGA_IGBT_HLogged FaultBSW_HW_FPGA_IGBT_LAut FaultBSW_HW_FPGA_IGBT_LDetected FaultBSW_HW_FPGA_IGBT_LLogged FaultBSW_HW_FPGA_OverUnderCurUIAut FaultBSW_HW_FPGA_OverUnderCurUIDetected FaultBSW_HW_FPGA_OverUnderCurUILogged FaultBSW_HW_FPGA_OverUnderCurVIAut FaultBSW_HW_FPGA_OverUnderCurVIDetected FaultBSW_HW_FPGA_OverUnderCurVILogged FaultBSW_HW_FPGA_OverUnderCurWIAut FaultBSW_HW_FPGA_OverUnderCurWIDetected FaultBSW_HW_FPGA_OverUnderCurWILogged FaultBSW_HW_Logged FaultBSW_HW_OCDataNotRationalAut FaultBSW_HW_OCDataNotRationalDetected FaultBSW_HW_OCDataNotRationalLogged FaultBSW_SYS_Detected FaultBSW_SYS_Logged FaultBSW_SYS_RstHotAut FaultBSW_SYS_RstHotDetected FaultBSW_SYS_RstHotLogged FaultBSW_SYS_StackOverflowAut FaultBSW_SYS_StackOverflowDetected FaultBSW_SYS_StackOverflowLogged FaultBSW_VSI_Detected FaultBSW_VSI_Logged FaultBSW_VSI_TimeoutTCalcAut FaultBSW_VSI_TimeoutTCalcDetected FaultBSW_VSI_TimeoutTCalcLogged FaultFSEVBHV_Detected FaultFSEVBHV_Logged FaultFSEVBHV_OverVoltageAut FaultFSEVBHV_OverVoltageDetected FaultFSEVBHV_OverVoltageLogged FaultFSEVBHV_SampleVolOutRngHAut FaultFSEVBHV_SampleVolOutRngHDetected FaultFSEVBHV_SampleVolOutRngHLogged FaultFSEVBHV_SampleVolOutRngLAut FaultFSEVBHV_SampleVolOutRngLDetected FaultFSEVBHV_SampleVolOutRngLLogged FaultFSEVBHV_UnderDetected FaultFSEVBHV_UnderLogged FaultFSEVBHV_UnderVoltageAut FaultFSEVBHV_UnderVoltageDetected FaultFSEVBHV_UnderVoltageLogged FaultFSEVBHV_UnderVoltageWarnAut FaultFSEVBHV_UnderVoltageWarnDetected FaultFSEVBHV_UnderVoltageWarnLogged FaultFSEVBHV_VolNotRationalAut FaultFSEVBHV_VolNotRationalDetected FaultFSEVBHV_VolNotRationalLogged FaultFSEVBHV_VoltageGndAut FaultFSEVBHV_VoltageGndDetected FaultFSEVBHV_VoltageGndLogged FaultFSEVBHV_VoltageVccAut FaultFSEVBHV_VoltageVccDetected FaultFSEVBHV_VoltageVccLogged FaultFSEVBLV_Detected FaultFSEVBLV_Logged FaultFSEVBLV_OverVoltageAut FaultFSEVBLV_OverVoltageDetected FaultFSEVBLV_OverVoltageLogged FaultFSEVBLV_P5VRefADCFltAut FaultFSEVBLV_P5VRefADCFltDetected FaultFSEVBLV_P5VRefADCFltLogged FaultFSEVBLV_UnderDetected FaultFSEVBLV_UnderLogged FaultFSEVBLV_UnderVoltageAut FaultFSEVBLV_UnderVoltageDetected FaultFSEVBLV_UnderVoltageLogged FaultFSEVBLV_UnderVoltageWarnAut FaultFSEVBLV_UnderVoltageWarnDetected FaultFSEVBLV_UnderVoltageWarnLogged FaultFSEVBLV_VoltageGndAut FaultFSEVBLV_VoltageGndDetected FaultFSEVBLV_VoltageGndLogged FaultFSEVBLV_VoltageVccAut FaultFSEVBLV_VoltageVccDetected FaultFSEVBLV_VoltageVccLogged FaultFSEVETA_Detected FaultFSEVETA_DrvTempRationAut FaultFSEVETA_DrvTempRationDetected FaultFSEVETA_DrvTempRationLogged FaultFSEVETA_IgbtTempRationalAut FaultFSEVETA_IgbtTempRationalDetected FaultFSEVETA_IgbtTempRationalLogged FaultFSEVETA_Logged FaultFSEVETA_OverDetected FaultFSEVETA_OverLogged FaultFSEVETA_OverTempDrvLeftAut FaultFSEVETA_OverTempDrvLeftDetected FaultFSEVETA_OverTempDrvLeftLogged FaultFSEVETA_OverTempIgbtLeftAut FaultFSEVETA_OverTempIgbtLeftDetected FaultFSEVETA_OverTempIgbtLeftLogged FaultFSEVETA_OverTempNTC1CmdBoardAut FaultFSEVETA_OverTempNTC1CmdBoardDetected FaultFSEVETA_OverTempNTC1CmdBoardLogged FaultFSEVETA_SampleIgbtTempOutRngHAut FaultFSEVETA_SampleIgbtTempOutRngHDetected FaultFSEVETA_SampleIgbtTempOutRngHLogged FaultFSEVETA_SampleIgbtTempOutRngLAut FaultFSEVETA_SampleIgbtTempOutRngLDetected FaultFSEVETA_SampleIgbtTempOutRngLLogged FaultFSEVETA_TempDetected FaultFSEVETA_TempDrvBoardLeftGndAut FaultFSEVETA_TempDrvBoardLeftGndDetected FaultFSEVETA_TempDrvBoardLeftGndLogged FaultFSEVETA_TempDrvBoardLeftVccAut FaultFSEVETA_TempDrvBoardLeftVccDetected FaultFSEVETA_TempDrvBoardLeftVccLogged FaultFSEVETA_TempIgbtLeftGndAut FaultFSEVETA_TempIgbtLeftGndDetected FaultFSEVETA_TempIgbtLeftGndLogged FaultFSEVETA_TempIgbtLeftVccAut FaultFSEVETA_TempIgbtLeftVccDetected FaultFSEVETA_TempIgbtLeftVccLogged FaultFSEVETA_TempLogged FaultFSEVETA_TempNTC1CmdBoardGndAut FaultFSEVETA_TempNTC1CmdBoardGndDetected FaultFSEVETA_TempNTC1CmdBoardGndLogged FaultFSEVETA_TempNTC1CmdBoardVccAut FaultFSEVETA_TempNTC1CmdBoardVccDetected FaultFSEVETA_TempNTC1CmdBoardVccLogged FaultFSEVETA_UnderDetected FaultFSEVETA_UnderLogged FaultFSEVETA_UnderTempDrvLeftAut FaultFSEVETA_UnderTempDrvLeftDetected FaultFSEVETA_UnderTempDrvLeftLogged FaultFSEVETA_UnderTempIgbtLeftAut FaultFSEVETA_UnderTempIgbtLeftDetected FaultFSEVETA_UnderTempIgbtLeftLogged FaultFSEVETA_UnderTempNTC1CmdBoardAut FaultFSEVETA_UnderTempNTC1CmdBoardDetected FaultFSEVETA_UnderTempNTC1CmdBoardLogged FaultFSMTMTA_OverDetected FaultFSMTMTA_OverLogged FaultFSMTMTA_OverTempWdgHead1Aut FaultFSMTMTA_OverTempWdgHead1Detected FaultFSMTMTA_OverTempWdgHead1Logged FaultFSMTMTA_TempDetected FaultFSMTMTA_TempLogged FaultFSMTMTA_TempWindHead1OutRngHAut FaultFSMTMTA_TempWindHead1OutRngHDetected FaultFSMTMTA_TempWindHead1OutRngHLogged FaultFSMTMTA_TempWindHead1OutRngLAut FaultFSMTMTA_TempWindHead1OutRngLDetected FaultFSMTMTA_TempWindHead1OutRngLLogged FaultFSMTMTA_TempWindingHead1GndAut FaultFSMTMTA_TempWindingHead1GndDetected FaultFSMTMTA_TempWindingHead1GndLogged FaultFSMTMTA_TempWindingHead1VccAut FaultFSMTMTA_TempWindingHead1VccDetected FaultFSMTMTA_TempWindingHead1VccLogged FaultFSMTMTA_UnderDetected FaultFSMTMTA_UnderLogged FaultFSMTMTA_UnderTempWdgHead1Aut FaultFSMTMTA_UnderTempWdgHead1Detected FaultFSMTMTA_UnderTempWdgHead1Logged FaultFSMTRDG_Detected FaultFSMTRDG_ExcGenerationAut FaultFSMTRDG_ExcGenerationDetected FaultFSMTRDG_ExcGenerationLogged FaultFSMTRDG_ExcSignalGNDAut FaultFSMTRDG_ExcSignalGNDDetected FaultFSMTRDG_ExcSignalGNDLogged FaultFSMTRDG_ExcSignalVCCAut FaultFSMTRDG_ExcSignalVCCDetected FaultFSMTRDG_ExcSignalVCCLogged FaultFSMTRDG_Logged FaultFSMTRDG_SinCosHLGndAut FaultFSMTRDG_SinCosHLGndDetected FaultFSMTRDG_SinCosHLGndLogged FaultFSMTRDG_SinCosHLOpenAut FaultFSMTRDG_SinCosHLOpenDetected FaultFSMTRDG_SinCosHLOpenLogged FaultFSMTRDG_SinCosHLVccAut FaultFSMTRDG_SinCosHLVccDetected FaultFSMTRDG_SinCosHLVccLogged FaultFSSMACS_AkdFailFlagAut FaultFSSMACS_AkdFailFlagDetected FaultFSSMACS_AkdFailFlagLogged FaultFSSMACS_Detected FaultFSSMACS_Logged FaultFTASBDS_BattVoltDeratingActAut FaultFTASBDS_BattVoltDeratingActDetected FaultFTASBDS_BattVoltDeratingActLogged FaultFTASBDS_Detected FaultFTASBDS_Logged FaultFTASETP_Detected FaultFTASETP_EstPmDeratingActAut FaultFTASETP_EstPmDeratingActDetected FaultFTASETP_EstPmDeratingActLogged FaultFTASETP_Logged FaultFTASETP_PmDeratingActAut FaultFTASETP_PmDeratingActDetected FaultFTASETP_PmDeratingActLogged FaultFTASMTP_Detected FaultFTASMTP_Logged FaultFTASMTP_Wndg1DeratingActAut FaultFTASMTP_Wndg1DeratingActDetected FaultFTASMTP_Wndg1DeratingActLogged FaultFTASOSP_Detected FaultFTASOSP_Logged FaultFTASOSP_MotorSpdDeratingActAut FaultFTASOSP_MotorSpdDeratingActDetected FaultFTASOSP_MotorSpdDeratingActLogged FaultFTCMSCS_CtrlSatTimoutAut FaultFTCMSCS_CtrlSatTimoutDetected FaultFTCMSCS_CtrlSatTimoutLogged FaultFTCMSCS_Detected FaultFTCMSCS_Logged FaultFTCMSCS_SpdOvershootAut FaultFTCMSCS_SpdOvershootDetected FaultFTCMSCS_SpdOvershootLogged FaultFTCMSCS_ZeroSpeedTimoutAut FaultFTCMSCS_ZeroSpeedTimoutDetected FaultFTCMSCS_ZeroSpeedTimoutLogged FaultFTCMTCS_Detected FaultFTCMTCS_Logged FaultFTCMTCS_VoltageMarginLowAut FaultFTCMTCS_VoltageMarginLowDetected FaultFTCMTCS_VoltageMarginLowLogged FaultFTEVEIT_Detected FaultFTEVEIT_EstOverTempAut FaultFTEVEIT_EstOverTempDetected FaultFTEVEIT_EstOverTempLogged FaultFTEVEIT_Logged FaultFTMTLCS_CurrentSumErrorAut FaultFTMTLCS_CurrentSumErrorDetected FaultFTMTLCS_CurrentSumErrorLogged FaultFTMTLCS_CurSenrPhaU_GNDAut FaultFTMTLCS_CurSenrPhaU_GNDDetected FaultFTMTLCS_CurSenrPhaU_GNDLogged FaultFTMTLCS_CurSenrPhaU_OutRngHAut FaultFTMTLCS_CurSenrPhaU_OutRngHDetected FaultFTMTLCS_CurSenrPhaU_OutRngHLogged FaultFTMTLCS_CurSenrPhaU_OutRngLAut FaultFTMTLCS_CurSenrPhaU_OutRngLDetected FaultFTMTLCS_CurSenrPhaU_OutRngLLogged FaultFTMTLCS_CurSenrPhaU_VCCAut FaultFTMTLCS_CurSenrPhaU_VCCDetected FaultFTMTLCS_CurSenrPhaU_VCCLogged FaultFTMTLCS_CurSenrPhaV_GNDAut FaultFTMTLCS_CurSenrPhaV_GNDDetected FaultFTMTLCS_CurSenrPhaV_GNDLogged FaultFTMTLCS_CurSenrPhaV_OutRngHAut FaultFTMTLCS_CurSenrPhaV_OutRngHDetected FaultFTMTLCS_CurSenrPhaV_OutRngHLogged FaultFTMTLCS_CurSenrPhaV_OutRngLAut FaultFTMTLCS_CurSenrPhaV_OutRngLDetected FaultFTMTLCS_CurSenrPhaV_OutRngLLogged FaultFTMTLCS_CurSenrPhaV_VCCAut FaultFTMTLCS_CurSenrPhaV_VCCDetected FaultFTMTLCS_CurSenrPhaV_VCCLogged FaultFTMTLCS_CurSenrPhaW_GNDAut FaultFTMTLCS_CurSenrPhaW_GNDDetected FaultFTMTLCS_CurSenrPhaW_GNDLogged FaultFTMTLCS_CurSenrPhaW_OutRngHAut FaultFTMTLCS_CurSenrPhaW_OutRngHDetected FaultFTMTLCS_CurSenrPhaW_OutRngHLogged FaultFTMTLCS_CurSenrPhaW_OutRngLAut FaultFTMTLCS_CurSenrPhaW_OutRngLDetected FaultFTMTLCS_CurSenrPhaW_OutRngLLogged FaultFTMTLCS_CurSenrPhaW_VCCAut FaultFTMTLCS_CurSenrPhaW_VCCDetected FaultFTMTLCS_CurSenrPhaW_VCCLogged FaultFTMTLCS_Detected FaultFTMTLCS_Logged FaultFunctionTypeDetectedArray FaultFunctionTypeDetectedArray[0] FaultFunctionTypeDetectedArray[10] FaultFunctionTypeDetectedArray[11] FaultFunctionTypeDetectedArray[12] FaultFunctionTypeDetectedArray[13] FaultFunctionTypeDetectedArray[14] FaultFunctionTypeDetectedArray[15] FaultFunctionTypeDetectedArray[16] FaultFunctionTypeDetectedArray[17] FaultFunctionTypeDetectedArray[18] FaultFunctionTypeDetectedArray[19] FaultFunctionTypeDetectedArray[1] FaultFunctionTypeDetectedArray[20] FaultFunctionTypeDetectedArray[21] FaultFunctionTypeDetectedArray[22] FaultFunctionTypeDetectedArray[23] FaultFunctionTypeDetectedArray[24] FaultFunctionTypeDetectedArray[25] FaultFunctionTypeDetectedArray[26] FaultFunctionTypeDetectedArray[27] FaultFunctionTypeDetectedArray[28] FaultFunctionTypeDetectedArray[29] FaultFunctionTypeDetectedArray[2] FaultFunctionTypeDetectedArray[3] FaultFunctionTypeDetectedArray[4] FaultFunctionTypeDetectedArray[5] FaultFunctionTypeDetectedArray[6] FaultFunctionTypeDetectedArray[7] FaultFunctionTypeDetectedArray[8] FaultFunctionTypeDetectedArray[9] FaultFunctionTypeLoggedArray FaultFunctionTypeLoggedArray[0] FaultFunctionTypeLoggedArray[10] FaultFunctionTypeLoggedArray[11] FaultFunctionTypeLoggedArray[12] FaultFunctionTypeLoggedArray[13] FaultFunctionTypeLoggedArray[14] FaultFunctionTypeLoggedArray[15] FaultFunctionTypeLoggedArray[16] FaultFunctionTypeLoggedArray[17] FaultFunctionTypeLoggedArray[18] FaultFunctionTypeLoggedArray[19] FaultFunctionTypeLoggedArray[1] FaultFunctionTypeLoggedArray[20] FaultFunctionTypeLoggedArray[21] FaultFunctionTypeLoggedArray[22] FaultFunctionTypeLoggedArray[23] FaultFunctionTypeLoggedArray[24] FaultFunctionTypeLoggedArray[25] FaultFunctionTypeLoggedArray[26] FaultFunctionTypeLoggedArray[27] FaultFunctionTypeLoggedArray[28] FaultFunctionTypeLoggedArray[29] FaultFunctionTypeLoggedArray[2] FaultFunctionTypeLoggedArray[3] FaultFunctionTypeLoggedArray[4] FaultFunctionTypeLoggedArray[5] FaultFunctionTypeLoggedArray[6] FaultFunctionTypeLoggedArray[7] FaultFunctionTypeLoggedArray[8] FaultFunctionTypeLoggedArray[9] FaultSDMTMEP_CosGndAut FaultSDMTMEP_CosGndDetected FaultSDMTMEP_CosGndLogged FaultSDMTMEP_CosOutRangeHighAut FaultSDMTMEP_CosOutRangeHighDetected FaultSDMTMEP_CosOutRangeHighLogged FaultSDMTMEP_CosOutRangeLowAut FaultSDMTMEP_CosOutRangeLowDetected FaultSDMTMEP_CosOutRangeLowLogged FaultSDMTMEP_CosVccAut FaultSDMTMEP_CosVccDetected FaultSDMTMEP_CosVccLogged FaultSDMTMEP_Detected FaultSDMTMEP_Logged FaultSDMTMEP_OverSpeedAut FaultSDMTMEP_OverSpeedDetected FaultSDMTMEP_OverSpeedLogged FaultSDMTMEP_ResSquaSumErrByFTAut FaultSDMTMEP_ResSquaSumErrByFTDetected FaultSDMTMEP_ResSquaSumErrByFTLogged FaultSDMTMEP_SinGndAut FaultSDMTMEP_SinGndDetected FaultSDMTMEP_SinGndLogged FaultSDMTMEP_SinOutRangeHighAut FaultSDMTMEP_SinOutRangeHighDetected FaultSDMTMEP_SinOutRangeHighLogged FaultSDMTMEP_SinOutRangeLowAut FaultSDMTMEP_SinOutRangeLowDetected FaultSDMTMEP_SinOutRangeLowLogged FaultSDMTMEP_SinVccAut FaultSDMTMEP_SinVccDetected FaultSDMTMEP_SinVccLogged FaultSDMTMEP_UnderSpeedAut FaultSDMTMEP_UnderSpeedDetected FaultSDMTMEP_UnderSpeedLogged FaultTableFuncTypeCounter1 FaultTableFuncTypeCounter1[0] FaultTableFuncTypeCounter1[100] FaultTableFuncTypeCounter1[101] FaultTableFuncTypeCounter1[102] FaultTableFuncTypeCounter1[103] FaultTableFuncTypeCounter1[104] FaultTableFuncTypeCounter1[105] FaultTableFuncTypeCounter1[106] FaultTableFuncTypeCounter1[107] FaultTableFuncTypeCounter1[108] FaultTableFuncTypeCounter1[109] FaultTableFuncTypeCounter1[10] FaultTableFuncTypeCounter1[110] FaultTableFuncTypeCounter1[111] FaultTableFuncTypeCounter1[112] FaultTableFuncTypeCounter1[113] FaultTableFuncTypeCounter1[114] FaultTableFuncTypeCounter1[115] FaultTableFuncTypeCounter1[116] FaultTableFuncTypeCounter1[117] FaultTableFuncTypeCounter1[118] FaultTableFuncTypeCounter1[119] FaultTableFuncTypeCounter1[11] FaultTableFuncTypeCounter1[120] FaultTableFuncTypeCounter1[121] FaultTableFuncTypeCounter1[122] FaultTableFuncTypeCounter1[123] FaultTableFuncTypeCounter1[124] FaultTableFuncTypeCounter1[125] FaultTableFuncTypeCounter1[126] FaultTableFuncTypeCounter1[127] FaultTableFuncTypeCounter1[128] FaultTableFuncTypeCounter1[129] FaultTableFuncTypeCounter1[12] FaultTableFuncTypeCounter1[130] FaultTableFuncTypeCounter1[131] FaultTableFuncTypeCounter1[132] FaultTableFuncTypeCounter1[13] FaultTableFuncTypeCounter1[14] FaultTableFuncTypeCounter1[15] FaultTableFuncTypeCounter1[16] FaultTableFuncTypeCounter1[17] FaultTableFuncTypeCounter1[18] FaultTableFuncTypeCounter1[19] FaultTableFuncTypeCounter1[1] FaultTableFuncTypeCounter1[20] FaultTableFuncTypeCounter1[21] FaultTableFuncTypeCounter1[22] FaultTableFuncTypeCounter1[23] FaultTableFuncTypeCounter1[24] FaultTableFuncTypeCounter1[25] FaultTableFuncTypeCounter1[26] FaultTableFuncTypeCounter1[27] FaultTableFuncTypeCounter1[28] FaultTableFuncTypeCounter1[29] FaultTableFuncTypeCounter1[2] FaultTableFuncTypeCounter1[30] FaultTableFuncTypeCounter1[31] FaultTableFuncTypeCounter1[32] FaultTableFuncTypeCounter1[33] FaultTableFuncTypeCounter1[34] FaultTableFuncTypeCounter1[35] FaultTableFuncTypeCounter1[36] FaultTableFuncTypeCounter1[37] FaultTableFuncTypeCounter1[38] FaultTableFuncTypeCounter1[39] FaultTableFuncTypeCounter1[3] FaultTableFuncTypeCounter1[40] FaultTableFuncTypeCounter1[41] FaultTableFuncTypeCounter1[42] FaultTableFuncTypeCounter1[43] FaultTableFuncTypeCounter1[44] FaultTableFuncTypeCounter1[45] FaultTableFuncTypeCounter1[46] FaultTableFuncTypeCounter1[47] FaultTableFuncTypeCounter1[48] FaultTableFuncTypeCounter1[49] FaultTableFuncTypeCounter1[4] FaultTableFuncTypeCounter1[50] FaultTableFuncTypeCounter1[51] FaultTableFuncTypeCounter1[52] FaultTableFuncTypeCounter1[53] FaultTableFuncTypeCounter1[54] FaultTableFuncTypeCounter1[55] FaultTableFuncTypeCounter1[56] FaultTableFuncTypeCounter1[57] FaultTableFuncTypeCounter1[58] FaultTableFuncTypeCounter1[59] FaultTableFuncTypeCounter1[5] FaultTableFuncTypeCounter1[60] FaultTableFuncTypeCounter1[61] FaultTableFuncTypeCounter1[62] FaultTableFuncTypeCounter1[63] FaultTableFuncTypeCounter1[64] FaultTableFuncTypeCounter1[65] FaultTableFuncTypeCounter1[66] FaultTableFuncTypeCounter1[67] FaultTableFuncTypeCounter1[68] FaultTableFuncTypeCounter1[69] FaultTableFuncTypeCounter1[6] FaultTableFuncTypeCounter1[70] FaultTableFuncTypeCounter1[71] FaultTableFuncTypeCounter1[72] FaultTableFuncTypeCounter1[73] FaultTableFuncTypeCounter1[74] FaultTableFuncTypeCounter1[75] FaultTableFuncTypeCounter1[76] FaultTableFuncTypeCounter1[77] FaultTableFuncTypeCounter1[78] FaultTableFuncTypeCounter1[79] FaultTableFuncTypeCounter1[7] FaultTableFuncTypeCounter1[80] FaultTableFuncTypeCounter1[81] FaultTableFuncTypeCounter1[82] FaultTableFuncTypeCounter1[83] FaultTableFuncTypeCounter1[84] FaultTableFuncTypeCounter1[85] FaultTableFuncTypeCounter1[86] FaultTableFuncTypeCounter1[87] FaultTableFuncTypeCounter1[88] FaultTableFuncTypeCounter1[89] FaultTableFuncTypeCounter1[8] FaultTableFuncTypeCounter1[90] FaultTableFuncTypeCounter1[91] FaultTableFuncTypeCounter1[92] FaultTableFuncTypeCounter1[93] FaultTableFuncTypeCounter1[94] FaultTableFuncTypeCounter1[95] FaultTableFuncTypeCounter1[96] FaultTableFuncTypeCounter1[97] FaultTableFuncTypeCounter1[98] FaultTableFuncTypeCounter1[99] FaultTableFuncTypeCounter1[9] FaultTCUCAP0_CAPPressureHAut FaultTCUCAP0_CAPPressureHDetected FaultTCUCAP0_CAPPressureHLogged FaultTCUCAP0_CAPPressureLAut FaultTCUCAP0_CAPPressureLDetected FaultTCUCAP0_CAPPressureLLogged FaultTCUCAP0_CAPPressureOverHAut FaultTCUCAP0_CAPPressureOverHDetected FaultTCUCAP0_CAPPressureOverHLogged FaultTCUCAP0_CAPSlipAut FaultTCUCAP0_CAPSlipDetected FaultTCUCAP0_CAPSlipLogged FaultTCUCAP0_Detected FaultTCUCAP0_DragMomentHAut FaultTCUCAP0_DragMomentHDetected FaultTCUCAP0_DragMomentHLogged FaultTCUCAP0_HLSinInvalidAut FaultTCUCAP0_HLSinInvalidDetected FaultTCUCAP0_HLSinInvalidLogged FaultTCUCAP0_HLSinUndefineAut FaultTCUCAP0_HLSinUndefineDetected FaultTCUCAP0_HLSinUndefineLogged FaultTCUCAP0_HLSupplyHAut FaultTCUCAP0_HLSupplyHDetected FaultTCUCAP0_HLSupplyHLogged FaultTCUCAP0_HLSupplyLAut FaultTCUCAP0_HLSupplyLDetected FaultTCUCAP0_HLSupplyLLogged FaultTCUCAP0_Logged FaultTCUCAP0_MotorPhaseVolHAut FaultTCUCAP0_MotorPhaseVolHDetected FaultTCUCAP0_MotorPhaseVolHLogged FaultTCUCAP0_PressureRationalAut FaultTCUCAP0_PressureRationalDetected FaultTCUCAP0_PressureRationalLogged FaultTCUCAP0_SenSigOpenOrGNDAut FaultTCUCAP0_SenSigOpenOrGNDDetected FaultTCUCAP0_SenSigOpenOrGNDLogged FaultTCUCAP0_SenSigVCCAut FaultTCUCAP0_SenSigVCCDetected FaultTCUCAP0_SenSigVCCLogged FaultTCUCAP0_SensorPerforErrAut FaultTCUCAP0_SensorPerforErrDetected FaultTCUCAP0_SensorPerforErrLogged FaultTCUCAP1_COM_GCUAut FaultTCUCAP1_COM_GCUDetected FaultTCUCAP1_COM_GCULogged FaultTCUCAP1_Detected FaultTCUCAP1_DriverTempHAut FaultTCUCAP1_DriverTempHDetected FaultTCUCAP1_DriverTempHLogged FaultTCUCAP1_FETShortAut FaultTCUCAP1_FETShortDetected FaultTCUCAP1_FETShortLogged FaultTCUCAP1_HWOverCurAut FaultTCUCAP1_HWOverCurDetected FaultTCUCAP1_HWOverCurLogged FaultTCUCAP1_Logged FaultTCUCAP1_MotorPhaseDriveErrAut FaultTCUCAP1_MotorPhaseDriveErrDetected FaultTCUCAP1_MotorPhaseDriveErrLogged FaultTCUCAP1_MotorStallAut FaultTCUCAP1_MotorStallDetected FaultTCUCAP1_MotorStallLogged FaultTCUCAP1_OverVoltageAut FaultTCUCAP1_OverVoltageDetected FaultTCUCAP1_OverVoltageLogged FaultTCUCAP1_PhaseDetectGNDAut FaultTCUCAP1_PhaseDetectGNDDetected FaultTCUCAP1_PhaseDetectGNDLogged FaultTCUCAP1_PhaseDetectVCCAut FaultTCUCAP1_PhaseDetectVCCDetected FaultTCUCAP1_PhaseDetectVCCLogged FaultTCUCAP1_SWOverCurAut FaultTCUCAP1_SWOverCurDetected FaultTCUCAP1_SWOverCurLogged FaultTCUCAP1_ThermalShutDownAut FaultTCUCAP1_ThermalShutDownDetected FaultTCUCAP1_ThermalShutDownLogged FaultTCUCAP1_ThermalWarningAut FaultTCUCAP1_ThermalWarningDetected FaultTCUCAP1_ThermalWarningLogged FaultTCUCAP1_UnderVoltageAut FaultTCUCAP1_UnderVoltageDetected FaultTCUCAP1_UnderVoltageLogged FaultTCUCCP_Detected FaultTCUCCP_Logged FaultTCUCCP_OilMotorRationalAut FaultTCUCCP_OilMotorRationalDetected FaultTCUCCP_OilMotorRationalLogged FaultTCUCCP_OilMotorStallAut FaultTCUCCP_OilMotorStallDetected FaultTCUCCP_OilMotorStallLogged FaultTCUCCP_OilSenRationalL1Aut FaultTCUCCP_OilSenRationalL1Detected FaultTCUCCP_OilSenRationalL1Logged FaultTCUCCP_OilSenRationalL2Aut FaultTCUCCP_OilSenRationalL2Detected FaultTCUCCP_OilSenRationalL2Logged FaultTCUCCP_OilTempRationalHAut FaultTCUCCP_OilTempRationalHDetected FaultTCUCCP_OilTempRationalHLogged FaultTCUCCP_OilTempRationalLAut FaultTCUCCP_OilTempRationalLDetected FaultTCUCCP_OilTempRationalLLogged /end OUT_MEASUREMENT
/end FUNCTION
/end MODULE
/end PROJECT
