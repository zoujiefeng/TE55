ASAP2_VERSION 1 3
/begin PROJECT P_TC375_PLATFORM_0_0 "P_TC375_PLATFORM_0_0"
/begin HEADER "" VERSION "5210.00" PROJECT_NO D0 /end HEADER
/begin MODULE P_TC375_PLATFORM_0_0 "Invt"
/begin MOD_COMMON "" DEPOSIT ABSOLUTE ALIGNMENT_BYTE 1 ALIGNMENT_WORD 2 ALIGNMENT_LONG 4 ALIGNMENT_FLOAT32_IEEE 4 ALIGNMENT_FLOAT64_IEEE 8 BYTE_ORDER MSB_LAST /end MOD_COMMON
/begin MEASUREMENT AFTASBDS_BattVoltDrtGainMax "AFTASBDS_BattVoltDrtGainMax" FLOAT32_IEEE F_1_p0_2 1 2 0 1 ECU_ADDRESS 0x70002C18 /end MEASUREMENT
/begin MEASUREMENT AFTASBDS_BattVoltDrtGainMin "AFTASBDS_BattVoltDrtGainMin" FLOAT32_IEEE F_1_p0_2 1 2 0 1 ECU_ADDRESS 0x70002C14 /end MEASUREMENT
/begin MEASUREMENT AFTASDPM_DeratingStatus "AFTASDPM_DeratingStatus" UBYTE Bool_ON_OFF 1 2 0 1 BIT_MASK 0x01 ECU_ADDRESS 0x70002C54 /end MEASUREMENT
/begin MEASUREMENT AFTASDPM_DrtGainMax "AFTASDPM_DrtGainMax" FLOAT32_IEEE F_1_p0_2 1 2 0 1 ECU_ADDRESS 0x70002C50 /end MEASUREMENT
/begin MEASUREMENT AFTASDPM_DrtGainMin "AFTASDPM_DrtGainMin" FLOAT32_IEEE F_1_p0_2 1 2 0 1 ECU_ADDRESS 0x70002C4C /end MEASUREMENT
/begin MEASUREMENT AFTASDPM_MaxMinI0dqDrtVect "AFTASDPM_MaxMinI0dqDrtVect" FLOAT32_IEEE F_1_p0_2 1 2 -1200 1200 MATRIX_DIM 1 6 1 ECU_ADDRESS 0x70002C34 /end MEASUREMENT
/begin MEASUREMENT AFTASDPM_MaxMinI0dqDrtVect[0] "AFTASDPM_MaxMinI0dqDrtVect[0]" FLOAT32_IEEE F_1_p0_2 1 2 -1200 1200 ECU_ADDRESS 0x70002C34 /end MEASUREMENT
/begin MEASUREMENT AFTASDPM_MaxMinI0dqDrtVect[1] "AFTASDPM_MaxMinI0dqDrtVect[1]" FLOAT32_IEEE F_1_p0_2 1 2 -1200 1200 ECU_ADDRESS 0x70002C38 /end MEASUREMENT
/begin MEASUREMENT AFTASDPM_MaxMinI0dqDrtVect[2] "AFTASDPM_MaxMinI0dqDrtVect[2]" FLOAT32_IEEE F_1_p0_2 1 2 -1200 1200 ECU_ADDRESS 0x70002C3C /end MEASUREMENT
/begin MEASUREMENT AFTASDPM_MaxMinI0dqDrtVect[3] "AFTASDPM_MaxMinI0dqDrtVect[3]" FLOAT32_IEEE F_1_p0_2 1 2 -1200 1200 ECU_ADDRESS 0x70002C40 /end MEASUREMENT
/begin MEASUREMENT AFTASDPM_MaxMinI0dqDrtVect[4] "AFTASDPM_MaxMinI0dqDrtVect[4]" FLOAT32_IEEE F_1_p0_2 1 2 -1200 1200 ECU_ADDRESS 0x70002C44 /end MEASUREMENT
/begin MEASUREMENT AFTASDPM_MaxMinI0dqDrtVect[5] "AFTASDPM_MaxMinI0dqDrtVect[5]" FLOAT32_IEEE F_1_p0_2 1 2 -1200 1200 ECU_ADDRESS 0x70002C48 /end MEASUREMENT
/begin MEASUREMENT AFTASDPM_MaxMinSpdDrtVect "AFTASDPM_MaxMinSpdDrtVect" FLOAT32_IEEE F_1_p0_2 1 2 -25000 25000 MATRIX_DIM 1 2 1 ECU_ADDRESS 0x70002C2C /end MEASUREMENT
/begin MEASUREMENT AFTASDPM_MaxMinSpdDrtVect[0] "AFTASDPM_MaxMinSpdDrtVect[0]" FLOAT32_IEEE F_1_p0_2 1 2 -25000 25000 ECU_ADDRESS 0x70002C2C /end MEASUREMENT
/begin MEASUREMENT AFTASDPM_MaxMinSpdDrtVect[1] "AFTASDPM_MaxMinSpdDrtVect[1]" FLOAT32_IEEE F_1_p0_2 1 2 -25000 25000 ECU_ADDRESS 0x70002C30 /end MEASUREMENT
/begin MEASUREMENT AFTASDPM_MaxMinTorqueDrtVect "AFTASDPM_MaxMinTorqueDrtVect" FLOAT32_IEEE F_1_p0_2 1 2 -500 500 MATRIX_DIM 1 2 1 ECU_ADDRESS 0x70002C24 /end MEASUREMENT
/begin MEASUREMENT AFTASDPM_MaxMinTorqueDrtVect[0] "AFTASDPM_MaxMinTorqueDrtVect[0]" FLOAT32_IEEE F_1_p0_2 1 2 -500 500 ECU_ADDRESS 0x70002C24 /end MEASUREMENT
/begin MEASUREMENT AFTASDPM_MaxMinTorqueDrtVect[1] "AFTASDPM_MaxMinTorqueDrtVect[1]" FLOAT32_IEEE F_1_p0_2 1 2 -500 500 ECU_ADDRESS 0x70002C28 /end MEASUREMENT
/begin MEASUREMENT AFTASDPM_MaxTorqueDerating "AFTASDPM_MaxTorqueDerating" FLOAT32_IEEE F_1_p0_2 1 2 -3.402823466E+038 3.402823466E+038 ECU_ADDRESS 0x70002C20 /end MEASUREMENT
/begin MEASUREMENT AFTASDPM_MinTorqueDerating "AFTASDPM_MinTorqueDerating" FLOAT32_IEEE F_1_p0_2 1 2 -3.402823466E+038 3.402823466E+038 ECU_ADDRESS 0x70002C1C /end MEASUREMENT
/begin MEASUREMENT AFTASETP_EstPmDrtGain "AFTASETP_EstPmDrtGain" FLOAT32_IEEE F_1_p0_2 1 2 0 1 ECU_ADDRESS 0x70002C64 /end MEASUREMENT
/begin MEASUREMENT AFTASETP_IntegralPmDrtGainZ "AFTASETP_IntegralPmDrtGainZ" FLOAT32_IEEE F_1_p0_2 1 2 0 1 ECU_ADDRESS 0x70002C60 /end MEASUREMENT
/begin MEASUREMENT AFTASETP_PmDrtGain "AFTASETP_PmDrtGain" FLOAT32_IEEE F_1_p0_2 1 2 0 1 ECU_ADDRESS 0x70002C5C /end MEASUREMENT
/begin MEASUREMENT AFTASETP_PmMaxTemp "AFTASETP_PmMaxTemp" FLOAT32_IEEE F_1_p0_2 1 2 -40 200 ECU_ADDRESS 0x70002C58 /end MEASUREMENT
/begin MEASUREMENT AFTASETP_PmResetZ "AFTASETP_PmResetZ" UBYTE Bool_ON_OFF 1 2 0 1 BIT_MASK 0x01 ECU_ADDRESS 0x70002C55 /end MEASUREMENT
/begin MEASUREMENT AFTASMTP_IntegralWndg1DrtGainZ "AFTASMTP_IntegralWndg1DrtGainZ" FLOAT32_IEEE F_1_p0_2 1 2 0 1 ECU_ADDRESS 0x70002C80 /end MEASUREMENT
/begin MEASUREMENT AFTASMTP_IntegralWndg2DrtGainZ "AFTASMTP_IntegralWndg2DrtGainZ" FLOAT32_IEEE F_1_p0_2 1 2 0 1 ECU_ADDRESS 0x70002C7C /end MEASUREMENT
/begin MEASUREMENT AFTASMTP_Wndg1ResetZ "AFTASMTP_Wndg1ResetZ" UBYTE Bool_ON_OFF 1 2 0 1 BIT_MASK 0x01 ECU_ADDRESS 0x70002C78 /end MEASUREMENT
/begin MEASUREMENT AFTASMTP_Wndg1Temp "AFTASMTP_Wndg1Temp" FLOAT32_IEEE F_1_p0_2 1 2 -40 200 ECU_ADDRESS 0x70002C74 /end MEASUREMENT
/begin MEASUREMENT AFTASMTP_Wndg2DeratingActDetn "AFTASMTP_Wndg2DeratingActDetn" UBYTE Bool_ON_OFF 1 2 0 1 BIT_MASK 0x01 ECU_ADDRESS 0x70002C71 /end MEASUREMENT
/begin MEASUREMENT AFTASMTP_Wndg2ResetZ "AFTASMTP_Wndg2ResetZ" UBYTE Bool_ON_OFF 1 2 0 1 BIT_MASK 0x01 ECU_ADDRESS 0x70002C70 /end MEASUREMENT
/begin MEASUREMENT AFTASMTP_Wndg2Temp "AFTASMTP_Wndg2Temp" FLOAT32_IEEE F_1_p0_2 1 2 -40 200 ECU_ADDRESS 0x70002C6C /end MEASUREMENT
/begin MEASUREMENT AFTASMTP_WndgDrtGain "AFTASMTP_WndgDrtGain" FLOAT32_IEEE F_1_p0_2 1 2 0 1 ECU_ADDRESS 0x70002C68 /end MEASUREMENT
/begin MEASUREMENT AFTASOSP_MotorSpeedDrtGainMax "AFTASOSP_MotorSpeedDrtGainMax" FLOAT32_IEEE F_1_p0_2 1 2 0 1 ECU_ADDRESS 0x70002C88 /end MEASUREMENT
/begin MEASUREMENT AFTASOSP_MotorSpeedDrtGainMin "AFTASOSP_MotorSpeedDrtGainMin" FLOAT32_IEEE F_1_p0_2 1 2 0 1 ECU_ADDRESS 0x70002C84 /end MEASUREMENT
/begin MEASUREMENT AFTCIVDC_1ByUbatHV "AFTCIVDC_1ByUbatHV" FLOAT32_IEEE F_1_p0_2 1 2 0.0001 1 ECU_ADDRESS 0x70002D00 /end MEASUREMENT
/begin MEASUREMENT AFTCIVDC_CompDutyUZ "AFTCIVDC_CompDutyUZ" FLOAT32_IEEE F_1_p0_2 1 2 -3.402823466E+038 3.402823466E+038 ECU_ADDRESS 0x70002CFC /end MEASUREMENT
/begin MEASUREMENT AFTCIVDC_CompDutyVZ "AFTCIVDC_CompDutyVZ" FLOAT32_IEEE F_1_p0_2 1 2 -3.402823466E+038 3.402823466E+038 ECU_ADDRESS 0x70002CF8 /end MEASUREMENT
/begin MEASUREMENT AFTCIVDC_CompDutyWZ "AFTCIVDC_CompDutyWZ" FLOAT32_IEEE F_1_p0_2 1 2 -3.402823466E+038 3.402823466E+038 ECU_ADDRESS 0x70002CF4 /end MEASUREMENT
/begin MEASUREMENT AFTCIVDC_CurrDeltaThetaRd "AFTCIVDC_CurrDeltaThetaRd" FLOAT32_IEEE F_1_p0_2 1 2 -3.402823466E+038 3.402823466E+038 ECU_ADDRESS 0x70002CF0 /end MEASUREMENT
/begin MEASUREMENT AFTCIVDC_DeadCompEnRelayZ "AFTCIVDC_DeadCompEnRelayZ" UBYTE Bool_ON_OFF 1 2 0 1 BIT_MASK 0x01 ECU_ADDRESS 0x70002CEE /end MEASUREMENT
/begin MEASUREMENT AFTCIVDC_DeadCompNumberZ "AFTCIVDC_DeadCompNumberZ" UBYTE F_1_p0_2 1 2 0 255 ECU_ADDRESS 0x70002CED /end MEASUREMENT
/begin MEASUREMENT AFTCIVDC_DeadZnEnaFlg "AFTCIVDC_DeadZnEnaFlg" UBYTE Bool_ON_OFF 1 2 0 1 BIT_MASK 0x01 ECU_ADDRESS 0x70002CEC /end MEASUREMENT
/begin MEASUREMENT AFTCIVDC_DutyCycle3[0] "AFTCIVDC_DutyCycle3" FLOAT32_IEEE F_1_p0_2 1 2 0 1 ECU_ADDRESS 0x70002CE0 /end MEASUREMENT
/begin MEASUREMENT AFTCIVDC_DutyCycle3[1] "AFTCIVDC_DutyCycle3" FLOAT32_IEEE F_1_p0_2 1 2 0 1 ECU_ADDRESS 0x70002CE4 /end MEASUREMENT
/begin MEASUREMENT AFTCIVDC_DutyCycle3[2] "AFTCIVDC_DutyCycle3" FLOAT32_IEEE F_1_p0_2 1 2 0 1 ECU_ADDRESS 0x70002CE8 /end MEASUREMENT
/begin MEASUREMENT AFTCIVDC_DutyCycleMinMax[0] "AFTCIVDC_DutyCycleMinMax" FLOAT32_IEEE F_1_p0_2 1 2 0 1 ECU_ADDRESS 0x70002CD8 /end MEASUREMENT
/begin MEASUREMENT AFTCIVDC_DutyCycleMinMax[1] "AFTCIVDC_DutyCycleMinMax" FLOAT32_IEEE F_1_p0_2 1 2 0 1 ECU_ADDRESS 0x70002CDC /end MEASUREMENT
/begin MEASUREMENT AFTCIVDC_DutyCycleOrg3[0] "AFTCIVDC_DutyCycleOrg3" FLOAT32_IEEE F_1_p0_2 1 2 -3.402823466E+038 3.402823466E+038 ECU_ADDRESS 0x70002CCC /end MEASUREMENT
/begin MEASUREMENT AFTCIVDC_DutyCycleOrg3[1] "AFTCIVDC_DutyCycleOrg3" FLOAT32_IEEE F_1_p0_2 1 2 -3.402823466E+038 3.402823466E+038 ECU_ADDRESS 0x70002CD0 /end MEASUREMENT
/begin MEASUREMENT AFTCIVDC_DutyCycleOrg3[2] "AFTCIVDC_DutyCycleOrg3" FLOAT32_IEEE F_1_p0_2 1 2 -3.402823466E+038 3.402823466E+038 ECU_ADDRESS 0x70002CD4 /end MEASUREMENT
/begin MEASUREMENT AFTCIVDC_IdFildZ "AFTCIVDC_IdFildZ" FLOAT32_IEEE F_1_p0_2 1 2 -3.402823466E+038 3.402823466E+038 ECU_ADDRESS 0x70002CC8 /end MEASUREMENT
/begin MEASUREMENT AFTCIVDC_IqFildZ "AFTCIVDC_IqFildZ" FLOAT32_IEEE F_1_p0_2 1 2 -3.402823466E+038 3.402823466E+038 ECU_ADDRESS 0x70002CC4 /end MEASUREMENT
/begin MEASUREMENT AFTCIVDC_Iuvw3Z[0] "AFTCIVDC_Iuvw3Z" FLOAT32_IEEE F_1_p0_2 1 2 -3.402823466E+038 3.402823466E+038 ECU_ADDRESS 0x70002CB8 /end MEASUREMENT
/begin MEASUREMENT AFTCIVDC_Iuvw3Z[1] "AFTCIVDC_Iuvw3Z" FLOAT32_IEEE F_1_p0_2 1 2 -3.402823466E+038 3.402823466E+038 ECU_ADDRESS 0x70002CBC /end MEASUREMENT
/begin MEASUREMENT AFTCIVDC_Iuvw3Z[2] "AFTCIVDC_Iuvw3Z" FLOAT32_IEEE F_1_p0_2 1 2 -3.402823466E+038 3.402823466E+038 ECU_ADDRESS 0x70002CC0 /end MEASUREMENT
/begin MEASUREMENT AFTCIVDC_MecaSpeedRpmFild "AFTCIVDC_MecaSpeedRpmFild" FLOAT32_IEEE F_1_p0_2 1 2 -3.402823466E+038 3.402823466E+038 ECU_ADDRESS 0x70002CB4 /end MEASUREMENT
/begin MEASUREMENT AFTCIVDC_MecaSpeedRpmZ "AFTCIVDC_MecaSpeedRpmZ" FLOAT32_IEEE F_1_p0_2 1 2 -3.402823466E+038 3.402823466E+038 ECU_ADDRESS 0x70002CB0 /end MEASUREMENT
/begin MEASUREMENT AFTCIVDC_PwmFrequence "AFTCIVDC_PwmFrequence" UWORD F_1_p0_2 1 2 0 65535 ECU_ADDRESS 0x70002CAE /end MEASUREMENT
/begin MEASUREMENT AFTCIVDC_PwmFrequenceZ "AFTCIVDC_PwmFrequenceZ" UWORD F_1_p0_2 1 2 0 65535 ECU_ADDRESS 0x70002CAC /end MEASUREMENT
/begin MEASUREMENT AFTCIVDC_PwmOnOff3[0] "AFTCIVDC_PwmOnOff3" UBYTE Bool_ON_OFF 1 2 0 1 BIT_MASK 0x01 ECU_ADDRESS 0x70002CA8 /end MEASUREMENT
/begin MEASUREMENT AFTCIVDC_PwmOnOff3[1] "AFTCIVDC_PwmOnOff3" UBYTE Bool_ON_OFF 1 2 0 1 BIT_MASK 0x01 ECU_ADDRESS 0x70002CA9 /end MEASUREMENT
/begin MEASUREMENT AFTCIVDC_PwmOnOff3[2] "AFTCIVDC_PwmOnOff3" UBYTE Bool_ON_OFF 1 2 0 1 BIT_MASK 0x01 ECU_ADDRESS 0x70002CAA /end MEASUREMENT
/begin MEASUREMENT AFTCIVDC_SimpleUVW3[0] "AFTCIVDC_SimpleUVW3" FLOAT32_IEEE F_1_p0_2 1 2 0 2000 ECU_ADDRESS 0x70002C9C /end MEASUREMENT
/begin MEASUREMENT AFTCIVDC_SimpleUVW3[1] "AFTCIVDC_SimpleUVW3" FLOAT32_IEEE F_1_p0_2 1 2 0 2000 ECU_ADDRESS 0x70002CA0 /end MEASUREMENT
/begin MEASUREMENT AFTCIVDC_SimpleUVW3[2] "AFTCIVDC_SimpleUVW3" FLOAT32_IEEE F_1_p0_2 1 2 0 2000 ECU_ADDRESS 0x70002CA4 /end MEASUREMENT
/begin MEASUREMENT AFTCIVDC_UM0zeroTgt "AFTCIVDC_UM0zeroTgt" FLOAT32_IEEE F_1_p0_2 1 2 0 2000 ECU_ADDRESS 0x70002C98 /end MEASUREMENT
/begin MEASUREMENT AFTCIVDC_UM1AlphaTgt "AFTCIVDC_UM1AlphaTgt" FLOAT32_IEEE F_1_p0_2 1 2 0 2000 ECU_ADDRESS 0x70002C94 /end MEASUREMENT
/begin MEASUREMENT AFTCIVDC_UM1BetaTgt "AFTCIVDC_UM1BetaTgt" FLOAT32_IEEE F_1_p0_2 1 2 0 2000 ECU_ADDRESS 0x70002C90 /end MEASUREMENT
/begin MEASUREMENT AFTCIVDC_UbatHV "AFTCIVDC_UbatHV" FLOAT32_IEEE F_1_p0_2 1 2 0 2000 ECU_ADDRESS 0x70002C8C /end MEASUREMENT
/begin MEASUREMENT AFTCMCCS_EM1dOpenLoopEst "AFTCMCCS_EM1dOpenLoopEst" FLOAT32_IEEE F_1_p0_2 1 2 -3.402823466E+038 3.402823466E+038 ECU_ADDRESS 0x70002DD0 /end MEASUREMENT
/begin MEASUREMENT AFTCMCCS_EM1qOpenLoopEst "AFTCMCCS_EM1qOpenLoopEst" FLOAT32_IEEE F_1_p0_2 1 2 -3.402823466E+038 3.402823466E+038 ECU_ADDRESS 0x70002DCC /end MEASUREMENT
/begin MEASUREMENT AFTCMCCS_EpsilonM0Ctrl "AFTCMCCS_EpsilonM0Ctrl" FLOAT32_IEEE F_1_p0_2 1 2 -3.402823466E+038 3.402823466E+038 ECU_ADDRESS 0x70002DC8 /end MEASUREMENT
/begin MEASUREMENT AFTCMCCS_EpsilonM1dCtrl "AFTCMCCS_EpsilonM1dCtrl" FLOAT32_IEEE F_1_p0_2 1 2 -3.402823466E+038 3.402823466E+038 ECU_ADDRESS 0x70002DC4 /end MEASUREMENT
/begin MEASUREMENT AFTCMCCS_EpsilonM1qCtrl "AFTCMCCS_EpsilonM1qCtrl" FLOAT32_IEEE F_1_p0_2 1 2 -3.402823466E+038 3.402823466E+038 ECU_ADDRESS 0x70002DC0 /end MEASUREMENT
/begin MEASUREMENT AFTCMCCS_HFIPeriodCntZ "AFTCMCCS_HFIPeriodCntZ" FLOAT32_IEEE F_1_p0_2 1 2 -3.402823466E+038 3.402823466E+038 ECU_ADDRESS 0x70002DBC /end MEASUREMENT
/begin MEASUREMENT AFTCMCCS_HFIPeriodThetaRd "AFTCMCCS_HFIPeriodThetaRd" FLOAT32_IEEE F_1_p0_2 1 2 -3.402823466E+038 3.402823466E+038 ECU_ADDRESS 0x70002DB8 /end MEASUREMENT
/begin MEASUREMENT AFTCMCCS_HFIPeriodThetaRdZ "AFTCMCCS_HFIPeriodThetaRdZ" FLOAT32_IEEE F_1_p0_2 1 2 -3.402823466E+038 3.402823466E+038 ECU_ADDRESS 0x70002DB4 /end MEASUREMENT
/begin MEASUREMENT AFTCMCCS_HFIUdInject "AFTCMCCS_HFIUdInject" FLOAT32_IEEE F_1_p0_2 1 2 -3.402823466E+038 3.402823466E+038 ECU_ADDRESS 0x70002DB0 /end MEASUREMENT
/begin MEASUREMENT AFTCMCCS_HFIUdInjectBasicSinCos[0] "AFTCMCCS_HFIUdInjectBasicSinCos" FLOAT32_IEEE F_1_p0_2 1 2 -3.402823466E+038 3.402823466E+038 ECU_ADDRESS 0x70002DA8 /end MEASUREMENT
/begin MEASUREMENT AFTCMCCS_HFIUdInjectBasicSinCos[1] "AFTCMCCS_HFIUdInjectBasicSinCos" FLOAT32_IEEE F_1_p0_2 1 2 -3.402823466E+038 3.402823466E+038 ECU_ADDRESS 0x70002DAC /end MEASUREMENT
/begin MEASUREMENT AFTCMCCS_HFIVinj "AFTCMCCS_HFIVinj" FLOAT32_IEEE F_1_p0_2 1 2 -3.402823466E+038 3.402823466E+038 ECU_ADDRESS 0x70002DA4 /end MEASUREMENT
/begin MEASUREMENT AFTCMCCS_Lm1d "AFTCMCCS_Lm1d" FLOAT32_IEEE F_1_p0_2 1 2 -3.402823466E+038 3.402823466E+038 ECU_ADDRESS 0x70002DA0 /end MEASUREMENT
/begin MEASUREMENT AFTCMCCS_Lm1q "AFTCMCCS_Lm1q" FLOAT32_IEEE F_1_p0_2 1 2 -3.402823466E+038 3.402823466E+038 ECU_ADDRESS 0x70002D9C /end MEASUREMENT
/begin MEASUREMENT AFTCMCCS_LutOutM1dCtrlTr "AFTCMCCS_LutOutM1dCtrlTr" FLOAT32_IEEE F_1_p0_2 1 2 -3.402823466E+038 3.402823466E+038 ECU_ADDRESS 0x70002D98 /end MEASUREMENT
/begin MEASUREMENT AFTCMCCS_LutOutM1qCtrlTr "AFTCMCCS_LutOutM1qCtrlTr" FLOAT32_IEEE F_1_p0_2 1 2 -3.402823466E+038 3.402823466E+038 ECU_ADDRESS 0x70002D94 /end MEASUREMENT
/begin MEASUREMENT AFTCMCCS_LutOutiM1dTgtFildTr "AFTCMCCS_LutOutiM1dTgtFildTr" FLOAT32_IEEE F_1_p0_2 1 2 -3.402823466E+038 3.402823466E+038 ECU_ADDRESS 0x70002D90 /end MEASUREMENT
/begin MEASUREMENT AFTCMCCS_LutOutiM1qTgtFildTr "AFTCMCCS_LutOutiM1qTgtFildTr" FLOAT32_IEEE F_1_p0_2 1 2 -3.402823466E+038 3.402823466E+038 ECU_ADDRESS 0x70002D8C /end MEASUREMENT
/begin MEASUREMENT AFTCMCCS_M0CtrlIntegratorZ "AFTCMCCS_M0CtrlIntegratorZ" FLOAT32_IEEE F_1_p0_2 1 2 -3.402823466E+038 3.402823466E+038 ECU_ADDRESS 0x70002D88 /end MEASUREMENT
/begin MEASUREMENT AFTCMCCS_M0CtrlKi "AFTCMCCS_M0CtrlKi" FLOAT32_IEEE F_1_p0_2 1 2 -3.402823466E+038 3.402823466E+038 ECU_ADDRESS 0x70002D84 /end MEASUREMENT
/begin MEASUREMENT AFTCMCCS_M0CtrlKp "AFTCMCCS_M0CtrlKp" FLOAT32_IEEE F_1_p0_2 1 2 -3.402823466E+038 3.402823466E+038 ECU_ADDRESS 0x70002D80 /end MEASUREMENT
/begin MEASUREMENT AFTCMCCS_M0CtrlTgt "AFTCMCCS_M0CtrlTgt" FLOAT32_IEEE F_1_p0_2 1 2 -3.402823466E+038 3.402823466E+038 ECU_ADDRESS 0x70002D7C /end MEASUREMENT
/begin MEASUREMENT AFTCMCCS_M1dCtrlIntegratorZ "AFTCMCCS_M1dCtrlIntegratorZ" FLOAT32_IEEE F_1_p0_2 1 2 -3.402823466E+038 3.402823466E+038 ECU_ADDRESS 0x70002D78 /end MEASUREMENT
/begin MEASUREMENT AFTCMCCS_M1dCtrlKi "AFTCMCCS_M1dCtrlKi" FLOAT32_IEEE F_1_p0_2 1 2 -3.402823466E+038 3.402823466E+038 ECU_ADDRESS 0x70002D74 /end MEASUREMENT
/begin MEASUREMENT AFTCMCCS_M1dCtrlKp "AFTCMCCS_M1dCtrlKp" FLOAT32_IEEE F_1_p0_2 1 2 -3.402823466E+038 3.402823466E+038 ECU_ADDRESS 0x70002D70 /end MEASUREMENT
/begin MEASUREMENT AFTCMCCS_M1dCtrlTgt "AFTCMCCS_M1dCtrlTgt" FLOAT32_IEEE F_1_p0_2 1 2 -3.402823466E+038 3.402823466E+038 ECU_ADDRESS 0x70002D6C /end MEASUREMENT
/begin MEASUREMENT AFTCMCCS_M1dCtrlTr "AFTCMCCS_M1dCtrlTr" FLOAT32_IEEE F_1_p0_2 1 2 -3.402823466E+038 3.402823466E+038 ECU_ADDRESS 0x70002D68 /end MEASUREMENT
/begin MEASUREMENT AFTCMCCS_M1qCtrlIntegratorZ "AFTCMCCS_M1qCtrlIntegratorZ" FLOAT32_IEEE F_1_p0_2 1 2 -3.402823466E+038 3.402823466E+038 ECU_ADDRESS 0x70002D64 /end MEASUREMENT
/begin MEASUREMENT AFTCMCCS_M1qCtrlKi "AFTCMCCS_M1qCtrlKi" FLOAT32_IEEE F_1_p0_2 1 2 -3.402823466E+038 3.402823466E+038 ECU_ADDRESS 0x70002D60 /end MEASUREMENT
/begin MEASUREMENT AFTCMCCS_M1qCtrlKp "AFTCMCCS_M1qCtrlKp" FLOAT32_IEEE F_1_p0_2 1 2 -3.402823466E+038 3.402823466E+038 ECU_ADDRESS 0x70002D5C /end MEASUREMENT
/begin MEASUREMENT AFTCMCCS_M1qCtrlTgt "AFTCMCCS_M1qCtrlTgt" FLOAT32_IEEE F_1_p0_2 1 2 -3.402823466E+038 3.402823466E+038 ECU_ADDRESS 0x70002D58 /end MEASUREMENT
/begin MEASUREMENT AFTCMCCS_M1qCtrlTr "AFTCMCCS_M1qCtrlTr" FLOAT32_IEEE F_1_p0_2 1 2 -3.402823466E+038 3.402823466E+038 ECU_ADDRESS 0x70002D54 /end MEASUREMENT
/begin MEASUREMENT AFTCMCCS_Phim "AFTCMCCS_Phim" FLOAT32_IEEE F_1_p0_2 1 2 -3.402823466E+038 3.402823466E+038 ECU_ADDRESS 0x70002D50 /end MEASUREMENT
/begin MEASUREMENT AFTCMCCS_Rs "AFTCMCCS_Rs" FLOAT32_IEEE F_1_p0_2 1 2 -3.402823466E+038 3.402823466E+038 ECU_ADDRESS 0x70002D4C /end MEASUREMENT
/begin MEASUREMENT AFTCMCCS_SampleTime3ST "AFTCMCCS_SampleTime3ST" FLOAT32_IEEE F_1_p0_2 1 2 -3.402823466E+038 3.402823466E+038 ECU_ADDRESS 0x70002D48 /end MEASUREMENT
/begin MEASUREMENT AFTCMCCS_SampleTimeF32 "AFTCMCCS_SampleTimeF32" FLOAT32_IEEE F_1_p0_2 1 2 -3.402823466E+038 3.402823466E+038 ECU_ADDRESS 0x70002D44 /end MEASUREMENT
/begin MEASUREMENT AFTCMCCS_TotalI0dqTgt3[0] "AFTCMCCS_TotalI0dqTgt3" FLOAT32_IEEE F_1_p0_2 1 2 -3.402823466E+038 3.402823466E+038 ECU_ADDRESS 0x70002D38 /end MEASUREMENT
/begin MEASUREMENT AFTCMCCS_TotalI0dqTgt3[1] "AFTCMCCS_TotalI0dqTgt3" FLOAT32_IEEE F_1_p0_2 1 2 -3.402823466E+038 3.402823466E+038 ECU_ADDRESS 0x70002D3C /end MEASUREMENT
/begin MEASUREMENT AFTCMCCS_TotalI0dqTgt3[2] "AFTCMCCS_TotalI0dqTgt3" FLOAT32_IEEE F_1_p0_2 1 2 -3.402823466E+038 3.402823466E+038 ECU_ADDRESS 0x70002D40 /end MEASUREMENT
/begin MEASUREMENT AFTCMCCS_TransEmfM1d "AFTCMCCS_TransEmfM1d" FLOAT32_IEEE F_1_p0_2 1 2 -3.402823466E+038 3.402823466E+038 ECU_ADDRESS 0x70002D34 /end MEASUREMENT
/begin MEASUREMENT AFTCMCCS_TransEmfM1q "AFTCMCCS_TransEmfM1q" FLOAT32_IEEE F_1_p0_2 1 2 -3.402823466E+038 3.402823466E+038 ECU_ADDRESS 0x70002D30 /end MEASUREMENT
/begin MEASUREMENT AFTCMCCS_TransUd "AFTCMCCS_TransUd" FLOAT32_IEEE F_1_p0_2 1 2 -3.402823466E+038 3.402823466E+038 ECU_ADDRESS 0x70002D2C /end MEASUREMENT
/begin MEASUREMENT AFTCMCCS_TransUq "AFTCMCCS_TransUq" FLOAT32_IEEE F_1_p0_2 1 2 -3.402823466E+038 3.402823466E+038 ECU_ADDRESS 0x70002D28 /end MEASUREMENT
/begin MEASUREMENT AFTCMCCS_U0dqTgt3[0] "AFTCMCCS_U0dqTgt3" FLOAT32_IEEE F_1_p0_2 1 2 -3.402823466E+038 3.402823466E+038 ECU_ADDRESS 0x70002D1C /end MEASUREMENT
/begin MEASUREMENT AFTCMCCS_U0dqTgt3[1] "AFTCMCCS_U0dqTgt3" FLOAT32_IEEE F_1_p0_2 1 2 -3.402823466E+038 3.402823466E+038 ECU_ADDRESS 0x70002D20 /end MEASUREMENT
/begin MEASUREMENT AFTCMCCS_U0dqTgt3[2] "AFTCMCCS_U0dqTgt3" FLOAT32_IEEE F_1_p0_2 1 2 -3.402823466E+038 3.402823466E+038 ECU_ADDRESS 0x70002D24 /end MEASUREMENT
/begin MEASUREMENT AFTCMCCS_UM1dTgt "AFTCMCCS_UM1dTgt" FLOAT32_IEEE F_1_p0_2 1 2 -3.402823466E+038 3.402823466E+038 ECU_ADDRESS 0x70002D18 /end MEASUREMENT
/begin MEASUREMENT AFTCMCCS_UM1qTgt "AFTCMCCS_UM1qTgt" FLOAT32_IEEE F_1_p0_2 1 2 -3.402823466E+038 3.402823466E+038 ECU_ADDRESS 0x70002D14 /end MEASUREMENT
/begin MEASUREMENT AFTCMCCS_iM1dTgtFild "AFTCMCCS_iM1dTgtFild" FLOAT32_IEEE F_1_p0_2 1 2 -3.402823466E+038 3.402823466E+038 ECU_ADDRESS 0x70002D10 /end MEASUREMENT
/begin MEASUREMENT AFTCMCCS_iM1dTgtFildZ "AFTCMCCS_iM1dTgtFildZ" FLOAT32_IEEE F_1_p0_2 1 2 -3.402823466E+038 3.402823466E+038 ECU_ADDRESS 0x70002D0C /end MEASUREMENT
/begin MEASUREMENT AFTCMCCS_iM1qTgtFild "AFTCMCCS_iM1qTgtFild" FLOAT32_IEEE F_1_p0_2 1 2 -3.402823466E+038 3.402823466E+038 ECU_ADDRESS 0x70002D08 /end MEASUREMENT
/begin MEASUREMENT AFTCMCCS_iM1qTgtFildZ "AFTCMCCS_iM1qTgtFildZ" FLOAT32_IEEE F_1_p0_2 1 2 -3.402823466E+038 3.402823466E+038 ECU_ADDRESS 0x70002D04 /end MEASUREMENT
/begin MEASUREMENT AFTCMRPC_HFIEstI0dq3[0] "value of the motor phase current in park frame" FLOAT32_IEEE F_1_p0_2 1 2 -3.402823466E+038 3.402823466E+038 ECU_ADDRESS 0x70002E64 /end MEASUREMENT
/begin MEASUREMENT AFTCMRPC_HFIEstI0dq3[1] "value of the motor phase current in park frame" FLOAT32_IEEE F_1_p0_2 1 2 -3.402823466E+038 3.402823466E+038 ECU_ADDRESS 0x70002E68 /end MEASUREMENT
/begin MEASUREMENT AFTCMRPC_HFIEstI0dq3[2] "value of the motor phase current in park frame" FLOAT32_IEEE F_1_p0_2 1 2 -3.402823466E+038 3.402823466E+038 ECU_ADDRESS 0x70002E6C /end MEASUREMENT
/begin MEASUREMENT AFTCMRPC_HFIIdsi "AFTCMRPC_HFIIdsi" FLOAT32_IEEE F_1_p0_2 1 2 -3.402823466E+038 3.402823466E+038 ECU_ADDRESS 0x70002E60 /end MEASUREMENT
/begin MEASUREMENT AFTCMRPC_HFIIdsi_m "AFTCMRPC_HFIIdsi_m" FLOAT32_IEEE F_1_p0_2 1 2 -3.402823466E+038 3.402823466E+038 ECU_ADDRESS 0x70002E5C /end MEASUREMENT
/begin MEASUREMENT AFTCMRPC_HFIIdsi_mAbs "AFTCMRPC_HFIIdsi_mAbs" FLOAT32_IEEE F_1_p0_2 1 2 -3.402823466E+038 3.402823466E+038 ECU_ADDRESS 0x70002E58 /end MEASUREMENT
/begin MEASUREMENT AFTCMRPC_HFIIqsi "AFTCMRPC_HFIIqsi" FLOAT32_IEEE F_1_p0_2 1 2 -3.402823466E+038 3.402823466E+038 ECU_ADDRESS 0x70002E54 /end MEASUREMENT
/begin MEASUREMENT AFTCMRPC_HFIIqsi_m "AFTCMRPC_HFIIqsi_m" FLOAT32_IEEE F_1_p0_2 1 2 -3.402823466E+038 3.402823466E+038 ECU_ADDRESS 0x70002E50 /end MEASUREMENT
/begin MEASUREMENT AFTCMRPC_HFIIqsi_mAbs "AFTCMRPC_HFIIqsi_mAbs" FLOAT32_IEEE F_1_p0_2 1 2 -3.402823466E+038 3.402823466E+038 ECU_ADDRESS 0x70002E4C /end MEASUREMENT
/begin MEASUREMENT AFTCMRPC_HFIK "value of the motor phase current in park frame" FLOAT32_IEEE F_1_p0_2 1 2 -3.402823466E+038 3.402823466E+038 ECU_ADDRESS 0x70002E48 /end MEASUREMENT
/begin MEASUREMENT AFTCMRPC_HFIPLLIntSpdRds "AFTCMRPC_HFIPLLIntSpdRds" FLOAT32_IEEE F_1_p0_2 1 2 -3.402823466E+038 3.402823466E+038 ECU_ADDRESS 0x70002E44 /end MEASUREMENT
/begin MEASUREMENT AFTCMRPC_HFIPLLIntSpdRdsSurTZ "AFTCMRPC_HFIPLLIntSpdRdsSurTZ" FLOAT32_IEEE F_1_p0_2 1 2 -3.402823466E+038 3.402823466E+038 ECU_ADDRESS 0x70002E40 /end MEASUREMENT
/begin MEASUREMENT AFTCMRPC_HFIPLLSpdRdsFild "AFTCMRPC_HFIPLLSpdRdsFild" FLOAT32_IEEE F_1_p0_2 1 2 -3.402823466E+038 3.402823466E+038 ECU_ADDRESS 0x70002E3C /end MEASUREMENT
/begin MEASUREMENT AFTCMRPC_HFIPLLSpdRdsFildZ "AFTCMRPC_HFIPLLSpdRdsFildZ" FLOAT32_IEEE F_1_p0_2 1 2 -3.402823466E+038 3.402823466E+038 ECU_ADDRESS 0x70002E38 /end MEASUREMENT
/begin MEASUREMENT AFTCMRPC_HFIPLLThetaOriginal "value of the motor phase current in park frame" FLOAT32_IEEE F_1_p0_2 1 2 -3.402823466E+038 3.402823466E+038 ECU_ADDRESS 0x70002E34 /end MEASUREMENT
/begin MEASUREMENT AFTCMRPC_HFIPLLThetaOriginalZ "value of the motor phase current in park frame" FLOAT32_IEEE F_1_p0_2 1 2 -3.402823466E+038 3.402823466E+038 ECU_ADDRESS 0x70002E30 /end MEASUREMENT
/begin MEASUREMENT AFTCMRPC_HFIPLLThetaRd "value of the motor phase current in park frame" FLOAT32_IEEE F_1_p0_2 1 2 -3.402823466E+038 3.402823466E+038 ECU_ADDRESS 0x70002E2C /end MEASUREMENT
/begin MEASUREMENT AFTCMRPC_HFIPLLThetaSinCosZ[0] "AFTCMRPC_HFIPLLThetaSinCosZ" FLOAT32_IEEE F_1_p0_2 1 2 -3.402823466E+038 3.402823466E+038 ECU_ADDRESS 0x70002E1C /end MEASUREMENT
/begin MEASUREMENT AFTCMRPC_HFIPLLThetaSinCosZ[1] "AFTCMRPC_HFIPLLThetaSinCosZ" FLOAT32_IEEE F_1_p0_2 1 2 -3.402823466E+038 3.402823466E+038 ECU_ADDRESS 0x70002E20 /end MEASUREMENT
/begin MEASUREMENT AFTCMRPC_HFIPLLThetaSinCos[0] "AFTCMRPC_HFIPLLThetaSinCos" FLOAT32_IEEE F_1_p0_2 1 2 -3.402823466E+038 3.402823466E+038 ECU_ADDRESS 0x70002E24 /end MEASUREMENT
/begin MEASUREMENT AFTCMRPC_HFIPLLThetaSinCos[1] "AFTCMRPC_HFIPLLThetaSinCos" FLOAT32_IEEE F_1_p0_2 1 2 -3.402823466E+038 3.402823466E+038 ECU_ADDRESS 0x70002E28 /end MEASUREMENT
/begin MEASUREMENT AFTCMRPC_HFISHThetaSinCos[0] "AFTCMRPC_HFISHThetaSinCos" FLOAT32_IEEE F_1_p0_2 1 2 -3.402823466E+038 3.402823466E+038 ECU_ADDRESS 0x70002E14 /end MEASUREMENT
/begin MEASUREMENT AFTCMRPC_HFISHThetaSinCos[1] "AFTCMRPC_HFISHThetaSinCos" FLOAT32_IEEE F_1_p0_2 1 2 -3.402823466E+038 3.402823466E+038 ECU_ADDRESS 0x70002E18 /end MEASUREMENT
/begin MEASUREMENT AFTCMRPC_HFISecondHarmonic "AFTCMRPC_HFISecondHarmonic" FLOAT32_IEEE F_1_p0_2 1 2 -3.402823466E+038 3.402823466E+038 ECU_ADDRESS 0x70002E10 /end MEASUREMENT
/begin MEASUREMENT AFTCMRPC_HFISecondHarmonicFbd "AFTCMRPC_HFISecondHarmonicFbd" FLOAT32_IEEE F_1_p0_2 1 2 -3.402823466E+038 3.402823466E+038 ECU_ADDRESS 0x70002E0C /end MEASUREMENT
/begin MEASUREMENT AFTCMRPC_HFISecondHarmonicFbdZ "AFTCMRPC_HFISecondHarmonicFbdZ" FLOAT32_IEEE F_1_p0_2 1 2 -3.402823466E+038 3.402823466E+038 ECU_ADDRESS 0x70002E08 /end MEASUREMENT
/begin MEASUREMENT AFTCMRPC_HFISecondHarmonicSurTZ "AFTCMRPC_HFISecondHarmonicSurTZ" FLOAT32_IEEE F_1_p0_2 1 2 -3.402823466E+038 3.402823466E+038 ECU_ADDRESS 0x70002E04 /end MEASUREMENT
/begin MEASUREMENT AFTCMRPC_HFISecondHarmonicZZ "AFTCMRPC_HFISecondHarmonicZZ" FLOAT32_IEEE F_1_p0_2 1 2 -3.402823466E+038 3.402823466E+038 ECU_ADDRESS 0x70002E00 /end MEASUREMENT
/begin MEASUREMENT AFTCMRPC_HFIThetaErr "value of the motor phase current in park frame" FLOAT32_IEEE F_1_p0_2 1 2 -3.402823466E+038 3.402823466E+038 ECU_ADDRESS 0x70002DFC /end MEASUREMENT
/begin MEASUREMENT AFTCMRPC_I0AlphaBeta[0] "AFTCMRPC_I0AlphaBeta" FLOAT32_IEEE F_1_p0_2 1 2 -3.402823466E+038 3.402823466E+038 ECU_ADDRESS 0x70002DF0 /end MEASUREMENT
/begin MEASUREMENT AFTCMRPC_I0AlphaBeta[1] "AFTCMRPC_I0AlphaBeta" FLOAT32_IEEE F_1_p0_2 1 2 -3.402823466E+038 3.402823466E+038 ECU_ADDRESS 0x70002DF4 /end MEASUREMENT
/begin MEASUREMENT AFTCMRPC_I0AlphaBeta[2] "AFTCMRPC_I0AlphaBeta" FLOAT32_IEEE F_1_p0_2 1 2 -3.402823466E+038 3.402823466E+038 ECU_ADDRESS 0x70002DF8 /end MEASUREMENT
/begin MEASUREMENT AFTCMRPC_I0dq3[0] "value of the motor phase current in park frame" FLOAT32_IEEE F_1_p0_2 1 2 -3.402823466E+038 3.402823466E+038 ECU_ADDRESS 0x70002DE4 /end MEASUREMENT
/begin MEASUREMENT AFTCMRPC_I0dq3[1] "value of the motor phase current in park frame" FLOAT32_IEEE F_1_p0_2 1 2 -3.402823466E+038 3.402823466E+038 ECU_ADDRESS 0x70002DE8 /end MEASUREMENT
/begin MEASUREMENT AFTCMRPC_I0dq3[2] "value of the motor phase current in park frame" FLOAT32_IEEE F_1_p0_2 1 2 -3.402823466E+038 3.402823466E+038 ECU_ADDRESS 0x70002DEC /end MEASUREMENT
/begin MEASUREMENT AFTCMRPC_IdZ "AFTCMRPC_IdZ" FLOAT32_IEEE F_1_p0_2 1 2 -3.402823466E+038 3.402823466E+038 ECU_ADDRESS 0x70002DE0 /end MEASUREMENT
/begin MEASUREMENT AFTCMRPC_IdZZ "AFTCMRPC_IdZZ" FLOAT32_IEEE F_1_p0_2 1 2 -3.402823466E+038 3.402823466E+038 ECU_ADDRESS 0x70002DDC /end MEASUREMENT
/begin MEASUREMENT AFTCMRPC_IqZ "AFTCMRPC_IqZ" FLOAT32_IEEE F_1_p0_2 1 2 -3.402823466E+038 3.402823466E+038 ECU_ADDRESS 0x70002DD8 /end MEASUREMENT
/begin MEASUREMENT AFTCMRPC_IqZZ "AFTCMRPC_IqZZ" FLOAT32_IEEE F_1_p0_2 1 2 -3.402823466E+038 3.402823466E+038 ECU_ADDRESS 0x70002DD4 /end MEASUREMENT
/begin MEASUREMENT AFTCMSCS_ActState "AFTCMSCS_ActState" UWORD F_1_p0_2 1 2 0 65535 ECU_ADDRESS 0x70002F4A /end MEASUREMENT
/begin MEASUREMENT AFTCMSCS_ClimbOverCnt "AFTCMSCS_ClimbOverCnt" UWORD F_1_p0_2 1 2 0 65535 ECU_ADDRESS 0x70002F48 /end MEASUREMENT
/begin MEASUREMENT AFTCMSCS_ClimbOverSpeedRpm "AFTCMSCS_ClimbOverSpeedRpm" FLOAT32_IEEE F_1_p0_2 1 2 -3.402823466E+038 3.402823466E+038 ECU_ADDRESS 0x70002F44 /end MEASUREMENT
/begin MEASUREMENT AFTCMSCS_ClimbSpeedRpmUpStep "AFTCMSCS_ClimbSpeedRpmUpStep" FLOAT32_IEEE F_1_p0_2 1 2 -3.402823466E+038 3.402823466E+038 ECU_ADDRESS 0x70002F40 /end MEASUREMENT
/begin MEASUREMENT AFTCMSCS_ClimbStIFAdaptGainZ "AFTCMSCS_ClimbStIFAdaptGainZ" FLOAT32_IEEE F_1_p0_2 1 2 -3.402823466E+038 3.402823466E+038 ECU_ADDRESS 0x70002F3C /end MEASUREMENT
/begin MEASUREMENT AFTCMSCS_ClimbStartAutoSatErrZ "AFTCMSCS_ClimbStartAutoSatErrZ" FLOAT32_IEEE F_1_p0_2 1 2 -3.402823466E+038 3.402823466E+038 ECU_ADDRESS 0x70002F38 /end MEASUREMENT
/begin MEASUREMENT AFTCMSCS_ClimbStartAutoSatZ "AFTCMSCS_ClimbStartAutoSatZ" UBYTE Bool_ON_OFF 1 2 0 1 BIT_MASK 0x01 ECU_ADDRESS 0x70002F34 /end MEASUREMENT
/begin MEASUREMENT AFTCMSCS_ClimbStartEmfD "AFTCMSCS_ClimbStartEmfD" FLOAT32_IEEE F_1_p0_2 1 2 -3.402823466E+038 3.402823466E+038 ECU_ADDRESS 0x70002F30 /end MEASUREMENT
/begin MEASUREMENT AFTCMSCS_ClimbStartIntegratorZ "AFTCMSCS_ClimbStartIntegratorZ" FLOAT32_IEEE F_1_p0_2 1 2 -3.402823466E+038 3.402823466E+038 ECU_ADDRESS 0x70002F2C /end MEASUREMENT
/begin MEASUREMENT AFTCMSCS_ClimbStartOverFlg "AFTCMSCS_ClimbStartOverFlg" UBYTE Bool_ON_OFF 1 2 0 1 BIT_MASK 0x01 ECU_ADDRESS 0x70002F28 /end MEASUREMENT
/begin MEASUREMENT AFTCMSCS_ClimbStartPm "AFTCMSCS_ClimbStartPm" FLOAT32_IEEE F_1_p0_2 1 2 -3.402823466E+038 3.402823466E+038 ECU_ADDRESS 0x70002F24 /end MEASUREMENT
/begin MEASUREMENT AFTCMSCS_ClimbStartPmDiffFild "AFTCMSCS_ClimbStartPmDiffFild" FLOAT32_IEEE F_1_p0_2 1 2 -3.402823466E+038 3.402823466E+038 ECU_ADDRESS 0x70002F20 /end MEASUREMENT
/begin MEASUREMENT AFTCMSCS_ClimbStartPmDiffFildZ "AFTCMSCS_ClimbStartPmDiffFildZ" FLOAT32_IEEE F_1_p0_2 1 2 -3.402823466E+038 3.402823466E+038 ECU_ADDRESS 0x70002F1C /end MEASUREMENT
/begin MEASUREMENT AFTCMSCS_ClimbStartPmZ "AFTCMSCS_ClimbStartPmZ" FLOAT32_IEEE F_1_p0_2 1 2 -3.402823466E+038 3.402823466E+038 ECU_ADDRESS 0x70002F18 /end MEASUREMENT
/begin MEASUREMENT AFTCMSCS_ClimbStartPq "AFTCMSCS_ClimbStartPq" FLOAT32_IEEE F_1_p0_2 1 2 -3.402823466E+038 3.402823466E+038 ECU_ADDRESS 0x70002F14 /end MEASUREMENT
/begin MEASUREMENT AFTCMSCS_CloseRunFailCnt "AFTCMSCS_CloseRunFailCnt" SWORD F_1_p0_2 1 2 -32768 32767 ECU_ADDRESS 0x70002F10 /end MEASUREMENT
/begin MEASUREMENT AFTCMSCS_CloseRunFailFlg "AFTCMSCS_CloseRunFailFlg" UBYTE Bool_ON_OFF 1 2 0 1 BIT_MASK 0x01 ECU_ADDRESS 0x70002F0E /end MEASUREMENT
/begin MEASUREMENT AFTCMSCS_CloseRunFailNumber "AFTCMSCS_CloseRunFailNumber" UWORD F_1_p0_2 1 2 0 65535 ECU_ADDRESS 0x70002F0C /end MEASUREMENT
/begin MEASUREMENT AFTCMSCS_CtrlIntegratorZ "AFTCMSCS_CtrlIntegratorZ" FLOAT32_IEEE F_1_p0_2 1 2 -3.402823466E+038 3.402823466E+038 ECU_ADDRESS 0x70002F08 /end MEASUREMENT
/begin MEASUREMENT AFTCMSCS_CtrlTgt "AFTCMSCS_CtrlTgt" FLOAT32_IEEE F_1_p0_2 1 2 -3.402823466E+038 3.402823466E+038 ECU_ADDRESS 0x70002F04 /end MEASUREMENT
/begin MEASUREMENT AFTCMSCS_CtrlTgtZ "AFTCMSCS_CtrlTgtZ" FLOAT32_IEEE F_1_p0_2 1 2 -3.402823466E+038 3.402823466E+038 ECU_ADDRESS 0x70002F00 /end MEASUREMENT
/begin MEASUREMENT AFTCMSCS_DampingSpeedRpmErr "AFTCMSCS_DampingSpeedRpmErr" FLOAT32_IEEE F_1_p0_2 1 2 -3.402823466E+038 3.402823466E+038 ECU_ADDRESS 0x70002EFC /end MEASUREMENT
/begin MEASUREMENT AFTCMSCS_Dece2ZeroCnt "AFTCMSCS_Dece2ZeroCnt" UWORD F_1_p0_2 1 2 0 65535 ECU_ADDRESS 0x70002EF8 /end MEASUREMENT
/begin MEASUREMENT AFTCMSCS_EleSpeedRdsTgt "AFTCMSCS_EleSpeedRdsTgt" FLOAT32_IEEE F_1_p0_2 1 2 -3.402823466E+038 3.402823466E+038 ECU_ADDRESS 0x70002EF4 /end MEASUREMENT
/begin MEASUREMENT AFTCMSCS_EpsilonCtrl "AFTCMSCS_EpsilonCtrl" FLOAT32_IEEE F_1_p0_2 1 2 -3.402823466E+038 3.402823466E+038 ECU_ADDRESS 0x70002EF0 /end MEASUREMENT
/begin MEASUREMENT AFTCMSCS_HFI2OBSCnt "AFTCMSCS_HFI2OBSCnt" SWORD F_1_p0_2 1 2 -32768 32767 ECU_ADDRESS 0x70002EEC /end MEASUREMENT
/begin MEASUREMENT AFTCMSCS_HFI2OBSElecSpdRdsMax "AFTCMSCS_HFI2OBSElecSpdRdsMax" FLOAT32_IEEE F_1_p0_2 1 2 -3.402823466E+038 3.402823466E+038 ECU_ADDRESS 0x70002EE8 /end MEASUREMENT
/begin MEASUREMENT AFTCMSCS_HFI2OBSElecSpdRdsMin "AFTCMSCS_HFI2OBSElecSpdRdsMin" FLOAT32_IEEE F_1_p0_2 1 2 -3.402823466E+038 3.402823466E+038 ECU_ADDRESS 0x70002EE4 /end MEASUREMENT
/begin MEASUREMENT AFTCMSCS_HFI2OBSOverFlg "AFTCMSCS_HFI2OBSOverFlg" UBYTE Bool_ON_OFF 1 2 0 1 BIT_MASK 0x01 ECU_ADDRESS 0x70002EE2 /end MEASUREMENT
/begin MEASUREMENT AFTCMSCS_HFICloseCnt "AFTCMSCS_HFICloseCnt" SWORD F_1_p0_2 1 2 -32768 32767 ECU_ADDRESS 0x70002EE0 /end MEASUREMENT
/begin MEASUREMENT AFTCMSCS_HFICloseFailFlg "AFTCMSCS_HFICloseFailFlg" UBYTE Bool_ON_OFF 1 2 0 1 BIT_MASK 0x01 ECU_ADDRESS 0x70002EDF /end MEASUREMENT
/begin MEASUREMENT AFTCMSCS_HFICloseFailNum "AFTCMSCS_HFICloseFailNum" UBYTE F_1_p0_2 1 2 0 255 ECU_ADDRESS 0x70002EDE /end MEASUREMENT
/begin MEASUREMENT AFTCMSCS_HFICloseOverFlg "AFTCMSCS_HFICloseOverFlg" UBYTE Bool_ON_OFF 1 2 0 1 BIT_MASK 0x01 ECU_ADDRESS 0x70002EDD /end MEASUREMENT
/begin MEASUREMENT AFTCMSCS_HFIENSEnable "AFTCMSCS_HFIENSEnable" UBYTE Bool_ON_OFF 1 2 0 1 BIT_MASK 0x01 ECU_ADDRESS 0x70002EDC /end MEASUREMENT
/begin MEASUREMENT AFTCMSCS_HFIElecThetaRdZ "AFTCMSCS_HFIElecThetaRdZ" FLOAT32_IEEE F_1_p0_2 1 2 -3.402823466E+038 3.402823466E+038 ECU_ADDRESS 0x70002ED8 /end MEASUREMENT
/begin MEASUREMENT AFTCMSCS_HFIEnable "AFTCMSCS_HFIEnable" UBYTE Bool_ON_OFF 1 2 0 1 BIT_MASK 0x01 ECU_ADDRESS 0x70002ED4 /end MEASUREMENT
/begin MEASUREMENT AFTCMSCS_HFINSAddTheta "AFTCMSCS_HFINSAddTheta" FLOAT32_IEEE F_1_p0_2 1 2 -3.402823466E+038 3.402823466E+038 ECU_ADDRESS 0x70002ED0 /end MEASUREMENT
/begin MEASUREMENT AFTCMSCS_IdTgt "AFTCMSCS_IdTgt" FLOAT32_IEEE F_1_p0_2 1 2 -3.402823466E+038 3.402823466E+038 ECU_ADDRESS 0x70002ECC /end MEASUREMENT
/begin MEASUREMENT AFTCMSCS_IdTgtFildZ "AFTCMSCS_IdTgtFildZ" FLOAT32_IEEE F_1_p0_2 1 2 -3.402823466E+038 3.402823466E+038 ECU_ADDRESS 0x70002EC8 /end MEASUREMENT
/begin MEASUREMENT AFTCMSCS_IdTgtPre "AFTCMSCS_IdTgtPre" FLOAT32_IEEE F_1_p0_2 1 2 -3.402823466E+038 3.402823466E+038 ECU_ADDRESS 0x70002EC4 /end MEASUREMENT
/begin MEASUREMENT AFTCMSCS_IqTgtFildZ "AFTCMSCS_IqTgtFildZ" FLOAT32_IEEE F_1_p0_2 1 2 -3.402823466E+038 3.402823466E+038 ECU_ADDRESS 0x70002EC0 /end MEASUREMENT
/begin MEASUREMENT AFTCMSCS_IqTgtPre "AFTCMSCS_IqTgtPre" FLOAT32_IEEE F_1_p0_2 1 2 -3.402823466E+038 3.402823466E+038 ECU_ADDRESS 0x70002EBC /end MEASUREMENT
/begin MEASUREMENT AFTCMSCS_MecaSpeedRpmTgtZ "AFTCMSCS_MecaSpeedRpmTgtZ" FLOAT32_IEEE F_1_p0_2 1 2 -3.402823466E+038 3.402823466E+038 ECU_ADDRESS 0x70002EB8 /end MEASUREMENT
/begin MEASUREMENT AFTCMSCS_NormalStopFlg "AFTCMSCS_NormalStopFlg" UBYTE Bool_ON_OFF 1 2 0 1 BIT_MASK 0x01 ECU_ADDRESS 0x70002EB4 /end MEASUREMENT
/begin MEASUREMENT AFTCMSCS_ObsState "AFTCMSCS_ObsState" UBYTE F_1_p0_2 1 2 0 255 ECU_ADDRESS 0x70002EB3 /end MEASUREMENT
/begin MEASUREMENT AFTCMSCS_ObsStatePre "AFTCMSCS_ObsStatePre" UBYTE F_1_p0_2 1 2 0 255 ECU_ADDRESS 0x70002EB2 /end MEASUREMENT
/begin MEASUREMENT AFTCMSCS_OpenAngleState "AFTCMSCS_OpenAngleState" UBYTE F_1_p0_2 1 2 0 255 ECU_ADDRESS 0x70002EB1 /end MEASUREMENT
/begin MEASUREMENT AFTCMSCS_OpenAngleStatePre "AFTCMSCS_OpenAngleStatePre" UBYTE F_1_p0_2 1 2 0 255 ECU_ADDRESS 0x70002EB0 /end MEASUREMENT
/begin MEASUREMENT AFTCMSCS_OpenEleSpeedRds "AFTCMSCS_OpenEleSpeedRds" FLOAT32_IEEE F_1_p0_2 1 2 -3.402823466E+038 3.402823466E+038 ECU_ADDRESS 0x70002EAC /end MEASUREMENT
/begin MEASUREMENT AFTCMSCS_OpenMecaSpeedRpm "AFTCMSCS_OpenMecaSpeedRpm" FLOAT32_IEEE F_1_p0_2 1 2 -3.402823466E+038 3.402823466E+038 ECU_ADDRESS 0x70002EA8 /end MEASUREMENT
/begin MEASUREMENT AFTCMSCS_OpenMecaSpeedRpmPre "AFTCMSCS_OpenMecaSpeedRpmPre" FLOAT32_IEEE F_1_p0_2 1 2 -3.402823466E+038 3.402823466E+038 ECU_ADDRESS 0x70002EA4 /end MEASUREMENT
/begin MEASUREMENT AFTCMSCS_OpenTorqueTgtZ "AFTCMSCS_OpenTorqueTgtZ" FLOAT32_IEEE F_1_p0_2 1 2 -3.402823466E+038 3.402823466E+038 ECU_ADDRESS 0x70002EA0 /end MEASUREMENT
/begin MEASUREMENT AFTCMSCS_OverSpeedCnt "AFTCMSCS_OverSpeedCnt" SWORD F_1_p0_2 1 2 -32768 32767 ECU_ADDRESS 0x70002E9E /end MEASUREMENT
/begin MEASUREMENT AFTCMSCS_OverSpeedFlg "AFTCMSCS_OverSpeedFlg" UBYTE Bool_ON_OFF 1 2 0 1 BIT_MASK 0x01 ECU_ADDRESS 0x70002E9C /end MEASUREMENT
/begin MEASUREMENT AFTCMSCS_PrePositionDCnt "AFTCMSCS_PrePositionDCnt" UWORD F_1_p0_2 1 2 0 65535 ECU_ADDRESS 0x70002E9A /end MEASUREMENT
/begin MEASUREMENT AFTCMSCS_PrePositionOverFlg "AFTCMSCS_PrePositionOverFlg" UBYTE Bool_ON_OFF 1 2 0 1 BIT_MASK 0x01 ECU_ADDRESS 0x70002E98 /end MEASUREMENT
/begin MEASUREMENT AFTCMSCS_PrePositionQCnt "AFTCMSCS_PrePositionQCnt" UWORD F_1_p0_2 1 2 0 65535 ECU_ADDRESS 0x70002E96 /end MEASUREMENT
/begin MEASUREMENT AFTCMSCS_ShiftDirectFlg "AFTCMSCS_ShiftDirectFlg" UBYTE Bool_ON_OFF 1 2 0 1 BIT_MASK 0x01 ECU_ADDRESS 0x70002E94 /end MEASUREMENT
/begin MEASUREMENT AFTCMSCS_ShiftIdIncreaseCnt "AFTCMSCS_ShiftIdIncreaseCnt" UWORD F_1_p0_2 1 2 0 65535 ECU_ADDRESS 0x70002E92 /end MEASUREMENT
/begin MEASUREMENT AFTCMSCS_ShiftIqDecreaseCnt "AFTCMSCS_ShiftIqDecreaseCnt" UWORD F_1_p0_2 1 2 0 65535 ECU_ADDRESS 0x70002E90 /end MEASUREMENT
/begin MEASUREMENT AFTCMSCS_ShiftRunGain "AFTCMSCS_ShiftRunGain" FLOAT32_IEEE F_1_p0_2 1 2 -3.402823466E+038 3.402823466E+038 ECU_ADDRESS 0x70002E8C /end MEASUREMENT
/begin MEASUREMENT AFTCMSCS_SpeedDiffCntZ "AFTCMSCS_SpeedDiffCntZ" SWORD F_1_p0_2 1 2 -32768 32767 ECU_ADDRESS 0x70002E88 /end MEASUREMENT
/begin MEASUREMENT AFTCMSCS_SpeedFilterZ "AFTCMSCS_SpeedFilterZ" FLOAT32_IEEE F_1_p0_2 1 2 -3.402823466E+038 3.402823466E+038 ECU_ADDRESS 0x70002E84 /end MEASUREMENT
/begin MEASUREMENT AFTCMSCS_SpeedModeTrqSatZ "AFTCMSCS_SpeedModeTrqSatZ" UBYTE Bool_ON_OFF 1 2 0 1 BIT_MASK 0x01 ECU_ADDRESS 0x70002E82 /end MEASUREMENT
/begin MEASUREMENT AFTCMSCS_StartFailCnt "AFTCMSCS_StartFailCnt" SWORD F_1_p0_2 1 2 -32768 32767 ECU_ADDRESS 0x70002E80 /end MEASUREMENT
/begin MEASUREMENT AFTCMSCS_StartFailFlg "AFTCMSCS_StartFailFlg" UBYTE Bool_ON_OFF 1 2 0 1 BIT_MASK 0x01 ECU_ADDRESS 0x70002E7E /end MEASUREMENT
/begin MEASUREMENT AFTCMSCS_StartFailNumber "AFTCMSCS_StartFailNumber" UWORD F_1_p0_2 1 2 0 65535 ECU_ADDRESS 0x70002E7C /end MEASUREMENT
/begin MEASUREMENT AFTCMSCS_StopFailFlg "AFTCMSCS_StopFailFlg" UBYTE Bool_ON_OFF 1 2 0 1 BIT_MASK 0x01 ECU_ADDRESS 0x70002E7A /end MEASUREMENT
/begin MEASUREMENT AFTCMSCS_StopRunCnt "AFTCMSCS_StopRunCnt" UWORD F_1_p0_2 1 2 0 65535 ECU_ADDRESS 0x70002E78 /end MEASUREMENT
/begin MEASUREMENT AFTCMSCS_TorqueTgt "AFTCMSCS_TorqueTgt" FLOAT32_IEEE F_1_p0_2 1 2 -3.402823466E+038 3.402823466E+038 ECU_ADDRESS 0x70002E74 /end MEASUREMENT
/begin MEASUREMENT AFTCMSCS_UdTgtReserve "AFTCMSCS_UdTgtReserve" FLOAT32_IEEE F_1_p0_2 1 2 -3.402823466E+038 3.402823466E+038 ECU_ADDRESS 0x70002E70 /end MEASUREMENT
/begin MEASUREMENT AFTCMSTC_RateLimiterOutZ "AFTCMSTC_RateLimiterOutZ" FLOAT32_IEEE F_1_p0_2 1 2 -3.402823466E+038 3.402823466E+038 ECU_ADDRESS 0x70002F50 /end MEASUREMENT
/begin MEASUREMENT AFTCMSTC_SpeedRpmTgtFiltered "AFTCMSTC_SpeedRpmTgtFiltered" FLOAT32_IEEE F_1_p0_2 1 2 -20000 20000 ECU_ADDRESS 0x70002F4C /end MEASUREMENT
/begin MEASUREMENT AFTCMTCS_1ByUbatHV "AFTCMTCS_1ByUbatHV" FLOAT32_IEEE F_1_p0_2 1 2 -3.402823466E+038 3.402823466E+038 ECU_ADDRESS 0x70002FAC /end MEASUREMENT
/begin MEASUREMENT AFTCMTCS_CurrentControllerSat "AFTCMTCS_CurrentControllerSat" UBYTE Bool_ON_OFF 1 2 0 1 BIT_MASK 0x01 ECU_ADDRESS 0x70002FA8 /end MEASUREMENT
/begin MEASUREMENT AFTCMTCS_DelVol "AFTCMTCS_DelVol" FLOAT32_IEEE F_1_p0_2 1 2 -3.402823466E+038 3.402823466E+038 ECU_ADDRESS 0x70002FA4 /end MEASUREMENT
/begin MEASUREMENT AFTCMTCS_ElecTorqueMaxMin[0] "AFTCMTCS_ElecTorqueMaxMin" FLOAT32_IEEE F_1_p0_2 1 2 -3.402823466E+038 3.402823466E+038 ECU_ADDRESS 0x70002F9C /end MEASUREMENT
/begin MEASUREMENT AFTCMTCS_ElecTorqueMaxMin[1] "AFTCMTCS_ElecTorqueMaxMin" FLOAT32_IEEE F_1_p0_2 1 2 -3.402823466E+038 3.402823466E+038 ECU_ADDRESS 0x70002FA0 /end MEASUREMENT
/begin MEASUREMENT AFTCMTCS_ElecTorqueTgt "AFTCMTCS_ElecTorqueTgt" FLOAT32_IEEE F_1_p0_2 1 2 -3.402823466E+038 3.402823466E+038 ECU_ADDRESS 0x70002F98 /end MEASUREMENT
/begin MEASUREMENT AFTCMTCS_FluxControllerTgt "AFTCMTCS_FluxControllerTgt" FLOAT32_IEEE F_1_p0_2 1 2 -3.402823466E+038 3.402823466E+038 ECU_ADDRESS 0x70002F94 /end MEASUREMENT
/begin MEASUREMENT AFTCMTCS_FluxControllerTgtZ "AFTCMTCS_FluxControllerTgtZ" FLOAT32_IEEE F_1_p0_2 1 2 -3.402823466E+038 3.402823466E+038 ECU_ADDRESS 0x70002F90 /end MEASUREMENT
/begin MEASUREMENT AFTCMTCS_ParkVoltageTgt "AFTCMTCS_ParkVoltageTgt" FLOAT32_IEEE F_1_p0_2 1 2 -3.402823466E+038 3.402823466E+038 ECU_ADDRESS 0x70002F8C /end MEASUREMENT
/begin MEASUREMENT AFTCMTCS_PhaseVoltagePeakTgt "AFTCMTCS_PhaseVoltagePeakTgt" FLOAT32_IEEE F_1_p0_2 1 2 -3.402823466E+038 3.402823466E+038 ECU_ADDRESS 0x70002F88 /end MEASUREMENT
/begin MEASUREMENT AFTCMTCS_TorqueLimActivation "AFTCMTCS_TorqueLimActivation" UBYTE Bool_ON_OFF 1 2 0 1 BIT_MASK 0x01 ECU_ADDRESS 0x70002F84 /end MEASUREMENT
/begin MEASUREMENT AFTCMTCS_TorqueVolim "AFTCMTCS_TorqueVolim" FLOAT32_IEEE F_1_p0_2 1 2 -3.402823466E+038 3.402823466E+038 ECU_ADDRESS 0x70002F80 /end MEASUREMENT
/begin MEASUREMENT AFTCMTCS_UdqNorm "AFTCMTCS_UdqNorm" FLOAT32_IEEE F_1_p0_2 1 2 -3.402823466E+038 3.402823466E+038 ECU_ADDRESS 0x70002F7C /end MEASUREMENT
/begin MEASUREMENT AFTCMTCS_VoltageMargin "AFTCMTCS_VoltageMargin" FLOAT32_IEEE F_1_p0_2 1 2 -3.402823466E+038 3.402823466E+038 ECU_ADDRESS 0x70002F78 /end MEASUREMENT
/begin MEASUREMENT AFTCMTCS_VoltageMarginCorZ "AFTCMTCS_VoltageMarginCorZ" FLOAT32_IEEE F_1_p0_2 1 2 -3.402823466E+038 3.402823466E+038 ECU_ADDRESS 0x70002F74 /end MEASUREMENT
/begin MEASUREMENT AFTCMTCS_i0dqTgt3[0] "AFTCMTCS_i0dqTgt3" FLOAT32_IEEE F_1_p0_2 1 2 -3.402823466E+038 3.402823466E+038 ECU_ADDRESS 0x70002F68 /end MEASUREMENT
/begin MEASUREMENT AFTCMTCS_i0dqTgt3[1] "AFTCMTCS_i0dqTgt3" FLOAT32_IEEE F_1_p0_2 1 2 -3.402823466E+038 3.402823466E+038 ECU_ADDRESS 0x70002F6C /end MEASUREMENT
/begin MEASUREMENT AFTCMTCS_i0dqTgt3[2] "AFTCMTCS_i0dqTgt3" FLOAT32_IEEE F_1_p0_2 1 2 -3.402823466E+038 3.402823466E+038 ECU_ADDRESS 0x70002F70 /end MEASUREMENT
/begin MEASUREMENT AFTCMTCS_idCorTgt "AFTCMTCS_idCorTgt" FLOAT32_IEEE F_1_p0_2 1 2 -3.402823466E+038 3.402823466E+038 ECU_ADDRESS 0x70002F64 /end MEASUREMENT
/begin MEASUREMENT AFTCMTCS_idCorTgtZ "AFTCMTCS_idCorTgtZ" FLOAT32_IEEE F_1_p0_2 1 2 -3.402823466E+038 3.402823466E+038 ECU_ADDRESS 0x70002F60 /end MEASUREMENT
/begin MEASUREMENT AFTCMTCS_idLutTgt "AFTCMTCS_idLutTgt" FLOAT32_IEEE F_1_p0_2 1 2 -3.402823466E+038 3.402823466E+038 ECU_ADDRESS 0x70002F5C /end MEASUREMENT
/begin MEASUREMENT AFTCMTCS_idLutTgtZ "AFTCMTCS_idLutTgtZ" FLOAT32_IEEE F_1_p0_2 1 2 -3.402823466E+038 3.402823466E+038 ECU_ADDRESS 0x70002F58 /end MEASUREMENT
/begin MEASUREMENT AFTCMTCS_iqLutTgt "AFTCMTCS_iqLutTgt" FLOAT32_IEEE F_1_p0_2 1 2 -3.402823466E+038 3.402823466E+038 ECU_ADDRESS 0x70002F54 /end MEASUREMENT
/begin MEASUREMENT AFTCMTTC_ElecTorqueTgtFild "Electromagnetic torque target" FLOAT32_IEEE F_1_p0_2 1 2 -3.402823466E+038 3.402823466E+038 ECU_ADDRESS 0x70002FC8 /end MEASUREMENT
/begin MEASUREMENT AFTCMTTC_ElecTorqueTgtFildZ "AFTCMTTC_ElecTorqueTgtFildZ" FLOAT32_IEEE F_1_p0_2 1 2 -3.402823466E+038 3.402823466E+038 ECU_ADDRESS 0x70002FC4 /end MEASUREMENT
/begin MEASUREMENT AFTCMTTC_ElecTorqueTgtTotal "AFTCMTTC_ElecTorqueTgtTotal" FLOAT32_IEEE F_1_p0_2 1 2 -3.402823466E+038 3.402823466E+038 ECU_ADDRESS 0x70002FC0 /end MEASUREMENT
/begin MEASUREMENT AFTCMTTC_ElecTorqueTgtZ "AFTCMTTC_ElecTorqueTgtZ" FLOAT32_IEEE F_1_p0_2 1 2 -3.402823466E+038 3.402823466E+038 ECU_ADDRESS 0x70002FBC /end MEASUREMENT
/begin MEASUREMENT AFTCMTTC_MecaTorqueMax "AFTCMTTC_MecaTorqueMax" FLOAT32_IEEE F_1_p0_2 1 2 -3.402823466E+038 3.402823466E+038 ECU_ADDRESS 0x70002FB8 /end MEASUREMENT
/begin MEASUREMENT AFTCMTTC_MecaTorqueMin "AFTCMTTC_MecaTorqueMin" FLOAT32_IEEE F_1_p0_2 1 2 -3.402823466E+038 3.402823466E+038 ECU_ADDRESS 0x70002FB4 /end MEASUREMENT
/begin MEASUREMENT AFTCMTTC_MecaTorqueTgt "Limited mechanical torque target" FLOAT32_IEEE F_1_p0_2 1 2 -3.402823466E+038 3.402823466E+038 ECU_ADDRESS 0x70002FB0 /end MEASUREMENT
/begin MEASUREMENT AFTDDLMP_MaxMinI0dqLimitVect "The maximum&amp;minimum current of I0,Id,Iq limit value in limp control mode." FLOAT32_IEEE F_1_p0_2 1 2 -1200 1200 MATRIX_DIM 1 6 1 ECU_ADDRESS 0x70002FDC /end MEASUREMENT
/begin MEASUREMENT AFTDDLMP_MaxMinI0dqLimitVect[0] "AFTDDLMP_MaxMinI0dqLimitVect[0]" FLOAT32_IEEE F_1_p0_2 1 2 -1200 1200 ECU_ADDRESS 0x70002FDC /end MEASUREMENT
/begin MEASUREMENT AFTDDLMP_MaxMinI0dqLimitVect[1] "AFTDDLMP_MaxMinI0dqLimitVect[1]" FLOAT32_IEEE F_1_p0_2 1 2 -1200 1200 ECU_ADDRESS 0x70002FE0 /end MEASUREMENT
/begin MEASUREMENT AFTDDLMP_MaxMinI0dqLimitVect[2] "AFTDDLMP_MaxMinI0dqLimitVect[2]" FLOAT32_IEEE F_1_p0_2 1 2 -1200 1200 ECU_ADDRESS 0x70002FE4 /end MEASUREMENT
/begin MEASUREMENT AFTDDLMP_MaxMinI0dqLimitVect[3] "AFTDDLMP_MaxMinI0dqLimitVect[3]" FLOAT32_IEEE F_1_p0_2 1 2 -1200 1200 ECU_ADDRESS 0x70002FE8 /end MEASUREMENT
/begin MEASUREMENT AFTDDLMP_MaxMinI0dqLimitVect[4] "AFTDDLMP_MaxMinI0dqLimitVect[4]" FLOAT32_IEEE F_1_p0_2 1 2 -1200 1200 ECU_ADDRESS 0x70002FEC /end MEASUREMENT
/begin MEASUREMENT AFTDDLMP_MaxMinI0dqLimitVect[5] "AFTDDLMP_MaxMinI0dqLimitVect[5]" FLOAT32_IEEE F_1_p0_2 1 2 -1200 1200 ECU_ADDRESS 0x70002FF0 /end MEASUREMENT
/begin MEASUREMENT AFTDDLMP_MaxMinSpdLimitVect "The maximum&amp;minimum speed limit value in limp control mode." FLOAT32_IEEE F_1_p0_2 1 2 -25000 25000 MATRIX_DIM 1 2 1 ECU_ADDRESS 0x70002FD4 /end MEASUREMENT
/begin MEASUREMENT AFTDDLMP_MaxMinSpdLimitVect[0] "AFTDDLMP_MaxMinSpdLimitVect[0]" FLOAT32_IEEE F_1_p0_2 1 2 -25000 25000 ECU_ADDRESS 0x70002FD4 /end MEASUREMENT
/begin MEASUREMENT AFTDDLMP_MaxMinSpdLimitVect[1] "AFTDDLMP_MaxMinSpdLimitVect[1]" FLOAT32_IEEE F_1_p0_2 1 2 -25000 25000 ECU_ADDRESS 0x70002FD8 /end MEASUREMENT
/begin MEASUREMENT AFTDDLMP_MaxMinTorqueLimitVect "Maximum or Minimum Torque Limit Value." FLOAT32_IEEE F_1_p0_2 1 2 -500 500 MATRIX_DIM 1 2 1 ECU_ADDRESS 0x70002FCC /end MEASUREMENT
/begin MEASUREMENT AFTDDLMP_MaxMinTorqueLimitVect[0] "AFTDDLMP_MaxMinTorqueLimitVect[0]" FLOAT32_IEEE F_1_p0_2 1 2 -500 500 ECU_ADDRESS 0x70002FCC /end MEASUREMENT
/begin MEASUREMENT AFTDDLMP_MaxMinTorqueLimitVect[1] "AFTDDLMP_MaxMinTorqueLimitVect[1]" FLOAT32_IEEE F_1_p0_2 1 2 -500 500 ECU_ADDRESS 0x70002FD0 /end MEASUREMENT
/begin MEASUREMENT AFTMTLCS_1ByAccumulator "AFTMTLCS_1ByAccumulator" FLOAT32_IEEE F_1_p0_2 1 2 -3.402823466E+038 3.402823466E+038 ECU_ADDRESS 0x70003234 /end MEASUREMENT
/begin MEASUREMENT AFTMTLCS_A2DOffsetIsuL "parameter used to correct the sensor offset error" FLOAT32_IEEE F_1_p0_2 1 2 -3.402823466E+038 3.402823466E+038 ECU_ADDRESS 0x70003230 /end MEASUREMENT
/begin MEASUREMENT AFTMTLCS_A2DOffsetIsvL "parameter used to correct the sensor offset error" FLOAT32_IEEE F_1_p0_2 1 2 -3.402823466E+038 3.402823466E+038 ECU_ADDRESS 0x7000322C /end MEASUREMENT
/begin MEASUREMENT AFTMTLCS_A2DOffsetIswL "parameter used to correct the sensor offset error" FLOAT32_IEEE F_1_p0_2 1 2 -3.402823466E+038 3.402823466E+038 ECU_ADDRESS 0x70003228 /end MEASUREMENT
/begin MEASUREMENT AFTMTLCS_A2DOffsetSumIsuLZ "sum of the current sample durring initialization" FLOAT32_IEEE F_1_p0_2 1 2 -3.402823466E+038 3.402823466E+038 ECU_ADDRESS 0x70003224 /end MEASUREMENT
/begin MEASUREMENT AFTMTLCS_A2DOffsetSumIsvLZ "sum of the current sample durring initialization" FLOAT32_IEEE F_1_p0_2 1 2 -3.402823466E+038 3.402823466E+038 ECU_ADDRESS 0x70003220 /end MEASUREMENT
/begin MEASUREMENT AFTMTLCS_A2DOffsetSumIswLZ "sum of the current sample durring initialization" FLOAT32_IEEE F_1_p0_2 1 2 -3.402823466E+038 3.402823466E+038 ECU_ADDRESS 0x7000321C /end MEASUREMENT
/begin MEASUREMENT AFTMTLCS_A2DResCorrd_IsuL "corrected ADC value of the current sensor" FLOAT32_IEEE F_1_p0_2 1 2 0 4095 ECU_ADDRESS 0x70003218 /end MEASUREMENT
/begin MEASUREMENT AFTMTLCS_A2DResCorrd_IsvL "corrected ADC value of the current sensor" FLOAT32_IEEE F_1_p0_2 1 2 0 4095 ECU_ADDRESS 0x70003214 /end MEASUREMENT
/begin MEASUREMENT AFTMTLCS_A2DResCorrd_IswL "corrected ADC value of the current sensor" FLOAT32_IEEE F_1_p0_2 1 2 0 4095 ECU_ADDRESS 0x70003210 /end MEASUREMENT
/begin MEASUREMENT AFTMTLCS_ContorOverLoadCntZ "AFTMTLCS_ContorOverLoadCntZ" FLOAT32_IEEE F_1_p0_2 1 2 -3.402823466E+038 3.402823466E+038 ECU_ADDRESS 0x7000320C /end MEASUREMENT
/begin MEASUREMENT AFTMTLCS_CurrentSumError "AFTMTLCS_CurrentSumError" UBYTE Bool_ON_OFF 1 2 0 1 BIT_MASK 0x01 ECU_ADDRESS 0x70003208 /end MEASUREMENT
/begin MEASUREMENT AFTMTLCS_ElecSpeedRdsFildZ "AFTMTLCS_ElecSpeedRdsFildZ" FLOAT32_IEEE F_1_p0_2 1 2 -3.402823466E+038 3.402823466E+038 ECU_ADDRESS 0x70003204 /end MEASUREMENT
/begin MEASUREMENT AFTMTLCS_Iu "AFTMTLCS_Iu" FLOAT32_IEEE F_1_p0_2 1 2 -1000 1000 ECU_ADDRESS 0x70003200 /end MEASUREMENT
/begin MEASUREMENT AFTMTLCS_IuInput "AFTMTLCS_IuInput" FLOAT32_IEEE F_1_p0_2 1 2 -3.402823466E+038 3.402823466E+038 ECU_ADDRESS 0x700031FC /end MEASUREMENT
/begin MEASUREMENT AFTMTLCS_Iu_Rms "AFTMTLCS_Iu_Rms" FLOAT32_IEEE F_1_p0_2 1 2 -3.402823466E+038 3.402823466E+038 ECU_ADDRESS 0x700031F8 /end MEASUREMENT
/begin MEASUREMENT AFTMTLCS_Iu_RmsSum "AFTMTLCS_Iu_RmsSum" FLOAT32_IEEE F_1_p0_2 1 2 -3.402823466E+038 3.402823466E+038 ECU_ADDRESS 0x700031F4 /end MEASUREMENT
/begin MEASUREMENT AFTMTLCS_Iuvw3RmsSum[0] "AFTMTLCS_Iuvw3RmsSum" FLOAT32_IEEE F_1_p0_2 1 2 -3.402823466E+038 3.402823466E+038 ECU_ADDRESS 0x700031DC /end MEASUREMENT
/begin MEASUREMENT AFTMTLCS_Iuvw3RmsSum[1] "AFTMTLCS_Iuvw3RmsSum" FLOAT32_IEEE F_1_p0_2 1 2 -3.402823466E+038 3.402823466E+038 ECU_ADDRESS 0x700031E0 /end MEASUREMENT
/begin MEASUREMENT AFTMTLCS_Iuvw3RmsSum[2] "AFTMTLCS_Iuvw3RmsSum" FLOAT32_IEEE F_1_p0_2 1 2 -3.402823466E+038 3.402823466E+038 ECU_ADDRESS 0x700031E4 /end MEASUREMENT
/begin MEASUREMENT AFTMTLCS_Iuvw3[0] "AFTMTLCS_Iuvw3" FLOAT32_IEEE F_1_p0_2 1 2 -3.402823466E+038 3.402823466E+038 ECU_ADDRESS 0x700031E8 /end MEASUREMENT
/begin MEASUREMENT AFTMTLCS_Iuvw3[1] "AFTMTLCS_Iuvw3" FLOAT32_IEEE F_1_p0_2 1 2 -3.402823466E+038 3.402823466E+038 ECU_ADDRESS 0x700031EC /end MEASUREMENT
/begin MEASUREMENT AFTMTLCS_Iuvw3[2] "AFTMTLCS_Iuvw3" FLOAT32_IEEE F_1_p0_2 1 2 -3.402823466E+038 3.402823466E+038 ECU_ADDRESS 0x700031F0 /end MEASUREMENT
/begin MEASUREMENT AFTMTLCS_Iuvw3_Rms[0] "AFTMTLCS_Iuvw3_Rms" FLOAT32_IEEE F_1_p0_2 1 2 -3.402823466E+038 3.402823466E+038 ECU_ADDRESS 0x700031D0 /end MEASUREMENT
/begin MEASUREMENT AFTMTLCS_Iuvw3_Rms[1] "AFTMTLCS_Iuvw3_Rms" FLOAT32_IEEE F_1_p0_2 1 2 -3.402823466E+038 3.402823466E+038 ECU_ADDRESS 0x700031D4 /end MEASUREMENT
/begin MEASUREMENT AFTMTLCS_Iuvw3_Rms[2] "AFTMTLCS_Iuvw3_Rms" FLOAT32_IEEE F_1_p0_2 1 2 -3.402823466E+038 3.402823466E+038 ECU_ADDRESS 0x700031D8 /end MEASUREMENT
/begin MEASUREMENT AFTMTLCS_IuvwGain3[0] "AFTMTLCS_IuvwGain3" FLOAT32_IEEE F_1_p0_2 1 2 -3.402823466E+038 3.402823466E+038 ECU_ADDRESS 0x700031C4 /end MEASUREMENT
/begin MEASUREMENT AFTMTLCS_IuvwGain3[1] "AFTMTLCS_IuvwGain3" FLOAT32_IEEE F_1_p0_2 1 2 -3.402823466E+038 3.402823466E+038 ECU_ADDRESS 0x700031C8 /end MEASUREMENT
/begin MEASUREMENT AFTMTLCS_IuvwGain3[2] "AFTMTLCS_IuvwGain3" FLOAT32_IEEE F_1_p0_2 1 2 -3.402823466E+038 3.402823466E+038 ECU_ADDRESS 0x700031CC /end MEASUREMENT
/begin MEASUREMENT AFTMTLCS_Iv "AFTMTLCS_Iv" FLOAT32_IEEE F_1_p0_2 1 2 -1000 1000 ECU_ADDRESS 0x700031C0 /end MEASUREMENT
/begin MEASUREMENT AFTMTLCS_IvInput "AFTMTLCS_IvInput" FLOAT32_IEEE F_1_p0_2 1 2 -3.402823466E+038 3.402823466E+038 ECU_ADDRESS 0x700031BC /end MEASUREMENT
/begin MEASUREMENT AFTMTLCS_Iv_Rms "AFTMTLCS_Iv_Rms" FLOAT32_IEEE F_1_p0_2 1 2 -3.402823466E+038 3.402823466E+038 ECU_ADDRESS 0x700031B8 /end MEASUREMENT
/begin MEASUREMENT AFTMTLCS_Iv_RmsSum "AFTMTLCS_Iv_RmsSum" FLOAT32_IEEE F_1_p0_2 1 2 -3.402823466E+038 3.402823466E+038 ECU_ADDRESS 0x700031B4 /end MEASUREMENT
/begin MEASUREMENT AFTMTLCS_Iw "AFTMTLCS_Iw" FLOAT32_IEEE F_1_p0_2 1 2 -1000 1000 ECU_ADDRESS 0x700031B0 /end MEASUREMENT
/begin MEASUREMENT AFTMTLCS_IwInput "AFTMTLCS_IwInput" FLOAT32_IEEE F_1_p0_2 1 2 -3.402823466E+038 3.402823466E+038 ECU_ADDRESS 0x700031AC /end MEASUREMENT
/begin MEASUREMENT AFTMTLCS_Iw_Rms "AFTMTLCS_Iw_Rms" FLOAT32_IEEE F_1_p0_2 1 2 -3.402823466E+038 3.402823466E+038 ECU_ADDRESS 0x700031A8 /end MEASUREMENT
/begin MEASUREMENT AFTMTLCS_Iw_RmsSum "AFTMTLCS_Iw_RmsSum" FLOAT32_IEEE F_1_p0_2 1 2 -3.402823466E+038 3.402823466E+038 ECU_ADDRESS 0x700031A4 /end MEASUREMENT
/begin MEASUREMENT AFTMTLCS_LostPhaseError "AFTMTLCS_LostPhaseError" UBYTE Bool_ON_OFF 1 2 0 1 BIT_MASK 0x01 ECU_ADDRESS 0x700031A0 /end MEASUREMENT
/begin MEASUREMENT AFTMTLCS_MotorOverLoadCntZ "AFTMTLCS_MotorOverLoadCntZ" FLOAT32_IEEE F_1_p0_2 1 2 -3.402823466E+038 3.402823466E+038 ECU_ADDRESS 0x7000319C /end MEASUREMENT
/begin MEASUREMENT AFTMTLCS_OffsetCompOK "AFTMTLCS_OffsetCompOK" UBYTE Bool_ON_OFF 1 2 0 1 BIT_MASK 0x01 ECU_ADDRESS 0x70003198 /end MEASUREMENT
/begin MEASUREMENT AFTMTLCS_RmsNumberZ "AFTMTLCS_RmsNumberZ" ULONG F_1_p0_2 1 2 0 4294967295 ECU_ADDRESS 0x70003194 /end MEASUREMENT
/begin MEASUREMENT AFTMTLCS_RmsSumIuZ "AFTMTLCS_RmsSumIuZ" FLOAT32_IEEE F_1_p0_2 1 2 -3.402823466E+038 3.402823466E+038 ECU_ADDRESS 0x70003190 /end MEASUREMENT
/begin MEASUREMENT AFTMTLCS_RmsSumIvZ "AFTMTLCS_RmsSumIvZ" FLOAT32_IEEE F_1_p0_2 1 2 -3.402823466E+038 3.402823466E+038 ECU_ADDRESS 0x7000318C /end MEASUREMENT
/begin MEASUREMENT AFTMTLCS_RmsSumIwZ "AFTMTLCS_RmsSumIwZ" FLOAT32_IEEE F_1_p0_2 1 2 -3.402823466E+038 3.402823466E+038 ECU_ADDRESS 0x70003188 /end MEASUREMENT
/begin MEASUREMENT AFTMTLCS_SampleNumberZ "number of sample since the beginning of the initialization" ULONG F_1_p0_2 1 2 0 4294967295 ECU_ADDRESS 0x70003184 /end MEASUREMENT
/begin MEASUREMENT AFTMTLCS_Scaled_Isu "AFTMTLCS_Scaled_Isu" FLOAT32_IEEE F_1_p0_2 1 2 -3.402823466E+038 3.402823466E+038 ECU_ADDRESS 0x70003180 /end MEASUREMENT
/begin MEASUREMENT AFTMTLCS_Scaled_Isv "AFTMTLCS_Scaled_Isv" FLOAT32_IEEE F_1_p0_2 1 2 -3.402823466E+038 3.402823466E+038 ECU_ADDRESS 0x7000317C /end MEASUREMENT
/begin MEASUREMENT AFTMTLCS_Scaled_Isw "AFTMTLCS_Scaled_Isw" FLOAT32_IEEE F_1_p0_2 1 2 -3.402823466E+038 3.402823466E+038 ECU_ADDRESS 0x70003178 /end MEASUREMENT
/begin MEASUREMENT AFTMTLCS_TrimIsuvw[0] "AFTMTLCS_TrimIsuvw" FLOAT32_IEEE F_1_p0_2 1 2 -3.402823466E+038 3.402823466E+038 ECU_ADDRESS 0x7000316C /end MEASUREMENT
/begin MEASUREMENT AFTMTLCS_TrimIsuvw[1] "AFTMTLCS_TrimIsuvw" FLOAT32_IEEE F_1_p0_2 1 2 -3.402823466E+038 3.402823466E+038 ECU_ADDRESS 0x70003170 /end MEASUREMENT
/begin MEASUREMENT AFTMTLCS_TrimIsuvw[2] "AFTMTLCS_TrimIsuvw" FLOAT32_IEEE F_1_p0_2 1 2 -3.402823466E+038 3.402823466E+038 ECU_ADDRESS 0x70003174 /end MEASUREMENT
/begin MEASUREMENT AFTMTSEP_ElecSpeedRds "resolver speed with 1 time delay" FLOAT32_IEEE F_1_p0_2 1 2 -1000000 1000000 ECU_ADDRESS 0x7000325C /end MEASUREMENT
/begin MEASUREMENT AFTMTSEP_ElecSpeedRpm "resolver speed with 1 time delay" FLOAT32_IEEE F_1_p0_2 1 2 -1000000 1000000 ECU_ADDRESS 0x70003258 /end MEASUREMENT
/begin MEASUREMENT AFTMTSEP_MecaSpeedRds "resolver speed with 1 time delay" FLOAT32_IEEE F_1_p0_2 1 2 -1000000 1000000 ECU_ADDRESS 0x70003254 /end MEASUREMENT
/begin MEASUREMENT AFTMTSEP_MecaSpeedRpm "resolver speed with 1 time delay" FLOAT32_IEEE F_1_p0_2 1 2 -1000000 1000000 ECU_ADDRESS 0x70003250 /end MEASUREMENT
/begin MEASUREMENT AFTMTSEP_NextThetaElecRd "next time step value of the electrical angle" FLOAT32_IEEE F_1_p0_2 1 2 -3.402823466E+038 3.402823466E+038 ECU_ADDRESS 0x7000324C /end MEASUREMENT
/begin MEASUREMENT AFTMTSEP_SinCosNextThetaElec[0] "next time step cosinus  and sinus values of the electrical angle" FLOAT32_IEEE F_1_p0_2 1 2 -3.402823466E+038 3.402823466E+038 ECU_ADDRESS 0x70003244 /end MEASUREMENT
/begin MEASUREMENT AFTMTSEP_SinCosNextThetaElec[1] "next time step cosinus  and sinus values of the electrical angle" FLOAT32_IEEE F_1_p0_2 1 2 -3.402823466E+038 3.402823466E+038 ECU_ADDRESS 0x70003248 /end MEASUREMENT
/begin MEASUREMENT AFTMTSEP_SinCosThetaElec[0] "cosinus  and sinus values of the electrical angle" FLOAT32_IEEE F_1_p0_2 1 2 -3.402823466E+038 3.402823466E+038 ECU_ADDRESS 0x7000323C /end MEASUREMENT
/begin MEASUREMENT AFTMTSEP_SinCosThetaElec[1] "cosinus  and sinus values of the electrical angle" FLOAT32_IEEE F_1_p0_2 1 2 -3.402823466E+038 3.402823466E+038 ECU_ADDRESS 0x70003240 /end MEASUREMENT
/begin MEASUREMENT AFTMTSEP_ThetaElecRd "next time step value of the electrical angle" FLOAT32_IEEE F_1_p0_2 1 2 -3.402823466E+038 3.402823466E+038 ECU_ADDRESS 0x70003238 /end MEASUREMENT
/begin MEASUREMENT AFTSLOBS_ActEleSpeedRdsFild "AFTSLOBS_ActEleSpeedRdsFild" FLOAT32_IEEE F_1_p0_2 1 2 -3.402823466E+038 3.402823466E+038 ECU_ADDRESS 0x700030D0 /end MEASUREMENT
/begin MEASUREMENT AFTSLOBS_ActEleThetaRd "AFTSLOBS_ActEleThetaRd" FLOAT32_IEEE F_1_p0_2 1 2 -3.402823466E+038 3.402823466E+038 ECU_ADDRESS 0x700030CC /end MEASUREMENT
/begin MEASUREMENT AFTSLOBS_CloseLoopCheckFlg "AFTSLOBS_CloseLoopCheckFlg" UBYTE Bool_ON_OFF 1 2 0 1 BIT_MASK 0x01 ECU_ADDRESS 0x700030C9 /end MEASUREMENT
/begin MEASUREMENT AFTSLOBS_CloseLoopCheckFlgZ "AFTSLOBS_CloseLoopCheckFlgZ" UBYTE Bool_ON_OFF 1 2 0 1 BIT_MASK 0x01 ECU_ADDRESS 0x700030C8 /end MEASUREMENT
/begin MEASUREMENT AFTSLOBS_DeltaUdFild "AFTSLOBS_DeltaUdFild" FLOAT32_IEEE F_1_p0_2 1 2 -3.402823466E+038 3.402823466E+038 ECU_ADDRESS 0x700030C4 /end MEASUREMENT
/begin MEASUREMENT AFTSLOBS_DeltaUdFildZ "AFTSLOBS_DeltaUdFildZ" FLOAT32_IEEE F_1_p0_2 1 2 -3.402823466E+038 3.402823466E+038 ECU_ADDRESS 0x700030C0 /end MEASUREMENT
/begin MEASUREMENT AFTSLOBS_ElecSpeedRdsZ "AFTSLOBS_ElecSpeedRdsZ" FLOAT32_IEEE F_1_p0_2 1 2 -3.402823466E+038 3.402823466E+038 ECU_ADDRESS 0x700030BC /end MEASUREMENT
/begin MEASUREMENT AFTSLOBS_ElecThetaCloseCntZ "AFTSLOBS_ElecThetaCloseCntZ" SWORD F_1_p0_2 1 2 -32768 32767 ECU_ADDRESS 0x700030B8 /end MEASUREMENT
/begin MEASUREMENT AFTSLOBS_EmfSAlphaCorre "AFTSLOBS_EmfSAlphaCorre" FLOAT32_IEEE F_1_p0_2 1 2 -3.402823466E+038 3.402823466E+038 ECU_ADDRESS 0x700030B4 /end MEASUREMENT
/begin MEASUREMENT AFTSLOBS_EmfSBetaCorre "AFTSLOBS_EmfSBetaCorre" FLOAT32_IEEE F_1_p0_2 1 2 -3.402823466E+038 3.402823466E+038 ECU_ADDRESS 0x700030B0 /end MEASUREMENT
/begin MEASUREMENT AFTSLOBS_EmfSalphaZ "AFTSLOBS_EmfSalphaZ" FLOAT32_IEEE F_1_p0_2 1 2 -3.402823466E+038 3.402823466E+038 ECU_ADDRESS 0x700030AC /end MEASUREMENT
/begin MEASUREMENT AFTSLOBS_EmfSbetaZ "AFTSLOBS_EmfSbetaZ" FLOAT32_IEEE F_1_p0_2 1 2 -3.402823466E+038 3.402823466E+038 ECU_ADDRESS 0x700030A8 /end MEASUREMENT
/begin MEASUREMENT AFTSLOBS_ErrThetaElec "AFTSLOBS_ErrThetaElec" FLOAT32_IEEE F_1_p0_2 1 2 -3.402823466E+038 3.402823466E+038 ECU_ADDRESS 0x700030A4 /end MEASUREMENT
/begin MEASUREMENT AFTSLOBS_ErrThetaElecSatZ "AFTSLOBS_ErrThetaElecSatZ" UBYTE Bool_ON_OFF 1 2 0 1 BIT_MASK 0x01 ECU_ADDRESS 0x700030A0 /end MEASUREMENT
/begin MEASUREMENT AFTSLOBS_ErrThetaElecZ "AFTSLOBS_ErrThetaElecZ" FLOAT32_IEEE F_1_p0_2 1 2 -3.402823466E+038 3.402823466E+038 ECU_ADDRESS 0x7000309C /end MEASUREMENT
/begin MEASUREMENT AFTSLOBS_EstimateStableUd "AFTSLOBS_EstimateStableUd" FLOAT32_IEEE F_1_p0_2 1 2 -3.402823466E+038 3.402823466E+038 ECU_ADDRESS 0x70003098 /end MEASUREMENT
/begin MEASUREMENT AFTSLOBS_HFI2OBSRate "AFTSLOBS_HFI2OBSRate" FLOAT32_IEEE F_1_p0_2 1 2 -3.402823466E+038 3.402823466E+038 ECU_ADDRESS 0x70003094 /end MEASUREMENT
/begin MEASUREMENT AFTSLOBS_LowSpdActEleSpdRds "AFTSLOBS_LowSpdActEleSpdRds" FLOAT32_IEEE F_1_p0_2 1 2 -3.402823466E+038 3.402823466E+038 ECU_ADDRESS 0x70003090 /end MEASUREMENT
/begin MEASUREMENT AFTSLOBS_LowSpdActEleThetaRd "AFTSLOBS_LowSpdActEleThetaRd" FLOAT32_IEEE F_1_p0_2 1 2 -3.402823466E+038 3.402823466E+038 ECU_ADDRESS 0x7000308C /end MEASUREMENT
/begin MEASUREMENT AFTSLOBS_OpenDiffThetaRd "AFTSLOBS_OpenDiffThetaRd" FLOAT32_IEEE F_1_p0_2 1 2 -3.402823466E+038 3.402823466E+038 ECU_ADDRESS 0x70003088 /end MEASUREMENT
/begin MEASUREMENT AFTSLOBS_OpenThetaRd "AFTSLOBS_OpenThetaRd" FLOAT32_IEEE F_1_p0_2 1 2 -3.402823466E+038 3.402823466E+038 ECU_ADDRESS 0x70003084 /end MEASUREMENT
/begin MEASUREMENT AFTSLOBS_OpenThetaRdZ "AFTSLOBS_OpenThetaRdZ" FLOAT32_IEEE F_1_p0_2 1 2 -3.402823466E+038 3.402823466E+038 ECU_ADDRESS 0x70003080 /end MEASUREMENT
/begin MEASUREMENT AFTSLOBS_PsiActive "AFTSLOBS_PsiActive" FLOAT32_IEEE F_1_p0_2 1 2 -3.402823466E+038 3.402823466E+038 ECU_ADDRESS 0x7000307C /end MEASUREMENT
/begin MEASUREMENT AFTSLOBS_PsiActiveAlpha "AFTSLOBS_PsiActiveAlpha" FLOAT32_IEEE F_1_p0_2 1 2 -3.402823466E+038 3.402823466E+038 ECU_ADDRESS 0x70003078 /end MEASUREMENT
/begin MEASUREMENT AFTSLOBS_PsiActiveBeta "AFTSLOBS_PsiActiveBeta" FLOAT32_IEEE F_1_p0_2 1 2 -3.402823466E+038 3.402823466E+038 ECU_ADDRESS 0x70003074 /end MEASUREMENT
/begin MEASUREMENT AFTSLOBS_PsiSAlphaDelta "AFTSLOBS_PsiSAlphaDelta" FLOAT32_IEEE F_1_p0_2 1 2 -3.402823466E+038 3.402823466E+038 ECU_ADDRESS 0x70003070 /end MEASUREMENT
/begin MEASUREMENT AFTSLOBS_PsiSAlphaErr "AFTSLOBS_PsiSAlphaErr" FLOAT32_IEEE F_1_p0_2 1 2 -3.402823466E+038 3.402823466E+038 ECU_ADDRESS 0x7000306C /end MEASUREMENT
/begin MEASUREMENT AFTSLOBS_PsiSAlphaZ "AFTSLOBS_PsiSAlphaZ" FLOAT32_IEEE F_1_p0_2 1 2 -3.402823466E+038 3.402823466E+038 ECU_ADDRESS 0x70003068 /end MEASUREMENT
/begin MEASUREMENT AFTSLOBS_PsiSBetaDelta "AFTSLOBS_PsiSBetaDelta" FLOAT32_IEEE F_1_p0_2 1 2 -3.402823466E+038 3.402823466E+038 ECU_ADDRESS 0x70003064 /end MEASUREMENT
/begin MEASUREMENT AFTSLOBS_PsiSBetaErr "AFTSLOBS_PsiSBetaErr" FLOAT32_IEEE F_1_p0_2 1 2 -3.402823466E+038 3.402823466E+038 ECU_ADDRESS 0x70003060 /end MEASUREMENT
/begin MEASUREMENT AFTSLOBS_PsiSBetaZ "AFTSLOBS_PsiSBetaZ" FLOAT32_IEEE F_1_p0_2 1 2 -3.402823466E+038 3.402823466E+038 ECU_ADDRESS 0x7000305C /end MEASUREMENT
/begin MEASUREMENT AFTSLOBS_Rising2FastCntZ "AFTSLOBS_Rising2FastCntZ" SWORD F_1_p0_2 1 2 -32768 32767 ECU_ADDRESS 0x70003058 /end MEASUREMENT
/begin MEASUREMENT AFTSLOBS_RunFailState "AFTSLOBS_RunFailState" UBYTE F_1_p0_2 1 2 0 255 ECU_ADDRESS 0x70003056 /end MEASUREMENT
/begin MEASUREMENT AFTSLOBS_RunIsLowCntZ "AFTSLOBS_RunIsLowCntZ" SWORD F_1_p0_2 1 2 -32768 32767 ECU_ADDRESS 0x70003054 /end MEASUREMENT
/begin MEASUREMENT AFTSLOBS_SinCosCorElecThetaZ[0] "AFTSLOBS_SinCosCorElecThetaZ" FLOAT32_IEEE F_1_p0_2 1 2 -3.402823466E+038 3.402823466E+038 ECU_ADDRESS 0x7000304C /end MEASUREMENT
/begin MEASUREMENT AFTSLOBS_SinCosCorElecThetaZ[1] "AFTSLOBS_SinCosCorElecThetaZ" FLOAT32_IEEE F_1_p0_2 1 2 -3.402823466E+038 3.402823466E+038 ECU_ADDRESS 0x70003050 /end MEASUREMENT
/begin MEASUREMENT AFTSLOBS_SinCosElecTheta[0] "AFTSLOBS_SinCosElecTheta" FLOAT32_IEEE F_1_p0_2 1 2 -3.402823466E+038 3.402823466E+038 ECU_ADDRESS 0x70003044 /end MEASUREMENT
/begin MEASUREMENT AFTSLOBS_SinCosElecTheta[1] "AFTSLOBS_SinCosElecTheta" FLOAT32_IEEE F_1_p0_2 1 2 -3.402823466E+038 3.402823466E+038 ECU_ADDRESS 0x70003048 /end MEASUREMENT
/begin MEASUREMENT AFTSLOBS_SpdErrIqMinCntZ "AFTSLOBS_SpdErrIqMinCntZ" SWORD F_1_p0_2 1 2 -32768 32767 ECU_ADDRESS 0x70003040 /end MEASUREMENT
/begin MEASUREMENT AFTSLOBS_aDeltaThetaElec "AFTSLOBS_aDeltaThetaElec" FLOAT32_IEEE F_1_p0_2 1 2 -3.402823466E+038 3.402823466E+038 ECU_ADDRESS 0x7000303C /end MEASUREMENT
/begin MEASUREMENT AFTSLOBS_aElecSpeedRds "AFTSLOBS_aElecSpeedRds" FLOAT32_IEEE F_1_p0_2 1 2 -3.402823466E+038 3.402823466E+038 ECU_ADDRESS 0x70003038 /end MEASUREMENT
/begin MEASUREMENT AFTSLOBS_aNorPiDeltaThetaElec "AFTSLOBS_aNorPiDeltaThetaElec" FLOAT32_IEEE F_1_p0_2 1 2 -3.402823466E+038 3.402823466E+038 ECU_ADDRESS 0x70003034 /end MEASUREMENT
/begin MEASUREMENT AFTSLOBS_aRawThetaElec "AFTSLOBS_aRawThetaElec" FLOAT32_IEEE F_1_p0_2 1 2 -3.402823466E+038 3.402823466E+038 ECU_ADDRESS 0x70003030 /end MEASUREMENT
/begin MEASUREMENT AFTSLOBS_aThetaElecRd "AFTSLOBS_aThetaElecRd" FLOAT32_IEEE F_1_p0_2 1 2 -3.402823466E+038 3.402823466E+038 ECU_ADDRESS 0x7000302C /end MEASUREMENT
/begin MEASUREMENT AFTSLOBS_aThetaElecZ "AFTSLOBS_aThetaElecZ" FLOAT32_IEEE F_1_p0_2 1 2 -3.402823466E+038 3.402823466E+038 ECU_ADDRESS 0x70003028 /end MEASUREMENT
/begin MEASUREMENT AFTSLOBS_pCorElecThetaRd "AFTSLOBS_pCorElecThetaRd" FLOAT32_IEEE F_1_p0_2 1 2 -3.402823466E+038 3.402823466E+038 ECU_ADDRESS 0x70003024 /end MEASUREMENT
/begin MEASUREMENT AFTSLOBS_pCorElecThetaRdZ "AFTSLOBS_pCorElecThetaRdZ" FLOAT32_IEEE F_1_p0_2 1 2 -3.402823466E+038 3.402823466E+038 ECU_ADDRESS 0x70003020 /end MEASUREMENT
/begin MEASUREMENT AFTSLOBS_pDeltaThetaElec "AFTSLOBS_pDeltaThetaElec" FLOAT32_IEEE F_1_p0_2 1 2 -3.402823466E+038 3.402823466E+038 ECU_ADDRESS 0x7000301C /end MEASUREMENT
/begin MEASUREMENT AFTSLOBS_pEleAcceleration "AFTSLOBS_pEleAcceleration" FLOAT32_IEEE F_1_p0_2 1 2 -3.402823466E+038 3.402823466E+038 ECU_ADDRESS 0x70003018 /end MEASUREMENT
/begin MEASUREMENT AFTSLOBS_pElecNextThetaRd "AFTSLOBS_pElecNextThetaRd" FLOAT32_IEEE F_1_p0_2 1 2 -3.402823466E+038 3.402823466E+038 ECU_ADDRESS 0x70003014 /end MEASUREMENT
/begin MEASUREMENT AFTSLOBS_pElecNextThetaRdZ "AFTSLOBS_pElecNextThetaRdZ" FLOAT32_IEEE F_1_p0_2 1 2 -3.402823466E+038 3.402823466E+038 ECU_ADDRESS 0x70003010 /end MEASUREMENT
/begin MEASUREMENT AFTSLOBS_pElecRdsSurSampleTimeZ "AFTSLOBS_pElecRdsSurSampleTimeZ" FLOAT32_IEEE F_1_p0_2 1 2 -3.402823466E+038 3.402823466E+038 ECU_ADDRESS 0x7000300C /end MEASUREMENT
/begin MEASUREMENT AFTSLOBS_pElecSpeedRds "AFTSLOBS_pElecSpeedRds" FLOAT32_IEEE F_1_p0_2 1 2 -3.402823466E+038 3.402823466E+038 ECU_ADDRESS 0x70003008 /end MEASUREMENT
/begin MEASUREMENT AFTSLOBS_pElecSpeedRdsFild "AFTSLOBS_pElecSpeedRdsFild" FLOAT32_IEEE F_1_p0_2 1 2 -3.402823466E+038 3.402823466E+038 ECU_ADDRESS 0x70003004 /end MEASUREMENT
/begin MEASUREMENT AFTSLOBS_pElecSpeedRdsFildZ "AFTSLOBS_pElecSpeedRdsFildZ" FLOAT32_IEEE F_1_p0_2 1 2 -3.402823466E+038 3.402823466E+038 ECU_ADDRESS 0x70003000 /end MEASUREMENT
/begin MEASUREMENT AFTSLOBS_pElecSpeedRdsFilterZ "AFTSLOBS_pElecSpeedRdsFilterZ" FLOAT32_IEEE F_1_p0_2 1 2 -3.402823466E+038 3.402823466E+038 ECU_ADDRESS 0x70002FFC /end MEASUREMENT
/begin MEASUREMENT AFTSLOBS_pThetaElecTempRd "AFTSLOBS_pThetaElecTempRd" FLOAT32_IEEE F_1_p0_2 1 2 -3.402823466E+038 3.402823466E+038 ECU_ADDRESS 0x70002FF8 /end MEASUREMENT
/begin MEASUREMENT AFTSLOBS_pThetaTempRdZ "AFTSLOBS_pThetaTempRdZ" FLOAT32_IEEE F_1_p0_2 1 2 -3.402823466E+038 3.402823466E+038 ECU_ADDRESS 0x70002FF4 /end MEASUREMENT
/begin MEASUREMENT AFTSMACS_AclPreviousState "AFTSMACS_AclPreviousState" UWORD F_1_p0_2 1 2 0 65535 ECU_ADDRESS 0x700030E0 /end MEASUREMENT
/begin MEASUREMENT AFTSMACS_AclState "AFTSMACS_AclState" UWORD F_1_p0_2 1 2 0 65535 ECU_ADDRESS 0x700030DE /end MEASUREMENT
/begin MEASUREMENT AFTSMACS_CmdAftShutDownRes "AFTSMACS_CmdAftShutDownRes" UBYTE Bool_ON_OFF 1 2 0 1 BIT_MASK 0x01 ECU_ADDRESS 0x700030DD /end MEASUREMENT
/begin MEASUREMENT AFTSMACS_CmdAftStartRes "AFTSMACS_CmdAftStartRes" UBYTE Bool_ON_OFF 1 2 0 1 BIT_MASK 0x01 ECU_ADDRESS 0x700030DC /end MEASUREMENT
/begin MEASUREMENT AFTSMACS_CmdPwmDirectReq "AFTSMACS_CmdPwmDirectReq" UBYTE Bool_ON_OFF 1 2 0 1 BIT_MASK 0x01 ECU_ADDRESS 0x700030DB /end MEASUREMENT
/begin MEASUREMENT AFTSMACS_CmdPwmOffReq "AFTSMACS_CmdPwmOffReq" UBYTE Bool_ON_OFF 1 2 0 1 BIT_MASK 0x01 ECU_ADDRESS 0x700030DA /end MEASUREMENT
/begin MEASUREMENT AFTSMACS_ReinitFault "Boolean for fault reinitialization." UBYTE Bool_ON_OFF 1 2 0 1 BIT_MASK 0x01 ECU_ADDRESS 0x700030D9 /end MEASUREMENT
/begin MEASUREMENT AFTSMACS_TestFault "Boolean for fault reinitialization." UBYTE Bool_ON_OFF 1 2 0 1 BIT_MASK 0x01 ECU_ADDRESS 0x700030D8 /end MEASUREMENT
/begin MEASUREMENT AFTSMACS_VsiTimerFreqRatioRef "Timer frequency ratio reference." FLOAT32_IEEE F_1_p0_2 1 2 0 65535 ECU_ADDRESS 0x700030D4 /end MEASUREMENT
/begin MEASUREMENT AFTSMMAM_AFTCIVDC_State "AFTSMMAM_AFTCIVDC_State" UWORD F_1_p0_2 1 2 0 65535 ECU_ADDRESS 0x700030F4 /end MEASUREMENT
/begin MEASUREMENT AFTSMMAM_AFTCMCCS_State "AFTSMMAM_AFTCMCCS_State" UWORD F_1_p0_2 1 2 0 65535 ECU_ADDRESS 0x700030F2 /end MEASUREMENT
/begin MEASUREMENT AFTSMMAM_AFTCMSCS_State "AFTSMMAM_AFTCMSCS_State" UWORD F_1_p0_2 1 2 0 65535 ECU_ADDRESS 0x700030F0 /end MEASUREMENT
/begin MEASUREMENT AFTSMMAM_AFTCMTCS_State "AFTSMMAM_AFTCMTCS_State" UWORD F_1_p0_2 1 2 0 65535 ECU_ADDRESS 0x700030EE /end MEASUREMENT
/begin MEASUREMENT AFTSMMAM_AclState "AFTSMMAM_AclState" UWORD F_1_p0_2 1 2 0 65535 ECU_ADDRESS 0x700030EC /end MEASUREMENT
/begin MEASUREMENT AFTSMMAM_AftModeReq "AFTSMMAM_AftModeReq" UWORD F_1_p0_2 1 2 0 65535 ECU_ADDRESS 0x700030EA /end MEASUREMENT
/begin MEASUREMENT AFTSMMAM_CMCCS_M0ConOnoff "AFTSMMAM_CMCCS_M0ConOnoff" UBYTE Bool_ON_OFF 1 2 0 1 BIT_MASK 0x01 ECU_ADDRESS 0x700030E9 /end MEASUREMENT
/begin MEASUREMENT AFTSMMAM_EVEIT_MainEnable "AFTSMMAM_EVEIT_MainEnable" UBYTE Bool_ON_OFF 1 2 0 1 BIT_MASK 0x01 ECU_ADDRESS 0x700030E8 /end MEASUREMENT
/begin MEASUREMENT AFTSMMAM_MTLCS_State "AFTSMMAM_MTLCS_State" UWORD F_1_p0_2 1 2 0 65535 ECU_ADDRESS 0x700030E6 /end MEASUREMENT
/begin MEASUREMENT AFTSMMAM_MTMEP_State "AFTSMMAM_MTMEP_State" UWORD F_1_p0_2 1 2 0 65535 ECU_ADDRESS 0x700030E4 /end MEASUREMENT
/begin MEASUREMENT AFTSMMAM_SMREF_MainEnable "AFTSMMAM_SMREF_MainEnable" UBYTE Bool_ON_OFF 1 2 0 1 BIT_MASK 0x01 ECU_ADDRESS 0x700030E2 /end MEASUREMENT
/begin MEASUREMENT AFT_Iuvw3_U16[2] "AFT_Iuvw3_U16" UWORD F_1_p0_2 1 2 0 65535 ECU_ADDRESS 0x7000312C /end MEASUREMENT
/begin MEASUREMENT AFT_MecaSpeedRpmTgt_F32 "AFT_MecaSpeedRpmTgt_F32" FLOAT32_IEEE F_1_p0_2 1 2 -3.402823466E+038 3.402823466E+038 ECU_ADDRESS 0x70003124 /end MEASUREMENT
/begin MEASUREMENT AFT_MotorMagnetTemp_F32 "AFT_MotorMagnetTemp_F32" FLOAT32_IEEE F_1_p0_2 1 2 -3.402823466E+038 3.402823466E+038 ECU_ADDRESS 0x70003120 /end MEASUREMENT
/begin MEASUREMENT AFT_MotorWindingTemp2_F32[0] "AFT_MotorWindingTemp2_F32" FLOAT32_IEEE F_1_p0_2 1 2 -3.402823466E+038 3.402823466E+038 ECU_ADDRESS 0x70003118 /end MEASUREMENT
/begin MEASUREMENT AFT_MotorWindingTemp2_F32[1] "AFT_MotorWindingTemp2_F32" FLOAT32_IEEE F_1_p0_2 1 2 -3.402823466E+038 3.402823466E+038 ECU_ADDRESS 0x7000311C /end MEASUREMENT
/begin MEASUREMENT AFT_PowerModuleTemp_F32 "AFT_PowerModuleTemp_F32" FLOAT32_IEEE F_1_p0_2 1 2 -3.402823466E+038 3.402823466E+038 ECU_ADDRESS 0x70003114 /end MEASUREMENT
/begin MEASUREMENT AFT_PwmZeroMatch_B "AFT_PwmZeroMatch_B" UBYTE Bool_ON_OFF 1 2 0 1 BIT_MASK 0x01 ECU_ADDRESS 0x70003111 /end MEASUREMENT
/begin MEASUREMENT AFT_ScsStartCmd_B "AFT_ScsStartCmd_B" UBYTE Bool_ON_OFF 1 2 0 1 BIT_MASK 0x01 ECU_ADDRESS 0x70003110 /end MEASUREMENT
/begin MEASUREMENT AFT_TorqueTgt_F32 "AFT_TorqueTgt_F32" FLOAT32_IEEE F_1_p0_2 1 2 -3.402823466E+038 3.402823466E+038 ECU_ADDRESS 0x7000310C /end MEASUREMENT
/begin MEASUREMENT AFT_U0dqTgt3_F32[0] "AFT_U0dqTgt3_F32" FLOAT32_IEEE F_1_p0_2 1 2 -3.402823466E+038 3.402823466E+038 ECU_ADDRESS 0x70003100 /end MEASUREMENT
/begin MEASUREMENT AFT_U0dqTgt3_F32[1] "AFT_U0dqTgt3_F32" FLOAT32_IEEE F_1_p0_2 1 2 -3.402823466E+038 3.402823466E+038 ECU_ADDRESS 0x70003104 /end MEASUREMENT
/begin MEASUREMENT AFT_U0dqTgt3_F32[2] "AFT_U0dqTgt3_F32" FLOAT32_IEEE F_1_p0_2 1 2 -3.402823466E+038 3.402823466E+038 ECU_ADDRESS 0x70003108 /end MEASUREMENT
/begin MEASUREMENT AFT_UbatHV_F32 "AFT_UbatHV_F32" FLOAT32_IEEE F_1_p0_2 1 2 -3.402823466E+038 3.402823466E+038 ECU_ADDRESS 0x700030FC /end MEASUREMENT
/begin MEASUREMENT AFT_VsiPwmPeriod_F32 "AFT_VsiPwmPeriod_F32" FLOAT32_IEEE F_1_p0_2 1 2 -3.402823466E+038 3.402823466E+038 ECU_ADDRESS 0x700030F8 /end MEASUREMENT
/begin MEASUREMENT FTASBDS_BattVoltDrtGainMax "FTASBDS_BattVoltDrtGainMax" FLOAT32_IEEE F_1_p0_2 1 2 0 1 ECU_ADDRESS 0x70003264 /end MEASUREMENT
/begin MEASUREMENT FTASBDS_BattVoltDrtGainMin "FTASBDS_BattVoltDrtGainMin" FLOAT32_IEEE F_1_p0_2 1 2 0 1 ECU_ADDRESS 0x70003260 /end MEASUREMENT
/begin MEASUREMENT FTASDPM_DeratingStatus "FTASDPM_DeratingStatus" UBYTE Bool_ON_OFF 1 2 0 1 BIT_MASK 0x01 ECU_ADDRESS 0x700032A8 /end MEASUREMENT
/begin MEASUREMENT FTASDPM_DrtGainMax "FTASDPM_DrtGainMax" FLOAT32_IEEE F_1_p0_2 1 2 0 1 ECU_ADDRESS 0x700032A4 /end MEASUREMENT
/begin MEASUREMENT FTASDPM_DrtGainMaxMin[0] "FTASDPM_DrtGainMaxMin" FLOAT32_IEEE F_1_p0_2 1 2 0 1 ECU_ADDRESS 0x7000329C /end MEASUREMENT
/begin MEASUREMENT FTASDPM_DrtGainMaxMin[1] "FTASDPM_DrtGainMaxMin" FLOAT32_IEEE F_1_p0_2 1 2 0 1 ECU_ADDRESS 0x700032A0 /end MEASUREMENT
/begin MEASUREMENT FTASDPM_DrtGainMin "FTASDPM_DrtGainMin" FLOAT32_IEEE F_1_p0_2 1 2 0 1 ECU_ADDRESS 0x70003298 /end MEASUREMENT
/begin MEASUREMENT FTASDPM_MaxMinI0dqDrtVect "FTASDPM_MaxMinI0dqDrtVect" FLOAT32_IEEE F_1_p0_2 1 2 -1200 1200 MATRIX_DIM 1 6 1 ECU_ADDRESS 0x70003280 /end MEASUREMENT
/begin MEASUREMENT FTASDPM_MaxMinI0dqDrtVect[0] "FTASDPM_MaxMinI0dqDrtVect[0]" FLOAT32_IEEE F_1_p0_2 1 2 -1200 1200 ECU_ADDRESS 0x70003280 /end MEASUREMENT
/begin MEASUREMENT FTASDPM_MaxMinI0dqDrtVect[1] "FTASDPM_MaxMinI0dqDrtVect[1]" FLOAT32_IEEE F_1_p0_2 1 2 -1200 1200 ECU_ADDRESS 0x70003284 /end MEASUREMENT
/begin MEASUREMENT FTASDPM_MaxMinI0dqDrtVect[2] "FTASDPM_MaxMinI0dqDrtVect[2]" FLOAT32_IEEE F_1_p0_2 1 2 -1200 1200 ECU_ADDRESS 0x70003288 /end MEASUREMENT
/begin MEASUREMENT FTASDPM_MaxMinI0dqDrtVect[3] "FTASDPM_MaxMinI0dqDrtVect[3]" FLOAT32_IEEE F_1_p0_2 1 2 -1200 1200 ECU_ADDRESS 0x7000328C /end MEASUREMENT
/begin MEASUREMENT FTASDPM_MaxMinI0dqDrtVect[4] "FTASDPM_MaxMinI0dqDrtVect[4]" FLOAT32_IEEE F_1_p0_2 1 2 -1200 1200 ECU_ADDRESS 0x70003290 /end MEASUREMENT
/begin MEASUREMENT FTASDPM_MaxMinI0dqDrtVect[5] "FTASDPM_MaxMinI0dqDrtVect[5]" FLOAT32_IEEE F_1_p0_2 1 2 -1200 1200 ECU_ADDRESS 0x70003294 /end MEASUREMENT
/begin MEASUREMENT FTASDPM_MaxMinSpdDrtVect "FTASDPM_MaxMinSpdDrtVect" FLOAT32_IEEE F_1_p0_2 1 2 -25000 25000 MATRIX_DIM 1 2 1 ECU_ADDRESS 0x70003278 /end MEASUREMENT
/begin MEASUREMENT FTASDPM_MaxMinSpdDrtVect[0] "FTASDPM_MaxMinSpdDrtVect[0]" FLOAT32_IEEE F_1_p0_2 1 2 -25000 25000 ECU_ADDRESS 0x70003278 /end MEASUREMENT
/begin MEASUREMENT FTASDPM_MaxMinSpdDrtVect[1] "FTASDPM_MaxMinSpdDrtVect[1]" FLOAT32_IEEE F_1_p0_2 1 2 -25000 25000 ECU_ADDRESS 0x7000327C /end MEASUREMENT
/begin MEASUREMENT FTASDPM_MaxMinTorqueDrtVect "FTASDPM_MaxMinTorqueDrtVect" FLOAT32_IEEE F_1_p0_2 1 2 -500 500 MATRIX_DIM 1 2 1 ECU_ADDRESS 0x70003270 /end MEASUREMENT
/begin MEASUREMENT FTASDPM_MaxMinTorqueDrtVect[0] "FTASDPM_MaxMinTorqueDrtVect[0]" FLOAT32_IEEE F_1_p0_2 1 2 -500 500 ECU_ADDRESS 0x70003270 /end MEASUREMENT
/begin MEASUREMENT FTASDPM_MaxMinTorqueDrtVect[1] "FTASDPM_MaxMinTorqueDrtVect[1]" FLOAT32_IEEE F_1_p0_2 1 2 -500 500 ECU_ADDRESS 0x70003274 /end MEASUREMENT
/begin MEASUREMENT FTASDPM_MaxTorqueDerating "FTASDPM_MaxTorqueDerating" FLOAT32_IEEE F_1_p0_2 1 2 -3.402823466E+038 3.402823466E+038 ECU_ADDRESS 0x7000326C /end MEASUREMENT
/begin MEASUREMENT FTASDPM_MinTorqueDerating "FTASDPM_MinTorqueDerating" FLOAT32_IEEE F_1_p0_2 1 2 -3.402823466E+038 3.402823466E+038 ECU_ADDRESS 0x70003268 /end MEASUREMENT
/begin MEASUREMENT FTASETP_EstPmDeratingAct "FTASETP_EstPmDeratingAct" UBYTE Bool_ON_OFF 1 2 0 1 BIT_MASK 0x01 ECU_ADDRESS 0x700032D0 /end MEASUREMENT
/begin MEASUREMENT FTASETP_EstPmDrtGain "FTASETP_EstPmDrtGain" FLOAT32_IEEE F_1_p0_2 1 2 0 1 ECU_ADDRESS 0x700032CC /end MEASUREMENT
/begin MEASUREMENT FTASETP_EstPmMaxTemp "FTASETP_EstPmMaxTemp" FLOAT32_IEEE F_1_p0_2 1 2 -40 200 ECU_ADDRESS 0x700032C8 /end MEASUREMENT
/begin MEASUREMENT FTASETP_EstPmResetZ "FTASETP_EstPmResetZ" UBYTE Bool_ON_OFF 1 2 0 1 BIT_MASK 0x01 ECU_ADDRESS 0x700032C4 /end MEASUREMENT
/begin MEASUREMENT FTASETP_IntegralEstPmDrtGainZ "FTASETP_IntegralEstPmDrtGainZ" FLOAT32_IEEE F_1_p0_2 1 2 0 1 ECU_ADDRESS 0x700032C0 /end MEASUREMENT
/begin MEASUREMENT FTASETP_IntegralPmDrtGainZ "FTASETP_IntegralPmDrtGainZ" FLOAT32_IEEE F_1_p0_2 1 2 0 1 ECU_ADDRESS 0x700032BC /end MEASUREMENT
/begin MEASUREMENT FTASETP_OpenLoopEstPmDrtGain "FTASETP_OpenLoopEstPmDrtGain" FLOAT32_IEEE F_1_p0_2 1 2 0 1 ECU_ADDRESS 0x700032B8 /end MEASUREMENT
/begin MEASUREMENT FTASETP_PmDeratingAct "FTASETP_PmDeratingAct" UBYTE Bool_ON_OFF 1 2 0 1 BIT_MASK 0x01 ECU_ADDRESS 0x700032B4 /end MEASUREMENT
/begin MEASUREMENT FTASETP_PmDrtGain "FTASETP_PmDrtGain" FLOAT32_IEEE F_1_p0_2 1 2 0 1 ECU_ADDRESS 0x700032B0 /end MEASUREMENT
/begin MEASUREMENT FTASETP_PmMaxTemp "FTASETP_PmMaxTemp" FLOAT32_IEEE F_1_p0_2 1 2 -40 200 ECU_ADDRESS 0x700032AC /end MEASUREMENT
/begin MEASUREMENT FTASETP_PmResetZ "FTASETP_PmResetZ" UBYTE Bool_ON_OFF 1 2 0 1 BIT_MASK 0x01 ECU_ADDRESS 0x700032A9 /end MEASUREMENT
/begin MEASUREMENT FTASMTP_IntegralWndg1DrtGainZ "FTASMTP_IntegralWndg1DrtGainZ" FLOAT32_IEEE F_1_p0_2 1 2 0 1 ECU_ADDRESS 0x700032EC /end MEASUREMENT
/begin MEASUREMENT FTASMTP_IntegralWndg2DrtGainZ "FTASMTP_IntegralWndg2DrtGainZ" FLOAT32_IEEE F_1_p0_2 1 2 0 1 ECU_ADDRESS 0x700032E8 /end MEASUREMENT
/begin MEASUREMENT FTASMTP_Wndg1ResetZ "FTASMTP_Wndg1ResetZ" UBYTE Bool_ON_OFF 1 2 0 1 BIT_MASK 0x01 ECU_ADDRESS 0x700032E4 /end MEASUREMENT
/begin MEASUREMENT FTASMTP_Wndg1Temp "FTASMTP_Wndg1Temp" FLOAT32_IEEE F_1_p0_2 1 2 -40 200 ECU_ADDRESS 0x700032E0 /end MEASUREMENT
/begin MEASUREMENT FTASMTP_Wndg2DeratingActDetn "FTASMTP_Wndg2DeratingActDetn" UBYTE Bool_ON_OFF 1 2 0 1 BIT_MASK 0x01 ECU_ADDRESS 0x700032DD /end MEASUREMENT
/begin MEASUREMENT FTASMTP_Wndg2ResetZ "FTASMTP_Wndg2ResetZ" UBYTE Bool_ON_OFF 1 2 0 1 BIT_MASK 0x01 ECU_ADDRESS 0x700032DC /end MEASUREMENT
/begin MEASUREMENT FTASMTP_Wndg2Temp "FTASMTP_Wndg2Temp" FLOAT32_IEEE F_1_p0_2 1 2 -40 200 ECU_ADDRESS 0x700032D8 /end MEASUREMENT
/begin MEASUREMENT FTASMTP_WndgDrtGain "FTASMTP_WndgDrtGain" FLOAT32_IEEE F_1_p0_2 1 2 0 1 ECU_ADDRESS 0x700032D4 /end MEASUREMENT
/begin MEASUREMENT FTASOSP_MotorSpeedDrtGainMax "FTASOSP_MotorSpeedDrtGainMax" FLOAT32_IEEE F_1_p0_2 1 2 0 1 ECU_ADDRESS 0x700032F4 /end MEASUREMENT
/begin MEASUREMENT FTASOSP_MotorSpeedDrtGainMin "FTASOSP_MotorSpeedDrtGainMin" FLOAT32_IEEE F_1_p0_2 1 2 0 1 ECU_ADDRESS 0x700032F0 /end MEASUREMENT
/begin MEASUREMENT FTCIVDC_1ByUbatHV "FTCIVDC_1ByUbatHV" FLOAT32_IEEE F_1_p0_2 1 2 0.0001 1 ECU_ADDRESS 0x700033C4 /end MEASUREMENT
/begin MEASUREMENT FTCIVDC_AntiNarrowPulseMaxDuty "FTCIVDC_AntiNarrowPulseMaxDuty" FLOAT32_IEEE F_1_p0_2 1 2 0 1 ECU_ADDRESS 0x700033C0 /end MEASUREMENT
/begin MEASUREMENT FTCIVDC_CntTimeZ "FTCIVDC_CntTimeZ" UWORD F_1_p0_2 1 2 0 65535 ECU_ADDRESS 0x700033BC /end MEASUREMENT
/begin MEASUREMENT FTCIVDC_CompDutyU "FTCIVDC_CompDutyU" FLOAT32_IEEE F_1_p0_2 1 2 -3.402823466E+038 3.402823466E+038 ECU_ADDRESS 0x700033B8 /end MEASUREMENT
/begin MEASUREMENT FTCIVDC_CompDutyUZ "FTCIVDC_CompDutyUZ" FLOAT32_IEEE F_1_p0_2 1 2 -3.402823466E+038 3.402823466E+038 ECU_ADDRESS 0x700033B4 /end MEASUREMENT
/begin MEASUREMENT FTCIVDC_CompDutyV "FTCIVDC_CompDutyV" FLOAT32_IEEE F_1_p0_2 1 2 -3.402823466E+038 3.402823466E+038 ECU_ADDRESS 0x700033B0 /end MEASUREMENT
/begin MEASUREMENT FTCIVDC_CompDutyVZ "FTCIVDC_CompDutyVZ" FLOAT32_IEEE F_1_p0_2 1 2 -3.402823466E+038 3.402823466E+038 ECU_ADDRESS 0x700033AC /end MEASUREMENT
/begin MEASUREMENT FTCIVDC_CompDutyW "FTCIVDC_CompDutyW" FLOAT32_IEEE F_1_p0_2 1 2 -3.402823466E+038 3.402823466E+038 ECU_ADDRESS 0x700033A8 /end MEASUREMENT
/begin MEASUREMENT FTCIVDC_CompDutyWZ "FTCIVDC_CompDutyWZ" FLOAT32_IEEE F_1_p0_2 1 2 -3.402823466E+038 3.402823466E+038 ECU_ADDRESS 0x700033A4 /end MEASUREMENT
/begin MEASUREMENT FTCIVDC_CurrDeltaThetaRd "FTCIVDC_CurrDeltaThetaRd" FLOAT32_IEEE F_1_p0_2 1 2 -3.402823466E+038 3.402823466E+038 ECU_ADDRESS 0x700033A0 /end MEASUREMENT
/begin MEASUREMENT FTCIVDC_DeadCompEnRelayZ "FTCIVDC_DeadCompEnRelayZ" UBYTE Bool_ON_OFF 1 2 0 1 BIT_MASK 0x01 ECU_ADDRESS 0x7000339D /end MEASUREMENT
/begin MEASUREMENT FTCIVDC_DeadCompNumberZ "FTCIVDC_DeadCompNumberZ" UBYTE F_1_p0_2 1 2 0 255 ECU_ADDRESS 0x7000339C /end MEASUREMENT
/begin MEASUREMENT FTCIVDC_DeadTimeUGain "FTCIVDC_DeadTimeUGain" FLOAT32_IEEE F_1_p0_2 1 2 -3.402823466E+038 3.402823466E+038 ECU_ADDRESS 0x70003398 /end MEASUREMENT
/begin MEASUREMENT FTCIVDC_DeadTimeVGain "FTCIVDC_DeadTimeVGain" FLOAT32_IEEE F_1_p0_2 1 2 -3.402823466E+038 3.402823466E+038 ECU_ADDRESS 0x70003394 /end MEASUREMENT
/begin MEASUREMENT FTCIVDC_DeadTimeWGain "FTCIVDC_DeadTimeWGain" FLOAT32_IEEE F_1_p0_2 1 2 -3.402823466E+038 3.402823466E+038 ECU_ADDRESS 0x70003390 /end MEASUREMENT
/begin MEASUREMENT FTCIVDC_DeadZnCompSpdEnZ "FTCIVDC_DeadZnCompSpdEnZ" UBYTE Bool_ON_OFF 1 2 0 1 BIT_MASK 0x01 ECU_ADDRESS 0x7000338D /end MEASUREMENT
/begin MEASUREMENT FTCIVDC_DeadZnEnaFlg "FTCIVDC_DeadZnEnaFlg" UBYTE Bool_ON_OFF 1 2 0 1 BIT_MASK 0x01 ECU_ADDRESS 0x7000338C /end MEASUREMENT
/begin MEASUREMENT FTCIVDC_DutyCycle3[0] "FTCIVDC_DutyCycle3" FLOAT32_IEEE F_1_p0_2 1 2 0 1 ECU_ADDRESS 0x70003380 /end MEASUREMENT
/begin MEASUREMENT FTCIVDC_DutyCycle3[1] "FTCIVDC_DutyCycle3" FLOAT32_IEEE F_1_p0_2 1 2 0 1 ECU_ADDRESS 0x70003384 /end MEASUREMENT
/begin MEASUREMENT FTCIVDC_DutyCycle3[2] "FTCIVDC_DutyCycle3" FLOAT32_IEEE F_1_p0_2 1 2 0 1 ECU_ADDRESS 0x70003388 /end MEASUREMENT
/begin MEASUREMENT FTCIVDC_DutyCycleMinMax[0] "FTCIVDC_DutyCycleMinMax" FLOAT32_IEEE F_1_p0_2 1 2 0 1 ECU_ADDRESS 0x70003378 /end MEASUREMENT
/begin MEASUREMENT FTCIVDC_DutyCycleMinMax[1] "FTCIVDC_DutyCycleMinMax" FLOAT32_IEEE F_1_p0_2 1 2 0 1 ECU_ADDRESS 0x7000337C /end MEASUREMENT
/begin MEASUREMENT FTCIVDC_DutyCycleOrg3[0] "FTCIVDC_DutyCycleOrg3" FLOAT32_IEEE F_1_p0_2 1 2 -3.402823466E+038 3.402823466E+038 ECU_ADDRESS 0x7000336C /end MEASUREMENT
/begin MEASUREMENT FTCIVDC_DutyCycleOrg3[1] "FTCIVDC_DutyCycleOrg3" FLOAT32_IEEE F_1_p0_2 1 2 -3.402823466E+038 3.402823466E+038 ECU_ADDRESS 0x70003370 /end MEASUREMENT
/begin MEASUREMENT FTCIVDC_DutyCycleOrg3[2] "FTCIVDC_DutyCycleOrg3" FLOAT32_IEEE F_1_p0_2 1 2 -3.402823466E+038 3.402823466E+038 ECU_ADDRESS 0x70003374 /end MEASUREMENT
/begin MEASUREMENT FTCIVDC_DutyCycleTemp3[0] "FTCIVDC_DutyCycleTemp3" FLOAT32_IEEE F_1_p0_2 1 2 0 1 ECU_ADDRESS 0x70003360 /end MEASUREMENT
/begin MEASUREMENT FTCIVDC_DutyCycleTemp3[1] "FTCIVDC_DutyCycleTemp3" FLOAT32_IEEE F_1_p0_2 1 2 0 1 ECU_ADDRESS 0x70003364 /end MEASUREMENT
/begin MEASUREMENT FTCIVDC_DutyCycleTemp3[2] "FTCIVDC_DutyCycleTemp3" FLOAT32_IEEE F_1_p0_2 1 2 0 1 ECU_ADDRESS 0x70003368 /end MEASUREMENT
/begin MEASUREMENT FTCIVDC_DutyCycleTempANP3[0] "FTCIVDC_DutyCycleTempANP3" FLOAT32_IEEE F_1_p0_2 1 2 0 1 ECU_ADDRESS 0x70003354 /end MEASUREMENT
/begin MEASUREMENT FTCIVDC_DutyCycleTempANP3[1] "FTCIVDC_DutyCycleTempANP3" FLOAT32_IEEE F_1_p0_2 1 2 0 1 ECU_ADDRESS 0x70003358 /end MEASUREMENT
/begin MEASUREMENT FTCIVDC_DutyCycleTempANP3[2] "FTCIVDC_DutyCycleTempANP3" FLOAT32_IEEE F_1_p0_2 1 2 0 1 ECU_ADDRESS 0x7000335C /end MEASUREMENT
/begin MEASUREMENT FTCIVDC_EitEstPwmFrequence "FTCIVDC_EitEstPwmFrequence" UWORD F_1_p0_2 1 2 1000 65535 ECU_ADDRESS 0x70003350 /end MEASUREMENT
/begin MEASUREMENT FTCIVDC_IdFildZ "FTCIVDC_IdFildZ" FLOAT32_IEEE F_1_p0_2 1 2 -3.402823466E+038 3.402823466E+038 ECU_ADDRESS 0x7000334C /end MEASUREMENT
/begin MEASUREMENT FTCIVDC_IqFildZ "FTCIVDC_IqFildZ" FLOAT32_IEEE F_1_p0_2 1 2 -3.402823466E+038 3.402823466E+038 ECU_ADDRESS 0x70003348 /end MEASUREMENT
/begin MEASUREMENT FTCIVDC_Iuvw3Z[0] "FTCIVDC_Iuvw3Z" FLOAT32_IEEE F_1_p0_2 1 2 -3.402823466E+038 3.402823466E+038 ECU_ADDRESS 0x7000333C /end MEASUREMENT
/begin MEASUREMENT FTCIVDC_Iuvw3Z[1] "FTCIVDC_Iuvw3Z" FLOAT32_IEEE F_1_p0_2 1 2 -3.402823466E+038 3.402823466E+038 ECU_ADDRESS 0x70003340 /end MEASUREMENT
/begin MEASUREMENT FTCIVDC_Iuvw3Z[2] "FTCIVDC_Iuvw3Z" FLOAT32_IEEE F_1_p0_2 1 2 -3.402823466E+038 3.402823466E+038 ECU_ADDRESS 0x70003344 /end MEASUREMENT
/begin MEASUREMENT FTCIVDC_LutOutFreq "FTCIVDC_LutOutFreq" UWORD F_1_p0_2 1 2 0 65535 ECU_ADDRESS 0x70003338 /end MEASUREMENT
/begin MEASUREMENT FTCIVDC_MecaSpeedRpmFild "FTCIVDC_MecaSpeedRpmFild" FLOAT32_IEEE F_1_p0_2 1 2 -3.402823466E+038 3.402823466E+038 ECU_ADDRESS 0x70003334 /end MEASUREMENT
/begin MEASUREMENT FTCIVDC_MecaSpeedRpmZ "FTCIVDC_MecaSpeedRpmZ" FLOAT32_IEEE F_1_p0_2 1 2 -3.402823466E+038 3.402823466E+038 ECU_ADDRESS 0x70003330 /end MEASUREMENT
/begin MEASUREMENT FTCIVDC_PhaseCurrentAngle "FTCIVDC_PhaseCurrentAngle" FLOAT32_IEEE F_1_p0_2 1 2 -3.402823466E+038 3.402823466E+038 ECU_ADDRESS 0x7000332C /end MEASUREMENT
/begin MEASUREMENT FTCIVDC_PwmFrequence "FTCIVDC_PwmFrequence" UWORD F_1_p0_2 1 2 1000 65535 ECU_ADDRESS 0x7000332A /end MEASUREMENT
/begin MEASUREMENT FTCIVDC_PwmFrequenceZ "FTCIVDC_PwmFrequenceZ" UWORD F_1_p0_2 1 2 0 65535 ECU_ADDRESS 0x70003328 /end MEASUREMENT
/begin MEASUREMENT FTCIVDC_PwmOnOff3[0] "FTCIVDC_PwmOnOff3" UBYTE Bool_ON_OFF 1 2 0 1 BIT_MASK 0x01 ECU_ADDRESS 0x70003324 /end MEASUREMENT
/begin MEASUREMENT FTCIVDC_PwmOnOff3[1] "FTCIVDC_PwmOnOff3" UBYTE Bool_ON_OFF 1 2 0 1 BIT_MASK 0x01 ECU_ADDRESS 0x70003325 /end MEASUREMENT
/begin MEASUREMENT FTCIVDC_PwmOnOff3[2] "FTCIVDC_PwmOnOff3" UBYTE Bool_ON_OFF 1 2 0 1 BIT_MASK 0x01 ECU_ADDRESS 0x70003326 /end MEASUREMENT
/begin MEASUREMENT FTCIVDC_RandFreq "FTCIVDC_RandFreq" FLOAT32_IEEE F_1_p0_2 1 2 -3.402823466E+038 3.402823466E+038 ECU_ADDRESS 0x70003320 /end MEASUREMENT
/begin MEASUREMENT FTCIVDC_RandNumScal "FTCIVDC_RandNumScal" FLOAT32_IEEE F_1_p0_2 1 2 -3.402823466E+038 3.402823466E+038 ECU_ADDRESS 0x7000331C /end MEASUREMENT
/begin MEASUREMENT FTCIVDC_RandomNum "FTCIVDC_RandomNum" FLOAT32_IEEE F_1_p0_2 1 2 -3.402823466E+038 3.402823466E+038 ECU_ADDRESS 0x70003318 /end MEASUREMENT
/begin MEASUREMENT FTCIVDC_SimpleUVW3[0] "FTCIVDC_SimpleUVW3" FLOAT32_IEEE F_1_p0_2 1 2 0 2000 ECU_ADDRESS 0x7000330C /end MEASUREMENT
/begin MEASUREMENT FTCIVDC_SimpleUVW3[1] "FTCIVDC_SimpleUVW3" FLOAT32_IEEE F_1_p0_2 1 2 0 2000 ECU_ADDRESS 0x70003310 /end MEASUREMENT
/begin MEASUREMENT FTCIVDC_SimpleUVW3[2] "FTCIVDC_SimpleUVW3" FLOAT32_IEEE F_1_p0_2 1 2 0 2000 ECU_ADDRESS 0x70003314 /end MEASUREMENT
/begin MEASUREMENT FTCIVDC_TimeEnableZ "FTCIVDC_TimeEnableZ" UBYTE Bool_ON_OFF 1 2 0 1 BIT_MASK 0x01 ECU_ADDRESS 0x70003308 /end MEASUREMENT
/begin MEASUREMENT FTCIVDC_UM0zeroTgt "FTCIVDC_UM0zeroTgt" FLOAT32_IEEE F_1_p0_2 1 2 0 2000 ECU_ADDRESS 0x70003304 /end MEASUREMENT
/begin MEASUREMENT FTCIVDC_UM1AlphaTgt "FTCIVDC_UM1AlphaTgt" FLOAT32_IEEE F_1_p0_2 1 2 0 2000 ECU_ADDRESS 0x70003300 /end MEASUREMENT
/begin MEASUREMENT FTCIVDC_UM1BetaTgt "FTCIVDC_UM1BetaTgt" FLOAT32_IEEE F_1_p0_2 1 2 0 2000 ECU_ADDRESS 0x700032FC /end MEASUREMENT
/begin MEASUREMENT FTCIVDC_UbatHV "FTCIVDC_UbatHV" FLOAT32_IEEE F_1_p0_2 1 2 0 2000 ECU_ADDRESS 0x700032F8 /end MEASUREMENT
/begin MEASUREMENT FTCMCCS_AAfilterVar1Z "FTCMCCS_AAfilterVar1Z" FLOAT32_IEEE F_1_p0_2 1 2 -3.402823466E+038 3.402823466E+038 ECU_ADDRESS 0x700034B0 /end MEASUREMENT
/begin MEASUREMENT FTCMCCS_AAfilterVar2Z "FTCMCCS_AAfilterVar2Z" FLOAT32_IEEE F_1_p0_2 1 2 -3.402823466E+038 3.402823466E+038 ECU_ADDRESS 0x700034AC /end MEASUREMENT
/begin MEASUREMENT FTCMCCS_AAfilterVar3Z "FTCMCCS_AAfilterVar3Z" FLOAT32_IEEE F_1_p0_2 1 2 -3.402823466E+038 3.402823466E+038 ECU_ADDRESS 0x700034A8 /end MEASUREMENT
/begin MEASUREMENT FTCMCCS_AAfilterVar4Z "FTCMCCS_AAfilterVar4Z" FLOAT32_IEEE F_1_p0_2 1 2 -3.402823466E+038 3.402823466E+038 ECU_ADDRESS 0x700034A4 /end MEASUREMENT
/begin MEASUREMENT FTCMCCS_AAfilterVar5Z "FTCMCCS_AAfilterVar5Z" FLOAT32_IEEE F_1_p0_2 1 2 -3.402823466E+038 3.402823466E+038 ECU_ADDRESS 0x700034A0 /end MEASUREMENT
/begin MEASUREMENT FTCMCCS_EM1dOpenLoopEst "FTCMCCS_EM1dOpenLoopEst" FLOAT32_IEEE F_1_p0_2 1 2 -3.402823466E+038 3.402823466E+038 ECU_ADDRESS 0x7000349C /end MEASUREMENT
/begin MEASUREMENT FTCMCCS_EM1qOpenLoopEst "FTCMCCS_EM1qOpenLoopEst" FLOAT32_IEEE F_1_p0_2 1 2 -3.402823466E+038 3.402823466E+038 ECU_ADDRESS 0x70003498 /end MEASUREMENT
/begin MEASUREMENT FTCMCCS_EpsilonM0Ctrl "FTCMCCS_EpsilonM0Ctrl" FLOAT32_IEEE F_1_p0_2 1 2 -3.402823466E+038 3.402823466E+038 ECU_ADDRESS 0x70003494 /end MEASUREMENT
/begin MEASUREMENT FTCMCCS_EpsilonM1dCtrl "FTCMCCS_EpsilonM1dCtrl" FLOAT32_IEEE F_1_p0_2 1 2 -3.402823466E+038 3.402823466E+038 ECU_ADDRESS 0x70003490 /end MEASUREMENT
/begin MEASUREMENT FTCMCCS_EpsilonM1qCtrl "FTCMCCS_EpsilonM1qCtrl" FLOAT32_IEEE F_1_p0_2 1 2 -3.402823466E+038 3.402823466E+038 ECU_ADDRESS 0x7000348C /end MEASUREMENT
/begin MEASUREMENT FTCMCCS_Lm1d "FTCMCCS_Lm1d" FLOAT32_IEEE F_1_p0_2 1 2 -3.402823466E+038 3.402823466E+038 ECU_ADDRESS 0x70003488 /end MEASUREMENT
/begin MEASUREMENT FTCMCCS_Lm1dOut "FTCMCCS_Lm1dOut" FLOAT32_IEEE F_1_p0_2 1 2 -3.402823466E+038 3.402823466E+038 ECU_ADDRESS 0x70003484 /end MEASUREMENT
/begin MEASUREMENT FTCMCCS_Lm1q "FTCMCCS_Lm1q" FLOAT32_IEEE F_1_p0_2 1 2 -3.402823466E+038 3.402823466E+038 ECU_ADDRESS 0x70003480 /end MEASUREMENT
/begin MEASUREMENT FTCMCCS_Lm1qOut "FTCMCCS_Lm1qOut" FLOAT32_IEEE F_1_p0_2 1 2 -3.402823466E+038 3.402823466E+038 ECU_ADDRESS 0x7000347C /end MEASUREMENT
/begin MEASUREMENT FTCMCCS_LutOutM1dCtrlTr "FTCMCCS_LutOutM1dCtrlTr" FLOAT32_IEEE F_1_p0_2 1 2 -3.402823466E+038 3.402823466E+038 ECU_ADDRESS 0x70003478 /end MEASUREMENT
/begin MEASUREMENT FTCMCCS_LutOutM1qCtrlTr "FTCMCCS_LutOutM1qCtrlTr" FLOAT32_IEEE F_1_p0_2 1 2 -3.402823466E+038 3.402823466E+038 ECU_ADDRESS 0x70003474 /end MEASUREMENT
/begin MEASUREMENT FTCMCCS_LutOutiM1dTgtFildTr "FTCMCCS_LutOutiM1dTgtFildTr" FLOAT32_IEEE F_1_p0_2 1 2 -3.402823466E+038 3.402823466E+038 ECU_ADDRESS 0x70003470 /end MEASUREMENT
/begin MEASUREMENT FTCMCCS_LutOutiM1qTgtFildTr "FTCMCCS_LutOutiM1qTgtFildTr" FLOAT32_IEEE F_1_p0_2 1 2 -3.402823466E+038 3.402823466E+038 ECU_ADDRESS 0x7000346C /end MEASUREMENT
/begin MEASUREMENT FTCMCCS_M0CtrlIntegratorZ "FTCMCCS_M0CtrlIntegratorZ" FLOAT32_IEEE F_1_p0_2 1 2 -3.402823466E+038 3.402823466E+038 ECU_ADDRESS 0x70003468 /end MEASUREMENT
/begin MEASUREMENT FTCMCCS_M0CtrlKi "FTCMCCS_M0CtrlKi" FLOAT32_IEEE F_1_p0_2 1 2 -3.402823466E+038 3.402823466E+038 ECU_ADDRESS 0x70003464 /end MEASUREMENT
/begin MEASUREMENT FTCMCCS_M0CtrlKp "FTCMCCS_M0CtrlKp" FLOAT32_IEEE F_1_p0_2 1 2 -3.402823466E+038 3.402823466E+038 ECU_ADDRESS 0x70003460 /end MEASUREMENT
/begin MEASUREMENT FTCMCCS_M0CtrlTgt "FTCMCCS_M0CtrlTgt" FLOAT32_IEEE F_1_p0_2 1 2 -3.402823466E+038 3.402823466E+038 ECU_ADDRESS 0x7000345C /end MEASUREMENT
/begin MEASUREMENT FTCMCCS_M1dCtrlIntegratorZ "FTCMCCS_M1dCtrlIntegratorZ" FLOAT32_IEEE F_1_p0_2 1 2 -3.402823466E+038 3.402823466E+038 ECU_ADDRESS 0x70003458 /end MEASUREMENT
/begin MEASUREMENT FTCMCCS_M1dCtrlKi "FTCMCCS_M1dCtrlKi" FLOAT32_IEEE F_1_p0_2 1 2 -3.402823466E+038 3.402823466E+038 ECU_ADDRESS 0x70003454 /end MEASUREMENT
/begin MEASUREMENT FTCMCCS_M1dCtrlKp "FTCMCCS_M1dCtrlKp" FLOAT32_IEEE F_1_p0_2 1 2 -3.402823466E+038 3.402823466E+038 ECU_ADDRESS 0x70003450 /end MEASUREMENT
/begin MEASUREMENT FTCMCCS_M1dCtrlTgt "FTCMCCS_M1dCtrlTgt" FLOAT32_IEEE F_1_p0_2 1 2 -3.402823466E+038 3.402823466E+038 ECU_ADDRESS 0x7000344C /end MEASUREMENT
/begin MEASUREMENT FTCMCCS_M1dCtrlTr "FTCMCCS_M1dCtrlTr" FLOAT32_IEEE F_1_p0_2 1 2 -3.402823466E+038 3.402823466E+038 ECU_ADDRESS 0x70003448 /end MEASUREMENT
/begin MEASUREMENT FTCMCCS_M1dObsIntegratorZ "FTCMCCS_M1dObsIntegratorZ" FLOAT32_IEEE F_1_p0_2 1 2 -3.402823466E+038 3.402823466E+038 ECU_ADDRESS 0x70003444 /end MEASUREMENT
/begin MEASUREMENT FTCMCCS_M1qCtrlIntegratorZ "FTCMCCS_M1qCtrlIntegratorZ" FLOAT32_IEEE F_1_p0_2 1 2 -3.402823466E+038 3.402823466E+038 ECU_ADDRESS 0x70003440 /end MEASUREMENT
/begin MEASUREMENT FTCMCCS_M1qCtrlKi "FTCMCCS_M1qCtrlKi" FLOAT32_IEEE F_1_p0_2 1 2 -3.402823466E+038 3.402823466E+038 ECU_ADDRESS 0x7000343C /end MEASUREMENT
/begin MEASUREMENT FTCMCCS_M1qCtrlKp "FTCMCCS_M1qCtrlKp" FLOAT32_IEEE F_1_p0_2 1 2 -3.402823466E+038 3.402823466E+038 ECU_ADDRESS 0x70003438 /end MEASUREMENT
/begin MEASUREMENT FTCMCCS_M1qCtrlTgt "FTCMCCS_M1qCtrlTgt" FLOAT32_IEEE F_1_p0_2 1 2 -3.402823466E+038 3.402823466E+038 ECU_ADDRESS 0x70003434 /end MEASUREMENT
/begin MEASUREMENT FTCMCCS_M1qCtrlTr "FTCMCCS_M1qCtrlTr" FLOAT32_IEEE F_1_p0_2 1 2 -3.402823466E+038 3.402823466E+038 ECU_ADDRESS 0x70003430 /end MEASUREMENT
/begin MEASUREMENT FTCMCCS_Phim "FTCMCCS_Phim" FLOAT32_IEEE F_1_p0_2 1 2 -3.402823466E+038 3.402823466E+038 ECU_ADDRESS 0x7000342C /end MEASUREMENT
/begin MEASUREMENT FTCMCCS_PhimOut "FTCMCCS_PhimOut" FLOAT32_IEEE F_1_p0_2 1 2 -3.402823466E+038 3.402823466E+038 ECU_ADDRESS 0x70003428 /end MEASUREMENT
/begin MEASUREMENT FTCMCCS_Rs "FTCMCCS_Rs" FLOAT32_IEEE F_1_p0_2 1 2 -3.402823466E+038 3.402823466E+038 ECU_ADDRESS 0x70003424 /end MEASUREMENT
/begin MEASUREMENT FTCMCCS_RsOut "FTCMCCS_RsOut" FLOAT32_IEEE F_1_p0_2 1 2 -3.402823466E+038 3.402823466E+038 ECU_ADDRESS 0x70003420 /end MEASUREMENT
/begin MEASUREMENT FTCMCCS_RsiM1dEstZ "FTCMCCS_RsiM1dEstZ" FLOAT32_IEEE F_1_p0_2 1 2 -3.402823466E+038 3.402823466E+038 ECU_ADDRESS 0x7000341C /end MEASUREMENT
/begin MEASUREMENT FTCMCCS_SampleTime3ST "FTCMCCS_SampleTime3ST" FLOAT32_IEEE F_1_p0_2 1 2 -3.402823466E+038 3.402823466E+038 ECU_ADDRESS 0x70003418 /end MEASUREMENT
/begin MEASUREMENT FTCMCCS_SampleTimeF32 "FTCMCCS_SampleTimeF32" FLOAT32_IEEE F_1_p0_2 1 2 -3.402823466E+038 3.402823466E+038 ECU_ADDRESS 0x70003414 /end MEASUREMENT
/begin MEASUREMENT FTCMCCS_TotalI0dqTgt3[0] "FTCMCCS_TotalI0dqTgt3" FLOAT32_IEEE F_1_p0_2 1 2 -3.402823466E+038 3.402823466E+038 ECU_ADDRESS 0x70003408 /end MEASUREMENT
/begin MEASUREMENT FTCMCCS_TotalI0dqTgt3[1] "FTCMCCS_TotalI0dqTgt3" FLOAT32_IEEE F_1_p0_2 1 2 -3.402823466E+038 3.402823466E+038 ECU_ADDRESS 0x7000340C /end MEASUREMENT
/begin MEASUREMENT FTCMCCS_TotalI0dqTgt3[2] "FTCMCCS_TotalI0dqTgt3" FLOAT32_IEEE F_1_p0_2 1 2 -3.402823466E+038 3.402823466E+038 ECU_ADDRESS 0x70003410 /end MEASUREMENT
/begin MEASUREMENT FTCMCCS_TransEmfM1d "FTCMCCS_TransEmfM1d" FLOAT32_IEEE F_1_p0_2 1 2 -3.402823466E+038 3.402823466E+038 ECU_ADDRESS 0x70003404 /end MEASUREMENT
/begin MEASUREMENT FTCMCCS_TransEmfM1q "FTCMCCS_TransEmfM1q" FLOAT32_IEEE F_1_p0_2 1 2 -3.402823466E+038 3.402823466E+038 ECU_ADDRESS 0x70003400 /end MEASUREMENT
/begin MEASUREMENT FTCMCCS_TransUd "FTCMCCS_TransUd" FLOAT32_IEEE F_1_p0_2 1 2 -3.402823466E+038 3.402823466E+038 ECU_ADDRESS 0x700033FC /end MEASUREMENT
/begin MEASUREMENT FTCMCCS_TransUq "FTCMCCS_TransUq" FLOAT32_IEEE F_1_p0_2 1 2 -3.402823466E+038 3.402823466E+038 ECU_ADDRESS 0x700033F8 /end MEASUREMENT
/begin MEASUREMENT FTCMCCS_U0dqTgt3[0] "FTCMCCS_U0dqTgt3" FLOAT32_IEEE F_1_p0_2 1 2 -3.402823466E+038 3.402823466E+038 ECU_ADDRESS 0x700033EC /end MEASUREMENT
/begin MEASUREMENT FTCMCCS_U0dqTgt3[1] "FTCMCCS_U0dqTgt3" FLOAT32_IEEE F_1_p0_2 1 2 -3.402823466E+038 3.402823466E+038 ECU_ADDRESS 0x700033F0 /end MEASUREMENT
/begin MEASUREMENT FTCMCCS_U0dqTgt3[2] "FTCMCCS_U0dqTgt3" FLOAT32_IEEE F_1_p0_2 1 2 -3.402823466E+038 3.402823466E+038 ECU_ADDRESS 0x700033F4 /end MEASUREMENT
/begin MEASUREMENT FTCMCCS_UM1dTgt "FTCMCCS_UM1dTgt" FLOAT32_IEEE F_1_p0_2 1 2 -3.402823466E+038 3.402823466E+038 ECU_ADDRESS 0x700033E8 /end MEASUREMENT
/begin MEASUREMENT FTCMCCS_UM1qTgt "FTCMCCS_UM1qTgt" FLOAT32_IEEE F_1_p0_2 1 2 -3.402823466E+038 3.402823466E+038 ECU_ADDRESS 0x700033E4 /end MEASUREMENT
/begin MEASUREMENT FTCMCCS_UdqNorm "FTCMCCS_UdqNorm" FLOAT32_IEEE F_1_p0_2 1 2 -3.402823466E+038 3.402823466E+038 ECU_ADDRESS 0x700033E0 /end MEASUREMENT
/begin MEASUREMENT FTCMCCS_iM1dTgtFild "FTCMCCS_iM1dTgtFild" FLOAT32_IEEE F_1_p0_2 1 2 -3.402823466E+038 3.402823466E+038 ECU_ADDRESS 0x700033DC /end MEASUREMENT
/begin MEASUREMENT FTCMCCS_iM1dTgtFildTr "FTCMCCS_iM1dTgtFildTr" FLOAT32_IEEE F_1_p0_2 1 2 -3.402823466E+038 3.402823466E+038 ECU_ADDRESS 0x700033D8 /end MEASUREMENT
/begin MEASUREMENT FTCMCCS_iM1dTgtFildZ "FTCMCCS_iM1dTgtFildZ" FLOAT32_IEEE F_1_p0_2 1 2 -3.402823466E+038 3.402823466E+038 ECU_ADDRESS 0x700033D4 /end MEASUREMENT
/begin MEASUREMENT FTCMCCS_iM1qTgtFild "FTCMCCS_iM1qTgtFild" FLOAT32_IEEE F_1_p0_2 1 2 -3.402823466E+038 3.402823466E+038 ECU_ADDRESS 0x700033D0 /end MEASUREMENT
/begin MEASUREMENT FTCMCCS_iM1qTgtFildTr "FTCMCCS_iM1qTgtFildTr" FLOAT32_IEEE F_1_p0_2 1 2 -3.402823466E+038 3.402823466E+038 ECU_ADDRESS 0x700033CC /end MEASUREMENT
/begin MEASUREMENT FTCMCCS_iM1qTgtFildZ "FTCMCCS_iM1qTgtFildZ" FLOAT32_IEEE F_1_p0_2 1 2 -3.402823466E+038 3.402823466E+038 ECU_ADDRESS 0x700033C8 /end MEASUREMENT
/begin MEASUREMENT FTCMCTC_CoggingComp "FTCMCTC_CoggingComp" FLOAT32_IEEE F_1_p0_2 1 2 -3.402823466E+038 3.402823466E+038 ECU_ADDRESS 0x700034D8 /end MEASUREMENT
/begin MEASUREMENT FTCMCTC_H3CurrentTgt "FTCMCTC_H3CurrentTgt" FLOAT32_IEEE F_1_p0_2 1 2 -3.402823466E+038 3.402823466E+038 ECU_ADDRESS 0x700034D4 /end MEASUREMENT
/begin MEASUREMENT FTCMCTC_I0dqTgt3[0] "FTCMCTC_I0dqTgt3" FLOAT32_IEEE F_1_p0_2 1 2 -3.402823466E+038 3.402823466E+038 ECU_ADDRESS 0x700034C8 /end MEASUREMENT
/begin MEASUREMENT FTCMCTC_I0dqTgt3[1] "FTCMCTC_I0dqTgt3" FLOAT32_IEEE F_1_p0_2 1 2 -3.402823466E+038 3.402823466E+038 ECU_ADDRESS 0x700034CC /end MEASUREMENT
/begin MEASUREMENT FTCMCTC_I0dqTgt3[2] "FTCMCTC_I0dqTgt3" FLOAT32_IEEE F_1_p0_2 1 2 -3.402823466E+038 3.402823466E+038 ECU_ADDRESS 0x700034D0 /end MEASUREMENT
/begin MEASUREMENT FTCMCTC_Sin3NextThetaElec "FTCMCTC_Sin3NextThetaElec" FLOAT32_IEEE F_1_p0_2 1 2 -3.402823466E+038 3.402823466E+038 ECU_ADDRESS 0x700034C4 /end MEASUREMENT
/begin MEASUREMENT FTCMCTC_Sin6NextThetaElec "FTCMCTC_Sin6NextThetaElec" FLOAT32_IEEE F_1_p0_2 1 2 -3.402823466E+038 3.402823466E+038 ECU_ADDRESS 0x700034C0 /end MEASUREMENT
/begin MEASUREMENT FTCMCTC_iM0Tgt "FTCMCTC_iM0Tgt" FLOAT32_IEEE F_1_p0_2 1 2 -3.402823466E+038 3.402823466E+038 ECU_ADDRESS 0x700034BC /end MEASUREMENT
/begin MEASUREMENT FTCMCTC_iMdTgt "FTCMCTC_iMdTgt" FLOAT32_IEEE F_1_p0_2 1 2 -3.402823466E+038 3.402823466E+038 ECU_ADDRESS 0x700034B8 /end MEASUREMENT
/begin MEASUREMENT FTCMCTC_iMqTgt "FTCMCTC_iMqTgt" FLOAT32_IEEE F_1_p0_2 1 2 -3.402823466E+038 3.402823466E+038 ECU_ADDRESS 0x700034B4 /end MEASUREMENT
/begin MEASUREMENT FTCMHIJ_11NextTheta "value of the motor phase current in park frame" FLOAT32_IEEE F_1_p0_2 1 2 -3.402823466E+038 3.402823466E+038 ECU_ADDRESS 0x70003718 /end MEASUREMENT
/begin MEASUREMENT FTCMHIJ_11thIdFilt "value of the motor phase current in park frame" FLOAT32_IEEE F_1_p0_2 1 2 -3.402823466E+038 3.402823466E+038 ECU_ADDRESS 0x70003714 /end MEASUREMENT
/begin MEASUREMENT FTCMHIJ_11thIdLpfXn1Z "value of the motor phase current in park frame" FLOAT32_IEEE F_1_p0_2 1 2 -3.402823466E+038 3.402823466E+038 ECU_ADDRESS 0x70003710 /end MEASUREMENT
/begin MEASUREMENT FTCMHIJ_11thIdLpfXn2Z "value of the motor phase current in park frame" FLOAT32_IEEE F_1_p0_2 1 2 -3.402823466E+038 3.402823466E+038 ECU_ADDRESS 0x7000370C /end MEASUREMENT
/begin MEASUREMENT FTCMHIJ_11thIdLpfYn1Z "value of the motor phase current in park frame" FLOAT32_IEEE F_1_p0_2 1 2 -3.402823466E+038 3.402823466E+038 ECU_ADDRESS 0x70003708 /end MEASUREMENT
/begin MEASUREMENT FTCMHIJ_11thIdLpfYn2Z "value of the motor phase current in park frame" FLOAT32_IEEE F_1_p0_2 1 2 -3.402823466E+038 3.402823466E+038 ECU_ADDRESS 0x70003704 /end MEASUREMENT
/begin MEASUREMENT FTCMHIJ_11thIdOrg "value of the motor phase current in park frame" FLOAT32_IEEE F_1_p0_2 1 2 -3.402823466E+038 3.402823466E+038 ECU_ADDRESS 0x70003700 /end MEASUREMENT
/begin MEASUREMENT FTCMHIJ_11thIdPiZ "value of the motor phase current in park frame" FLOAT32_IEEE F_1_p0_2 1 2 -3.402823466E+038 3.402823466E+038 ECU_ADDRESS 0x700036FC /end MEASUREMENT
/begin MEASUREMENT FTCMHIJ_11thIdRef "value of the motor phase current in park frame" FLOAT32_IEEE F_1_p0_2 1 2 -3.402823466E+038 3.402823466E+038 ECU_ADDRESS 0x700036F8 /end MEASUREMENT
/begin MEASUREMENT FTCMHIJ_11thIdTgt "value of the motor phase current in park frame" FLOAT32_IEEE F_1_p0_2 1 2 -3.402823466E+038 3.402823466E+038 ECU_ADDRESS 0x700036F4 /end MEASUREMENT
/begin MEASUREMENT FTCMHIJ_11thIdTgtLpfZ "value of the motor phase current in park frame" FLOAT32_IEEE F_1_p0_2 1 2 -3.402823466E+038 3.402823466E+038 ECU_ADDRESS 0x700036F0 /end MEASUREMENT
/begin MEASUREMENT FTCMHIJ_11thIqFilt "value of the motor phase current in park frame" FLOAT32_IEEE F_1_p0_2 1 2 -3.402823466E+038 3.402823466E+038 ECU_ADDRESS 0x700036EC /end MEASUREMENT
/begin MEASUREMENT FTCMHIJ_11thIqLpfXn1Z "value of the motor phase current in park frame" FLOAT32_IEEE F_1_p0_2 1 2 -3.402823466E+038 3.402823466E+038 ECU_ADDRESS 0x700036E8 /end MEASUREMENT
/begin MEASUREMENT FTCMHIJ_11thIqLpfXn2Z "value of the motor phase current in park frame" FLOAT32_IEEE F_1_p0_2 1 2 -3.402823466E+038 3.402823466E+038 ECU_ADDRESS 0x700036E4 /end MEASUREMENT
/begin MEASUREMENT FTCMHIJ_11thIqLpfYn1Z "value of the motor phase current in park frame" FLOAT32_IEEE F_1_p0_2 1 2 -3.402823466E+038 3.402823466E+038 ECU_ADDRESS 0x700036E0 /end MEASUREMENT
/begin MEASUREMENT FTCMHIJ_11thIqLpfYn2Z "value of the motor phase current in park frame" FLOAT32_IEEE F_1_p0_2 1 2 -3.402823466E+038 3.402823466E+038 ECU_ADDRESS 0x700036DC /end MEASUREMENT
/begin MEASUREMENT FTCMHIJ_11thIqOrg "value of the motor phase current in park frame" FLOAT32_IEEE F_1_p0_2 1 2 -3.402823466E+038 3.402823466E+038 ECU_ADDRESS 0x700036D8 /end MEASUREMENT
/begin MEASUREMENT FTCMHIJ_11thIqPiZ "value of the motor phase current in park frame" FLOAT32_IEEE F_1_p0_2 1 2 -3.402823466E+038 3.402823466E+038 ECU_ADDRESS 0x700036D4 /end MEASUREMENT
/begin MEASUREMENT FTCMHIJ_11thIqRef "value of the motor phase current in park frame" FLOAT32_IEEE F_1_p0_2 1 2 -3.402823466E+038 3.402823466E+038 ECU_ADDRESS 0x700036D0 /end MEASUREMENT
/begin MEASUREMENT FTCMHIJ_11thIqTgt "value of the motor phase current in park frame" FLOAT32_IEEE F_1_p0_2 1 2 -3.402823466E+038 3.402823466E+038 ECU_ADDRESS 0x700036CC /end MEASUREMENT
/begin MEASUREMENT FTCMHIJ_11thIqTgtLpfZ "value of the motor phase current in park frame" FLOAT32_IEEE F_1_p0_2 1 2 -3.402823466E+038 3.402823466E+038 ECU_ADDRESS 0x700036C8 /end MEASUREMENT
/begin MEASUREMENT FTCMHIJ_11thUdSum "value of the motor phase current in park frame" FLOAT32_IEEE F_1_p0_2 1 2 -3.402823466E+038 3.402823466E+038 ECU_ADDRESS 0x700036C4 /end MEASUREMENT
/begin MEASUREMENT FTCMHIJ_11thUdSumRaw "value of the motor phase current in park frame" FLOAT32_IEEE F_1_p0_2 1 2 -3.402823466E+038 3.402823466E+038 ECU_ADDRESS 0x700036C0 /end MEASUREMENT
/begin MEASUREMENT FTCMHIJ_11thUdorg "value of the motor phase current in park frame" FLOAT32_IEEE F_1_p0_2 1 2 -3.402823466E+038 3.402823466E+038 ECU_ADDRESS 0x700036BC /end MEASUREMENT
/begin MEASUREMENT FTCMHIJ_11thUqSum "value of the motor phase current in park frame" FLOAT32_IEEE F_1_p0_2 1 2 -3.402823466E+038 3.402823466E+038 ECU_ADDRESS 0x700036B8 /end MEASUREMENT
/begin MEASUREMENT FTCMHIJ_11thUqSumRaw "value of the motor phase current in park frame" FLOAT32_IEEE F_1_p0_2 1 2 -3.402823466E+038 3.402823466E+038 ECU_ADDRESS 0x700036B4 /end MEASUREMENT
/begin MEASUREMENT FTCMHIJ_11thUqorg "value of the motor phase current in park frame" FLOAT32_IEEE F_1_p0_2 1 2 -3.402823466E+038 3.402823466E+038 ECU_ADDRESS 0x700036B0 /end MEASUREMENT
/begin MEASUREMENT FTCMHIJ_11thUsLimitCoff "value of the motor phase current in park frame" FLOAT32_IEEE F_1_p0_2 1 2 -3.402823466E+038 3.402823466E+038 ECU_ADDRESS 0x700036AC /end MEASUREMENT
/begin MEASUREMENT FTCMHIJ_11th_Den0 "value of the motor phase current in park frame" FLOAT32_IEEE F_1_p0_2 1 2 -3.402823466E+038 3.402823466E+038 ECU_ADDRESS 0x700036A8 /end MEASUREMENT
/begin MEASUREMENT FTCMHIJ_11th_Den1 "value of the motor phase current in park frame" FLOAT32_IEEE F_1_p0_2 1 2 -3.402823466E+038 3.402823466E+038 ECU_ADDRESS 0x700036A4 /end MEASUREMENT
/begin MEASUREMENT FTCMHIJ_11th_Den2 "value of the motor phase current in park frame" FLOAT32_IEEE F_1_p0_2 1 2 -3.402823466E+038 3.402823466E+038 ECU_ADDRESS 0x700036A0 /end MEASUREMENT
/begin MEASUREMENT FTCMHIJ_11th_Num0 "value of the motor phase current in park frame" FLOAT32_IEEE F_1_p0_2 1 2 -3.402823466E+038 3.402823466E+038 ECU_ADDRESS 0x7000369C /end MEASUREMENT
/begin MEASUREMENT FTCMHIJ_11theta "value of the motor phase current in park frame" FLOAT32_IEEE F_1_p0_2 1 2 -3.402823466E+038 3.402823466E+038 ECU_ADDRESS 0x70003698 /end MEASUREMENT
/begin MEASUREMENT FTCMHIJ_13NextTheta "value of the motor phase current in park frame" FLOAT32_IEEE F_1_p0_2 1 2 -3.402823466E+038 3.402823466E+038 ECU_ADDRESS 0x70003694 /end MEASUREMENT
/begin MEASUREMENT FTCMHIJ_13thIdFilt "value of the motor phase current in park frame" FLOAT32_IEEE F_1_p0_2 1 2 -3.402823466E+038 3.402823466E+038 ECU_ADDRESS 0x70003690 /end MEASUREMENT
/begin MEASUREMENT FTCMHIJ_13thIdLpfXn1Z "value of the motor phase current in park frame" FLOAT32_IEEE F_1_p0_2 1 2 -3.402823466E+038 3.402823466E+038 ECU_ADDRESS 0x7000368C /end MEASUREMENT
/begin MEASUREMENT FTCMHIJ_13thIdLpfXn2Z "value of the motor phase current in park frame" FLOAT32_IEEE F_1_p0_2 1 2 -3.402823466E+038 3.402823466E+038 ECU_ADDRESS 0x70003688 /end MEASUREMENT
/begin MEASUREMENT FTCMHIJ_13thIdLpfYn1Z "value of the motor phase current in park frame" FLOAT32_IEEE F_1_p0_2 1 2 -3.402823466E+038 3.402823466E+038 ECU_ADDRESS 0x70003684 /end MEASUREMENT
/begin MEASUREMENT FTCMHIJ_13thIdLpfYn2Z "value of the motor phase current in park frame" FLOAT32_IEEE F_1_p0_2 1 2 -3.402823466E+038 3.402823466E+038 ECU_ADDRESS 0x70003680 /end MEASUREMENT
/begin MEASUREMENT FTCMHIJ_13thIdPiZ "value of the motor phase current in park frame" FLOAT32_IEEE F_1_p0_2 1 2 -3.402823466E+038 3.402823466E+038 ECU_ADDRESS 0x7000367C /end MEASUREMENT
/begin MEASUREMENT FTCMHIJ_13thIdRef "value of the motor phase current in park frame" FLOAT32_IEEE F_1_p0_2 1 2 -3.402823466E+038 3.402823466E+038 ECU_ADDRESS 0x70003678 /end MEASUREMENT
/begin MEASUREMENT FTCMHIJ_13thIdTgt "value of the motor phase current in park frame" FLOAT32_IEEE F_1_p0_2 1 2 -3.402823466E+038 3.402823466E+038 ECU_ADDRESS 0x70003674 /end MEASUREMENT
/begin MEASUREMENT FTCMHIJ_13thIdTgtLpfZ "value of the motor phase current in park frame" FLOAT32_IEEE F_1_p0_2 1 2 -3.402823466E+038 3.402823466E+038 ECU_ADDRESS 0x70003670 /end MEASUREMENT
/begin MEASUREMENT FTCMHIJ_13thIqFilt "value of the motor phase current in park frame" FLOAT32_IEEE F_1_p0_2 1 2 -3.402823466E+038 3.402823466E+038 ECU_ADDRESS 0x7000366C /end MEASUREMENT
/begin MEASUREMENT FTCMHIJ_13thIqLpfXn1Z "value of the motor phase current in park frame" FLOAT32_IEEE F_1_p0_2 1 2 -3.402823466E+038 3.402823466E+038 ECU_ADDRESS 0x70003668 /end MEASUREMENT
/begin MEASUREMENT FTCMHIJ_13thIqLpfXn2Z "value of the motor phase current in park frame" FLOAT32_IEEE F_1_p0_2 1 2 -3.402823466E+038 3.402823466E+038 ECU_ADDRESS 0x70003664 /end MEASUREMENT
/begin MEASUREMENT FTCMHIJ_13thIqLpfYn1Z "value of the motor phase current in park frame" FLOAT32_IEEE F_1_p0_2 1 2 -3.402823466E+038 3.402823466E+038 ECU_ADDRESS 0x70003660 /end MEASUREMENT
/begin MEASUREMENT FTCMHIJ_13thIqLpfYn2Z "value of the motor phase current in park frame" FLOAT32_IEEE F_1_p0_2 1 2 -3.402823466E+038 3.402823466E+038 ECU_ADDRESS 0x7000365C /end MEASUREMENT
/begin MEASUREMENT FTCMHIJ_13thIqPiZ "value of the motor phase current in park frame" FLOAT32_IEEE F_1_p0_2 1 2 -3.402823466E+038 3.402823466E+038 ECU_ADDRESS 0x70003658 /end MEASUREMENT
/begin MEASUREMENT FTCMHIJ_13thIqRef "value of the motor phase current in park frame" FLOAT32_IEEE F_1_p0_2 1 2 -3.402823466E+038 3.402823466E+038 ECU_ADDRESS 0x70003654 /end MEASUREMENT
/begin MEASUREMENT FTCMHIJ_13thIqTgt "value of the motor phase current in park frame" FLOAT32_IEEE F_1_p0_2 1 2 -3.402823466E+038 3.402823466E+038 ECU_ADDRESS 0x70003650 /end MEASUREMENT
/begin MEASUREMENT FTCMHIJ_13thIqTgtLpfZ "value of the motor phase current in park frame" FLOAT32_IEEE F_1_p0_2 1 2 -3.402823466E+038 3.402823466E+038 ECU_ADDRESS 0x7000364C /end MEASUREMENT
/begin MEASUREMENT FTCMHIJ_13thUdSum "value of the motor phase current in park frame" FLOAT32_IEEE F_1_p0_2 1 2 -3.402823466E+038 3.402823466E+038 ECU_ADDRESS 0x70003648 /end MEASUREMENT
/begin MEASUREMENT FTCMHIJ_13thUdSumRaw "value of the motor phase current in park frame" FLOAT32_IEEE F_1_p0_2 1 2 -3.402823466E+038 3.402823466E+038 ECU_ADDRESS 0x70003644 /end MEASUREMENT
/begin MEASUREMENT FTCMHIJ_13thUqSum "value of the motor phase current in park frame" FLOAT32_IEEE F_1_p0_2 1 2 -3.402823466E+038 3.402823466E+038 ECU_ADDRESS 0x70003640 /end MEASUREMENT
/begin MEASUREMENT FTCMHIJ_13thUqSumRaw "value of the motor phase current in park frame" FLOAT32_IEEE F_1_p0_2 1 2 -3.402823466E+038 3.402823466E+038 ECU_ADDRESS 0x7000363C /end MEASUREMENT
/begin MEASUREMENT FTCMHIJ_13thUsLimitCoff "value of the motor phase current in park frame" FLOAT32_IEEE F_1_p0_2 1 2 -3.402823466E+038 3.402823466E+038 ECU_ADDRESS 0x70003638 /end MEASUREMENT
/begin MEASUREMENT FTCMHIJ_13theta "value of the motor phase current in park frame" FLOAT32_IEEE F_1_p0_2 1 2 -3.402823466E+038 3.402823466E+038 ECU_ADDRESS 0x70003634 /end MEASUREMENT
/begin MEASUREMENT FTCMHIJ_3rd_Den0 "value of the motor phase current in park frame" FLOAT32_IEEE F_1_p0_2 1 2 -3.402823466E+038 3.402823466E+038 ECU_ADDRESS 0x70003630 /end MEASUREMENT
/begin MEASUREMENT FTCMHIJ_3rd_Den1 "value of the motor phase current in park frame" FLOAT32_IEEE F_1_p0_2 1 2 -3.402823466E+038 3.402823466E+038 ECU_ADDRESS 0x7000362C /end MEASUREMENT
/begin MEASUREMENT FTCMHIJ_3rd_Den2 "value of the motor phase current in park frame" FLOAT32_IEEE F_1_p0_2 1 2 -3.402823466E+038 3.402823466E+038 ECU_ADDRESS 0x70003628 /end MEASUREMENT
/begin MEASUREMENT FTCMHIJ_3rd_Num0 "value of the motor phase current in park frame" FLOAT32_IEEE F_1_p0_2 1 2 -3.402823466E+038 3.402823466E+038 ECU_ADDRESS 0x70003624 /end MEASUREMENT
/begin MEASUREMENT FTCMHIJ_5NextTheta "value of the motor phase current in park frame" FLOAT32_IEEE F_1_p0_2 1 2 -3.402823466E+038 3.402823466E+038 ECU_ADDRESS 0x70003620 /end MEASUREMENT
/begin MEASUREMENT FTCMHIJ_5thIdFilt "value of the motor phase current in park frame" FLOAT32_IEEE F_1_p0_2 1 2 -3.402823466E+038 3.402823466E+038 ECU_ADDRESS 0x7000361C /end MEASUREMENT
/begin MEASUREMENT FTCMHIJ_5thIdLpfXn1Z "value of the motor phase current in park frame" FLOAT32_IEEE F_1_p0_2 1 2 -3.402823466E+038 3.402823466E+038 ECU_ADDRESS 0x70003618 /end MEASUREMENT
/begin MEASUREMENT FTCMHIJ_5thIdLpfXn2Z "value of the motor phase current in park frame" FLOAT32_IEEE F_1_p0_2 1 2 -3.402823466E+038 3.402823466E+038 ECU_ADDRESS 0x70003614 /end MEASUREMENT
/begin MEASUREMENT FTCMHIJ_5thIdLpfYn1Z "value of the motor phase current in park frame" FLOAT32_IEEE F_1_p0_2 1 2 -3.402823466E+038 3.402823466E+038 ECU_ADDRESS 0x70003610 /end MEASUREMENT
/begin MEASUREMENT FTCMHIJ_5thIdLpfYn2Z "value of the motor phase current in park frame" FLOAT32_IEEE F_1_p0_2 1 2 -3.402823466E+038 3.402823466E+038 ECU_ADDRESS 0x7000360C /end MEASUREMENT
/begin MEASUREMENT FTCMHIJ_5thIdOrg "value of the motor phase current in park frame" FLOAT32_IEEE F_1_p0_2 1 2 -3.402823466E+038 3.402823466E+038 ECU_ADDRESS 0x70003608 /end MEASUREMENT
/begin MEASUREMENT FTCMHIJ_5thIdPiZ "value of the motor phase current in park frame" FLOAT32_IEEE F_1_p0_2 1 2 -3.402823466E+038 3.402823466E+038 ECU_ADDRESS 0x70003604 /end MEASUREMENT
/begin MEASUREMENT FTCMHIJ_5thIdRef "value of the motor phase current in park frame" FLOAT32_IEEE F_1_p0_2 1 2 -3.402823466E+038 3.402823466E+038 ECU_ADDRESS 0x70003600 /end MEASUREMENT
/begin MEASUREMENT FTCMHIJ_5thIdTgt "value of the motor phase current in park frame" FLOAT32_IEEE F_1_p0_2 1 2 -3.402823466E+038 3.402823466E+038 ECU_ADDRESS 0x700035FC /end MEASUREMENT
/begin MEASUREMENT FTCMHIJ_5thIdTgtLpfZ "value of the motor phase current in park frame" FLOAT32_IEEE F_1_p0_2 1 2 -3.402823466E+038 3.402823466E+038 ECU_ADDRESS 0x700035F8 /end MEASUREMENT
/begin MEASUREMENT FTCMHIJ_5thIqFilt "value of the motor phase current in park frame" FLOAT32_IEEE F_1_p0_2 1 2 -3.402823466E+038 3.402823466E+038 ECU_ADDRESS 0x700035F4 /end MEASUREMENT
/begin MEASUREMENT FTCMHIJ_5thIqLpfXn1Z "value of the motor phase current in park frame" FLOAT32_IEEE F_1_p0_2 1 2 -3.402823466E+038 3.402823466E+038 ECU_ADDRESS 0x700035F0 /end MEASUREMENT
/begin MEASUREMENT FTCMHIJ_5thIqLpfXn2Z "value of the motor phase current in park frame" FLOAT32_IEEE F_1_p0_2 1 2 -3.402823466E+038 3.402823466E+038 ECU_ADDRESS 0x700035EC /end MEASUREMENT
/begin MEASUREMENT FTCMHIJ_5thIqLpfYn1Z "value of the motor phase current in park frame" FLOAT32_IEEE F_1_p0_2 1 2 -3.402823466E+038 3.402823466E+038 ECU_ADDRESS 0x700035E8 /end MEASUREMENT
/begin MEASUREMENT FTCMHIJ_5thIqLpfYn2Z "value of the motor phase current in park frame" FLOAT32_IEEE F_1_p0_2 1 2 -3.402823466E+038 3.402823466E+038 ECU_ADDRESS 0x700035E4 /end MEASUREMENT
/begin MEASUREMENT FTCMHIJ_5thIqOrg "value of the motor phase current in park frame" FLOAT32_IEEE F_1_p0_2 1 2 -3.402823466E+038 3.402823466E+038 ECU_ADDRESS 0x700035E0 /end MEASUREMENT
/begin MEASUREMENT FTCMHIJ_5thIqPiZ "value of the motor phase current in park frame" FLOAT32_IEEE F_1_p0_2 1 2 -3.402823466E+038 3.402823466E+038 ECU_ADDRESS 0x700035DC /end MEASUREMENT
/begin MEASUREMENT FTCMHIJ_5thIqRef "value of the motor phase current in park frame" FLOAT32_IEEE F_1_p0_2 1 2 -3.402823466E+038 3.402823466E+038 ECU_ADDRESS 0x700035D8 /end MEASUREMENT
/begin MEASUREMENT FTCMHIJ_5thIqTgt "value of the motor phase current in park frame" FLOAT32_IEEE F_1_p0_2 1 2 -3.402823466E+038 3.402823466E+038 ECU_ADDRESS 0x700035D4 /end MEASUREMENT
/begin MEASUREMENT FTCMHIJ_5thIqTgtLpfZ "value of the motor phase current in park frame" FLOAT32_IEEE F_1_p0_2 1 2 -3.402823466E+038 3.402823466E+038 ECU_ADDRESS 0x700035D0 /end MEASUREMENT
/begin MEASUREMENT FTCMHIJ_5thKi "value of the motor phase current in park frame" FLOAT32_IEEE F_1_p0_2 1 2 -3.402823466E+038 3.402823466E+038 ECU_ADDRESS 0x700035CC /end MEASUREMENT
/begin MEASUREMENT FTCMHIJ_5thKp "value of the motor phase current in park frame" FLOAT32_IEEE F_1_p0_2 1 2 -3.402823466E+038 3.402823466E+038 ECU_ADDRESS 0x700035C8 /end MEASUREMENT
/begin MEASUREMENT FTCMHIJ_5thUdSum "value of the motor phase current in park frame" FLOAT32_IEEE F_1_p0_2 1 2 -3.402823466E+038 3.402823466E+038 ECU_ADDRESS 0x700035C4 /end MEASUREMENT
/begin MEASUREMENT FTCMHIJ_5thUdSumRaw "value of the motor phase current in park frame" FLOAT32_IEEE F_1_p0_2 1 2 -3.402823466E+038 3.402823466E+038 ECU_ADDRESS 0x700035C0 /end MEASUREMENT
/begin MEASUREMENT FTCMHIJ_5thUdorg "value of the motor phase current in park frame" FLOAT32_IEEE F_1_p0_2 1 2 -3.402823466E+038 3.402823466E+038 ECU_ADDRESS 0x700035BC /end MEASUREMENT
/begin MEASUREMENT FTCMHIJ_5thUqSum "value of the motor phase current in park frame" FLOAT32_IEEE F_1_p0_2 1 2 -3.402823466E+038 3.402823466E+038 ECU_ADDRESS 0x700035B8 /end MEASUREMENT
/begin MEASUREMENT FTCMHIJ_5thUqSumRaw "value of the motor phase current in park frame" FLOAT32_IEEE F_1_p0_2 1 2 -3.402823466E+038 3.402823466E+038 ECU_ADDRESS 0x700035B4 /end MEASUREMENT
/begin MEASUREMENT FTCMHIJ_5thUqorg "value of the motor phase current in park frame" FLOAT32_IEEE F_1_p0_2 1 2 -3.402823466E+038 3.402823466E+038 ECU_ADDRESS 0x700035B0 /end MEASUREMENT
/begin MEASUREMENT FTCMHIJ_5thUsLimitCoff "value of the motor phase current in park frame" FLOAT32_IEEE F_1_p0_2 1 2 -3.402823466E+038 3.402823466E+038 ECU_ADDRESS 0x700035AC /end MEASUREMENT
/begin MEASUREMENT FTCMHIJ_5th_Den0 "value of the motor phase current in park frame" FLOAT32_IEEE F_1_p0_2 1 2 -3.402823466E+038 3.402823466E+038 ECU_ADDRESS 0x700035A8 /end MEASUREMENT
/begin MEASUREMENT FTCMHIJ_5th_Den1 "value of the motor phase current in park frame" FLOAT32_IEEE F_1_p0_2 1 2 -3.402823466E+038 3.402823466E+038 ECU_ADDRESS 0x700035A4 /end MEASUREMENT
/begin MEASUREMENT FTCMHIJ_5th_Den2 "value of the motor phase current in park frame" FLOAT32_IEEE F_1_p0_2 1 2 -3.402823466E+038 3.402823466E+038 ECU_ADDRESS 0x700035A0 /end MEASUREMENT
/begin MEASUREMENT FTCMHIJ_5th_Num0 "value of the motor phase current in park frame" FLOAT32_IEEE F_1_p0_2 1 2 -3.402823466E+038 3.402823466E+038 ECU_ADDRESS 0x7000359C /end MEASUREMENT
/begin MEASUREMENT FTCMHIJ_5theta "value of the motor phase current in park frame" FLOAT32_IEEE F_1_p0_2 1 2 -3.402823466E+038 3.402823466E+038 ECU_ADDRESS 0x70003598 /end MEASUREMENT
/begin MEASUREMENT FTCMHIJ_7NextTheta "value of the motor phase current in park frame" FLOAT32_IEEE F_1_p0_2 1 2 -3.402823466E+038 3.402823466E+038 ECU_ADDRESS 0x70003594 /end MEASUREMENT
/begin MEASUREMENT FTCMHIJ_7thIdFilt "value of the motor phase current in park frame" FLOAT32_IEEE F_1_p0_2 1 2 -3.402823466E+038 3.402823466E+038 ECU_ADDRESS 0x70003590 /end MEASUREMENT
/begin MEASUREMENT FTCMHIJ_7thIdLpfXn1Z "value of the motor phase current in park frame" FLOAT32_IEEE F_1_p0_2 1 2 -3.402823466E+038 3.402823466E+038 ECU_ADDRESS 0x7000358C /end MEASUREMENT
/begin MEASUREMENT FTCMHIJ_7thIdLpfXn2Z "value of the motor phase current in park frame" FLOAT32_IEEE F_1_p0_2 1 2 -3.402823466E+038 3.402823466E+038 ECU_ADDRESS 0x70003588 /end MEASUREMENT
/begin MEASUREMENT FTCMHIJ_7thIdLpfYn1Z "value of the motor phase current in park frame" FLOAT32_IEEE F_1_p0_2 1 2 -3.402823466E+038 3.402823466E+038 ECU_ADDRESS 0x70003584 /end MEASUREMENT
/begin MEASUREMENT FTCMHIJ_7thIdLpfYn2Z "value of the motor phase current in park frame" FLOAT32_IEEE F_1_p0_2 1 2 -3.402823466E+038 3.402823466E+038 ECU_ADDRESS 0x70003580 /end MEASUREMENT
/begin MEASUREMENT FTCMHIJ_7thIdOrg "value of the motor phase current in park frame" FLOAT32_IEEE F_1_p0_2 1 2 -3.402823466E+038 3.402823466E+038 ECU_ADDRESS 0x7000357C /end MEASUREMENT
/begin MEASUREMENT FTCMHIJ_7thIdPiZ "value of the motor phase current in park frame" FLOAT32_IEEE F_1_p0_2 1 2 -3.402823466E+038 3.402823466E+038 ECU_ADDRESS 0x70003578 /end MEASUREMENT
/begin MEASUREMENT FTCMHIJ_7thIdRef "value of the motor phase current in park frame" FLOAT32_IEEE F_1_p0_2 1 2 -3.402823466E+038 3.402823466E+038 ECU_ADDRESS 0x70003574 /end MEASUREMENT
/begin MEASUREMENT FTCMHIJ_7thIdTgt "value of the motor phase current in park frame" FLOAT32_IEEE F_1_p0_2 1 2 -3.402823466E+038 3.402823466E+038 ECU_ADDRESS 0x70003570 /end MEASUREMENT
/begin MEASUREMENT FTCMHIJ_7thIdTgtLpfZ "value of the motor phase current in park frame" FLOAT32_IEEE F_1_p0_2 1 2 -3.402823466E+038 3.402823466E+038 ECU_ADDRESS 0x7000356C /end MEASUREMENT
/begin MEASUREMENT FTCMHIJ_7thIqFilt "value of the motor phase current in park frame" FLOAT32_IEEE F_1_p0_2 1 2 -3.402823466E+038 3.402823466E+038 ECU_ADDRESS 0x70003568 /end MEASUREMENT
/begin MEASUREMENT FTCMHIJ_7thIqLpfXn1Z "value of the motor phase current in park frame" FLOAT32_IEEE F_1_p0_2 1 2 -3.402823466E+038 3.402823466E+038 ECU_ADDRESS 0x70003564 /end MEASUREMENT
/begin MEASUREMENT FTCMHIJ_7thIqLpfXn2Z "value of the motor phase current in park frame" FLOAT32_IEEE F_1_p0_2 1 2 -3.402823466E+038 3.402823466E+038 ECU_ADDRESS 0x70003560 /end MEASUREMENT
/begin MEASUREMENT FTCMHIJ_7thIqLpfYn1Z "value of the motor phase current in park frame" FLOAT32_IEEE F_1_p0_2 1 2 -3.402823466E+038 3.402823466E+038 ECU_ADDRESS 0x7000355C /end MEASUREMENT
/begin MEASUREMENT FTCMHIJ_7thIqLpfYn2Z "value of the motor phase current in park frame" FLOAT32_IEEE F_1_p0_2 1 2 -3.402823466E+038 3.402823466E+038 ECU_ADDRESS 0x70003558 /end MEASUREMENT
/begin MEASUREMENT FTCMHIJ_7thIqOrg "value of the motor phase current in park frame" FLOAT32_IEEE F_1_p0_2 1 2 -3.402823466E+038 3.402823466E+038 ECU_ADDRESS 0x70003554 /end MEASUREMENT
/begin MEASUREMENT FTCMHIJ_7thIqPiZ "value of the motor phase current in park frame" FLOAT32_IEEE F_1_p0_2 1 2 -3.402823466E+038 3.402823466E+038 ECU_ADDRESS 0x70003550 /end MEASUREMENT
/begin MEASUREMENT FTCMHIJ_7thIqRef "value of the motor phase current in park frame" FLOAT32_IEEE F_1_p0_2 1 2 -3.402823466E+038 3.402823466E+038 ECU_ADDRESS 0x7000354C /end MEASUREMENT
/begin MEASUREMENT FTCMHIJ_7thIqTgt "value of the motor phase current in park frame" FLOAT32_IEEE F_1_p0_2 1 2 -3.402823466E+038 3.402823466E+038 ECU_ADDRESS 0x70003548 /end MEASUREMENT
/begin MEASUREMENT FTCMHIJ_7thIqTgtLpfZ "value of the motor phase current in park frame" FLOAT32_IEEE F_1_p0_2 1 2 -3.402823466E+038 3.402823466E+038 ECU_ADDRESS 0x70003544 /end MEASUREMENT
/begin MEASUREMENT FTCMHIJ_7thUdSum "value of the motor phase current in park frame" FLOAT32_IEEE F_1_p0_2 1 2 -3.402823466E+038 3.402823466E+038 ECU_ADDRESS 0x70003540 /end MEASUREMENT
/begin MEASUREMENT FTCMHIJ_7thUdSumRaw "value of the motor phase current in park frame" FLOAT32_IEEE F_1_p0_2 1 2 -3.402823466E+038 3.402823466E+038 ECU_ADDRESS 0x7000353C /end MEASUREMENT
/begin MEASUREMENT FTCMHIJ_7thUdorg "value of the motor phase current in park frame" FLOAT32_IEEE F_1_p0_2 1 2 -3.402823466E+038 3.402823466E+038 ECU_ADDRESS 0x70003538 /end MEASUREMENT
/begin MEASUREMENT FTCMHIJ_7thUqSum "value of the motor phase current in park frame" FLOAT32_IEEE F_1_p0_2 1 2 -3.402823466E+038 3.402823466E+038 ECU_ADDRESS 0x70003534 /end MEASUREMENT
/begin MEASUREMENT FTCMHIJ_7thUqSumRaw "value of the motor phase current in park frame" FLOAT32_IEEE F_1_p0_2 1 2 -3.402823466E+038 3.402823466E+038 ECU_ADDRESS 0x70003530 /end MEASUREMENT
/begin MEASUREMENT FTCMHIJ_7thUqorg "value of the motor phase current in park frame" FLOAT32_IEEE F_1_p0_2 1 2 -3.402823466E+038 3.402823466E+038 ECU_ADDRESS 0x7000352C /end MEASUREMENT
/begin MEASUREMENT FTCMHIJ_7thUsLimitCoff "value of the motor phase current in park frame" FLOAT32_IEEE F_1_p0_2 1 2 -3.402823466E+038 3.402823466E+038 ECU_ADDRESS 0x70003528 /end MEASUREMENT
/begin MEASUREMENT FTCMHIJ_7th_Den0 "value of the motor phase current in park frame" FLOAT32_IEEE F_1_p0_2 1 2 -3.402823466E+038 3.402823466E+038 ECU_ADDRESS 0x70003524 /end MEASUREMENT
/begin MEASUREMENT FTCMHIJ_7th_Den1 "value of the motor phase current in park frame" FLOAT32_IEEE F_1_p0_2 1 2 -3.402823466E+038 3.402823466E+038 ECU_ADDRESS 0x70003520 /end MEASUREMENT
/begin MEASUREMENT FTCMHIJ_7th_Den2 "value of the motor phase current in park frame" FLOAT32_IEEE F_1_p0_2 1 2 -3.402823466E+038 3.402823466E+038 ECU_ADDRESS 0x7000351C /end MEASUREMENT
/begin MEASUREMENT FTCMHIJ_7th_Num0 "value of the motor phase current in park frame" FLOAT32_IEEE F_1_p0_2 1 2 -3.402823466E+038 3.402823466E+038 ECU_ADDRESS 0x70003518 /end MEASUREMENT
/begin MEASUREMENT FTCMHIJ_7theta "value of the motor phase current in park frame" FLOAT32_IEEE F_1_p0_2 1 2 -3.402823466E+038 3.402823466E+038 ECU_ADDRESS 0x70003514 /end MEASUREMENT
/begin MEASUREMENT FTCMHIJ_FinalUalpha "value of the motor phase current in park frame" FLOAT32_IEEE F_1_p0_2 1 2 -3.402823466E+038 3.402823466E+038 ECU_ADDRESS 0x70003510 /end MEASUREMENT
/begin MEASUREMENT FTCMHIJ_FinalUbeta "value of the motor phase current in park frame" FLOAT32_IEEE F_1_p0_2 1 2 -3.402823466E+038 3.402823466E+038 ECU_ADDRESS 0x7000350C /end MEASUREMENT
/begin MEASUREMENT FTCMHIJ_UalphaBeta[0] "value of the motor phase current in park frame" FLOAT32_IEEE F_1_p0_2 1 2 -3.402823466E+038 3.402823466E+038 ECU_ADDRESS 0x70003504 /end MEASUREMENT
/begin MEASUREMENT FTCMHIJ_UalphaBeta[1] "value of the motor phase current in park frame" FLOAT32_IEEE F_1_p0_2 1 2 -3.402823466E+038 3.402823466E+038 ECU_ADDRESS 0x70003508 /end MEASUREMENT
/begin MEASUREMENT FTCMHIJ_b11thUsSatFlgZ "value of the motor phase current in park frame" UBYTE Bool_ON_OFF 1 2 0 1 BIT_MASK 0x01 ECU_ADDRESS 0x70003502 /end MEASUREMENT
/begin MEASUREMENT FTCMHIJ_b13thUsSatFlgZ "value of the motor phase current in park frame" UBYTE Bool_ON_OFF 1 2 0 1 BIT_MASK 0x01 ECU_ADDRESS 0x70003501 /end MEASUREMENT
/begin MEASUREMENT FTCMHIJ_b5thUsSatFlgZ "value of the motor phase current in park frame" UBYTE Bool_ON_OFF 1 2 0 1 BIT_MASK 0x01 ECU_ADDRESS 0x70003500 /end MEASUREMENT
/begin MEASUREMENT FTCMHIJ_b7thUsSatFlgZ "value of the motor phase current in park frame" UBYTE Bool_ON_OFF 1 2 0 1 BIT_MASK 0x01 ECU_ADDRESS 0x700034FF /end MEASUREMENT
/begin MEASUREMENT FTCMHIJ_bExtUsSatFlg "value of the motor phase current in park frame" UBYTE Bool_ON_OFF 1 2 0 1 BIT_MASK 0x01 ECU_ADDRESS 0x700034FE /end MEASUREMENT
/begin MEASUREMENT FTCMHIJ_bExtUsSatFlgZ "value of the motor phase current in park frame" UBYTE Bool_ON_OFF 1 2 0 1 BIT_MASK 0x01 ECU_ADDRESS 0x700034FD /end MEASUREMENT
/begin MEASUREMENT FTCMRPC_I0AlphaBeta[0] "FTCMRPC_I0AlphaBeta" FLOAT32_IEEE F_1_p0_2 1 2 -3.402823466E+038 3.402823466E+038 ECU_ADDRESS 0x70003728 /end MEASUREMENT
/begin MEASUREMENT FTCMRPC_I0AlphaBeta[1] "FTCMRPC_I0AlphaBeta" FLOAT32_IEEE F_1_p0_2 1 2 -3.402823466E+038 3.402823466E+038 ECU_ADDRESS 0x7000372C /end MEASUREMENT
/begin MEASUREMENT FTCMRPC_I0AlphaBeta[2] "FTCMRPC_I0AlphaBeta" FLOAT32_IEEE F_1_p0_2 1 2 -3.402823466E+038 3.402823466E+038 ECU_ADDRESS 0x70003730 /end MEASUREMENT
/begin MEASUREMENT FTCMRPC_I0dq3[0] "value of the motor phase current in park frame" FLOAT32_IEEE F_1_p0_2 1 2 -3.402823466E+038 3.402823466E+038 ECU_ADDRESS 0x7000371C /end MEASUREMENT
/begin MEASUREMENT FTCMRPC_I0dq3[1] "value of the motor phase current in park frame" FLOAT32_IEEE F_1_p0_2 1 2 -3.402823466E+038 3.402823466E+038 ECU_ADDRESS 0x70003720 /end MEASUREMENT
/begin MEASUREMENT FTCMRPC_I0dq3[2] "value of the motor phase current in park frame" FLOAT32_IEEE F_1_p0_2 1 2 -3.402823466E+038 3.402823466E+038 ECU_ADDRESS 0x70003724 /end MEASUREMENT
/begin MEASUREMENT FTCMSCS_CtrlIntegratorZ "FTCMSCS_CtrlIntegratorZ" FLOAT32_IEEE F_1_p0_2 1 2 -3.402823466E+038 3.402823466E+038 ECU_ADDRESS 0x70003764 /end MEASUREMENT
/begin MEASUREMENT FTCMSCS_CtrlKi "FTCMSCS_CtrlKi" FLOAT32_IEEE F_1_p0_2 1 2 -3.402823466E+038 3.402823466E+038 ECU_ADDRESS 0x70003760 /end MEASUREMENT
/begin MEASUREMENT FTCMSCS_CtrlKp "FTCMSCS_CtrlKp" FLOAT32_IEEE F_1_p0_2 1 2 -3.402823466E+038 3.402823466E+038 ECU_ADDRESS 0x7000375C /end MEASUREMENT
/begin MEASUREMENT FTCMSCS_CtrlSatCntZ "FTCMSCS_CtrlSatCntZ" SWORD F_1_p0_2 1 2 -32768 32767 ECU_ADDRESS 0x7000375A /end MEASUREMENT
/begin MEASUREMENT FTCMSCS_CtrlSatTimoutDetn "FTCMSCS_CtrlSatTimoutDetn" UBYTE Bool_ON_OFF 1 2 0 1 BIT_MASK 0x01 ECU_ADDRESS 0x70003758 /end MEASUREMENT
/begin MEASUREMENT FTCMSCS_CtrlTgt "FTCMSCS_CtrlTgt" FLOAT32_IEEE F_1_p0_2 1 2 -3.402823466E+038 3.402823466E+038 ECU_ADDRESS 0x70003754 /end MEASUREMENT
/begin MEASUREMENT FTCMSCS_DeltaSpeedRpmZ "FTCMSCS_DeltaSpeedRpmZ" FLOAT32_IEEE F_1_p0_2 1 2 -3.402823466E+038 3.402823466E+038 ECU_ADDRESS 0x70003750 /end MEASUREMENT
/begin MEASUREMENT FTCMSCS_EpsilonCtrl "FTCMSCS_EpsilonCtrl" FLOAT32_IEEE F_1_p0_2 1 2 -3.402823466E+038 3.402823466E+038 ECU_ADDRESS 0x7000374C /end MEASUREMENT
/begin MEASUREMENT FTCMSCS_ObsIntegratorZ "FTCMSCS_ObsIntegratorZ" FLOAT32_IEEE F_1_p0_2 1 2 -3.402823466E+038 3.402823466E+038 ECU_ADDRESS 0x70003748 /end MEASUREMENT
/begin MEASUREMENT FTCMSCS_SpdOverShootCntZ "FTCMSCS_SpdOverShootCntZ" SWORD F_1_p0_2 1 2 -32768 32767 ECU_ADDRESS 0x70003746 /end MEASUREMENT
/begin MEASUREMENT FTCMSCS_SpeedModelTrqSatZ "FTCMSCS_SpeedModelTrqSatZ" UBYTE Bool_ON_OFF 1 2 0 1 BIT_MASK 0x01 ECU_ADDRESS 0x70003744 /end MEASUREMENT
/begin MEASUREMENT FTCMSCS_TorqueTestCountZ "FTCMSCS_TorqueTestCountZ" FLOAT32_IEEE F_1_p0_2 1 2 -3.402823466E+038 3.402823466E+038 ECU_ADDRESS 0x70003740 /end MEASUREMENT
/begin MEASUREMENT FTCMSCS_TorqueTgt "FTCMSCS_TorqueTgt" FLOAT32_IEEE F_1_p0_2 1 2 -3.402823466E+038 3.402823466E+038 ECU_ADDRESS 0x7000373C /end MEASUREMENT
/begin MEASUREMENT FTCMSCS_ZeroSpeedCntZ "FTCMSCS_ZeroSpeedCntZ" SWORD F_1_p0_2 1 2 -32768 32767 ECU_ADDRESS 0x70003738 /end MEASUREMENT
/begin MEASUREMENT FTCMSCS_fOmegaEstZ "FTCMSCS_fOmegaEstZ" FLOAT32_IEEE F_1_p0_2 1 2 -3.402823466E+038 3.402823466E+038 ECU_ADDRESS 0x70003734 /end MEASUREMENT
/begin MEASUREMENT FTCMSTC_RateLimiterOutZ "FTCMSTC_RateLimiterOutZ" FLOAT32_IEEE F_1_p0_2 1 2 -3.402823466E+038 3.402823466E+038 ECU_ADDRESS 0x7000376C /end MEASUREMENT
/begin MEASUREMENT FTCMSTC_SpeedRpmTgtFiltered "FTCMSTC_SpeedRpmTgtFiltered" FLOAT32_IEEE F_1_p0_2 1 2 -20000 20000 ECU_ADDRESS 0x70003768 /end MEASUREMENT
/begin MEASUREMENT FTCMTCS_AntiSlideEnaCountOutZ "FTCMTCS_AntiSlideEnaCountOutZ" SLONG F_1_p0_2 1 2 -2147483648 2147483647 ECU_ADDRESS 0x70003820 /end MEASUREMENT
/begin MEASUREMENT FTCMTCS_AntiSlideInhibOutZ "FTCMTCS_AntiSlideInhibOutZ" UBYTE Bool_ON_OFF 1 2 0 1 BIT_MASK 0x01 ECU_ADDRESS 0x7000381C /end MEASUREMENT
/begin MEASUREMENT FTCMTCS_AntiSlideTorqueThr "FTCMTCS_AntiSlideTorqueThr" FLOAT32_IEEE F_1_p0_2 1 2 -3.402823466E+038 3.402823466E+038 ECU_ADDRESS 0x70003818 /end MEASUREMENT
/begin MEASUREMENT FTCMTCS_CurrentControllerSat "FTCMTCS_CurrentControllerSat" UBYTE Bool_ON_OFF 1 2 0 1 BIT_MASK 0x01 ECU_ADDRESS 0x70003814 /end MEASUREMENT
/begin MEASUREMENT FTCMTCS_DelVol "FTCMTCS_DelVol" FLOAT32_IEEE F_1_p0_2 1 2 -3.402823466E+038 3.402823466E+038 ECU_ADDRESS 0x70003810 /end MEASUREMENT
/begin MEASUREMENT FTCMTCS_ElecTorqueGenMax "FTCMTCS_ElecTorqueGenMax" FLOAT32_IEEE F_1_p0_2 1 2 -3.402823466E+038 3.402823466E+038 ECU_ADDRESS 0x7000380C /end MEASUREMENT
/begin MEASUREMENT FTCMTCS_ElecTorqueMaxMin[0] "FTCMTCS_ElecTorqueMaxMin" FLOAT32_IEEE F_1_p0_2 1 2 -3.402823466E+038 3.402823466E+038 ECU_ADDRESS 0x70003804 /end MEASUREMENT
/begin MEASUREMENT FTCMTCS_ElecTorqueMaxMin[1] "FTCMTCS_ElecTorqueMaxMin" FLOAT32_IEEE F_1_p0_2 1 2 -3.402823466E+038 3.402823466E+038 ECU_ADDRESS 0x70003808 /end MEASUREMENT
/begin MEASUREMENT FTCMTCS_ElecTorqueMotMax "FTCMTCS_ElecTorqueMotMax" FLOAT32_IEEE F_1_p0_2 1 2 -3.402823466E+038 3.402823466E+038 ECU_ADDRESS 0x70003800 /end MEASUREMENT
/begin MEASUREMENT FTCMTCS_ElecTorqueTgt "FTCMTCS_ElecTorqueTgt" FLOAT32_IEEE F_1_p0_2 1 2 -3.402823466E+038 3.402823466E+038 ECU_ADDRESS 0x700037FC /end MEASUREMENT
/begin MEASUREMENT FTCMTCS_EntrySlideCountOutZ "FTCMTCS_EntrySlideCountOutZ" SLONG F_1_p0_2 1 2 -2147483648 2147483647 ECU_ADDRESS 0x700037F8 /end MEASUREMENT
/begin MEASUREMENT FTCMTCS_EntrySlideFlag "FTCMTCS_EntrySlideFlag" UBYTE Bool_ON_OFF 1 2 0 1 BIT_MASK 0x01 ECU_ADDRESS 0x700037F4 /end MEASUREMENT
/begin MEASUREMENT FTCMTCS_FastSlipDelayZ "FTCMTCS_FastSlipDelayZ" FLOAT32_IEEE F_1_p0_2 1 2 -3.402823466E+038 3.402823466E+038 ECU_ADDRESS 0x700037F0 /end MEASUREMENT
/begin MEASUREMENT FTCMTCS_FluxControllerTgt "FTCMTCS_FluxControllerTgt" FLOAT32_IEEE F_1_p0_2 1 2 -3.402823466E+038 3.402823466E+038 ECU_ADDRESS 0x700037EC /end MEASUREMENT
/begin MEASUREMENT FTCMTCS_FluxControllerTgtZ "FTCMTCS_FluxControllerTgtZ" FLOAT32_IEEE F_1_p0_2 1 2 -3.402823466E+038 3.402823466E+038 ECU_ADDRESS 0x700037E8 /end MEASUREMENT
/begin MEASUREMENT FTCMTCS_IdTgtAdd "FTCMTCS_IdTgtAdd" FLOAT32_IEEE F_1_p0_2 1 2 -3.402823466E+038 3.402823466E+038 ECU_ADDRESS 0x700037E4 /end MEASUREMENT
/begin MEASUREMENT FTCMTCS_IdTgtAdd0 "FTCMTCS_IdTgtAdd0" FLOAT32_IEEE F_1_p0_2 1 2 -3.402823466E+038 3.402823466E+038 ECU_ADDRESS 0x700037E0 /end MEASUREMENT
/begin MEASUREMENT FTCMTCS_IdqTgtAddRatio "FTCMTCS_IdqTgtAddRatio" FLOAT32_IEEE F_1_p0_2 1 2 0 1 ECU_ADDRESS 0x700037DC /end MEASUREMENT
/begin MEASUREMENT FTCMTCS_IqTgtAdd "FTCMTCS_IqTgtAdd" FLOAT32_IEEE F_1_p0_2 1 2 -3.402823466E+038 3.402823466E+038 ECU_ADDRESS 0x700037D8 /end MEASUREMENT
/begin MEASUREMENT FTCMTCS_MecaSpeedDiff "FTCMTCS_MecaSpeedDiff" FLOAT32_IEEE F_1_p0_2 1 2 -3.402823466E+038 3.402823466E+038 ECU_ADDRESS 0x700037D4 /end MEASUREMENT
/begin MEASUREMENT FTCMTCS_MecaSpeedOutZ "FTCMTCS_MecaSpeedOutZ" FLOAT32_IEEE F_1_p0_2 1 2 -3.402823466E+038 3.402823466E+038 ECU_ADDRESS 0x700037D0 /end MEASUREMENT
/begin MEASUREMENT FTCMTCS_ParkVoltageTgt "FTCMTCS_ParkVoltageTgt" FLOAT32_IEEE F_1_p0_2 1 2 -3.402823466E+038 3.402823466E+038 ECU_ADDRESS 0x700037CC /end MEASUREMENT
/begin MEASUREMENT FTCMTCS_PhaseVoltagePeakTgt "FTCMTCS_PhaseVoltagePeakTgt" FLOAT32_IEEE F_1_p0_2 1 2 -3.402823466E+038 3.402823466E+038 ECU_ADDRESS 0x700037C8 /end MEASUREMENT
/begin MEASUREMENT FTCMTCS_SlideDelayFildZ "FTCMTCS_SlideDelayFildZ" FLOAT32_IEEE F_1_p0_2 1 2 -3.402823466E+038 3.402823466E+038 ECU_ADDRESS 0x700037C4 /end MEASUREMENT
/begin MEASUREMENT FTCMTCS_SpdRpmDelayFildZ "FTCMTCS_SpdRpmDelayFildZ" FLOAT32_IEEE F_1_p0_2 1 2 -3.402823466E+038 3.402823466E+038 ECU_ADDRESS 0x700037C0 /end MEASUREMENT
/begin MEASUREMENT FTCMTCS_TorqueGain "FTCMTCS_TorqueGain" FLOAT32_IEEE F_1_p0_2 1 2 -3.402823466E+038 3.402823466E+038 ECU_ADDRESS 0x700037BC /end MEASUREMENT
/begin MEASUREMENT FTCMTCS_TorqueGainFild "FTCMTCS_TorqueGainFild" FLOAT32_IEEE F_1_p0_2 1 2 -3.402823466E+038 3.402823466E+038 ECU_ADDRESS 0x700037B8 /end MEASUREMENT
/begin MEASUREMENT FTCMTCS_TorqueGainOutZ "FTCMTCS_TorqueGainOutZ" FLOAT32_IEEE F_1_p0_2 1 2 -3.402823466E+038 3.402823466E+038 ECU_ADDRESS 0x700037B4 /end MEASUREMENT
/begin MEASUREMENT FTCMTCS_TorqueLimActivation "FTCMTCS_TorqueLimActivation" UBYTE Bool_ON_OFF 1 2 0 1 BIT_MASK 0x01 ECU_ADDRESS 0x700037B0 /end MEASUREMENT
/begin MEASUREMENT FTCMTCS_TorqueSlideTgt "FTCMTCS_TorqueSlideTgt" FLOAT32_IEEE F_1_p0_2 1 2 -3.402823466E+038 3.402823466E+038 ECU_ADDRESS 0x700037AC /end MEASUREMENT
/begin MEASUREMENT FTCMTCS_TorqueVolim "FTCMTCS_TorqueVolim" FLOAT32_IEEE F_1_p0_2 1 2 -3.402823466E+038 3.402823466E+038 ECU_ADDRESS 0x700037A8 /end MEASUREMENT
/begin MEASUREMENT FTCMTCS_VoltageMargin "FTCMTCS_VoltageMargin" FLOAT32_IEEE F_1_p0_2 1 2 -3.402823466E+038 3.402823466E+038 ECU_ADDRESS 0x700037A4 /end MEASUREMENT
/begin MEASUREMENT FTCMTCS_VoltageMarginCorZ "FTCMTCS_VoltageMarginCorZ" FLOAT32_IEEE F_1_p0_2 1 2 -3.402823466E+038 3.402823466E+038 ECU_ADDRESS 0x700037A0 /end MEASUREMENT
/begin MEASUREMENT FTCMTCS_bFastSlipFlg "FTCMTCS_bFastSlipFlg" UBYTE Bool_ON_OFF 1 2 0 1 BIT_MASK 0x01 ECU_ADDRESS 0x7000379D /end MEASUREMENT
/begin MEASUREMENT FTCMTCS_bGenSlideFlg "FTCMTCS_bGenSlideFlg" UBYTE Bool_ON_OFF 1 2 0 1 BIT_MASK 0x01 ECU_ADDRESS 0x7000379C /end MEASUREMENT
/begin MEASUREMENT FTCMTCS_i0dqTgt3[0] "FTCMTCS_i0dqTgt3" FLOAT32_IEEE F_1_p0_2 1 2 -3.402823466E+038 3.402823466E+038 ECU_ADDRESS 0x70003790 /end MEASUREMENT
/begin MEASUREMENT FTCMTCS_i0dqTgt3[1] "FTCMTCS_i0dqTgt3" FLOAT32_IEEE F_1_p0_2 1 2 -3.402823466E+038 3.402823466E+038 ECU_ADDRESS 0x70003794 /end MEASUREMENT
/begin MEASUREMENT FTCMTCS_i0dqTgt3[2] "FTCMTCS_i0dqTgt3" FLOAT32_IEEE F_1_p0_2 1 2 -3.402823466E+038 3.402823466E+038 ECU_ADDRESS 0x70003798 /end MEASUREMENT
/begin MEASUREMENT FTCMTCS_idCorActDiffZ "FTCMTCS_idCorActDiffZ" FLOAT32_IEEE F_1_p0_2 1 2 -3.402823466E+038 3.402823466E+038 ECU_ADDRESS 0x7000378C /end MEASUREMENT
/begin MEASUREMENT FTCMTCS_idCorTgt "FTCMTCS_idCorTgt" FLOAT32_IEEE F_1_p0_2 1 2 -3.402823466E+038 3.402823466E+038 ECU_ADDRESS 0x70003788 /end MEASUREMENT
/begin MEASUREMENT FTCMTCS_idCorTgtZ "FTCMTCS_idCorTgtZ" FLOAT32_IEEE F_1_p0_2 1 2 -3.402823466E+038 3.402823466E+038 ECU_ADDRESS 0x70003784 /end MEASUREMENT
/begin MEASUREMENT FTCMTCS_idLutAddTgt "FTCMTCS_idLutAddTgt" FLOAT32_IEEE F_1_p0_2 1 2 -3.402823466E+038 3.402823466E+038 ECU_ADDRESS 0x70003780 /end MEASUREMENT
/begin MEASUREMENT FTCMTCS_idLutTgt "FTCMTCS_idLutTgt" FLOAT32_IEEE F_1_p0_2 1 2 -3.402823466E+038 3.402823466E+038 ECU_ADDRESS 0x7000377C /end MEASUREMENT
/begin MEASUREMENT FTCMTCS_idLutTgtZ "FTCMTCS_idLutTgtZ" FLOAT32_IEEE F_1_p0_2 1 2 -3.402823466E+038 3.402823466E+038 ECU_ADDRESS 0x70003778 /end MEASUREMENT
/begin MEASUREMENT FTCMTCS_iqLutAddTgt "FTCMTCS_iqLutAddTgt" FLOAT32_IEEE F_1_p0_2 1 2 -3.402823466E+038 3.402823466E+038 ECU_ADDRESS 0x70003774 /end MEASUREMENT
/begin MEASUREMENT FTCMTCS_iqLutTgt "FTCMTCS_iqLutTgt" FLOAT32_IEEE F_1_p0_2 1 2 -3.402823466E+038 3.402823466E+038 ECU_ADDRESS 0x70003770 /end MEASUREMENT
/begin MEASUREMENT FTCMTTC_AfterPreTorqueTgt "After pretorque model torque target" FLOAT32_IEEE F_1_p0_2 1 2 -3.402823466E+038 3.402823466E+038 ECU_ADDRESS 0x7000389C /end MEASUREMENT
/begin MEASUREMENT FTCMTTC_AntiJerkBaseGain "FTCMTTC_AntiJerkBaseGain" FLOAT32_IEEE F_1_p0_2 1 2 -3.402823466E+038 3.402823466E+038 ECU_ADDRESS 0x70003898 /end MEASUREMENT
/begin MEASUREMENT FTCMTTC_AntiJerkMecaTorqueTgt "FTCMTTC_AntiJerkMecaTorqueTgt" FLOAT32_IEEE F_1_p0_2 1 2 -3.402823466E+038 3.402823466E+038 ECU_ADDRESS 0x70003894 /end MEASUREMENT
/begin MEASUREMENT FTCMTTC_AntiJerkTrqTgt "FTCMTTC_AntiJerkTrqTgt" FLOAT32_IEEE F_1_p0_2 1 2 -3.402823466E+038 3.402823466E+038 ECU_ADDRESS 0x70003890 /end MEASUREMENT
/begin MEASUREMENT FTCMTTC_AntiJerkTrqTgtHpZ "FTCMTTC_AntiJerkTrqTgtHpZ" FLOAT32_IEEE F_1_p0_2 1 2 -3.402823466E+038 3.402823466E+038 ECU_ADDRESS 0x7000388C /end MEASUREMENT
/begin MEASUREMENT FTCMTTC_AntiJerkTrqTgtZ "FTCMTTC_AntiJerkTrqTgtZ" FLOAT32_IEEE F_1_p0_2 1 2 -3.402823466E+038 3.402823466E+038 ECU_ADDRESS 0x70003888 /end MEASUREMENT
/begin MEASUREMENT FTCMTTC_AtjkBpAccTorqueTgt "FTCMTTC_AtjkBpAccTorqueTgt" FLOAT32_IEEE F_1_p0_2 1 2 -3.402823466E+038 3.402823466E+038 ECU_ADDRESS 0x70003884 /end MEASUREMENT
/begin MEASUREMENT FTCMTTC_AtjkDeltaTorqueTgt "FTCMTTC_AtjkDeltaTorqueTgt" FLOAT32_IEEE F_1_p0_2 1 2 -3.402823466E+038 3.402823466E+038 ECU_ADDRESS 0x70003880 /end MEASUREMENT
/begin MEASUREMENT FTCMTTC_BpLowCutOffFrequency "FTCMTTC_BpLowCutOffFrequency" FLOAT32_IEEE F_1_p0_2 1 2 -3.402823466E+038 3.402823466E+038 ECU_ADDRESS 0x7000387C /end MEASUREMENT
/begin MEASUREMENT FTCMTTC_DampTorqueCompTgt "FTCMTTC_DampTorqueCompTgt" FLOAT32_IEEE F_1_p0_2 1 2 -3.402823466E+038 3.402823466E+038 ECU_ADDRESS 0x70003878 /end MEASUREMENT
/begin MEASUREMENT FTCMTTC_DampingActive "FTCMTTC_DampingActive" UBYTE Bool_ON_OFF 1 2 0 1 BIT_MASK 0x01 ECU_ADDRESS 0x70003875 /end MEASUREMENT
/begin MEASUREMENT FTCMTTC_DampingSpdHighDetnZ "FTCMTTC_DampingSpdHighDetnZ" UBYTE Bool_ON_OFF 1 2 0 1 BIT_MASK 0x01 ECU_ADDRESS 0x70003874 /end MEASUREMENT
/begin MEASUREMENT FTCMTTC_DeltaSpeedRpm "FTCMTTC_DeltaSpeedRpm" FLOAT32_IEEE F_1_p0_2 1 2 -3.402823466E+038 3.402823466E+038 ECU_ADDRESS 0x70003870 /end MEASUREMENT
/begin MEASUREMENT FTCMTTC_ElecTorqueTgt "FTCMTTC_ElecTorqueTgt" FLOAT32_IEEE F_1_p0_2 1 2 -3.402823466E+038 3.402823466E+038 ECU_ADDRESS 0x7000386C /end MEASUREMENT
/begin MEASUREMENT FTCMTTC_ElecTorqueTgtCor "FTCMTTC_ElecTorqueTgtCor" FLOAT32_IEEE F_1_p0_2 1 2 -3.402823466E+038 3.402823466E+038 ECU_ADDRESS 0x70003868 /end MEASUREMENT
/begin MEASUREMENT FTCMTTC_ElecTorqueTgtFild "Electromagnetic torque target" FLOAT32_IEEE F_1_p0_2 1 2 -3.402823466E+038 3.402823466E+038 ECU_ADDRESS 0x70003864 /end MEASUREMENT
/begin MEASUREMENT FTCMTTC_ElecTorqueTgtFildZ "FTCMTTC_ElecTorqueTgtFildZ" FLOAT32_IEEE F_1_p0_2 1 2 -3.402823466E+038 3.402823466E+038 ECU_ADDRESS 0x70003860 /end MEASUREMENT
/begin MEASUREMENT FTCMTTC_ElecTorqueTgtTotal "FTCMTTC_ElecTorqueTgtTotal" FLOAT32_IEEE F_1_p0_2 1 2 -3.402823466E+038 3.402823466E+038 ECU_ADDRESS 0x7000385C /end MEASUREMENT
/begin MEASUREMENT FTCMTTC_ElecTorqueTgtZ "FTCMTTC_ElecTorqueTgtZ" FLOAT32_IEEE F_1_p0_2 1 2 -3.402823466E+038 3.402823466E+038 ECU_ADDRESS 0x70003858 /end MEASUREMENT
/begin MEASUREMENT FTCMTTC_FastSlipFlg "FTCMTTC_FastSlipFlg" UBYTE Bool_ON_OFF 1 2 0 1 BIT_MASK 0x01 ECU_ADDRESS 0x700034FC /end MEASUREMENT
/begin MEASUREMENT FTCMTTC_HijEnGainFild "value of the motor phase current in park frame" FLOAT32_IEEE F_1_p0_2 1 2 -3.402823466E+038 3.402823466E+038 ECU_ADDRESS 0x700034F8 /end MEASUREMENT
/begin MEASUREMENT FTCMTTC_HijEnGainFildZ "value of the motor phase current in park frame" FLOAT32_IEEE F_1_p0_2 1 2 -3.402823466E+038 3.402823466E+038 ECU_ADDRESS 0x700034F4 /end MEASUREMENT
/begin MEASUREMENT FTCMTTC_MecTrqTgtFild "value of the motor phase current in park frame" FLOAT32_IEEE F_1_p0_2 1 2 -3.402823466E+038 3.402823466E+038 ECU_ADDRESS 0x700034F0 /end MEASUREMENT
/begin MEASUREMENT FTCMTTC_MecTrqTgtLpfZ "value of the motor phase current in park frame" FLOAT32_IEEE F_1_p0_2 1 2 -3.402823466E+038 3.402823466E+038 ECU_ADDRESS 0x700034EC /end MEASUREMENT
/begin MEASUREMENT FTCMTTC_MecaSpeedAccSlewRate "FTCMTTC_MecaSpeedAccSlewRate" FLOAT32_IEEE F_1_p0_2 1 2 -3.402823466E+038 3.402823466E+038 ECU_ADDRESS 0x70003854 /end MEASUREMENT
/begin MEASUREMENT FTCMTTC_MecaSpeedRpmFildZ "FTCMTTC_MecaSpeedRpmFildZ" FLOAT32_IEEE F_1_p0_2 1 2 -3.402823466E+038 3.402823466E+038 ECU_ADDRESS 0x70003850 /end MEASUREMENT
/begin MEASUREMENT FTCMTTC_MecaSpeedRpmLpZ "FTCMTTC_MecaSpeedRpmLpZ" FLOAT32_IEEE F_1_p0_2 1 2 -3.402823466E+038 3.402823466E+038 ECU_ADDRESS 0x7000384C /end MEASUREMENT
/begin MEASUREMENT FTCMTTC_MecaTorqueMaxMin[0] "FTCMTTC_MecaTorqueMaxMin" FLOAT32_IEEE F_1_p0_2 1 2 -3.402823466E+038 3.402823466E+038 ECU_ADDRESS 0x70003844 /end MEASUREMENT
/begin MEASUREMENT FTCMTTC_MecaTorqueMaxMin[1] "FTCMTTC_MecaTorqueMaxMin" FLOAT32_IEEE F_1_p0_2 1 2 -3.402823466E+038 3.402823466E+038 ECU_ADDRESS 0x70003848 /end MEASUREMENT
/begin MEASUREMENT FTCMTTC_MecaTorqueTgt "Limited mechanical torque target" FLOAT32_IEEE F_1_p0_2 1 2 -3.402823466E+038 3.402823466E+038 ECU_ADDRESS 0x70003840 /end MEASUREMENT
/begin MEASUREMENT FTCMTTC_PowLmtMinTorqureRaw "FTCMTTC_PowLmtMinTorqureRaw" FLOAT32_IEEE F_1_p0_2 1 2 -3.402823466E+038 3.402823466E+038 ECU_ADDRESS 0x7000383C /end MEASUREMENT
/begin MEASUREMENT FTCMTTC_PowLmtTorqureRaw "FTCMTTC_PowLmtTorqureRaw" FLOAT32_IEEE F_1_p0_2 1 2 -3.402823466E+038 3.402823466E+038 ECU_ADDRESS 0x70003838 /end MEASUREMENT
/begin MEASUREMENT FTCMTTC_PreTorqueFlg "FTCMTTC_PreTorqueFlg" UBYTE Bool_ON_OFF 1 2 0 1 BIT_MASK 0x01 ECU_ADDRESS 0x70003834 /end MEASUREMENT
/begin MEASUREMENT FTCMTTC_RealMecaTorqueTgt "FTCMTTC_RealMecaTorqueTgt" FLOAT32_IEEE F_1_p0_2 1 2 -3.402823466E+038 3.402823466E+038 ECU_ADDRESS 0x70003830 /end MEASUREMENT
/begin MEASUREMENT FTCMTTC_RealMecaTrqTgtRate "FTCMTTC_RealMecaTrqTgtRate" FLOAT32_IEEE F_1_p0_2 1 2 -3.402823466E+038 3.402823466E+038 ECU_ADDRESS 0x7000382C /end MEASUREMENT
/begin MEASUREMENT FTCMTTC_RealSpdRpmZ "FTCMTTC_RealSpdRpmZ" FLOAT32_IEEE F_1_p0_2 1 2 -3.402823466E+038 3.402823466E+038 ECU_ADDRESS 0x700034E8 /end MEASUREMENT
/begin MEASUREMENT FTCMTTC_SpdRpmFild "value of the motor phase current in park frame" FLOAT32_IEEE F_1_p0_2 1 2 -3.402823466E+038 3.402823466E+038 ECU_ADDRESS 0x700034E4 /end MEASUREMENT
/begin MEASUREMENT FTCMTTC_SpdRpmLpfZ "value of the motor phase current in park frame" FLOAT32_IEEE F_1_p0_2 1 2 -3.402823466E+038 3.402823466E+038 ECU_ADDRESS 0x700034E0 /end MEASUREMENT
/begin MEASUREMENT FTCMTTC_TempPreTorqTrasStep "FTCMTTC_TempPreTorqTrasStep" FLOAT32_IEEE F_1_p0_2 1 2 -3.402823466E+038 3.402823466E+038 ECU_ADDRESS 0x70003828 /end MEASUREMENT
/begin MEASUREMENT FTCMTTC_TorqueHpFilterEnable "FTCMTTC_TorqueHpFilterEnable" UBYTE Bool_ON_OFF 1 2 0 1 BIT_MASK 0x01 ECU_ADDRESS 0x70003827 /end MEASUREMENT
/begin MEASUREMENT FTCMTTC_TorqueHpFilterEnableZ "FTCMTTC_TorqueHpFilterEnableZ" UBYTE Bool_ON_OFF 1 2 0 1 BIT_MASK 0x01 ECU_ADDRESS 0x70003826 /end MEASUREMENT
/begin MEASUREMENT FTCMTTC_TrqTrasitionFlg "FTCMTTC_TrqTrasitionFlg" UBYTE Bool_ON_OFF 1 2 0 1 BIT_MASK 0x01 ECU_ADDRESS 0x70003825 /end MEASUREMENT
/begin MEASUREMENT FTCMTTC_TsatActv "FTCMTTC_TsatActv" UBYTE Bool_ON_OFF 1 2 0 1 BIT_MASK 0x01 ECU_ADDRESS 0x70003824 /end MEASUREMENT
/begin MEASUREMENT FTCMTTC_bGenFlg "value of the motor phase current in park frame" UBYTE Bool_ON_OFF 1 2 0 1 BIT_MASK 0x01 ECU_ADDRESS 0x700034DE /end MEASUREMENT
/begin MEASUREMENT FTCMTTC_bNvh16EnFlg "value of the motor phase current in park frame" UBYTE Bool_ON_OFF 1 2 0 1 BIT_MASK 0x01 ECU_ADDRESS 0x700034DD /end MEASUREMENT
/begin MEASUREMENT FTCMTTC_bNvh48EnFlg "value of the motor phase current in park frame" UBYTE Bool_ON_OFF 1 2 0 1 BIT_MASK 0x01 ECU_ADDRESS 0x700034DC /end MEASUREMENT
/begin MEASUREMENT FTDDLMP_MaxMinI0dqLimitVect "The maximum&amp;minimum current of I0,Id,Iq limit value in limp control mode." FLOAT32_IEEE F_1_p0_2 1 2 -1200 1200 MATRIX_DIM 1 6 1 ECU_ADDRESS 0x700038B0 /end MEASUREMENT
/begin MEASUREMENT FTDDLMP_MaxMinI0dqLimitVect[0] "FTDDLMP_MaxMinI0dqLimitVect[0]" FLOAT32_IEEE F_1_p0_2 1 2 -1200 1200 ECU_ADDRESS 0x700038B0 /end MEASUREMENT
/begin MEASUREMENT FTDDLMP_MaxMinI0dqLimitVect[1] "FTDDLMP_MaxMinI0dqLimitVect[1]" FLOAT32_IEEE F_1_p0_2 1 2 -1200 1200 ECU_ADDRESS 0x700038B4 /end MEASUREMENT
/begin MEASUREMENT FTDDLMP_MaxMinI0dqLimitVect[2] "FTDDLMP_MaxMinI0dqLimitVect[2]" FLOAT32_IEEE F_1_p0_2 1 2 -1200 1200 ECU_ADDRESS 0x700038B8 /end MEASUREMENT
/begin MEASUREMENT FTDDLMP_MaxMinI0dqLimitVect[3] "FTDDLMP_MaxMinI0dqLimitVect[3]" FLOAT32_IEEE F_1_p0_2 1 2 -1200 1200 ECU_ADDRESS 0x700038BC /end MEASUREMENT
/begin MEASUREMENT FTDDLMP_MaxMinI0dqLimitVect[4] "FTDDLMP_MaxMinI0dqLimitVect[4]" FLOAT32_IEEE F_1_p0_2 1 2 -1200 1200 ECU_ADDRESS 0x700038C0 /end MEASUREMENT
/begin MEASUREMENT FTDDLMP_MaxMinI0dqLimitVect[5] "FTDDLMP_MaxMinI0dqLimitVect[5]" FLOAT32_IEEE F_1_p0_2 1 2 -1200 1200 ECU_ADDRESS 0x700038C4 /end MEASUREMENT
/begin MEASUREMENT FTDDLMP_MaxMinSpdLimitVect "The maximum&amp;minimum speed limit value in limp control mode." FLOAT32_IEEE F_1_p0_2 1 2 -25000 25000 MATRIX_DIM 1 2 1 ECU_ADDRESS 0x700038A8 /end MEASUREMENT
/begin MEASUREMENT FTDDLMP_MaxMinSpdLimitVect[0] "FTDDLMP_MaxMinSpdLimitVect[0]" FLOAT32_IEEE F_1_p0_2 1 2 -25000 25000 ECU_ADDRESS 0x700038A8 /end MEASUREMENT
/begin MEASUREMENT FTDDLMP_MaxMinSpdLimitVect[1] "FTDDLMP_MaxMinSpdLimitVect[1]" FLOAT32_IEEE F_1_p0_2 1 2 -25000 25000 ECU_ADDRESS 0x700038AC /end MEASUREMENT
/begin MEASUREMENT FTDDLMP_MaxMinTorqueLimitVect "Maximum or Minimum Torque Limit Value." FLOAT32_IEEE F_1_p0_2 1 2 -500 500 MATRIX_DIM 1 2 1 ECU_ADDRESS 0x700038A0 /end MEASUREMENT
/begin MEASUREMENT FTDDLMP_MaxMinTorqueLimitVect[0] "FTDDLMP_MaxMinTorqueLimitVect[0]" FLOAT32_IEEE F_1_p0_2 1 2 -500 500 ECU_ADDRESS 0x700038A0 /end MEASUREMENT
/begin MEASUREMENT FTDDLMP_MaxMinTorqueLimitVect[1] "FTDDLMP_MaxMinTorqueLimitVect[1]" FLOAT32_IEEE F_1_p0_2 1 2 -500 500 ECU_ADDRESS 0x700038A4 /end MEASUREMENT
/begin MEASUREMENT FTEVEIT_CommutGain "gain of commutation losses for different pwm frequence" FLOAT32_IEEE F_1_p0_2 1 2 0.125 1 ECU_ADDRESS 0x70003CC4 /end MEASUREMENT
/begin MEASUREMENT FTEVEIT_CommutLossesDH_UL "Estimation of commutation losses of DH leg_UL." FLOAT32_IEEE F_1_p0_2 1 2 0 1000000 ECU_ADDRESS 0x70003CC0 /end MEASUREMENT
/begin MEASUREMENT FTEVEIT_CommutLossesDH_VL "Estimation of commutation losses of DH leg_VL." FLOAT32_IEEE F_1_p0_2 1 2 0 1000000 ECU_ADDRESS 0x70003CBC /end MEASUREMENT
/begin MEASUREMENT FTEVEIT_CommutLossesDH_WL "Estimation of commutation losses of DH leg_WL." FLOAT32_IEEE F_1_p0_2 1 2 0 1000000 ECU_ADDRESS 0x70003CB8 /end MEASUREMENT
/begin MEASUREMENT FTEVEIT_CommutLossesDL_UL "Estimation of commutation losses of DL leg_UL." FLOAT32_IEEE F_1_p0_2 1 2 0 1000000 ECU_ADDRESS 0x70003CB4 /end MEASUREMENT
/begin MEASUREMENT FTEVEIT_CommutLossesDL_VL "Estimation of commutation losses of DL leg_VL." FLOAT32_IEEE F_1_p0_2 1 2 0 1000000 ECU_ADDRESS 0x70003CB0 /end MEASUREMENT
/begin MEASUREMENT FTEVEIT_CommutLossesDL_WL "Estimation of commutation losses of DL leg_WL." FLOAT32_IEEE F_1_p0_2 1 2 0 1000000 ECU_ADDRESS 0x70003CAC /end MEASUREMENT
/begin MEASUREMENT FTEVEIT_CommutLossesTH_UL "Estimation of commutation losses of TH leg_UL." FLOAT32_IEEE F_1_p0_2 1 2 0 1000000 ECU_ADDRESS 0x70003CA8 /end MEASUREMENT
/begin MEASUREMENT FTEVEIT_CommutLossesTH_VL "Estimation of commutation losses of TH leg_VL." FLOAT32_IEEE F_1_p0_2 1 2 0 1000000 ECU_ADDRESS 0x70003CA4 /end MEASUREMENT
/begin MEASUREMENT FTEVEIT_CommutLossesTH_WL "Estimation of commutation losses of TH leg_WL." FLOAT32_IEEE F_1_p0_2 1 2 0 1000000 ECU_ADDRESS 0x70003CA0 /end MEASUREMENT
/begin MEASUREMENT FTEVEIT_CommutLossesTL_UL "Estimation of commutation losses of TL leg_UL." FLOAT32_IEEE F_1_p0_2 1 2 0 1000000 ECU_ADDRESS 0x70003C9C /end MEASUREMENT
/begin MEASUREMENT FTEVEIT_CommutLossesTL_VL "Estimation of commutation losses of TL leg_VL." FLOAT32_IEEE F_1_p0_2 1 2 0 1000000 ECU_ADDRESS 0x70003C98 /end MEASUREMENT
/begin MEASUREMENT FTEVEIT_CommutLossesTL_WL "Estimation of commutation losses of TL leg_WL." FLOAT32_IEEE F_1_p0_2 1 2 0 1000000 ECU_ADDRESS 0x70003C94 /end MEASUREMENT
/begin MEASUREMENT FTEVEIT_CondLossesDH_UL "Estimation of conduction losses of DH leg_UL." FLOAT32_IEEE F_1_p0_2 1 2 0 1000000 ECU_ADDRESS 0x70003C90 /end MEASUREMENT
/begin MEASUREMENT FTEVEIT_CondLossesDH_VL "Estimation of conduction losses of DH leg_VL." FLOAT32_IEEE F_1_p0_2 1 2 0 1000000 ECU_ADDRESS 0x70003C8C /end MEASUREMENT
/begin MEASUREMENT FTEVEIT_CondLossesDH_WL "Estimation of conduction losses of DH leg_WL." FLOAT32_IEEE F_1_p0_2 1 2 0 1000000 ECU_ADDRESS 0x70003C88 /end MEASUREMENT
/begin MEASUREMENT FTEVEIT_CondLossesDL_UL "Estimation of conduction losses of DL leg_UL." FLOAT32_IEEE F_1_p0_2 1 2 0 1000000 ECU_ADDRESS 0x70003C84 /end MEASUREMENT
/begin MEASUREMENT FTEVEIT_CondLossesDL_VL "Estimation of conduction losses of DL leg_VL." FLOAT32_IEEE F_1_p0_2 1 2 0 1000000 ECU_ADDRESS 0x70003C80 /end MEASUREMENT
/begin MEASUREMENT FTEVEIT_CondLossesDL_WL "Estimation of conduction losses of DL leg_WL." FLOAT32_IEEE F_1_p0_2 1 2 0 1000000 ECU_ADDRESS 0x70003C7C /end MEASUREMENT
/begin MEASUREMENT FTEVEIT_CondLossesTH_UL "Estimation of conduction losses of TH leg_UL." FLOAT32_IEEE F_1_p0_2 1 2 0 1000000 ECU_ADDRESS 0x70003C78 /end MEASUREMENT
/begin MEASUREMENT FTEVEIT_CondLossesTH_VL "Estimation of conduction losses of TH leg_VL." FLOAT32_IEEE F_1_p0_2 1 2 0 1000000 ECU_ADDRESS 0x70003C74 /end MEASUREMENT
/begin MEASUREMENT FTEVEIT_CondLossesTH_WL "Estimation of conduction losses of TH leg_WL." FLOAT32_IEEE F_1_p0_2 1 2 0 1000000 ECU_ADDRESS 0x70003C70 /end MEASUREMENT
/begin MEASUREMENT FTEVEIT_CondLossesTL_UL "Estimation of conduction losses of TL leg_UL." FLOAT32_IEEE F_1_p0_2 1 2 0 1000000 ECU_ADDRESS 0x70003C6C /end MEASUREMENT
/begin MEASUREMENT FTEVEIT_CondLossesTL_VL "Estimation of conduction losses of TL leg_VL." FLOAT32_IEEE F_1_p0_2 1 2 0 1000000 ECU_ADDRESS 0x70003C68 /end MEASUREMENT
/begin MEASUREMENT FTEVEIT_CondLossesTL_WL "Estimation of conduction losses of TL leg_WL." FLOAT32_IEEE F_1_p0_2 1 2 0 1000000 ECU_ADDRESS 0x70003C64 /end MEASUREMENT
/begin MEASUREMENT FTEVEIT_CurrDH_UL "Estimation of current crossing DH leg_UL." FLOAT32_IEEE F_1_p0_2 1 2 0 1000 ECU_ADDRESS 0x70003C60 /end MEASUREMENT
/begin MEASUREMENT FTEVEIT_CurrDH_VL "Estimation of current crossing DH leg_VL." FLOAT32_IEEE F_1_p0_2 1 2 0 1000 ECU_ADDRESS 0x70003C5C /end MEASUREMENT
/begin MEASUREMENT FTEVEIT_CurrDH_WL "Estimation of current crossing DH leg_WL." FLOAT32_IEEE F_1_p0_2 1 2 0 1000 ECU_ADDRESS 0x70003C58 /end MEASUREMENT
/begin MEASUREMENT FTEVEIT_CurrDL_UL "Estimation of current crossing DL leg_UL." FLOAT32_IEEE F_1_p0_2 1 2 0 1000 ECU_ADDRESS 0x70003C54 /end MEASUREMENT
/begin MEASUREMENT FTEVEIT_CurrDL_VL "Estimation of current crossing DL leg_VL." FLOAT32_IEEE F_1_p0_2 1 2 0 1000 ECU_ADDRESS 0x70003C50 /end MEASUREMENT
/begin MEASUREMENT FTEVEIT_CurrDL_WL "Estimation of current crossing DL leg_WL." FLOAT32_IEEE F_1_p0_2 1 2 0 1000 ECU_ADDRESS 0x70003C4C /end MEASUREMENT
/begin MEASUREMENT FTEVEIT_CurrTH_UL "Estimation of current crossing TH leg_UL." FLOAT32_IEEE F_1_p0_2 1 2 0 1000 ECU_ADDRESS 0x70003C48 /end MEASUREMENT
/begin MEASUREMENT FTEVEIT_CurrTH_VL "Estimation of current crossing TH leg_VL." FLOAT32_IEEE F_1_p0_2 1 2 0 1000 ECU_ADDRESS 0x70003C44 /end MEASUREMENT
/begin MEASUREMENT FTEVEIT_CurrTH_WL "Estimation of current crossing TH leg_WL." FLOAT32_IEEE F_1_p0_2 1 2 0 1000 ECU_ADDRESS 0x70003C40 /end MEASUREMENT
/begin MEASUREMENT FTEVEIT_CurrTL_UL "Estimation of current crossing TL leg_UL." FLOAT32_IEEE F_1_p0_2 1 2 0 1000 ECU_ADDRESS 0x70003C3C /end MEASUREMENT
/begin MEASUREMENT FTEVEIT_CurrTL_VL "Estimation of current crossing TL leg_VL." FLOAT32_IEEE F_1_p0_2 1 2 0 1000 ECU_ADDRESS 0x70003C38 /end MEASUREMENT
/begin MEASUREMENT FTEVEIT_CurrTL_WL "Estimation of current crossing TL leg_WL." FLOAT32_IEEE F_1_p0_2 1 2 0 1000 ECU_ADDRESS 0x70003C34 /end MEASUREMENT
/begin MEASUREMENT FTEVEIT_EnableInit "Initialization part is enable." UBYTE Bool_ON_OFF 1 2 0 1 BIT_MASK 0x01 ECU_ADDRESS 0x70003C32 /end MEASUREMENT
/begin MEASUREMENT FTEVEIT_EnableKO "Estimation part is disable." UBYTE Bool_ON_OFF 1 2 0 1 BIT_MASK 0x01 ECU_ADDRESS 0x70003C31 /end MEASUREMENT
/begin MEASUREMENT FTEVEIT_EnableOK "Estimation part is enable." UBYTE Bool_ON_OFF 1 2 0 1 BIT_MASK 0x01 ECU_ADDRESS 0x70003C30 /end MEASUREMENT
/begin MEASUREMENT FTEVEIT_EstimTempDHVect[0] "Estimation of DH junction temperature for all legs." FLOAT32_IEEE F_1_p0_2 1 2 -200 400 ECU_ADDRESS 0x70003C24 /end MEASUREMENT
/begin MEASUREMENT FTEVEIT_EstimTempDHVect[1] "Estimation of DH junction temperature for all legs." FLOAT32_IEEE F_1_p0_2 1 2 -200 400 ECU_ADDRESS 0x70003C28 /end MEASUREMENT
/begin MEASUREMENT FTEVEIT_EstimTempDHVect[2] "Estimation of DH junction temperature for all legs." FLOAT32_IEEE F_1_p0_2 1 2 -200 400 ECU_ADDRESS 0x70003C2C /end MEASUREMENT
/begin MEASUREMENT FTEVEIT_EstimTempDH_UL "Estimation of DH junction temperature leg_UL." FLOAT32_IEEE F_1_p0_2 1 2 -200 400 ECU_ADDRESS 0x70003C20 /end MEASUREMENT
/begin MEASUREMENT FTEVEIT_EstimTempDH_VL "Estimation of DH junction temperature leg_VL." FLOAT32_IEEE F_1_p0_2 1 2 -200 400 ECU_ADDRESS 0x70003C1C /end MEASUREMENT
/begin MEASUREMENT FTEVEIT_EstimTempDH_WL "Estimation of DH junction temperature leg_WL." FLOAT32_IEEE F_1_p0_2 1 2 -200 400 ECU_ADDRESS 0x70003C18 /end MEASUREMENT
/begin MEASUREMENT FTEVEIT_EstimTempDLVect[0] "Estimation of DL junction temperature for all legs." FLOAT32_IEEE F_1_p0_2 1 2 -200 400 ECU_ADDRESS 0x70003C0C /end MEASUREMENT
/begin MEASUREMENT FTEVEIT_EstimTempDLVect[1] "Estimation of DL junction temperature for all legs." FLOAT32_IEEE F_1_p0_2 1 2 -200 400 ECU_ADDRESS 0x70003C10 /end MEASUREMENT
/begin MEASUREMENT FTEVEIT_EstimTempDLVect[2] "Estimation of DL junction temperature for all legs." FLOAT32_IEEE F_1_p0_2 1 2 -200 400 ECU_ADDRESS 0x70003C14 /end MEASUREMENT
/begin MEASUREMENT FTEVEIT_EstimTempDL_UL "Estimation of DL junction temperature leg_UL." FLOAT32_IEEE F_1_p0_2 1 2 -200 400 ECU_ADDRESS 0x70003C08 /end MEASUREMENT
/begin MEASUREMENT FTEVEIT_EstimTempDL_VL "Estimation of DL junction temperature leg_VL." FLOAT32_IEEE F_1_p0_2 1 2 -200 400 ECU_ADDRESS 0x70003C04 /end MEASUREMENT
/begin MEASUREMENT FTEVEIT_EstimTempDL_WL "Estimation of DL junction temperature leg_WL." FLOAT32_IEEE F_1_p0_2 1 2 -200 400 ECU_ADDRESS 0x70003C00 /end MEASUREMENT
/begin MEASUREMENT FTEVEIT_EstimTempFirstFild "Current value of the maximal estimated temperature after the first filter." FLOAT32_IEEE F_1_p0_2 1 2 -40 200 ECU_ADDRESS 0x70003BFC /end MEASUREMENT
/begin MEASUREMENT FTEVEIT_EstimTempFirstFildZ "Previous value of the maximal estimated temperature after the first filter." FLOAT32_IEEE F_1_p0_2 1 2 -40 200 ECU_ADDRESS 0x70003BF8 /end MEASUREMENT
/begin MEASUREMENT FTEVEIT_EstimTempSecFild "Current value of the maximal estimated temperature after the second filter." FLOAT32_IEEE F_1_p0_2 1 2 -40 200 ECU_ADDRESS 0x70003BF4 /end MEASUREMENT
/begin MEASUREMENT FTEVEIT_EstimTempSecFildZ "Previous value of the maximal estimated temperature after the second filter." FLOAT32_IEEE F_1_p0_2 1 2 -40 200 ECU_ADDRESS 0x70003BF0 /end MEASUREMENT
/begin MEASUREMENT FTEVEIT_EstimTempTHVect[0] "Estimation of TH junction temperature for all legs." FLOAT32_IEEE F_1_p0_2 1 2 -200 400 ECU_ADDRESS 0x70003BE4 /end MEASUREMENT
/begin MEASUREMENT FTEVEIT_EstimTempTHVect[1] "Estimation of TH junction temperature for all legs." FLOAT32_IEEE F_1_p0_2 1 2 -200 400 ECU_ADDRESS 0x70003BE8 /end MEASUREMENT
/begin MEASUREMENT FTEVEIT_EstimTempTHVect[2] "Estimation of TH junction temperature for all legs." FLOAT32_IEEE F_1_p0_2 1 2 -200 400 ECU_ADDRESS 0x70003BEC /end MEASUREMENT
/begin MEASUREMENT FTEVEIT_EstimTempTH_UL "Estimation of TH junction temperature leg_UL." FLOAT32_IEEE F_1_p0_2 1 2 -200 400 ECU_ADDRESS 0x70003BE0 /end MEASUREMENT
/begin MEASUREMENT FTEVEIT_EstimTempTH_VL "Estimation of TH junction temperature leg_VL." FLOAT32_IEEE F_1_p0_2 1 2 -200 400 ECU_ADDRESS 0x70003BDC /end MEASUREMENT
/begin MEASUREMENT FTEVEIT_EstimTempTH_WL "Estimation of TH junction temperature leg_WL." FLOAT32_IEEE F_1_p0_2 1 2 -200 400 ECU_ADDRESS 0x70003BD8 /end MEASUREMENT
/begin MEASUREMENT FTEVEIT_EstimTempTLVect[0] "Estimation of TL junction temperature for all legs." FLOAT32_IEEE F_1_p0_2 1 2 -200 400 ECU_ADDRESS 0x70003BCC /end MEASUREMENT
/begin MEASUREMENT FTEVEIT_EstimTempTLVect[1] "Estimation of TL junction temperature for all legs." FLOAT32_IEEE F_1_p0_2 1 2 -200 400 ECU_ADDRESS 0x70003BD0 /end MEASUREMENT
/begin MEASUREMENT FTEVEIT_EstimTempTLVect[2] "Estimation of TL junction temperature for all legs." FLOAT32_IEEE F_1_p0_2 1 2 -200 400 ECU_ADDRESS 0x70003BD4 /end MEASUREMENT
/begin MEASUREMENT FTEVEIT_EstimTempTL_UL "Estimation of TL junction temperature leg_UL." FLOAT32_IEEE F_1_p0_2 1 2 -200 400 ECU_ADDRESS 0x70003BC8 /end MEASUREMENT
/begin MEASUREMENT FTEVEIT_EstimTempTL_VL "Estimation of TL junction temperature leg_VL." FLOAT32_IEEE F_1_p0_2 1 2 -200 400 ECU_ADDRESS 0x70003BC4 /end MEASUREMENT
/begin MEASUREMENT FTEVEIT_EstimTempTL_WL "Estimation of TL junction temperature leg_WL." FLOAT32_IEEE F_1_p0_2 1 2 -200 400 ECU_ADDRESS 0x70003BC0 /end MEASUREMENT
/begin MEASUREMENT FTEVEIT_HysteresisZ "Hysteresis previous value." UBYTE Bool_ON_OFF 1 2 0 1 BIT_MASK 0x01 ECU_ADDRESS 0x70003BBC /end MEASUREMENT
/begin MEASUREMENT FTEVEIT_PdhTdhS1_UL "DH junction temperature estimation from DH power losses leg_UL subsytem 1." FLOAT32_IEEE F_1_p0_2 1 2 -200 400 ECU_ADDRESS 0x70003BB8 /end MEASUREMENT
/begin MEASUREMENT FTEVEIT_PdhTdhS1_VL "DH junction temperature estimation from DH power losses leg_VL subsytem 1." FLOAT32_IEEE F_1_p0_2 1 2 -200 400 ECU_ADDRESS 0x70003BB4 /end MEASUREMENT
/begin MEASUREMENT FTEVEIT_PdhTdhS1_WL "DH junction temperature estimation from DH power losses leg_WL subsytem 1." FLOAT32_IEEE F_1_p0_2 1 2 -200 400 ECU_ADDRESS 0x70003BB0 /end MEASUREMENT
/begin MEASUREMENT FTEVEIT_PdhTdhS2_UL "DH junction temperature estimation from DH power losses leg_UL subsytem 2." FLOAT32_IEEE F_1_p0_2 1 2 -200 400 ECU_ADDRESS 0x70003BAC /end MEASUREMENT
/begin MEASUREMENT FTEVEIT_PdhTdhS2_VL "DH junction temperature estimation from DH power losses leg_VL subsytem 2." FLOAT32_IEEE F_1_p0_2 1 2 -200 400 ECU_ADDRESS 0x70003BA8 /end MEASUREMENT
/begin MEASUREMENT FTEVEIT_PdhTdhS2_WL "DH junction temperature estimation from DH power losses leg_WL subsytem 2." FLOAT32_IEEE F_1_p0_2 1 2 -200 400 ECU_ADDRESS 0x70003BA4 /end MEASUREMENT
/begin MEASUREMENT FTEVEIT_PdhTdhS3_UL "DH junction temperature estimation from DH power losses leg_UL subsytem 3." FLOAT32_IEEE F_1_p0_2 1 2 -200 400 ECU_ADDRESS 0x70003BA0 /end MEASUREMENT
/begin MEASUREMENT FTEVEIT_PdhTdhS3_VL "DH junction temperature estimation from DH power losses leg_VL subsytem 3." FLOAT32_IEEE F_1_p0_2 1 2 -200 400 ECU_ADDRESS 0x70003B9C /end MEASUREMENT
/begin MEASUREMENT FTEVEIT_PdhTdhS3_WL "DH junction temperature estimation from DH power losses leg_WL subsytem 3." FLOAT32_IEEE F_1_p0_2 1 2 -200 400 ECU_ADDRESS 0x70003B98 /end MEASUREMENT
/begin MEASUREMENT FTEVEIT_PdhTdhS4_UL "DH junction temperature estimation from DH power losses leg_UL subsytem 4." FLOAT32_IEEE F_1_p0_2 1 2 -200 400 ECU_ADDRESS 0x70003B94 /end MEASUREMENT
/begin MEASUREMENT FTEVEIT_PdhTdhS4_VL "DH junction temperature estimation from DH power losses leg_VL subsytem 4." FLOAT32_IEEE F_1_p0_2 1 2 -200 400 ECU_ADDRESS 0x70003B90 /end MEASUREMENT
/begin MEASUREMENT FTEVEIT_PdhTdhS4_WL "DH junction temperature estimation from DH power losses leg_WL subsytem 4." FLOAT32_IEEE F_1_p0_2 1 2 -200 400 ECU_ADDRESS 0x70003B8C /end MEASUREMENT
/begin MEASUREMENT FTEVEIT_PdhTdhS5_UL "DH junction temperature estimation from DH power losses leg_UL subsytem 5." FLOAT32_IEEE F_1_p0_2 1 2 -200 400 ECU_ADDRESS 0x70003B88 /end MEASUREMENT
/begin MEASUREMENT FTEVEIT_PdhTdhS5_VL "DH junction temperature estimation from DH power losses leg_VL subsytem 5." FLOAT32_IEEE F_1_p0_2 1 2 -200 400 ECU_ADDRESS 0x70003B84 /end MEASUREMENT
/begin MEASUREMENT FTEVEIT_PdhTdhS5_WL "DH junction temperature estimation from DH power losses leg_WL subsytem 5." FLOAT32_IEEE F_1_p0_2 1 2 -200 400 ECU_ADDRESS 0x70003B80 /end MEASUREMENT
/begin MEASUREMENT FTEVEIT_PdhTdh_UL "DH junction temperature estimation from DH power losses leg_UL." FLOAT32_IEEE F_1_p0_2 1 2 -200 400 ECU_ADDRESS 0x70003B7C /end MEASUREMENT
/begin MEASUREMENT FTEVEIT_PdhTdh_VL "DH junction temperature estimation from DH power losses leg_VL." FLOAT32_IEEE F_1_p0_2 1 2 -200 400 ECU_ADDRESS 0x70003B78 /end MEASUREMENT
/begin MEASUREMENT FTEVEIT_PdhTdh_WL "DH junction temperature estimation from DH power losses leg_WL." FLOAT32_IEEE F_1_p0_2 1 2 -200 400 ECU_ADDRESS 0x70003B74 /end MEASUREMENT
/begin MEASUREMENT FTEVEIT_PdhTth_UL "TH junction temperature estimation from DH power losses leg_UL." FLOAT32_IEEE F_1_p0_2 1 2 -200 400 ECU_ADDRESS 0x70003B70 /end MEASUREMENT
/begin MEASUREMENT FTEVEIT_PdhTth_VL "TH junction temperature estimation from DH power losses leg_VL." FLOAT32_IEEE F_1_p0_2 1 2 -200 400 ECU_ADDRESS 0x70003B6C /end MEASUREMENT
/begin MEASUREMENT FTEVEIT_PdhTth_WL "TH junction temperature estimation from DH power losses leg_WL." FLOAT32_IEEE F_1_p0_2 1 2 -200 400 ECU_ADDRESS 0x70003B68 /end MEASUREMENT
/begin MEASUREMENT FTEVEIT_PdlTdlS1_UL "DL junction temperature estimation from DL power losses leg_UL subsytem 1." FLOAT32_IEEE F_1_p0_2 1 2 -200 400 ECU_ADDRESS 0x70003B64 /end MEASUREMENT
/begin MEASUREMENT FTEVEIT_PdlTdlS1_VL "DL junction temperature estimation from DL power losses leg_VL subsytem 1." FLOAT32_IEEE F_1_p0_2 1 2 -200 400 ECU_ADDRESS 0x70003B60 /end MEASUREMENT
/begin MEASUREMENT FTEVEIT_PdlTdlS1_WL "DL junction temperature estimation from DL power losses leg_WL subsytem 1." FLOAT32_IEEE F_1_p0_2 1 2 -200 400 ECU_ADDRESS 0x70003B5C /end MEASUREMENT
/begin MEASUREMENT FTEVEIT_PdlTdlS2_UL "DL junction temperature estimation from DL power losses leg_UL subsytem 2." FLOAT32_IEEE F_1_p0_2 1 2 -200 400 ECU_ADDRESS 0x70003B58 /end MEASUREMENT
/begin MEASUREMENT FTEVEIT_PdlTdlS2_VL "DL junction temperature estimation from DL power losses leg_VL subsytem 2." FLOAT32_IEEE F_1_p0_2 1 2 -200 400 ECU_ADDRESS 0x70003B54 /end MEASUREMENT
/begin MEASUREMENT FTEVEIT_PdlTdlS2_WL "DL junction temperature estimation from DL power losses leg_WL subsytem 2." FLOAT32_IEEE F_1_p0_2 1 2 -200 400 ECU_ADDRESS 0x70003B50 /end MEASUREMENT
/begin MEASUREMENT FTEVEIT_PdlTdlS3_UL "DL junction temperature estimation from DL power losses leg_UL subsytem 3." FLOAT32_IEEE F_1_p0_2 1 2 -200 400 ECU_ADDRESS 0x70003B4C /end MEASUREMENT
/begin MEASUREMENT FTEVEIT_PdlTdlS3_VL "DL junction temperature estimation from DL power losses leg_VL subsytem 3." FLOAT32_IEEE F_1_p0_2 1 2 -200 400 ECU_ADDRESS 0x70003B48 /end MEASUREMENT
/begin MEASUREMENT FTEVEIT_PdlTdlS3_WL "DL junction temperature estimation from DL power losses leg_WL subsytem 3." FLOAT32_IEEE F_1_p0_2 1 2 -200 400 ECU_ADDRESS 0x70003B44 /end MEASUREMENT
/begin MEASUREMENT FTEVEIT_PdlTdlS4_UL "DL junction temperature estimation from DL power losses leg_UL subsytem 4." FLOAT32_IEEE F_1_p0_2 1 2 -200 400 ECU_ADDRESS 0x70003B40 /end MEASUREMENT
/begin MEASUREMENT FTEVEIT_PdlTdlS4_VL "DL junction temperature estimation from DL power losses leg_VL subsytem 4." FLOAT32_IEEE F_1_p0_2 1 2 -200 400 ECU_ADDRESS 0x70003B3C /end MEASUREMENT
/begin MEASUREMENT FTEVEIT_PdlTdlS4_WL "DL junction temperature estimation from DL power losses leg_WL subsytem 4." FLOAT32_IEEE F_1_p0_2 1 2 -200 400 ECU_ADDRESS 0x70003B38 /end MEASUREMENT
/begin MEASUREMENT FTEVEIT_PdlTdlS5_UL "DL junction temperature estimation from DL power losses leg_UL subsytem 5." FLOAT32_IEEE F_1_p0_2 1 2 -200 400 ECU_ADDRESS 0x70003B34 /end MEASUREMENT
/begin MEASUREMENT FTEVEIT_PdlTdlS5_VL "DL junction temperature estimation from DL power losses leg_VL subsytem 5." FLOAT32_IEEE F_1_p0_2 1 2 -200 400 ECU_ADDRESS 0x70003B30 /end MEASUREMENT
/begin MEASUREMENT FTEVEIT_PdlTdlS5_WL "DL junction temperature estimation from DL power losses leg_WL subsytem 5." FLOAT32_IEEE F_1_p0_2 1 2 -200 400 ECU_ADDRESS 0x70003B2C /end MEASUREMENT
/begin MEASUREMENT FTEVEIT_PdlTdl_UL "DL junction temperature estimation from DL power losses leg_UL." FLOAT32_IEEE F_1_p0_2 1 2 -200 400 ECU_ADDRESS 0x70003B28 /end MEASUREMENT
/begin MEASUREMENT FTEVEIT_PdlTdl_VL "DL junction temperature estimation from DL power losses leg_VL." FLOAT32_IEEE F_1_p0_2 1 2 -200 400 ECU_ADDRESS 0x70003B24 /end MEASUREMENT
/begin MEASUREMENT FTEVEIT_PdlTdl_WL "DL junction temperature estimation from DL power losses leg_WL." FLOAT32_IEEE F_1_p0_2 1 2 -200 400 ECU_ADDRESS 0x70003B20 /end MEASUREMENT
/begin MEASUREMENT FTEVEIT_PdlTtl_UL "TL junction temperature estimation from DL power losses leg_UL." FLOAT32_IEEE F_1_p0_2 1 2 -200 400 ECU_ADDRESS 0x70003B1C /end MEASUREMENT
/begin MEASUREMENT FTEVEIT_PdlTtl_VL "TL junction temperature estimation from DL power losses leg_VL." FLOAT32_IEEE F_1_p0_2 1 2 -200 400 ECU_ADDRESS 0x70003B18 /end MEASUREMENT
/begin MEASUREMENT FTEVEIT_PdlTtl_WL "TL junction temperature estimation from DL power losses leg_WL." FLOAT32_IEEE F_1_p0_2 1 2 -200 400 ECU_ADDRESS 0x70003B14 /end MEASUREMENT
/begin MEASUREMENT FTEVEIT_PlossesVect[0] "Power losses estimation for all legs." FLOAT32_IEEE F_1_p0_2 1 2 0 1000000 ECU_ADDRESS 0x70003B08 /end MEASUREMENT
/begin MEASUREMENT FTEVEIT_PlossesVect[1] "Power losses estimation for all legs." FLOAT32_IEEE F_1_p0_2 1 2 0 1000000 ECU_ADDRESS 0x70003B0C /end MEASUREMENT
/begin MEASUREMENT FTEVEIT_PlossesVect[2] "Power losses estimation for all legs." FLOAT32_IEEE F_1_p0_2 1 2 0 1000000 ECU_ADDRESS 0x70003B10 /end MEASUREMENT
/begin MEASUREMENT FTEVEIT_Plosses_UL "Power losses estimation of the leg_UL." FLOAT32_IEEE F_1_p0_2 1 2 0 1000000 ECU_ADDRESS 0x70003B04 /end MEASUREMENT
/begin MEASUREMENT FTEVEIT_Plosses_VL "Power losses estimation of the leg_VL." FLOAT32_IEEE F_1_p0_2 1 2 0 1000000 ECU_ADDRESS 0x70003B00 /end MEASUREMENT
/begin MEASUREMENT FTEVEIT_Plosses_WL "Power losses estimation of the leg_WL." FLOAT32_IEEE F_1_p0_2 1 2 0 1000000 ECU_ADDRESS 0x70003AFC /end MEASUREMENT
/begin MEASUREMENT FTEVEIT_PowerModuleEstTemp "Maximal value of each temperatures estimations." FLOAT32_IEEE F_1_p0_2 1 2 -200 200 ECU_ADDRESS 0x70003AF8 /end MEASUREMENT
/begin MEASUREMENT FTEVEIT_PthTdh_UL "DH junction temperature estimation from TH power losses leg_UL." FLOAT32_IEEE F_1_p0_2 1 2 -200 400 ECU_ADDRESS 0x70003AF4 /end MEASUREMENT
/begin MEASUREMENT FTEVEIT_PthTdh_VL "DH junction temperature estimation from TH power losses leg_VL." FLOAT32_IEEE F_1_p0_2 1 2 -200 400 ECU_ADDRESS 0x70003AF0 /end MEASUREMENT
/begin MEASUREMENT FTEVEIT_PthTdh_WL "DH junction temperature estimation from TH power losses leg_WL." FLOAT32_IEEE F_1_p0_2 1 2 -200 400 ECU_ADDRESS 0x70003AEC /end MEASUREMENT
/begin MEASUREMENT FTEVEIT_PthTthS1_UL "TH junction temperature estimation from TH power losses leg_UL subsystem 1." FLOAT32_IEEE F_1_p0_2 1 2 -200 400 ECU_ADDRESS 0x70003AE8 /end MEASUREMENT
/begin MEASUREMENT FTEVEIT_PthTthS1_VL "TH junction temperature estimation from TH power losses leg_VL subsystem 1." FLOAT32_IEEE F_1_p0_2 1 2 -200 400 ECU_ADDRESS 0x70003AE4 /end MEASUREMENT
/begin MEASUREMENT FTEVEIT_PthTthS1_WL "TH junction temperature estimation from TH power losses leg_WL subsystem 1." FLOAT32_IEEE F_1_p0_2 1 2 -200 400 ECU_ADDRESS 0x70003AE0 /end MEASUREMENT
/begin MEASUREMENT FTEVEIT_PthTthS2_UL "TH junction temperature estimation from TH power losses leg_UL subsystem 2." FLOAT32_IEEE F_1_p0_2 1 2 -200 400 ECU_ADDRESS 0x70003ADC /end MEASUREMENT
/begin MEASUREMENT FTEVEIT_PthTthS2_VL "TH junction temperature estimation from TH power losses leg_VL subsystem 2." FLOAT32_IEEE F_1_p0_2 1 2 -200 400 ECU_ADDRESS 0x70003AD8 /end MEASUREMENT
/begin MEASUREMENT FTEVEIT_PthTthS2_WL "TH junction temperature estimation from TH power losses leg_WL subsystem 2." FLOAT32_IEEE F_1_p0_2 1 2 -200 400 ECU_ADDRESS 0x70003AD4 /end MEASUREMENT
/begin MEASUREMENT FTEVEIT_PthTthS3_UL "TH junction temperature estimation from TH power losses leg_UL subsystem 3." FLOAT32_IEEE F_1_p0_2 1 2 -200 400 ECU_ADDRESS 0x70003AD0 /end MEASUREMENT
/begin MEASUREMENT FTEVEIT_PthTth_UL "TH junction temperature estimation from TH power losses leg_UL." FLOAT32_IEEE F_1_p0_2 1 2 -200 400 ECU_ADDRESS 0x70003AAC /end MEASUREMENT
/begin MEASUREMENT FTEVEIT_PthTth_VL "TH junction temperature estimation from TH power losses leg_VL." FLOAT32_IEEE F_1_p0_2 1 2 -200 400 ECU_ADDRESS 0x70003AA8 /end MEASUREMENT
/begin MEASUREMENT FTEVEIT_PthTth_WL "TH junction temperature estimation from TH power losses leg_WL." FLOAT32_IEEE F_1_p0_2 1 2 -200 400 ECU_ADDRESS 0x70003AA4 /end MEASUREMENT
/begin MEASUREMENT FT_AkdAfterAsc_B "FT_AkdAfterAsc_B" UBYTE Bool_ON_OFF 1 2 0 1 BIT_MASK 0x01 ECU_ADDRESS 0x700039E9 /end MEASUREMENT
/begin MEASUREMENT FT_BhvCheckEna_B "FT_BhvCheckEna_B" UBYTE Bool_ON_OFF 1 2 0 1 BIT_MASK 0x01 ECU_ADDRESS 0x700039E8 /end MEASUREMENT
/begin MEASUREMENT FT_CmdFtShutDownReq_B "FT_CmdFtShutDownReq_B" UBYTE Bool_ON_OFF 1 2 0 1 BIT_MASK 0x01 ECU_ADDRESS 0x700039E7 /end MEASUREMENT
/begin MEASUREMENT FT_CmdFtStartReq_B "FT_CmdFtStartReq_B" UBYTE Bool_ON_OFF 1 2 0 1 BIT_MASK 0x01 ECU_ADDRESS 0x700039E6 /end MEASUREMENT
/begin MEASUREMENT FT_CmdPwmDirectRes_B "FT_CmdPwmDirectRes_B" UBYTE Bool_ON_OFF 1 2 0 1 BIT_MASK 0x01 ECU_ADDRESS 0x700039E5 /end MEASUREMENT
/begin MEASUREMENT FT_CmdPwmOffRes_B "FT_CmdPwmOffRes_B" UBYTE Bool_ON_OFF 1 2 0 1 BIT_MASK 0x01 ECU_ADDRESS 0x700039E4 /end MEASUREMENT
/begin MEASUREMENT FT_CoolingTemp_F32 "FT_CoolingTemp_F32" FLOAT32_IEEE F_1_p0_2 1 2 -3.402823466E+038 3.402823466E+038 ECU_ADDRESS 0x700039E0 /end MEASUREMENT
/begin MEASUREMENT FT_DutyCycle3_F32[0] "FT_DutyCycle3_F32" FLOAT32_IEEE F_1_p0_2 1 2 -3.402823466E+038 3.402823466E+038 ECU_ADDRESS 0x700039D4 /end MEASUREMENT
/begin MEASUREMENT FT_DutyCycle3_F32[1] "FT_DutyCycle3_F32" FLOAT32_IEEE F_1_p0_2 1 2 -3.402823466E+038 3.402823466E+038 ECU_ADDRESS 0x700039D8 /end MEASUREMENT
/begin MEASUREMENT FT_DutyCycle3_F32[2] "FT_DutyCycle3_F32" FLOAT32_IEEE F_1_p0_2 1 2 -3.402823466E+038 3.402823466E+038 ECU_ADDRESS 0x700039DC /end MEASUREMENT
/begin MEASUREMENT FT_EXTAntiSlideEnable_B "FT_EXTAntiSlideEnable_B" UBYTE Bool_ON_OFF 1 2 0 1 BIT_MASK 0x01 ECU_ADDRESS 0x700039D1 /end MEASUREMENT
/begin MEASUREMENT FT_EXTPrechargeFinish_B "FT_EXTPrechargeFinish_B" UBYTE Bool_ON_OFF 1 2 0 1 BIT_MASK 0x01 ECU_ADDRESS 0x700039D0 /end MEASUREMENT
/begin MEASUREMENT FT_ElecSpeedRds_F32 "FT_ElecSpeedRds_F32" FLOAT32_IEEE F_1_p0_2 1 2 -3.402823466E+038 3.402823466E+038 ECU_ADDRESS 0x700039CC /end MEASUREMENT
/begin MEASUREMENT FT_ErrThetaRdSurPi_F32 "FT_ErrThetaRdSurPi_F32" FLOAT32_IEEE F_1_p0_2 1 2 -3.402823466E+038 3.402823466E+038 ECU_ADDRESS 0x700039C8 /end MEASUREMENT
/begin MEASUREMENT FT_ExtCurrentGain3_U16[0] "FT_ExtCurrentGain3_U16" UWORD F_1_p0_2 1 2 0 65535 ECU_ADDRESS 0x700039C0 /end MEASUREMENT
/begin MEASUREMENT FT_ExtCurrentGain3_U16[1] "FT_ExtCurrentGain3_U16" UWORD F_1_p0_2 1 2 0 65535 ECU_ADDRESS 0x700039C2 /end MEASUREMENT
/begin MEASUREMENT FT_ExtCurrentGain3_U16[2] "FT_ExtCurrentGain3_U16" UWORD F_1_p0_2 1 2 0 65535 ECU_ADDRESS 0x700039C4 /end MEASUREMENT
/begin MEASUREMENT FT_FTModeReq_U16 "FT_FTModeReq_U16" UWORD F_1_p0_2 1 2 0 65535 ECU_ADDRESS 0x700039BE /end MEASUREMENT
/begin MEASUREMENT FT_FaultLevel_U16 "FT_FaultLevel_U16" UWORD F_1_p0_2 1 2 0 65535 ECU_ADDRESS 0x700039BC /end MEASUREMENT
/begin MEASUREMENT FT_FtRunFlg_U16 "FT_FtRunFlg_U16" UWORD F_1_p0_2 1 2 0 65535 ECU_ADDRESS 0x700039BA /end MEASUREMENT
/begin MEASUREMENT FT_HacModeDetn_B "FT_HacModeDetn_B" UBYTE Bool_ON_OFF 1 2 0 1 BIT_MASK 0x01 ECU_ADDRESS 0x700039B8 /end MEASUREMENT
/begin MEASUREMENT FT_I0dqTgt3_F32[0] "FT_I0dqTgt3_F32" FLOAT32_IEEE F_1_p0_2 1 2 -3.402823466E+038 3.402823466E+038 ECU_ADDRESS 0x700039AC /end MEASUREMENT
/begin MEASUREMENT FT_I0dqTgt3_F32[1] "FT_I0dqTgt3_F32" FLOAT32_IEEE F_1_p0_2 1 2 -3.402823466E+038 3.402823466E+038 ECU_ADDRESS 0x700039B0 /end MEASUREMENT
/begin MEASUREMENT FT_I0dqTgt3_F32[2] "FT_I0dqTgt3_F32" FLOAT32_IEEE F_1_p0_2 1 2 -3.402823466E+038 3.402823466E+038 ECU_ADDRESS 0x700039B4 /end MEASUREMENT
/begin MEASUREMENT FT_Iuvw3Rms_F32[0] "FT_Iuvw3Rms_F32" FLOAT32_IEEE F_1_p0_2 1 2 -3.402823466E+038 3.402823466E+038 ECU_ADDRESS 0x700039A0 /end MEASUREMENT
/begin MEASUREMENT FT_Iuvw3Rms_F32[1] "FT_Iuvw3Rms_F32" FLOAT32_IEEE F_1_p0_2 1 2 -3.402823466E+038 3.402823466E+038 ECU_ADDRESS 0x700039A4 /end MEASUREMENT
/begin MEASUREMENT FT_Iuvw3Rms_F32[2] "FT_Iuvw3Rms_F32" FLOAT32_IEEE F_1_p0_2 1 2 -3.402823466E+038 3.402823466E+038 ECU_ADDRESS 0x700039A8 /end MEASUREMENT
/begin MEASUREMENT FT_Iuvw3_U16[0] "FT_Iuvw3_U16" UWORD F_1_p0_2 1 2 0 65535 ECU_ADDRESS 0x70003998 /end MEASUREMENT
/begin MEASUREMENT FT_Iuvw3_U16[1] "FT_Iuvw3_U16" UWORD F_1_p0_2 1 2 0 65535 ECU_ADDRESS 0x7000399A /end MEASUREMENT
/begin MEASUREMENT FT_Iuvw3_U16[2] "FT_Iuvw3_U16" UWORD F_1_p0_2 1 2 0 65535 ECU_ADDRESS 0x7000399C /end MEASUREMENT
/begin MEASUREMENT FT_MecaSpeedRds_F32 "FT_MecaSpeedRds_F32" FLOAT32_IEEE F_1_p0_2 1 2 -3.402823466E+038 3.402823466E+038 ECU_ADDRESS 0x70003994 /end MEASUREMENT
/begin MEASUREMENT FT_MecaSpeedRpmTgt_F32 "FT_MecaSpeedRpmTgt_F32" FLOAT32_IEEE F_1_p0_2 1 2 -3.402823466E+038 3.402823466E+038 ECU_ADDRESS 0x70003990 /end MEASUREMENT
/begin MEASUREMENT FT_MecaSpeedRpm_F32 "FT_MecaSpeedRpm_F32" FLOAT32_IEEE F_1_p0_2 1 2 -3.402823466E+038 3.402823466E+038 ECU_ADDRESS 0x7000398C /end MEASUREMENT
/begin MEASUREMENT FT_MotorMagnetTemp_F32 "FT_MotorMagnetTemp_F32" FLOAT32_IEEE F_1_p0_2 1 2 -3.402823466E+038 3.402823466E+038 ECU_ADDRESS 0x70003988 /end MEASUREMENT
/begin MEASUREMENT FT_MotorWindingTemp2_F32[0] "FT_MotorWindingTemp2_F32" FLOAT32_IEEE F_1_p0_2 1 2 -3.402823466E+038 3.402823466E+038 ECU_ADDRESS 0x70003980 /end MEASUREMENT
/begin MEASUREMENT FT_MotorWindingTemp2_F32[1] "FT_MotorWindingTemp2_F32" FLOAT32_IEEE F_1_p0_2 1 2 -3.402823466E+038 3.402823466E+038 ECU_ADDRESS 0x70003984 /end MEASUREMENT
/begin MEASUREMENT FT_PosiCurrentDelay_F32 "FT_PosiCurrentDelay_F32" FLOAT32_IEEE F_1_p0_2 1 2 -3.402823466E+038 3.402823466E+038 ECU_ADDRESS 0x7000397C /end MEASUREMENT
/begin MEASUREMENT FT_PowerModuleTemp_F32 "FT_PowerModuleTemp_F32" FLOAT32_IEEE F_1_p0_2 1 2 -3.402823466E+038 3.402823466E+038 ECU_ADDRESS 0x70003978 /end MEASUREMENT
/begin MEASUREMENT FT_PwmZeroMatch_B "FT_PwmZeroMatch_B" UBYTE Bool_ON_OFF 1 2 0 1 BIT_MASK 0x01 ECU_ADDRESS 0x70003974 /end MEASUREMENT
/begin MEASUREMENT FT_PwrLmtTqrMax_F32 "FT_PwrLmtTqrMax_F32" FLOAT32_IEEE F_1_p0_2 1 2 -3.402823466E+038 3.402823466E+038 ECU_ADDRESS 0x70003970 /end MEASUREMENT
/begin MEASUREMENT FT_PwrLmtTqrMin_F32 "FT_PwrLmtTqrMin_F32" FLOAT32_IEEE F_1_p0_2 1 2 -3.402823466E+038 3.402823466E+038 ECU_ADDRESS 0x7000396C /end MEASUREMENT
/begin MEASUREMENT FT_PwrMaxMinTqr_F32[0] "FT_PwrMaxMinTqr_F32" FLOAT32_IEEE F_1_p0_2 1 2 -3.402823466E+038 3.402823466E+038 ECU_ADDRESS 0x70003964 /end MEASUREMENT
/begin MEASUREMENT FT_PwrMaxMinTqr_F32[1] "FT_PwrMaxMinTqr_F32" FLOAT32_IEEE F_1_p0_2 1 2 -3.402823466E+038 3.402823466E+038 ECU_ADDRESS 0x70003968 /end MEASUREMENT
/begin MEASUREMENT FT_RandomNum_U32 "FT_RandomNum_U32" ULONG F_1_p0_2 1 2 0 4294967295 ECU_ADDRESS 0x70003960 /end MEASUREMENT
/begin MEASUREMENT FT_ResThetaRdSurPiOc_F32 "FT_ResThetaRdSurPiOc_F32" FLOAT32_IEEE F_1_p0_2 1 2 -3.402823466E+038 3.402823466E+038 ECU_ADDRESS 0x7000395C /end MEASUREMENT
/begin MEASUREMENT FT_ResloverThetaRdSuiPi_F32 "FT_ResloverThetaRdSuiPi_F32" FLOAT32_IEEE F_1_p0_2 1 2 -3.402823466E+038 3.402823466E+038 ECU_ADDRESS 0x70003958 /end MEASUREMENT
/begin MEASUREMENT FT_SinCosNextThetaElec_F32[0] "FT_SinCosNextThetaElec_F32" FLOAT32_IEEE F_1_p0_2 1 2 -3.402823466E+038 3.402823466E+038 ECU_ADDRESS 0x70003950 /end MEASUREMENT
/begin MEASUREMENT FT_SinCosNextThetaElec_F32[1] "FT_SinCosNextThetaElec_F32" FLOAT32_IEEE F_1_p0_2 1 2 -3.402823466E+038 3.402823466E+038 ECU_ADDRESS 0x70003954 /end MEASUREMENT
/begin MEASUREMENT FT_SinCosThetaElec_F32[0] "FT_SinCosThetaElec_F32" FLOAT32_IEEE F_1_p0_2 1 2 -3.402823466E+038 3.402823466E+038 ECU_ADDRESS 0x70003948 /end MEASUREMENT
/begin MEASUREMENT FT_SinCosThetaElec_F32[1] "FT_SinCosThetaElec_F32" FLOAT32_IEEE F_1_p0_2 1 2 -3.402823466E+038 3.402823466E+038 ECU_ADDRESS 0x7000394C /end MEASUREMENT
/begin MEASUREMENT FT_SpdInitialValue_F32 "FT_SpdInitialValue_F32" FLOAT32_IEEE F_1_p0_2 1 2 -3.402823466E+038 3.402823466E+038 ECU_ADDRESS 0x70003944 /end MEASUREMENT
/begin MEASUREMENT FT_TorqueTgt_F32 "FT_TorqueTgt_F32" FLOAT32_IEEE F_1_p0_2 1 2 -3.402823466E+038 3.402823466E+038 ECU_ADDRESS 0x70003940 /end MEASUREMENT
/begin MEASUREMENT FT_U0dqTgt3_F32[0] "FT_U0dqTgt3_F32" FLOAT32_IEEE F_1_p0_2 1 2 -3.402823466E+038 3.402823466E+038 ECU_ADDRESS 0x70003934 /end MEASUREMENT
/begin MEASUREMENT FT_U0dqTgt3_F32[1] "FT_U0dqTgt3_F32" FLOAT32_IEEE F_1_p0_2 1 2 -3.402823466E+038 3.402823466E+038 ECU_ADDRESS 0x70003938 /end MEASUREMENT
/begin MEASUREMENT FT_U0dqTgt3_F32[2] "FT_U0dqTgt3_F32" FLOAT32_IEEE F_1_p0_2 1 2 -3.402823466E+038 3.402823466E+038 ECU_ADDRESS 0x7000393C /end MEASUREMENT
/begin MEASUREMENT FT_UbatHV_F32 "FT_UbatHV_F32" FLOAT32_IEEE F_1_p0_2 1 2 -3.402823466E+038 3.402823466E+038 ECU_ADDRESS 0x70003930 /end MEASUREMENT
/begin MEASUREMENT FT_VcuDampEnable_B "FT_VcuDampEnable_B" UBYTE Bool_ON_OFF 1 2 0 1 BIT_MASK 0x01 ECU_ADDRESS 0x7000392C /end MEASUREMENT
/begin MEASUREMENT FT_VsiPwmPeriod_F32 "FT_VsiPwmPeriod_F32" FLOAT32_IEEE F_1_p0_2 1 2 -3.402823466E+038 3.402823466E+038 ECU_ADDRESS 0x70003928 /end MEASUREMENT
/begin MEASUREMENT FT_VsiPwmRatioRes_U8 "FT_VsiPwmRatioRes_U8" UBYTE F_1_p0_2 1 2 0 3 ECU_ADDRESS 0x70003924 /end MEASUREMENT
/begin COMPU_METHOD F_1_p0_2 "" RAT_FUNC "%9.2" "" COEFFS 0 1 0 0 0 1 /end COMPU_METHOD
/begin COMPU_METHOD Bool_ON_OFF "" TAB_VERB "%8.4" "." COMPU_TAB_REF Bool_ON_OFF_table /end COMPU_METHOD
/begin COMPU_VTAB Bool_ON_OFF_table "" TAB_VERB 2 0 "OFF" 1 "ON" /end COMPU_VTAB
/begin FUNCTION SWC_FT ""
 /begin OUT_MEASUREMENT AFT_Iuvw3_U16[2] AFT_MecaSpeedRpmTgt_F32 AFT_MotorMagnetTemp_F32 AFT_MotorWindingTemp2_F32[0] AFT_MotorWindingTemp2_F32[1] AFT_PowerModuleTemp_F32 AFT_PwmZeroMatch_B AFT_ScsStartCmd_B AFT_TorqueTgt_F32 AFT_U0dqTgt3_F32[0] AFT_U0dqTgt3_F32[1] AFT_U0dqTgt3_F32[2] AFT_UbatHV_F32 AFT_VsiPwmPeriod_F32 AFTASBDS_BattVoltDrtGainMax AFTASBDS_BattVoltDrtGainMin AFTASDPM_DeratingStatus AFTASDPM_DrtGainMax AFTASDPM_DrtGainMin AFTASDPM_MaxMinI0dqDrtVect AFTASDPM_MaxMinI0dqDrtVect[0] AFTASDPM_MaxMinI0dqDrtVect[1] AFTASDPM_MaxMinI0dqDrtVect[2] AFTASDPM_MaxMinI0dqDrtVect[3] AFTASDPM_MaxMinI0dqDrtVect[4] AFTASDPM_MaxMinI0dqDrtVect[5] AFTASDPM_MaxMinSpdDrtVect AFTASDPM_MaxMinSpdDrtVect[0] AFTASDPM_MaxMinSpdDrtVect[1] AFTASDPM_MaxMinTorqueDrtVect AFTASDPM_MaxMinTorqueDrtVect[0] AFTASDPM_MaxMinTorqueDrtVect[1] AFTASDPM_MaxTorqueDerating AFTASDPM_MinTorqueDerating AFTASETP_EstPmDrtGain AFTASETP_IntegralPmDrtGainZ AFTASETP_PmDrtGain AFTASETP_PmMaxTemp AFTASETP_PmResetZ AFTASMTP_IntegralWndg1DrtGainZ AFTASMTP_IntegralWndg2DrtGainZ AFTASMTP_Wndg1ResetZ AFTASMTP_Wndg1Temp AFTASMTP_Wndg2DeratingActDetn AFTASMTP_Wndg2ResetZ AFTASMTP_Wndg2Temp AFTASMTP_WndgDrtGain AFTASOSP_MotorSpeedDrtGainMax AFTASOSP_MotorSpeedDrtGainMin AFTCIVDC_1ByUbatHV AFTCIVDC_CompDutyUZ AFTCIVDC_CompDutyVZ AFTCIVDC_CompDutyWZ AFTCIVDC_CurrDeltaThetaRd AFTCIVDC_DeadCompEnRelayZ AFTCIVDC_DeadCompNumberZ AFTCIVDC_DeadZnEnaFlg AFTCIVDC_DutyCycle3[0] AFTCIVDC_DutyCycle3[1] AFTCIVDC_DutyCycle3[2] AFTCIVDC_DutyCycleMinMax[0] AFTCIVDC_DutyCycleMinMax[1] AFTCIVDC_DutyCycleOrg3[0] AFTCIVDC_DutyCycleOrg3[1] AFTCIVDC_DutyCycleOrg3[2] AFTCIVDC_IdFildZ AFTCIVDC_IqFildZ AFTCIVDC_Iuvw3Z[0] AFTCIVDC_Iuvw3Z[1] AFTCIVDC_Iuvw3Z[2] AFTCIVDC_MecaSpeedRpmFild AFTCIVDC_MecaSpeedRpmZ AFTCIVDC_PwmFrequence AFTCIVDC_PwmFrequenceZ AFTCIVDC_PwmOnOff3[0] AFTCIVDC_PwmOnOff3[1] AFTCIVDC_PwmOnOff3[2] AFTCIVDC_SimpleUVW3[0] AFTCIVDC_SimpleUVW3[1] AFTCIVDC_SimpleUVW3[2] AFTCIVDC_UbatHV AFTCIVDC_UM0zeroTgt AFTCIVDC_UM1AlphaTgt AFTCIVDC_UM1BetaTgt AFTCMCCS_EM1dOpenLoopEst AFTCMCCS_EM1qOpenLoopEst AFTCMCCS_EpsilonM0Ctrl AFTCMCCS_EpsilonM1dCtrl AFTCMCCS_EpsilonM1qCtrl AFTCMCCS_HFIPeriodCntZ AFTCMCCS_HFIPeriodThetaRd AFTCMCCS_HFIPeriodThetaRdZ AFTCMCCS_HFIUdInject AFTCMCCS_HFIUdInjectBasicSinCos[0] AFTCMCCS_HFIUdInjectBasicSinCos[1] AFTCMCCS_HFIVinj AFTCMCCS_iM1dTgtFild AFTCMCCS_iM1dTgtFildZ AFTCMCCS_iM1qTgtFild AFTCMCCS_iM1qTgtFildZ AFTCMCCS_Lm1d AFTCMCCS_Lm1q AFTCMCCS_LutOutiM1dTgtFildTr AFTCMCCS_LutOutiM1qTgtFildTr AFTCMCCS_LutOutM1dCtrlTr AFTCMCCS_LutOutM1qCtrlTr AFTCMCCS_M0CtrlIntegratorZ AFTCMCCS_M0CtrlKi AFTCMCCS_M0CtrlKp AFTCMCCS_M0CtrlTgt AFTCMCCS_M1dCtrlIntegratorZ AFTCMCCS_M1dCtrlKi AFTCMCCS_M1dCtrlKp AFTCMCCS_M1dCtrlTgt AFTCMCCS_M1dCtrlTr AFTCMCCS_M1qCtrlIntegratorZ AFTCMCCS_M1qCtrlKi AFTCMCCS_M1qCtrlKp AFTCMCCS_M1qCtrlTgt AFTCMCCS_M1qCtrlTr AFTCMCCS_Phim AFTCMCCS_Rs AFTCMCCS_SampleTime3ST AFTCMCCS_SampleTimeF32 AFTCMCCS_TotalI0dqTgt3[0] AFTCMCCS_TotalI0dqTgt3[1] AFTCMCCS_TotalI0dqTgt3[2] AFTCMCCS_TransEmfM1d AFTCMCCS_TransEmfM1q AFTCMCCS_TransUd AFTCMCCS_TransUq AFTCMCCS_U0dqTgt3[0] AFTCMCCS_U0dqTgt3[1] AFTCMCCS_U0dqTgt3[2] AFTCMCCS_UM1dTgt AFTCMCCS_UM1qTgt AFTCMRPC_HFIEstI0dq3[0] AFTCMRPC_HFIEstI0dq3[1] AFTCMRPC_HFIEstI0dq3[2] AFTCMRPC_HFIIdsi AFTCMRPC_HFIIdsi_m AFTCMRPC_HFIIdsi_mAbs AFTCMRPC_HFIIqsi AFTCMRPC_HFIIqsi_m AFTCMRPC_HFIIqsi_mAbs AFTCMRPC_HFIK AFTCMRPC_HFIPLLIntSpdRds AFTCMRPC_HFIPLLIntSpdRdsSurTZ AFTCMRPC_HFIPLLSpdRdsFild AFTCMRPC_HFIPLLSpdRdsFildZ AFTCMRPC_HFIPLLThetaOriginal AFTCMRPC_HFIPLLThetaOriginalZ AFTCMRPC_HFIPLLThetaRd AFTCMRPC_HFIPLLThetaSinCos[0] AFTCMRPC_HFIPLLThetaSinCos[1] AFTCMRPC_HFIPLLThetaSinCosZ[0] AFTCMRPC_HFIPLLThetaSinCosZ[1] AFTCMRPC_HFISecondHarmonic AFTCMRPC_HFISecondHarmonicFbd AFTCMRPC_HFISecondHarmonicFbdZ AFTCMRPC_HFISecondHarmonicSurTZ AFTCMRPC_HFISecondHarmonicZZ AFTCMRPC_HFISHThetaSinCos[0] AFTCMRPC_HFISHThetaSinCos[1] AFTCMRPC_HFIThetaErr AFTCMRPC_I0AlphaBeta[0] AFTCMRPC_I0AlphaBeta[1] AFTCMRPC_I0AlphaBeta[2] AFTCMRPC_I0dq3[0] AFTCMRPC_I0dq3[1] AFTCMRPC_I0dq3[2] AFTCMRPC_IdZ AFTCMRPC_IdZZ AFTCMRPC_IqZ AFTCMRPC_IqZZ AFTCMSCS_ActState AFTCMSCS_ClimbOverCnt AFTCMSCS_ClimbOverSpeedRpm AFTCMSCS_ClimbSpeedRpmUpStep AFTCMSCS_ClimbStartAutoSatErrZ AFTCMSCS_ClimbStartAutoSatZ AFTCMSCS_ClimbStartEmfD AFTCMSCS_ClimbStartIntegratorZ AFTCMSCS_ClimbStartOverFlg AFTCMSCS_ClimbStartPm AFTCMSCS_ClimbStartPmDiffFild AFTCMSCS_ClimbStartPmDiffFildZ AFTCMSCS_ClimbStartPmZ AFTCMSCS_ClimbStartPq AFTCMSCS_ClimbStIFAdaptGainZ AFTCMSCS_CloseRunFailCnt AFTCMSCS_CloseRunFailFlg AFTCMSCS_CloseRunFailNumber AFTCMSCS_CtrlIntegratorZ AFTCMSCS_CtrlTgt AFTCMSCS_CtrlTgtZ AFTCMSCS_DampingSpeedRpmErr AFTCMSCS_Dece2ZeroCnt AFTCMSCS_EleSpeedRdsTgt AFTCMSCS_EpsilonCtrl AFTCMSCS_HFI2OBSCnt AFTCMSCS_HFI2OBSElecSpdRdsMax AFTCMSCS_HFI2OBSElecSpdRdsMin AFTCMSCS_HFI2OBSOverFlg AFTCMSCS_HFICloseCnt AFTCMSCS_HFICloseFailFlg AFTCMSCS_HFICloseFailNum AFTCMSCS_HFICloseOverFlg AFTCMSCS_HFIElecThetaRdZ AFTCMSCS_HFIEnable AFTCMSCS_HFIENSEnable AFTCMSCS_HFINSAddTheta AFTCMSCS_IdTgt AFTCMSCS_IdTgtFildZ AFTCMSCS_IdTgtPre AFTCMSCS_IqTgtFildZ AFTCMSCS_IqTgtPre AFTCMSCS_MecaSpeedRpmTgtZ AFTCMSCS_NormalStopFlg AFTCMSCS_ObsState AFTCMSCS_ObsStatePre AFTCMSCS_OpenAngleState AFTCMSCS_OpenAngleStatePre AFTCMSCS_OpenEleSpeedRds AFTCMSCS_OpenMecaSpeedRpm AFTCMSCS_OpenMecaSpeedRpmPre AFTCMSCS_OpenTorqueTgtZ AFTCMSCS_OverSpeedCnt AFTCMSCS_OverSpeedFlg AFTCMSCS_PrePositionDCnt AFTCMSCS_PrePositionOverFlg AFTCMSCS_PrePositionQCnt AFTCMSCS_ShiftDirectFlg AFTCMSCS_ShiftIdIncreaseCnt AFTCMSCS_ShiftIqDecreaseCnt AFTCMSCS_ShiftRunGain AFTCMSCS_SpeedDiffCntZ AFTCMSCS_SpeedFilterZ AFTCMSCS_SpeedModeTrqSatZ AFTCMSCS_StartFailCnt AFTCMSCS_StartFailFlg AFTCMSCS_StartFailNumber AFTCMSCS_StopFailFlg AFTCMSCS_StopRunCnt AFTCMSCS_TorqueTgt AFTCMSCS_UdTgtReserve AFTCMSTC_RateLimiterOutZ AFTCMSTC_SpeedRpmTgtFiltered AFTCMTCS_1ByUbatHV AFTCMTCS_CurrentControllerSat AFTCMTCS_DelVol AFTCMTCS_ElecTorqueMaxMin[0] AFTCMTCS_ElecTorqueMaxMin[1] AFTCMTCS_ElecTorqueTgt AFTCMTCS_FluxControllerTgt AFTCMTCS_FluxControllerTgtZ AFTCMTCS_i0dqTgt3[0] AFTCMTCS_i0dqTgt3[1] AFTCMTCS_i0dqTgt3[2] AFTCMTCS_idCorTgt AFTCMTCS_idCorTgtZ AFTCMTCS_idLutTgt AFTCMTCS_idLutTgtZ AFTCMTCS_iqLutTgt AFTCMTCS_ParkVoltageTgt AFTCMTCS_PhaseVoltagePeakTgt AFTCMTCS_TorqueLimActivation AFTCMTCS_TorqueVolim AFTCMTCS_UdqNorm AFTCMTCS_VoltageMargin AFTCMTCS_VoltageMarginCorZ AFTCMTTC_ElecTorqueTgtFild AFTCMTTC_ElecTorqueTgtFildZ AFTCMTTC_ElecTorqueTgtTotal AFTCMTTC_ElecTorqueTgtZ AFTCMTTC_MecaTorqueMax AFTCMTTC_MecaTorqueMin AFTCMTTC_MecaTorqueTgt AFTDDLMP_MaxMinI0dqLimitVect AFTDDLMP_MaxMinI0dqLimitVect[0] AFTDDLMP_MaxMinI0dqLimitVect[1] AFTDDLMP_MaxMinI0dqLimitVect[2] AFTDDLMP_MaxMinI0dqLimitVect[3] AFTDDLMP_MaxMinI0dqLimitVect[4] AFTDDLMP_MaxMinI0dqLimitVect[5] AFTDDLMP_MaxMinSpdLimitVect AFTDDLMP_MaxMinSpdLimitVect[0] AFTDDLMP_MaxMinSpdLimitVect[1] AFTDDLMP_MaxMinTorqueLimitVect AFTDDLMP_MaxMinTorqueLimitVect[0] AFTDDLMP_MaxMinTorqueLimitVect[1] AFTMTLCS_1ByAccumulator AFTMTLCS_A2DOffsetIsuL AFTMTLCS_A2DOffsetIsvL AFTMTLCS_A2DOffsetIswL AFTMTLCS_A2DOffsetSumIsuLZ AFTMTLCS_A2DOffsetSumIsvLZ AFTMTLCS_A2DOffsetSumIswLZ AFTMTLCS_A2DResCorrd_IsuL AFTMTLCS_A2DResCorrd_IsvL AFTMTLCS_A2DResCorrd_IswL AFTMTLCS_ContorOverLoadCntZ AFTMTLCS_CurrentSumError AFTMTLCS_ElecSpeedRdsFildZ AFTMTLCS_Iu AFTMTLCS_Iu_Rms AFTMTLCS_Iu_RmsSum AFTMTLCS_IuInput AFTMTLCS_Iuvw3[0] AFTMTLCS_Iuvw3[1] AFTMTLCS_Iuvw3[2] AFTMTLCS_Iuvw3_Rms[0] AFTMTLCS_Iuvw3_Rms[1] AFTMTLCS_Iuvw3_Rms[2] AFTMTLCS_Iuvw3RmsSum[0] AFTMTLCS_Iuvw3RmsSum[1] AFTMTLCS_Iuvw3RmsSum[2] AFTMTLCS_IuvwGain3[0] AFTMTLCS_IuvwGain3[1] AFTMTLCS_IuvwGain3[2] AFTMTLCS_Iv AFTMTLCS_Iv_Rms AFTMTLCS_Iv_RmsSum AFTMTLCS_IvInput AFTMTLCS_Iw AFTMTLCS_Iw_Rms AFTMTLCS_Iw_RmsSum AFTMTLCS_IwInput AFTMTLCS_LostPhaseError AFTMTLCS_MotorOverLoadCntZ AFTMTLCS_OffsetCompOK AFTMTLCS_RmsNumberZ AFTMTLCS_RmsSumIuZ AFTMTLCS_RmsSumIvZ AFTMTLCS_RmsSumIwZ AFTMTLCS_SampleNumberZ AFTMTLCS_Scaled_Isu AFTMTLCS_Scaled_Isv AFTMTLCS_Scaled_Isw AFTMTLCS_TrimIsuvw[0] AFTMTLCS_TrimIsuvw[1] AFTMTLCS_TrimIsuvw[2] AFTMTSEP_ElecSpeedRds AFTMTSEP_ElecSpeedRpm AFTMTSEP_MecaSpeedRds AFTMTSEP_MecaSpeedRpm AFTMTSEP_NextThetaElecRd AFTMTSEP_SinCosNextThetaElec[0] AFTMTSEP_SinCosNextThetaElec[1] AFTMTSEP_SinCosThetaElec[0] AFTMTSEP_SinCosThetaElec[1] AFTMTSEP_ThetaElecRd AFTSLOBS_ActEleSpeedRdsFild AFTSLOBS_ActEleThetaRd AFTSLOBS_aDeltaThetaElec AFTSLOBS_aElecSpeedRds AFTSLOBS_aNorPiDeltaThetaElec AFTSLOBS_aRawThetaElec AFTSLOBS_aThetaElecRd AFTSLOBS_aThetaElecZ AFTSLOBS_CloseLoopCheckFlg AFTSLOBS_CloseLoopCheckFlgZ AFTSLOBS_DeltaUdFild AFTSLOBS_DeltaUdFildZ AFTSLOBS_ElecSpeedRdsZ AFTSLOBS_ElecThetaCloseCntZ AFTSLOBS_EmfSAlphaCorre AFTSLOBS_EmfSalphaZ AFTSLOBS_EmfSBetaCorre AFTSLOBS_EmfSbetaZ AFTSLOBS_ErrThetaElec AFTSLOBS_ErrThetaElecSatZ AFTSLOBS_ErrThetaElecZ AFTSLOBS_EstimateStableUd AFTSLOBS_HFI2OBSRate AFTSLOBS_LowSpdActEleSpdRds AFTSLOBS_LowSpdActEleThetaRd AFTSLOBS_OpenDiffThetaRd AFTSLOBS_OpenThetaRd AFTSLOBS_OpenThetaRdZ AFTSLOBS_pCorElecThetaRd AFTSLOBS_pCorElecThetaRdZ AFTSLOBS_pDeltaThetaElec AFTSLOBS_pEleAcceleration AFTSLOBS_pElecNextThetaRd AFTSLOBS_pElecNextThetaRdZ AFTSLOBS_pElecRdsSurSampleTimeZ AFTSLOBS_pElecSpeedRds AFTSLOBS_pElecSpeedRdsFild AFTSLOBS_pElecSpeedRdsFildZ AFTSLOBS_pElecSpeedRdsFilterZ AFTSLOBS_PsiActive AFTSLOBS_PsiActiveAlpha AFTSLOBS_PsiActiveBeta AFTSLOBS_PsiSAlphaDelta AFTSLOBS_PsiSAlphaErr AFTSLOBS_PsiSAlphaZ AFTSLOBS_PsiSBetaDelta AFTSLOBS_PsiSBetaErr AFTSLOBS_PsiSBetaZ AFTSLOBS_pThetaElecTempRd AFTSLOBS_pThetaTempRdZ AFTSLOBS_Rising2FastCntZ AFTSLOBS_RunFailState AFTSLOBS_RunIsLowCntZ AFTSLOBS_SinCosCorElecThetaZ[0] AFTSLOBS_SinCosCorElecThetaZ[1] AFTSLOBS_SinCosElecTheta[0] AFTSLOBS_SinCosElecTheta[1] AFTSLOBS_SpdErrIqMinCntZ AFTSMACS_AclPreviousState AFTSMACS_AclState AFTSMACS_CmdAftShutDownRes AFTSMACS_CmdAftStartRes AFTSMACS_CmdPwmDirectReq AFTSMACS_CmdPwmOffReq AFTSMACS_ReinitFault AFTSMACS_TestFault AFTSMACS_VsiTimerFreqRatioRef AFTSMMAM_AclState AFTSMMAM_AFTCIVDC_State AFTSMMAM_AFTCMCCS_State AFTSMMAM_AFTCMSCS_State AFTSMMAM_AFTCMTCS_State AFTSMMAM_AftModeReq AFTSMMAM_CMCCS_M0ConOnoff AFTSMMAM_EVEIT_MainEnable AFTSMMAM_MTLCS_State AFTSMMAM_MTMEP_State AFTSMMAM_SMREF_MainEnable FT_AkdAfterAsc_B FT_BhvCheckEna_B FT_CmdFtShutDownReq_B FT_CmdFtStartReq_B FT_CmdPwmDirectRes_B FT_CmdPwmOffRes_B FT_CoolingTemp_F32 FT_DutyCycle3_F32[0] FT_DutyCycle3_F32[1] FT_DutyCycle3_F32[2] FT_ElecSpeedRds_F32 FT_ErrThetaRdSurPi_F32 FT_EXTAntiSlideEnable_B FT_ExtCurrentGain3_U16[0] FT_ExtCurrentGain3_U16[1] FT_ExtCurrentGain3_U16[2] FT_EXTPrechargeFinish_B FT_FaultLevel_U16 FT_FTModeReq_U16 FT_FtRunFlg_U16 FT_HacModeDetn_B FT_I0dqTgt3_F32[0] FT_I0dqTgt3_F32[1] FT_I0dqTgt3_F32[2] FT_Iuvw3_U16[0] FT_Iuvw3_U16[1] FT_Iuvw3_U16[2] FT_Iuvw3Rms_F32[0] FT_Iuvw3Rms_F32[1] FT_Iuvw3Rms_F32[2] FT_MecaSpeedRds_F32 FT_MecaSpeedRpm_F32 FT_MecaSpeedRpmTgt_F32 FT_MotorMagnetTemp_F32 FT_MotorWindingTemp2_F32[0] FT_MotorWindingTemp2_F32[1] FT_PosiCurrentDelay_F32 FT_PowerModuleTemp_F32 FT_PwmZeroMatch_B FT_PwrLmtTqrMax_F32 FT_PwrLmtTqrMin_F32 FT_PwrMaxMinTqr_F32[0] FT_PwrMaxMinTqr_F32[1] FT_RandomNum_U32 FT_ResloverThetaRdSuiPi_F32 FT_ResThetaRdSurPiOc_F32 FT_SinCosNextThetaElec_F32[0] FT_SinCosNextThetaElec_F32[1] FT_SinCosThetaElec_F32[0] FT_SinCosThetaElec_F32[1] FT_SpdInitialValue_F32 FT_TorqueTgt_F32 FT_U0dqTgt3_F32[0] FT_U0dqTgt3_F32[1] FT_U0dqTgt3_F32[2] FT_UbatHV_F32 FT_VcuDampEnable_B FT_VsiPwmPeriod_F32 FT_VsiPwmRatioRes_U8 FTASBDS_BattVoltDrtGainMax FTASBDS_BattVoltDrtGainMin FTASDPM_DeratingStatus FTASDPM_DrtGainMax FTASDPM_DrtGainMaxMin[0] FTASDPM_DrtGainMaxMin[1] FTASDPM_DrtGainMin FTASDPM_MaxMinI0dqDrtVect FTASDPM_MaxMinI0dqDrtVect[0] FTASDPM_MaxMinI0dqDrtVect[1] FTASDPM_MaxMinI0dqDrtVect[2] FTASDPM_MaxMinI0dqDrtVect[3] FTASDPM_MaxMinI0dqDrtVect[4] FTASDPM_MaxMinI0dqDrtVect[5] FTASDPM_MaxMinSpdDrtVect FTASDPM_MaxMinSpdDrtVect[0] FTASDPM_MaxMinSpdDrtVect[1] FTASDPM_MaxMinTorqueDrtVect FTASDPM_MaxMinTorqueDrtVect[0] FTASDPM_MaxMinTorqueDrtVect[1] FTASDPM_MaxTorqueDerating FTASDPM_MinTorqueDerating FTASETP_EstPmDeratingAct FTASETP_EstPmDrtGain FTASETP_EstPmMaxTemp FTASETP_EstPmResetZ FTASETP_IntegralEstPmDrtGainZ FTASETP_IntegralPmDrtGainZ FTASETP_OpenLoopEstPmDrtGain FTASETP_PmDeratingAct FTASETP_PmDrtGain FTASETP_PmMaxTemp FTASETP_PmResetZ FTASMTP_IntegralWndg1DrtGainZ FTASMTP_IntegralWndg2DrtGainZ FTASMTP_Wndg1ResetZ FTASMTP_Wndg1Temp FTASMTP_Wndg2DeratingActDetn FTASMTP_Wndg2ResetZ FTASMTP_Wndg2Temp FTASMTP_WndgDrtGain FTASOSP_MotorSpeedDrtGainMax FTASOSP_MotorSpeedDrtGainMin FTCIVDC_1ByUbatHV FTCIVDC_AntiNarrowPulseMaxDuty FTCIVDC_CntTimeZ FTCIVDC_CompDutyU FTCIVDC_CompDutyUZ FTCIVDC_CompDutyV FTCIVDC_CompDutyVZ FTCIVDC_CompDutyW FTCIVDC_CompDutyWZ FTCIVDC_CurrDeltaThetaRd FTCIVDC_DeadCompEnRelayZ FTCIVDC_DeadCompNumberZ FTCIVDC_DeadTimeUGain FTCIVDC_DeadTimeVGain FTCIVDC_DeadTimeWGain FTCIVDC_DeadZnCompSpdEnZ FTCIVDC_DeadZnEnaFlg FTCIVDC_DutyCycle3[0] FTCIVDC_DutyCycle3[1] FTCIVDC_DutyCycle3[2] FTCIVDC_DutyCycleMinMax[0] FTCIVDC_DutyCycleMinMax[1] FTCIVDC_DutyCycleOrg3[0] FTCIVDC_DutyCycleOrg3[1] FTCIVDC_DutyCycleOrg3[2] FTCIVDC_DutyCycleTemp3[0] FTCIVDC_DutyCycleTemp3[1] FTCIVDC_DutyCycleTemp3[2] FTCIVDC_DutyCycleTempANP3[0] FTCIVDC_DutyCycleTempANP3[1] FTCIVDC_DutyCycleTempANP3[2] FTCIVDC_EitEstPwmFrequence FTCIVDC_IdFildZ FTCIVDC_IqFildZ FTCIVDC_Iuvw3Z[0] FTCIVDC_Iuvw3Z[1] FTCIVDC_Iuvw3Z[2] FTCIVDC_LutOutFreq FTCIVDC_MecaSpeedRpmFild FTCIVDC_MecaSpeedRpmZ FTCIVDC_PhaseCurrentAngle FTCIVDC_PwmFrequence FTCIVDC_PwmFrequenceZ FTCIVDC_PwmOnOff3[0] FTCIVDC_PwmOnOff3[1] FTCIVDC_PwmOnOff3[2] FTCIVDC_RandFreq FTCIVDC_RandNumScal FTCIVDC_RandomNum FTCIVDC_SimpleUVW3[0] FTCIVDC_SimpleUVW3[1] FTCIVDC_SimpleUVW3[2] FTCIVDC_TimeEnableZ FTCIVDC_UbatHV FTCIVDC_UM0zeroTgt FTCIVDC_UM1AlphaTgt FTCIVDC_UM1BetaTgt FTCMCCS_AAfilterVar1Z FTCMCCS_AAfilterVar2Z FTCMCCS_AAfilterVar3Z FTCMCCS_AAfilterVar4Z FTCMCCS_AAfilterVar5Z FTCMCCS_EM1dOpenLoopEst FTCMCCS_EM1qOpenLoopEst FTCMCCS_EpsilonM0Ctrl FTCMCCS_EpsilonM1dCtrl FTCMCCS_EpsilonM1qCtrl FTCMCCS_iM1dTgtFild FTCMCCS_iM1dTgtFildTr FTCMCCS_iM1dTgtFildZ FTCMCCS_iM1qTgtFild FTCMCCS_iM1qTgtFildTr FTCMCCS_iM1qTgtFildZ FTCMCCS_Lm1d FTCMCCS_Lm1dOut FTCMCCS_Lm1q FTCMCCS_Lm1qOut FTCMCCS_LutOutiM1dTgtFildTr FTCMCCS_LutOutiM1qTgtFildTr FTCMCCS_LutOutM1dCtrlTr FTCMCCS_LutOutM1qCtrlTr FTCMCCS_M0CtrlIntegratorZ FTCMCCS_M0CtrlKi FTCMCCS_M0CtrlKp FTCMCCS_M0CtrlTgt FTCMCCS_M1dCtrlIntegratorZ FTCMCCS_M1dCtrlKi FTCMCCS_M1dCtrlKp FTCMCCS_M1dCtrlTgt FTCMCCS_M1dCtrlTr FTCMCCS_M1dObsIntegratorZ FTCMCCS_M1qCtrlIntegratorZ FTCMCCS_M1qCtrlKi FTCMCCS_M1qCtrlKp FTCMCCS_M1qCtrlTgt FTCMCCS_M1qCtrlTr FTCMCCS_Phim FTCMCCS_PhimOut FTCMCCS_Rs FTCMCCS_RsiM1dEstZ FTCMCCS_RsOut FTCMCCS_SampleTime3ST FTCMCCS_SampleTimeF32 FTCMCCS_TotalI0dqTgt3[0] FTCMCCS_TotalI0dqTgt3[1] FTCMCCS_TotalI0dqTgt3[2] FTCMCCS_TransEmfM1d FTCMCCS_TransEmfM1q FTCMCCS_TransUd FTCMCCS_TransUq FTCMCCS_U0dqTgt3[0] FTCMCCS_U0dqTgt3[1] FTCMCCS_U0dqTgt3[2] FTCMCCS_UdqNorm FTCMCCS_UM1dTgt FTCMCCS_UM1qTgt FTCMCTC_CoggingComp FTCMCTC_H3CurrentTgt FTCMCTC_I0dqTgt3[0] FTCMCTC_I0dqTgt3[1] FTCMCTC_I0dqTgt3[2] FTCMCTC_iM0Tgt FTCMCTC_iMdTgt FTCMCTC_iMqTgt FTCMCTC_Sin3NextThetaElec FTCMCTC_Sin6NextThetaElec FTCMHIJ_11NextTheta FTCMHIJ_11th_Den0 FTCMHIJ_11th_Den1 FTCMHIJ_11th_Den2 FTCMHIJ_11th_Num0 FTCMHIJ_11theta FTCMHIJ_11thIdFilt FTCMHIJ_11thIdLpfXn1Z FTCMHIJ_11thIdLpfXn2Z FTCMHIJ_11thIdLpfYn1Z FTCMHIJ_11thIdLpfYn2Z FTCMHIJ_11thIdOrg FTCMHIJ_11thIdPiZ FTCMHIJ_11thIdRef FTCMHIJ_11thIdTgt FTCMHIJ_11thIdTgtLpfZ FTCMHIJ_11thIqFilt FTCMHIJ_11thIqLpfXn1Z FTCMHIJ_11thIqLpfXn2Z FTCMHIJ_11thIqLpfYn1Z FTCMHIJ_11thIqLpfYn2Z FTCMHIJ_11thIqOrg FTCMHIJ_11thIqPiZ FTCMHIJ_11thIqRef FTCMHIJ_11thIqTgt FTCMHIJ_11thIqTgtLpfZ FTCMHIJ_11thUdorg FTCMHIJ_11thUdSum FTCMHIJ_11thUdSumRaw FTCMHIJ_11thUqorg FTCMHIJ_11thUqSum FTCMHIJ_11thUqSumRaw FTCMHIJ_11thUsLimitCoff FTCMHIJ_13NextTheta FTCMHIJ_13theta FTCMHIJ_13thIdFilt FTCMHIJ_13thIdLpfXn1Z FTCMHIJ_13thIdLpfXn2Z FTCMHIJ_13thIdLpfYn1Z FTCMHIJ_13thIdLpfYn2Z FTCMHIJ_13thIdPiZ FTCMHIJ_13thIdRef FTCMHIJ_13thIdTgt FTCMHIJ_13thIdTgtLpfZ FTCMHIJ_13thIqFilt FTCMHIJ_13thIqLpfXn1Z FTCMHIJ_13thIqLpfXn2Z FTCMHIJ_13thIqLpfYn1Z FTCMHIJ_13thIqLpfYn2Z FTCMHIJ_13thIqPiZ FTCMHIJ_13thIqRef FTCMHIJ_13thIqTgt FTCMHIJ_13thIqTgtLpfZ FTCMHIJ_13thUdSum FTCMHIJ_13thUdSumRaw FTCMHIJ_13thUqSum FTCMHIJ_13thUqSumRaw FTCMHIJ_13thUsLimitCoff FTCMHIJ_3rd_Den0 FTCMHIJ_3rd_Den1 FTCMHIJ_3rd_Den2 FTCMHIJ_3rd_Num0 FTCMHIJ_5NextTheta FTCMHIJ_5th_Den0 FTCMHIJ_5th_Den1 FTCMHIJ_5th_Den2 FTCMHIJ_5th_Num0 FTCMHIJ_5theta FTCMHIJ_5thIdFilt FTCMHIJ_5thIdLpfXn1Z FTCMHIJ_5thIdLpfXn2Z FTCMHIJ_5thIdLpfYn1Z FTCMHIJ_5thIdLpfYn2Z FTCMHIJ_5thIdOrg FTCMHIJ_5thIdPiZ FTCMHIJ_5thIdRef FTCMHIJ_5thIdTgt FTCMHIJ_5thIdTgtLpfZ FTCMHIJ_5thIqFilt FTCMHIJ_5thIqLpfXn1Z FTCMHIJ_5thIqLpfXn2Z FTCMHIJ_5thIqLpfYn1Z FTCMHIJ_5thIqLpfYn2Z FTCMHIJ_5thIqOrg FTCMHIJ_5thIqPiZ FTCMHIJ_5thIqRef FTCMHIJ_5thIqTgt FTCMHIJ_5thIqTgtLpfZ FTCMHIJ_5thKi FTCMHIJ_5thKp FTCMHIJ_5thUdorg FTCMHIJ_5thUdSum FTCMHIJ_5thUdSumRaw FTCMHIJ_5thUqorg FTCMHIJ_5thUqSum FTCMHIJ_5thUqSumRaw FTCMHIJ_5thUsLimitCoff FTCMHIJ_7NextTheta FTCMHIJ_7th_Den0 FTCMHIJ_7th_Den1 FTCMHIJ_7th_Den2 FTCMHIJ_7th_Num0 FTCMHIJ_7theta FTCMHIJ_7thIdFilt FTCMHIJ_7thIdLpfXn1Z FTCMHIJ_7thIdLpfXn2Z FTCMHIJ_7thIdLpfYn1Z FTCMHIJ_7thIdLpfYn2Z FTCMHIJ_7thIdOrg FTCMHIJ_7thIdPiZ FTCMHIJ_7thIdRef FTCMHIJ_7thIdTgt FTCMHIJ_7thIdTgtLpfZ FTCMHIJ_7thIqFilt FTCMHIJ_7thIqLpfXn1Z FTCMHIJ_7thIqLpfXn2Z FTCMHIJ_7thIqLpfYn1Z FTCMHIJ_7thIqLpfYn2Z FTCMHIJ_7thIqOrg FTCMHIJ_7thIqPiZ FTCMHIJ_7thIqRef FTCMHIJ_7thIqTgt FTCMHIJ_7thIqTgtLpfZ FTCMHIJ_7thUdorg FTCMHIJ_7thUdSum FTCMHIJ_7thUdSumRaw FTCMHIJ_7thUqorg FTCMHIJ_7thUqSum FTCMHIJ_7thUqSumRaw FTCMHIJ_7thUsLimitCoff FTCMHIJ_b11thUsSatFlgZ FTCMHIJ_b13thUsSatFlgZ FTCMHIJ_b5thUsSatFlgZ FTCMHIJ_b7thUsSatFlgZ FTCMHIJ_bExtUsSatFlg FTCMHIJ_bExtUsSatFlgZ FTCMHIJ_FinalUalpha FTCMHIJ_FinalUbeta FTCMHIJ_UalphaBeta[0] FTCMHIJ_UalphaBeta[1] FTCMRPC_I0AlphaBeta[0] FTCMRPC_I0AlphaBeta[1] FTCMRPC_I0AlphaBeta[2] FTCMRPC_I0dq3[0] FTCMRPC_I0dq3[1] FTCMRPC_I0dq3[2] FTCMSCS_CtrlIntegratorZ FTCMSCS_CtrlKi FTCMSCS_CtrlKp FTCMSCS_CtrlSatCntZ FTCMSCS_CtrlSatTimoutDetn FTCMSCS_CtrlTgt FTCMSCS_DeltaSpeedRpmZ FTCMSCS_EpsilonCtrl FTCMSCS_fOmegaEstZ FTCMSCS_ObsIntegratorZ FTCMSCS_SpdOverShootCntZ FTCMSCS_SpeedModelTrqSatZ FTCMSCS_TorqueTestCountZ FTCMSCS_TorqueTgt FTCMSCS_ZeroSpeedCntZ FTCMSTC_RateLimiterOutZ FTCMSTC_SpeedRpmTgtFiltered FTCMTCS_AntiSlideEnaCountOutZ FTCMTCS_AntiSlideInhibOutZ FTCMTCS_AntiSlideTorqueThr FTCMTCS_bFastSlipFlg FTCMTCS_bGenSlideFlg FTCMTCS_CurrentControllerSat FTCMTCS_DelVol FTCMTCS_ElecTorqueGenMax FTCMTCS_ElecTorqueMaxMin[0] FTCMTCS_ElecTorqueMaxMin[1] FTCMTCS_ElecTorqueMotMax FTCMTCS_ElecTorqueTgt FTCMTCS_EntrySlideCountOutZ FTCMTCS_EntrySlideFlag FTCMTCS_FastSlipDelayZ FTCMTCS_FluxControllerTgt FTCMTCS_FluxControllerTgtZ FTCMTCS_i0dqTgt3[0] FTCMTCS_i0dqTgt3[1] FTCMTCS_i0dqTgt3[2] FTCMTCS_idCorActDiffZ FTCMTCS_idCorTgt FTCMTCS_idCorTgtZ FTCMTCS_idLutAddTgt FTCMTCS_idLutTgt FTCMTCS_idLutTgtZ FTCMTCS_IdqTgtAddRatio FTCMTCS_IdTgtAdd FTCMTCS_IdTgtAdd0 FTCMTCS_iqLutAddTgt FTCMTCS_iqLutTgt FTCMTCS_IqTgtAdd FTCMTCS_MecaSpeedDiff FTCMTCS_MecaSpeedOutZ FTCMTCS_ParkVoltageTgt FTCMTCS_PhaseVoltagePeakTgt FTCMTCS_SlideDelayFildZ FTCMTCS_SpdRpmDelayFildZ FTCMTCS_TorqueGain FTCMTCS_TorqueGainFild FTCMTCS_TorqueGainOutZ FTCMTCS_TorqueLimActivation FTCMTCS_TorqueSlideTgt FTCMTCS_TorqueVolim FTCMTCS_VoltageMargin FTCMTCS_VoltageMarginCorZ FTCMTTC_AfterPreTorqueTgt FTCMTTC_AntiJerkBaseGain FTCMTTC_AntiJerkMecaTorqueTgt FTCMTTC_AntiJerkTrqTgt FTCMTTC_AntiJerkTrqTgtHpZ FTCMTTC_AntiJerkTrqTgtZ FTCMTTC_AtjkBpAccTorqueTgt FTCMTTC_AtjkDeltaTorqueTgt FTCMTTC_bGenFlg FTCMTTC_bNvh16EnFlg FTCMTTC_bNvh48EnFlg FTCMTTC_BpLowCutOffFrequency FTCMTTC_DampingActive FTCMTTC_DampingSpdHighDetnZ FTCMTTC_DampTorqueCompTgt FTCMTTC_DeltaSpeedRpm FTCMTTC_ElecTorqueTgt FTCMTTC_ElecTorqueTgtCor FTCMTTC_ElecTorqueTgtFild FTCMTTC_ElecTorqueTgtFildZ FTCMTTC_ElecTorqueTgtTotal FTCMTTC_ElecTorqueTgtZ FTCMTTC_FastSlipFlg FTCMTTC_HijEnGainFild FTCMTTC_HijEnGainFildZ FTCMTTC_MecaSpeedAccSlewRate FTCMTTC_MecaSpeedRpmFildZ FTCMTTC_MecaSpeedRpmLpZ FTCMTTC_MecaTorqueMaxMin[0] FTCMTTC_MecaTorqueMaxMin[1] FTCMTTC_MecaTorqueTgt FTCMTTC_MecTrqTgtFild FTCMTTC_MecTrqTgtLpfZ FTCMTTC_PowLmtMinTorqureRaw FTCMTTC_PowLmtTorqureRaw FTCMTTC_PreTorqueFlg FTCMTTC_RealMecaTorqueTgt FTCMTTC_RealMecaTrqTgtRate FTCMTTC_RealSpdRpmZ FTCMTTC_SpdRpmFild FTCMTTC_SpdRpmLpfZ FTCMTTC_TempPreTorqTrasStep FTCMTTC_TorqueHpFilterEnable FTCMTTC_TorqueHpFilterEnableZ FTCMTTC_TrqTrasitionFlg FTCMTTC_TsatActv FTDDLMP_MaxMinI0dqLimitVect FTDDLMP_MaxMinI0dqLimitVect[0] FTDDLMP_MaxMinI0dqLimitVect[1] FTDDLMP_MaxMinI0dqLimitVect[2] FTDDLMP_MaxMinI0dqLimitVect[3] FTDDLMP_MaxMinI0dqLimitVect[4] FTDDLMP_MaxMinI0dqLimitVect[5] FTDDLMP_MaxMinSpdLimitVect FTDDLMP_MaxMinSpdLimitVect[0] FTDDLMP_MaxMinSpdLimitVect[1] FTDDLMP_MaxMinTorqueLimitVect FTDDLMP_MaxMinTorqueLimitVect[0] FTDDLMP_MaxMinTorqueLimitVect[1] FTEVEIT_CommutGain FTEVEIT_CommutLossesDH_UL FTEVEIT_CommutLossesDH_VL FTEVEIT_CommutLossesDH_WL FTEVEIT_CommutLossesDL_UL FTEVEIT_CommutLossesDL_VL FTEVEIT_CommutLossesDL_WL FTEVEIT_CommutLossesTH_UL FTEVEIT_CommutLossesTH_VL FTEVEIT_CommutLossesTH_WL FTEVEIT_CommutLossesTL_UL FTEVEIT_CommutLossesTL_VL FTEVEIT_CommutLossesTL_WL FTEVEIT_CondLossesDH_UL FTEVEIT_CondLossesDH_VL FTEVEIT_CondLossesDH_WL FTEVEIT_CondLossesDL_UL FTEVEIT_CondLossesDL_VL FTEVEIT_CondLossesDL_WL FTEVEIT_CondLossesTH_UL FTEVEIT_CondLossesTH_VL FTEVEIT_CondLossesTH_WL FTEVEIT_CondLossesTL_UL FTEVEIT_CondLossesTL_VL FTEVEIT_CondLossesTL_WL FTEVEIT_CurrDH_UL FTEVEIT_CurrDH_VL FTEVEIT_CurrDH_WL FTEVEIT_CurrDL_UL FTEVEIT_CurrDL_VL FTEVEIT_CurrDL_WL FTEVEIT_CurrTH_UL FTEVEIT_CurrTH_VL FTEVEIT_CurrTH_WL FTEVEIT_CurrTL_UL FTEVEIT_CurrTL_VL FTEVEIT_CurrTL_WL FTEVEIT_EnableInit FTEVEIT_EnableKO FTEVEIT_EnableOK FTEVEIT_EstimTempDH_UL FTEVEIT_EstimTempDH_VL FTEVEIT_EstimTempDH_WL FTEVEIT_EstimTempDHVect[0] FTEVEIT_EstimTempDHVect[1] FTEVEIT_EstimTempDHVect[2] FTEVEIT_EstimTempDL_UL FTEVEIT_EstimTempDL_VL FTEVEIT_EstimTempDL_WL FTEVEIT_EstimTempDLVect[0] FTEVEIT_EstimTempDLVect[1] FTEVEIT_EstimTempDLVect[2] FTEVEIT_EstimTempFirstFild FTEVEIT_EstimTempFirstFildZ FTEVEIT_EstimTempSecFild FTEVEIT_EstimTempSecFildZ FTEVEIT_EstimTempTH_UL FTEVEIT_EstimTempTH_VL FTEVEIT_EstimTempTH_WL FTEVEIT_EstimTempTHVect[0] FTEVEIT_EstimTempTHVect[1] FTEVEIT_EstimTempTHVect[2] FTEVEIT_EstimTempTL_UL FTEVEIT_EstimTempTL_VL FTEVEIT_EstimTempTL_WL FTEVEIT_EstimTempTLVect[0] FTEVEIT_EstimTempTLVect[1] FTEVEIT_EstimTempTLVect[2] FTEVEIT_HysteresisZ FTEVEIT_PdhTdh_UL FTEVEIT_PdhTdh_VL FTEVEIT_PdhTdh_WL FTEVEIT_PdhTdhS1_UL FTEVEIT_PdhTdhS1_VL FTEVEIT_PdhTdhS1_WL FTEVEIT_PdhTdhS2_UL FTEVEIT_PdhTdhS2_VL FTEVEIT_PdhTdhS2_WL FTEVEIT_PdhTdhS3_UL FTEVEIT_PdhTdhS3_VL FTEVEIT_PdhTdhS3_WL FTEVEIT_PdhTdhS4_UL FTEVEIT_PdhTdhS4_VL FTEVEIT_PdhTdhS4_WL FTEVEIT_PdhTdhS5_UL FTEVEIT_PdhTdhS5_VL FTEVEIT_PdhTdhS5_WL FTEVEIT_PdhTth_UL FTEVEIT_PdhTth_VL FTEVEIT_PdhTth_WL FTEVEIT_PdlTdl_UL FTEVEIT_PdlTdl_VL FTEVEIT_PdlTdl_WL FTEVEIT_PdlTdlS1_UL FTEVEIT_PdlTdlS1_VL FTEVEIT_PdlTdlS1_WL FTEVEIT_PdlTdlS2_UL FTEVEIT_PdlTdlS2_VL FTEVEIT_PdlTdlS2_WL FTEVEIT_PdlTdlS3_UL FTEVEIT_PdlTdlS3_VL FTEVEIT_PdlTdlS3_WL FTEVEIT_PdlTdlS4_UL FTEVEIT_PdlTdlS4_VL FTEVEIT_PdlTdlS4_WL FTEVEIT_PdlTdlS5_UL FTEVEIT_PdlTdlS5_VL FTEVEIT_PdlTdlS5_WL FTEVEIT_PdlTtl_UL FTEVEIT_PdlTtl_VL FTEVEIT_PdlTtl_WL FTEVEIT_Plosses_UL FTEVEIT_Plosses_VL FTEVEIT_Plosses_WL FTEVEIT_PlossesVect[0] FTEVEIT_PlossesVect[1] FTEVEIT_PlossesVect[2] FTEVEIT_PowerModuleEstTemp FTEVEIT_PthTdh_UL FTEVEIT_PthTdh_VL FTEVEIT_PthTdh_WL FTEVEIT_PthTth_UL FTEVEIT_PthTth_VL FTEVEIT_PthTth_WL FTEVEIT_PthTthS1_UL FTEVEIT_PthTthS1_VL FTEVEIT_PthTthS1_WL FTEVEIT_PthTthS2_UL FTEVEIT_PthTthS2_VL FTEVEIT_PthTthS2_WL FTEVEIT_PthTthS3_UL /end OUT_MEASUREMENT
/end FUNCTION
/end MODULE
/end PROJECT
