ASAP2_VERSION 1 3
/begin PROJECT P_TC375_PLATFORM_0_0 "P_TC375_PLATFORM_0_0"
/begin HEADER "" VERSION "5210.00" PROJECT_NO D0 /end HEADER
/begin MODULE P_TC375_PLATFORM_0_0 "Invt"
/begin MOD_COMMON "" DEPOSIT ABSOLUTE ALIGNMENT_BYTE 1 ALIGNMENT_WORD 2 ALIGNMENT_LONG 4 ALIGNMENT_FLOAT32_IEEE 4 ALIGNMENT_FLOAT64_IEEE 8 BYTE_ORDER MSB_LAST /end MOD_COMMON
/begin RECORD_LAYOUT DATA_RECORD_UBYTE FNC_VALUES 1 UBYTE ROW_DIR DIRECT /end RECORD_LAYOUT
/begin RECORD_LAYOUT DATA_RECORD_UWORD FNC_VALUES 1 UWORD ROW_DIR DIRECT /end RECORD_LAYOUT
/begin RECORD_LAYOUT DATA_RECORD_SWORD FNC_VALUES 1 SWORD ROW_DIR DIRECT /end RECORD_LAYOUT
/begin RECORD_LAYOUT DATA_RECORD_ULONG FNC_VALUES 1 ULONG ROW_DIR DIRECT /end RECORD_LAYOUT
/begin RECORD_LAYOUT DATA_RECORD_FLOAT32_IEEE FNC_VALUES 1 FLOAT32_IEEE ROW_DIR DIRECT /end RECORD_LAYOUT
/begin RECORD_LAYOUT AXIS_PTS_X_UBYTE_VEMS AXIS_PTS_X 1 UBYTE INDEX_INCR DIRECT /end RECORD_LAYOUT
/begin CHARACTERISTIC FRecord_ku32TimeBeforeFaultOccurC "Spare" VALUE 0x80058C18 DATA_RECORD_ULONG 4294967295 F_1_m20000_29 -20000 4294947295 /end CHARACTERISTIC
/begin CHARACTERISTIC FaultFSEVETA_UnderTempNTC1CmdBoardInc "FaultFSEVETA_UnderTempNTC1CmdBoardInc" VALUE 0x800A34D8 DATA_RECORD_UBYTE 255 I_1 0 255 /end CHARACTERISTIC
/begin CHARACTERISTIC FaultFSMTMTA_OverTempWdgHead1Dec "FaultFSMTMTA_OverTempWdgHead1Dec" VALUE 0x800A346D DATA_RECORD_UBYTE 255 I_1 0 255 /end CHARACTERISTIC
/begin CHARACTERISTIC FaultFSMTMTA_OverTempWdgHead1FailMod "FaultFSMTMTA_OverTempWdgHead1FailMod" VALUE 0x800A3545 DATA_RECORD_UBYTE 255 I_1 0 255 /end CHARACTERISTIC
/begin CHARACTERISTIC FaultFSMTMTA_OverTempWdgHead1Inc "FaultFSMTMTA_OverTempWdgHead1Inc" VALUE 0x800A34D9 DATA_RECORD_UBYTE 255 I_1 0 255 /end CHARACTERISTIC
/begin CHARACTERISTIC FaultFSMTMTA_TempWindHead1OutRngHDec "FaultFSMTMTA_TempWindHead1OutRngHDec" VALUE 0x800A346E DATA_RECORD_UBYTE 255 I_1 0 255 /end CHARACTERISTIC
/begin CHARACTERISTIC FaultFSMTMTA_TempWindHead1OutRngHFailMod "FaultFSMTMTA_TempWindHead1OutRngHFailMod" VALUE 0x800A3546 DATA_RECORD_UBYTE 255 I_1 0 255 /end CHARACTERISTIC
/begin CHARACTERISTIC FaultFSMTMTA_TempWindHead1OutRngHInc "FaultFSMTMTA_TempWindHead1OutRngHInc" VALUE 0x800A34DA DATA_RECORD_UBYTE 255 I_1 0 255 /end CHARACTERISTIC
/begin CHARACTERISTIC FaultFSMTMTA_TempWindHead1OutRngLDec "FaultFSMTMTA_TempWindHead1OutRngLDec" VALUE 0x800A346F DATA_RECORD_UBYTE 255 I_1 0 255 /end CHARACTERISTIC
/begin CHARACTERISTIC FaultFSMTMTA_TempWindHead1OutRngLFailMod "FaultFSMTMTA_TempWindHead1OutRngLFailMod" VALUE 0x800A3547 DATA_RECORD_UBYTE 255 I_1 0 255 /end CHARACTERISTIC
/begin CHARACTERISTIC FaultFSMTMTA_TempWindHead1OutRngLInc "FaultFSMTMTA_TempWindHead1OutRngLInc" VALUE 0x800A34DB DATA_RECORD_UBYTE 255 I_1 0 255 /end CHARACTERISTIC
/begin CHARACTERISTIC FaultFSMTMTA_TempWindingHead1GndDec "FaultFSMTMTA_TempWindingHead1GndDec" VALUE 0x800A3470 DATA_RECORD_UBYTE 255 I_1 0 255 /end CHARACTERISTIC
/begin CHARACTERISTIC FaultFSMTMTA_TempWindingHead1GndFailMod "FaultFSMTMTA_TempWindingHead1GndFailMod" VALUE 0x800A3548 DATA_RECORD_UBYTE 255 I_1 0 255 /end CHARACTERISTIC
/begin CHARACTERISTIC FaultFSMTMTA_TempWindingHead1GndInc "FaultFSMTMTA_TempWindingHead1GndInc" VALUE 0x800A34DC DATA_RECORD_UBYTE 255 I_1 0 255 /end CHARACTERISTIC
/begin CHARACTERISTIC FaultFSMTMTA_TempWindingHead1VccDec "FaultFSMTMTA_TempWindingHead1VccDec" VALUE 0x800A3471 DATA_RECORD_UBYTE 255 I_1 0 255 /end CHARACTERISTIC
/begin CHARACTERISTIC FaultFSMTMTA_TempWindingHead1VccFailMod "FaultFSMTMTA_TempWindingHead1VccFailMod" VALUE 0x800A3549 DATA_RECORD_UBYTE 255 I_1 0 255 /end CHARACTERISTIC
/begin CHARACTERISTIC FaultFSMTMTA_TempWindingHead1VccInc "FaultFSMTMTA_TempWindingHead1VccInc" VALUE 0x800A34DD DATA_RECORD_UBYTE 255 I_1 0 255 /end CHARACTERISTIC
/begin CHARACTERISTIC FaultFSMTMTA_UnderTempWdgHead1Dec "FaultFSMTMTA_UnderTempWdgHead1Dec" VALUE 0x800A3472 DATA_RECORD_UBYTE 255 I_1 0 255 /end CHARACTERISTIC
/begin CHARACTERISTIC FaultFSMTMTA_UnderTempWdgHead1FailMod "FaultFSMTMTA_UnderTempWdgHead1FailMod" VALUE 0x800A354A DATA_RECORD_UBYTE 255 I_1 0 255 /end CHARACTERISTIC
/begin CHARACTERISTIC FaultFSMTMTA_UnderTempWdgHead1Inc "FaultFSMTMTA_UnderTempWdgHead1Inc" VALUE 0x800A34DE DATA_RECORD_UBYTE 255 I_1 0 255 /end CHARACTERISTIC
/begin CHARACTERISTIC FaultFSMTRDG_ExcGenerationDec "FaultFSMTRDG_ExcGenerationDec" VALUE 0x800A3473 DATA_RECORD_UBYTE 255 I_1 0 255 /end CHARACTERISTIC
/begin CHARACTERISTIC FaultFSMTRDG_ExcGenerationFailMod "FaultFSMTRDG_ExcGenerationFailMod" VALUE 0x800A354B DATA_RECORD_UBYTE 255 I_1 0 255 /end CHARACTERISTIC
/begin CHARACTERISTIC FaultFSMTRDG_ExcGenerationInc "FaultFSMTRDG_ExcGenerationInc" VALUE 0x800A34DF DATA_RECORD_UBYTE 255 I_1 0 255 /end CHARACTERISTIC
/begin CHARACTERISTIC FaultFSMTRDG_ExcSignalGNDDec "FaultFSMTRDG_ExcSignalGNDDec" VALUE 0x800A3474 DATA_RECORD_UBYTE 255 I_1 0 255 /end CHARACTERISTIC
/begin CHARACTERISTIC FaultFSMTRDG_ExcSignalGNDFailMod "FaultFSMTRDG_ExcSignalGNDFailMod" VALUE 0x800A354C DATA_RECORD_UBYTE 255 I_1 0 255 /end CHARACTERISTIC
/begin CHARACTERISTIC FaultFSMTRDG_ExcSignalGNDInc "FaultFSMTRDG_ExcSignalGNDInc" VALUE 0x800A34E0 DATA_RECORD_UBYTE 255 I_1 0 255 /end CHARACTERISTIC
/begin CHARACTERISTIC FaultFSMTRDG_ExcSignalVCCDec "FaultFSMTRDG_ExcSignalVCCDec" VALUE 0x800A3475 DATA_RECORD_UBYTE 255 I_1 0 255 /end CHARACTERISTIC
/begin CHARACTERISTIC FaultFSMTRDG_ExcSignalVCCFailMod "FaultFSMTRDG_ExcSignalVCCFailMod" VALUE 0x800A354D DATA_RECORD_UBYTE 255 I_1 0 255 /end CHARACTERISTIC
/begin CHARACTERISTIC FaultFSMTRDG_ExcSignalVCCInc "FaultFSMTRDG_ExcSignalVCCInc" VALUE 0x800A34E1 DATA_RECORD_UBYTE 255 I_1 0 255 /end CHARACTERISTIC
/begin CHARACTERISTIC FaultFSMTRDG_SinCosHLGndDec "FaultFSMTRDG_SinCosHLGndDec" VALUE 0x800A3476 DATA_RECORD_UBYTE 255 I_1 0 255 /end CHARACTERISTIC
/begin CHARACTERISTIC FaultFSMTRDG_SinCosHLGndFailMod "FaultFSMTRDG_SinCosHLGndFailMod" VALUE 0x800A354E DATA_RECORD_UBYTE 255 I_1 0 255 /end CHARACTERISTIC
/begin CHARACTERISTIC FaultFSMTRDG_SinCosHLGndInc "FaultFSMTRDG_SinCosHLGndInc" VALUE 0x800A34E2 DATA_RECORD_UBYTE 255 I_1 0 255 /end CHARACTERISTIC
/begin CHARACTERISTIC FaultFSMTRDG_SinCosHLOpenDec "FaultFSMTRDG_SinCosHLOpenDec" VALUE 0x800A3477 DATA_RECORD_UBYTE 255 I_1 0 255 /end CHARACTERISTIC
/begin CHARACTERISTIC FaultFSMTRDG_SinCosHLOpenFailMod "FaultFSMTRDG_SinCosHLOpenFailMod" VALUE 0x800A354F DATA_RECORD_UBYTE 255 I_1 0 255 /end CHARACTERISTIC
/begin CHARACTERISTIC FaultFSMTRDG_SinCosHLOpenInc "FaultFSMTRDG_SinCosHLOpenInc" VALUE 0x800A34E3 DATA_RECORD_UBYTE 255 I_1 0 255 /end CHARACTERISTIC
/begin CHARACTERISTIC FaultFSMTRDG_SinCosHLVccDec "FaultFSMTRDG_SinCosHLVccDec" VALUE 0x800A3478 DATA_RECORD_UBYTE 255 I_1 0 255 /end CHARACTERISTIC
/begin CHARACTERISTIC FaultFSMTRDG_SinCosHLVccFailMod "FaultFSMTRDG_SinCosHLVccFailMod" VALUE 0x800A3550 DATA_RECORD_UBYTE 255 I_1 0 255 /end CHARACTERISTIC
/begin CHARACTERISTIC FaultFSMTRDG_SinCosHLVccInc "FaultFSMTRDG_SinCosHLVccInc" VALUE 0x800A34E4 DATA_RECORD_UBYTE 255 I_1 0 255 /end CHARACTERISTIC
/begin CHARACTERISTIC FaultFSSMACS_AkdFailFlagDec "FaultFSSMACS_AkdFailFlagDec" VALUE 0x800A3479 DATA_RECORD_UBYTE 255 I_1 0 255 /end CHARACTERISTIC
/begin CHARACTERISTIC FaultFSSMACS_AkdFailFlagFailMod "FaultFSSMACS_AkdFailFlagFailMod" VALUE 0x800A3551 DATA_RECORD_UBYTE 255 I_1 0 255 /end CHARACTERISTIC
/begin CHARACTERISTIC FaultFSSMACS_AkdFailFlagInc "FaultFSSMACS_AkdFailFlagInc" VALUE 0x800A34E5 DATA_RECORD_UBYTE 255 I_1 0 255 /end CHARACTERISTIC
/begin CHARACTERISTIC FaultFTASBDS_BattVoltDeratingActDec "FaultFTASBDS_BattVoltDeratingActDec" VALUE 0x800A347A DATA_RECORD_UBYTE 255 I_1 0 255 /end CHARACTERISTIC
/begin CHARACTERISTIC FaultFTASBDS_BattVoltDeratingActFailMod "FaultFTASBDS_BattVoltDeratingActFailMod" VALUE 0x800A3552 DATA_RECORD_UBYTE 255 I_1 0 255 /end CHARACTERISTIC
/begin CHARACTERISTIC FaultFTASBDS_BattVoltDeratingActInc "FaultFTASBDS_BattVoltDeratingActInc" VALUE 0x800A34E6 DATA_RECORD_UBYTE 255 I_1 0 255 /end CHARACTERISTIC
/begin CHARACTERISTIC FaultFTASETP_EstPmDeratingActDec "FaultFTASETP_EstPmDeratingActDec" VALUE 0x800A347B DATA_RECORD_UBYTE 255 I_1 0 255 /end CHARACTERISTIC
/begin CHARACTERISTIC FaultFTASETP_EstPmDeratingActFailMod "FaultFTASETP_EstPmDeratingActFailMod" VALUE 0x800A3553 DATA_RECORD_UBYTE 255 I_1 0 255 /end CHARACTERISTIC
/begin CHARACTERISTIC FaultFTASETP_EstPmDeratingActInc "FaultFTASETP_EstPmDeratingActInc" VALUE 0x800A34E7 DATA_RECORD_UBYTE 255 I_1 0 255 /end CHARACTERISTIC
/begin CHARACTERISTIC FaultFTASETP_PmDeratingActDec "FaultFTASETP_PmDeratingActDec" VALUE 0x800A347C DATA_RECORD_UBYTE 255 I_1 0 255 /end CHARACTERISTIC
/begin CHARACTERISTIC FaultFTASETP_PmDeratingActFailMod "FaultFTASETP_PmDeratingActFailMod" VALUE 0x800A3554 DATA_RECORD_UBYTE 255 I_1 0 255 /end CHARACTERISTIC
/begin CHARACTERISTIC FaultFTASETP_PmDeratingActInc "FaultFTASETP_PmDeratingActInc" VALUE 0x800A34E8 DATA_RECORD_UBYTE 255 I_1 0 255 /end CHARACTERISTIC
/begin CHARACTERISTIC FaultFTASMTP_Wndg1DeratingActDec "FaultFTASMTP_Wndg1DeratingActDec" VALUE 0x800A347D DATA_RECORD_UBYTE 255 I_1 0 255 /end CHARACTERISTIC
/begin CHARACTERISTIC FaultFTASMTP_Wndg1DeratingActFailMod "FaultFTASMTP_Wndg1DeratingActFailMod" VALUE 0x800A3555 DATA_RECORD_UBYTE 255 I_1 0 255 /end CHARACTERISTIC
/begin CHARACTERISTIC FaultFTASMTP_Wndg1DeratingActInc "FaultFTASMTP_Wndg1DeratingActInc" VALUE 0x800A34E9 DATA_RECORD_UBYTE 255 I_1 0 255 /end CHARACTERISTIC
/begin CHARACTERISTIC FaultFTASOSP_MotorSpdDeratingActDec "FaultFTASOSP_MotorSpdDeratingActDec" VALUE 0x800A347E DATA_RECORD_UBYTE 255 I_1 0 255 /end CHARACTERISTIC
/begin CHARACTERISTIC FaultFTASOSP_MotorSpdDeratingActFailMod "FaultFTASOSP_MotorSpdDeratingActFailMod" VALUE 0x800A3556 DATA_RECORD_UBYTE 255 I_1 0 255 /end CHARACTERISTIC
/begin CHARACTERISTIC FaultFTASOSP_MotorSpdDeratingActInc "FaultFTASOSP_MotorSpdDeratingActInc" VALUE 0x800A34EA DATA_RECORD_UBYTE 255 I_1 0 255 /end CHARACTERISTIC
/begin CHARACTERISTIC FaultFTCMSCS_CtrlSatTimoutDec "FaultFTCMSCS_CtrlSatTimoutDec" VALUE 0x800A347F DATA_RECORD_UBYTE 255 I_1 0 255 /end CHARACTERISTIC
/begin CHARACTERISTIC FaultFTCMSCS_CtrlSatTimoutFailMod "FaultFTCMSCS_CtrlSatTimoutFailMod" VALUE 0x800A3557 DATA_RECORD_UBYTE 255 I_1 0 255 /end CHARACTERISTIC
/begin CHARACTERISTIC FaultFTCMSCS_CtrlSatTimoutInc "FaultFTCMSCS_CtrlSatTimoutInc" VALUE 0x800A34EB DATA_RECORD_UBYTE 255 I_1 0 255 /end CHARACTERISTIC
/begin CHARACTERISTIC FaultFTCMSCS_SpdOvershootDec "FaultFTCMSCS_SpdOvershootDec" VALUE 0x800A3480 DATA_RECORD_UBYTE 255 I_1 0 255 /end CHARACTERISTIC
/begin CHARACTERISTIC FaultFTCMSCS_SpdOvershootFailMod "FaultFTCMSCS_SpdOvershootFailMod" VALUE 0x800A3558 DATA_RECORD_UBYTE 255 I_1 0 255 /end CHARACTERISTIC
/begin CHARACTERISTIC FaultFTCMSCS_SpdOvershootInc "FaultFTCMSCS_SpdOvershootInc" VALUE 0x800A34EC DATA_RECORD_UBYTE 255 I_1 0 255 /end CHARACTERISTIC
/begin CHARACTERISTIC FaultFTCMSCS_ZeroSpeedTimoutDec "FaultFTCMSCS_ZeroSpeedTimoutDec" VALUE 0x800A3481 DATA_RECORD_UBYTE 255 I_1 0 255 /end CHARACTERISTIC
/begin CHARACTERISTIC FaultFTCMSCS_ZeroSpeedTimoutFailMod "FaultFTCMSCS_ZeroSpeedTimoutFailMod" VALUE 0x800A3559 DATA_RECORD_UBYTE 255 I_1 0 255 /end CHARACTERISTIC
/begin CHARACTERISTIC FaultFTCMSCS_ZeroSpeedTimoutInc "FaultFTCMSCS_ZeroSpeedTimoutInc" VALUE 0x800A34ED DATA_RECORD_UBYTE 255 I_1 0 255 /end CHARACTERISTIC
/begin CHARACTERISTIC FaultFTCMTCS_VoltageMarginLowDec "FaultFTCMTCS_VoltageMarginLowDec" VALUE 0x800A3482 DATA_RECORD_UBYTE 255 I_1 0 255 /end CHARACTERISTIC
/begin CHARACTERISTIC FaultFTCMTCS_VoltageMarginLowFailMod "FaultFTCMTCS_VoltageMarginLowFailMod" VALUE 0x800A355A DATA_RECORD_UBYTE 255 I_1 0 255 /end CHARACTERISTIC
/begin CHARACTERISTIC FaultFTCMTCS_VoltageMarginLowInc "FaultFTCMTCS_VoltageMarginLowInc" VALUE 0x800A34EE DATA_RECORD_UBYTE 255 I_1 0 255 /end CHARACTERISTIC
/begin CHARACTERISTIC FaultFTEVEIT_EstOverTempDec "FaultFTEVEIT_EstOverTempDec" VALUE 0x800A3483 DATA_RECORD_UBYTE 255 I_1 0 255 /end CHARACTERISTIC
/begin CHARACTERISTIC FaultFTEVEIT_EstOverTempFailMod "FaultFTEVEIT_EstOverTempFailMod" VALUE 0x800A355B DATA_RECORD_UBYTE 255 I_1 0 255 /end CHARACTERISTIC
/begin CHARACTERISTIC FaultFTEVEIT_EstOverTempInc "FaultFTEVEIT_EstOverTempInc" VALUE 0x800A34EF DATA_RECORD_UBYTE 255 I_1 0 255 /end CHARACTERISTIC
/begin CHARACTERISTIC FaultFTMTLCS_CurSenrPhaU_GNDDec "FaultFTMTLCS_CurSenrPhaU_GNDDec" VALUE 0x800A3485 DATA_RECORD_UBYTE 255 I_1 0 255 /end CHARACTERISTIC
/begin CHARACTERISTIC FaultFTMTLCS_CurSenrPhaU_GNDFailMod "FaultFTMTLCS_CurSenrPhaU_GNDFailMod" VALUE 0x800A355D DATA_RECORD_UBYTE 255 I_1 0 255 /end CHARACTERISTIC
/begin CHARACTERISTIC FaultFTMTLCS_CurSenrPhaU_GNDInc "FaultFTMTLCS_CurSenrPhaU_GNDInc" VALUE 0x800A34F1 DATA_RECORD_UBYTE 255 I_1 0 255 /end CHARACTERISTIC
/begin CHARACTERISTIC FaultFTMTLCS_CurSenrPhaU_OutRngHDec "FaultFTMTLCS_CurSenrPhaU_OutRngHDec" VALUE 0x800A3486 DATA_RECORD_UBYTE 255 I_1 0 255 /end CHARACTERISTIC
/begin CHARACTERISTIC FaultFTMTLCS_CurSenrPhaU_OutRngHFailMod "FaultFTMTLCS_CurSenrPhaU_OutRngHFailMod" VALUE 0x800A355E DATA_RECORD_UBYTE 255 I_1 0 255 /end CHARACTERISTIC
/begin CHARACTERISTIC FaultFTMTLCS_CurSenrPhaU_OutRngHInc "FaultFTMTLCS_CurSenrPhaU_OutRngHInc" VALUE 0x800A34F2 DATA_RECORD_UBYTE 255 I_1 0 255 /end CHARACTERISTIC
/begin CHARACTERISTIC FaultFTMTLCS_CurSenrPhaU_OutRngLDec "FaultFTMTLCS_CurSenrPhaU_OutRngLDec" VALUE 0x800A3487 DATA_RECORD_UBYTE 255 I_1 0 255 /end CHARACTERISTIC
/begin CHARACTERISTIC FaultFTMTLCS_CurSenrPhaU_OutRngLFailMod "FaultFTMTLCS_CurSenrPhaU_OutRngLFailMod" VALUE 0x800A355F DATA_RECORD_UBYTE 255 I_1 0 255 /end CHARACTERISTIC
/begin CHARACTERISTIC FaultFTMTLCS_CurSenrPhaU_OutRngLInc "FaultFTMTLCS_CurSenrPhaU_OutRngLInc" VALUE 0x800A34F3 DATA_RECORD_UBYTE 255 I_1 0 255 /end CHARACTERISTIC
/begin CHARACTERISTIC FaultFTMTLCS_CurSenrPhaU_VCCDec "FaultFTMTLCS_CurSenrPhaU_VCCDec" VALUE 0x800A3488 DATA_RECORD_UBYTE 255 I_1 0 255 /end CHARACTERISTIC
/begin CHARACTERISTIC FaultFTMTLCS_CurSenrPhaU_VCCFailMod "FaultFTMTLCS_CurSenrPhaU_VCCFailMod" VALUE 0x800A3560 DATA_RECORD_UBYTE 255 I_1 0 255 /end CHARACTERISTIC
/begin CHARACTERISTIC FaultFTMTLCS_CurSenrPhaU_VCCInc "FaultFTMTLCS_CurSenrPhaU_VCCInc" VALUE 0x800A34F4 DATA_RECORD_UBYTE 255 I_1 0 255 /end CHARACTERISTIC
/begin CHARACTERISTIC FaultFTMTLCS_CurSenrPhaV_GNDDec "FaultFTMTLCS_CurSenrPhaV_GNDDec" VALUE 0x800A3489 DATA_RECORD_UBYTE 255 I_1 0 255 /end CHARACTERISTIC
/begin CHARACTERISTIC FaultFTMTLCS_CurSenrPhaV_GNDFailMod "FaultFTMTLCS_CurSenrPhaV_GNDFailMod" VALUE 0x800A3561 DATA_RECORD_UBYTE 255 I_1 0 255 /end CHARACTERISTIC
/begin CHARACTERISTIC FaultFTMTLCS_CurSenrPhaV_GNDInc "FaultFTMTLCS_CurSenrPhaV_GNDInc" VALUE 0x800A34F5 DATA_RECORD_UBYTE 255 I_1 0 255 /end CHARACTERISTIC
/begin CHARACTERISTIC FaultFTMTLCS_CurSenrPhaV_OutRngHDec "FaultFTMTLCS_CurSenrPhaV_OutRngHDec" VALUE 0x800A348A DATA_RECORD_UBYTE 255 I_1 0 255 /end CHARACTERISTIC
/begin CHARACTERISTIC FaultFTMTLCS_CurSenrPhaV_OutRngHFailMod "FaultFTMTLCS_CurSenrPhaV_OutRngHFailMod" VALUE 0x800A3562 DATA_RECORD_UBYTE 255 I_1 0 255 /end CHARACTERISTIC
/begin CHARACTERISTIC FaultFTMTLCS_CurSenrPhaV_OutRngHInc "FaultFTMTLCS_CurSenrPhaV_OutRngHInc" VALUE 0x800A34F6 DATA_RECORD_UBYTE 255 I_1 0 255 /end CHARACTERISTIC
/begin CHARACTERISTIC FaultFTMTLCS_CurSenrPhaV_OutRngLDec "FaultFTMTLCS_CurSenrPhaV_OutRngLDec" VALUE 0x800A348B DATA_RECORD_UBYTE 255 I_1 0 255 /end CHARACTERISTIC
/begin CHARACTERISTIC FaultFTMTLCS_CurSenrPhaV_OutRngLFailMod "FaultFTMTLCS_CurSenrPhaV_OutRngLFailMod" VALUE 0x800A3563 DATA_RECORD_UBYTE 255 I_1 0 255 /end CHARACTERISTIC
/begin CHARACTERISTIC FaultFTMTLCS_CurSenrPhaV_OutRngLInc "FaultFTMTLCS_CurSenrPhaV_OutRngLInc" VALUE 0x800A34F7 DATA_RECORD_UBYTE 255 I_1 0 255 /end CHARACTERISTIC
/begin CHARACTERISTIC FaultFTMTLCS_CurSenrPhaV_VCCDec "FaultFTMTLCS_CurSenrPhaV_VCCDec" VALUE 0x800A348C DATA_RECORD_UBYTE 255 I_1 0 255 /end CHARACTERISTIC
/begin CHARACTERISTIC FaultFTMTLCS_CurSenrPhaV_VCCFailMod "FaultFTMTLCS_CurSenrPhaV_VCCFailMod" VALUE 0x800A3564 DATA_RECORD_UBYTE 255 I_1 0 255 /end CHARACTERISTIC
/begin CHARACTERISTIC FaultFTMTLCS_CurSenrPhaV_VCCInc "FaultFTMTLCS_CurSenrPhaV_VCCInc" VALUE 0x800A34F8 DATA_RECORD_UBYTE 255 I_1 0 255 /end CHARACTERISTIC
/begin CHARACTERISTIC FaultFTMTLCS_CurSenrPhaW_GNDDec "FaultFTMTLCS_CurSenrPhaW_GNDDec" VALUE 0x800A348D DATA_RECORD_UBYTE 255 I_1 0 255 /end CHARACTERISTIC
/begin CHARACTERISTIC FaultFTMTLCS_CurSenrPhaW_GNDFailMod "FaultFTMTLCS_CurSenrPhaW_GNDFailMod" VALUE 0x800A3565 DATA_RECORD_UBYTE 255 I_1 0 255 /end CHARACTERISTIC
/begin CHARACTERISTIC FaultFTMTLCS_CurSenrPhaW_GNDInc "FaultFTMTLCS_CurSenrPhaW_GNDInc" VALUE 0x800A34F9 DATA_RECORD_UBYTE 255 I_1 0 255 /end CHARACTERISTIC
/begin CHARACTERISTIC FaultFTMTLCS_CurSenrPhaW_OutRngHDec "FaultFTMTLCS_CurSenrPhaW_OutRngHDec" VALUE 0x800A348E DATA_RECORD_UBYTE 255 I_1 0 255 /end CHARACTERISTIC
/begin CHARACTERISTIC FaultFTMTLCS_CurSenrPhaW_OutRngHFailMod "FaultFTMTLCS_CurSenrPhaW_OutRngHFailMod" VALUE 0x800A3566 DATA_RECORD_UBYTE 255 I_1 0 255 /end CHARACTERISTIC
/begin CHARACTERISTIC FaultFTMTLCS_CurSenrPhaW_OutRngHInc "FaultFTMTLCS_CurSenrPhaW_OutRngHInc" VALUE 0x800A34FA DATA_RECORD_UBYTE 255 I_1 0 255 /end CHARACTERISTIC
/begin CHARACTERISTIC FaultFTMTLCS_CurSenrPhaW_OutRngLDec "FaultFTMTLCS_CurSenrPhaW_OutRngLDec" VALUE 0x800A348F DATA_RECORD_UBYTE 255 I_1 0 255 /end CHARACTERISTIC
/begin CHARACTERISTIC FaultFTMTLCS_CurSenrPhaW_OutRngLFailMod "FaultFTMTLCS_CurSenrPhaW_OutRngLFailMod" VALUE 0x800A3567 DATA_RECORD_UBYTE 255 I_1 0 255 /end CHARACTERISTIC
/begin CHARACTERISTIC FaultFTMTLCS_CurSenrPhaW_OutRngLInc "FaultFTMTLCS_CurSenrPhaW_OutRngLInc" VALUE 0x800A34FB DATA_RECORD_UBYTE 255 I_1 0 255 /end CHARACTERISTIC
/begin CHARACTERISTIC FaultFTMTLCS_CurSenrPhaW_VCCDec "FaultFTMTLCS_CurSenrPhaW_VCCDec" VALUE 0x800A3490 DATA_RECORD_UBYTE 255 I_1 0 255 /end CHARACTERISTIC
/begin CHARACTERISTIC FaultFTMTLCS_CurSenrPhaW_VCCFailMod "FaultFTMTLCS_CurSenrPhaW_VCCFailMod" VALUE 0x800A3568 DATA_RECORD_UBYTE 255 I_1 0 255 /end CHARACTERISTIC
/begin CHARACTERISTIC FaultFTMTLCS_CurSenrPhaW_VCCInc "FaultFTMTLCS_CurSenrPhaW_VCCInc" VALUE 0x800A34FC DATA_RECORD_UBYTE 255 I_1 0 255 /end CHARACTERISTIC
/begin CHARACTERISTIC FaultFTMTLCS_CurrentSumErrorDec "FaultFTMTLCS_CurrentSumErrorDec" VALUE 0x800A3484 DATA_RECORD_UBYTE 255 I_1 0 255 /end CHARACTERISTIC
/begin CHARACTERISTIC FaultFTMTLCS_CurrentSumErrorFailMod "FaultFTMTLCS_CurrentSumErrorFailMod" VALUE 0x800A355C DATA_RECORD_UBYTE 255 I_1 0 255 /end CHARACTERISTIC
/begin CHARACTERISTIC FaultFTMTLCS_CurrentSumErrorInc "FaultFTMTLCS_CurrentSumErrorInc" VALUE 0x800A34F0 DATA_RECORD_UBYTE 255 I_1 0 255 /end CHARACTERISTIC
/begin CHARACTERISTIC FaultSDMTMEP_CosGndDec "FaultSDMTMEP_CosGndDec" VALUE 0x800A3491 DATA_RECORD_UBYTE 255 I_1 0 255 /end CHARACTERISTIC
/begin CHARACTERISTIC FaultSDMTMEP_CosGndFailMod "FaultSDMTMEP_CosGndFailMod" VALUE 0x800A3569 DATA_RECORD_UBYTE 255 I_1 0 255 /end CHARACTERISTIC
/begin CHARACTERISTIC FaultSDMTMEP_CosGndInc "FaultSDMTMEP_CosGndInc" VALUE 0x800A34FD DATA_RECORD_UBYTE 255 I_1 0 255 /end CHARACTERISTIC
/begin CHARACTERISTIC FaultSDMTMEP_CosOutRangeHighDec "FaultSDMTMEP_CosOutRangeHighDec" VALUE 0x800A3492 DATA_RECORD_UBYTE 255 I_1 0 255 /end CHARACTERISTIC
/begin CHARACTERISTIC FaultSDMTMEP_CosOutRangeHighFailMod "FaultSDMTMEP_CosOutRangeHighFailMod" VALUE 0x800A356A DATA_RECORD_UBYTE 255 I_1 0 255 /end CHARACTERISTIC
/begin CHARACTERISTIC FaultSDMTMEP_CosOutRangeHighInc "FaultSDMTMEP_CosOutRangeHighInc" VALUE 0x800A34FE DATA_RECORD_UBYTE 255 I_1 0 255 /end CHARACTERISTIC
/begin CHARACTERISTIC FaultSDMTMEP_CosOutRangeLowDec "FaultSDMTMEP_CosOutRangeLowDec" VALUE 0x800A3493 DATA_RECORD_UBYTE 255 I_1 0 255 /end CHARACTERISTIC
/begin CHARACTERISTIC FaultSDMTMEP_CosOutRangeLowFailMod "FaultSDMTMEP_CosOutRangeLowFailMod" VALUE 0x800A356B DATA_RECORD_UBYTE 255 I_1 0 255 /end CHARACTERISTIC
/begin CHARACTERISTIC FaultSDMTMEP_CosOutRangeLowInc "FaultSDMTMEP_CosOutRangeLowInc" VALUE 0x800A34FF DATA_RECORD_UBYTE 255 I_1 0 255 /end CHARACTERISTIC
/begin CHARACTERISTIC FaultSDMTMEP_CosVccDec "FaultSDMTMEP_CosVccDec" VALUE 0x800A3494 DATA_RECORD_UBYTE 255 I_1 0 255 /end CHARACTERISTIC
/begin CHARACTERISTIC FaultSDMTMEP_CosVccFailMod "FaultSDMTMEP_CosVccFailMod" VALUE 0x800A356C DATA_RECORD_UBYTE 255 I_1 0 255 /end CHARACTERISTIC
/begin CHARACTERISTIC FaultSDMTMEP_CosVccInc "FaultSDMTMEP_CosVccInc" VALUE 0x800A3500 DATA_RECORD_UBYTE 255 I_1 0 255 /end CHARACTERISTIC
/begin CHARACTERISTIC FaultSDMTMEP_OverSpeedDec "FaultSDMTMEP_OverSpeedDec" VALUE 0x800A3495 DATA_RECORD_UBYTE 255 I_1 0 255 /end CHARACTERISTIC
/begin CHARACTERISTIC FaultSDMTMEP_OverSpeedFailMod "FaultSDMTMEP_OverSpeedFailMod" VALUE 0x800A356D DATA_RECORD_UBYTE 255 I_1 0 255 /end CHARACTERISTIC
/begin CHARACTERISTIC FaultSDMTMEP_OverSpeedInc "FaultSDMTMEP_OverSpeedInc" VALUE 0x800A3501 DATA_RECORD_UBYTE 255 I_1 0 255 /end CHARACTERISTIC
/begin CHARACTERISTIC FaultSDMTMEP_ResSquaSumErrByFTDec "FaultSDMTMEP_ResSquaSumErrByFTDec" VALUE 0x800A3496 DATA_RECORD_UBYTE 255 I_1 0 255 /end CHARACTERISTIC
/begin CHARACTERISTIC FaultSDMTMEP_ResSquaSumErrByFTFailMod "FaultSDMTMEP_ResSquaSumErrByFTFailMod" VALUE 0x800A356E DATA_RECORD_UBYTE 255 I_1 0 255 /end CHARACTERISTIC
/begin CHARACTERISTIC FaultSDMTMEP_ResSquaSumErrByFTInc "FaultSDMTMEP_ResSquaSumErrByFTInc" VALUE 0x800A3502 DATA_RECORD_UBYTE 255 I_1 0 255 /end CHARACTERISTIC
/begin CHARACTERISTIC FaultSDMTMEP_SinGndDec "FaultSDMTMEP_SinGndDec" VALUE 0x800A3497 DATA_RECORD_UBYTE 255 I_1 0 255 /end CHARACTERISTIC
/begin CHARACTERISTIC FaultSDMTMEP_SinGndFailMod "FaultSDMTMEP_SinGndFailMod" VALUE 0x800A356F DATA_RECORD_UBYTE 255 I_1 0 255 /end CHARACTERISTIC
/begin CHARACTERISTIC FaultSDMTMEP_SinGndInc "FaultSDMTMEP_SinGndInc" VALUE 0x800A3503 DATA_RECORD_UBYTE 255 I_1 0 255 /end CHARACTERISTIC
/begin CHARACTERISTIC FaultSDMTMEP_SinOutRangeHighDec "FaultSDMTMEP_SinOutRangeHighDec" VALUE 0x800A3498 DATA_RECORD_UBYTE 255 I_1 0 255 /end CHARACTERISTIC
/begin CHARACTERISTIC FaultSDMTMEP_SinOutRangeHighFailMod "FaultSDMTMEP_SinOutRangeHighFailMod" VALUE 0x800A3570 DATA_RECORD_UBYTE 255 I_1 0 255 /end CHARACTERISTIC
/begin CHARACTERISTIC FaultSDMTMEP_SinOutRangeHighInc "FaultSDMTMEP_SinOutRangeHighInc" VALUE 0x800A3504 DATA_RECORD_UBYTE 255 I_1 0 255 /end CHARACTERISTIC
/begin CHARACTERISTIC FaultSDMTMEP_SinOutRangeLowDec "FaultSDMTMEP_SinOutRangeLowDec" VALUE 0x800A3499 DATA_RECORD_UBYTE 255 I_1 0 255 /end CHARACTERISTIC
/begin CHARACTERISTIC FaultSDMTMEP_SinOutRangeLowFailMod "FaultSDMTMEP_SinOutRangeLowFailMod" VALUE 0x800A3571 DATA_RECORD_UBYTE 255 I_1 0 255 /end CHARACTERISTIC
/begin CHARACTERISTIC FaultSDMTMEP_SinOutRangeLowInc "FaultSDMTMEP_SinOutRangeLowInc" VALUE 0x800A3505 DATA_RECORD_UBYTE 255 I_1 0 255 /end CHARACTERISTIC
/begin CHARACTERISTIC FaultSDMTMEP_SinVccDec "FaultSDMTMEP_SinVccDec" VALUE 0x800A349A DATA_RECORD_UBYTE 255 I_1 0 255 /end CHARACTERISTIC
/begin CHARACTERISTIC FaultSDMTMEP_SinVccFailMod "FaultSDMTMEP_SinVccFailMod" VALUE 0x800A3572 DATA_RECORD_UBYTE 255 I_1 0 255 /end CHARACTERISTIC
/begin CHARACTERISTIC FaultSDMTMEP_SinVccInc "FaultSDMTMEP_SinVccInc" VALUE 0x800A3506 DATA_RECORD_UBYTE 255 I_1 0 255 /end CHARACTERISTIC
/begin CHARACTERISTIC FaultSDMTMEP_UnderSpeedDec "FaultSDMTMEP_UnderSpeedDec" VALUE 0x800A349B DATA_RECORD_UBYTE 255 I_1 0 255 /end CHARACTERISTIC
/begin CHARACTERISTIC FaultSDMTMEP_UnderSpeedFailMod "FaultSDMTMEP_UnderSpeedFailMod" VALUE 0x800A3573 DATA_RECORD_UBYTE 255 I_1 0 255 /end CHARACTERISTIC
/begin CHARACTERISTIC FaultSDMTMEP_UnderSpeedInc "FaultSDMTMEP_UnderSpeedInc" VALUE 0x800A3507 DATA_RECORD_UBYTE 255 I_1 0 255 /end CHARACTERISTIC
/begin CHARACTERISTIC FaultTCUCAP0_CAPPressureHDec "FaultTCUCAP0_CAPPressureHDec" VALUE 0x800A349C DATA_RECORD_UBYTE 255 I_1 0 255 /end CHARACTERISTIC
/begin CHARACTERISTIC FaultTCUCAP0_CAPPressureHFailMod "FaultTCUCAP0_CAPPressureHFailMod" VALUE 0x800A3574 DATA_RECORD_UBYTE 255 I_1 0 255 /end CHARACTERISTIC
/begin CHARACTERISTIC FaultTCUCAP0_CAPPressureHInc "FaultTCUCAP0_CAPPressureHInc" VALUE 0x800A3508 DATA_RECORD_UBYTE 255 I_1 0 255 /end CHARACTERISTIC
/begin CHARACTERISTIC FaultTCUCAP0_CAPPressureLDec "FaultTCUCAP0_CAPPressureLDec" VALUE 0x800A349D DATA_RECORD_UBYTE 255 I_1 0 255 /end CHARACTERISTIC
/begin CHARACTERISTIC FaultTCUCAP0_CAPPressureLFailMod "FaultTCUCAP0_CAPPressureLFailMod" VALUE 0x800A3575 DATA_RECORD_UBYTE 255 I_1 0 255 /end CHARACTERISTIC
/begin CHARACTERISTIC FaultTCUCAP0_CAPPressureLInc "FaultTCUCAP0_CAPPressureLInc" VALUE 0x800A3509 DATA_RECORD_UBYTE 255 I_1 0 255 /end CHARACTERISTIC
/begin CHARACTERISTIC FaultTCUCAP0_CAPPressureOverHDec "FaultTCUCAP0_CAPPressureOverHDec" VALUE 0x800A349E DATA_RECORD_UBYTE 255 I_1 0 255 /end CHARACTERISTIC
/begin CHARACTERISTIC FaultTCUCAP0_CAPPressureOverHFailMod "FaultTCUCAP0_CAPPressureOverHFailMod" VALUE 0x800A3576 DATA_RECORD_UBYTE 255 I_1 0 255 /end CHARACTERISTIC
/begin CHARACTERISTIC FaultTCUCAP0_CAPPressureOverHInc "FaultTCUCAP0_CAPPressureOverHInc" VALUE 0x800A350A DATA_RECORD_UBYTE 255 I_1 0 255 /end CHARACTERISTIC
/begin CHARACTERISTIC FaultTCUCAP0_CAPSlipDec "FaultTCUCAP0_CAPSlipDec" VALUE 0x800A349F DATA_RECORD_UBYTE 255 I_1 0 255 /end CHARACTERISTIC
/begin CHARACTERISTIC FaultTCUCAP0_CAPSlipFailMod "FaultTCUCAP0_CAPSlipFailMod" VALUE 0x800A3577 DATA_RECORD_UBYTE 255 I_1 0 255 /end CHARACTERISTIC
/begin CHARACTERISTIC FaultTCUCAP0_CAPSlipInc "FaultTCUCAP0_CAPSlipInc" VALUE 0x800A350B DATA_RECORD_UBYTE 255 I_1 0 255 /end CHARACTERISTIC
/begin CHARACTERISTIC FaultTCUCAP0_DragMomentHDec "FaultTCUCAP0_DragMomentHDec" VALUE 0x800A34A0 DATA_RECORD_UBYTE 255 I_1 0 255 /end CHARACTERISTIC
/begin CHARACTERISTIC FaultTCUCAP0_DragMomentHFailMod "FaultTCUCAP0_DragMomentHFailMod" VALUE 0x800A3578 DATA_RECORD_UBYTE 255 I_1 0 255 /end CHARACTERISTIC
/begin CHARACTERISTIC FaultTCUCAP0_DragMomentHInc "FaultTCUCAP0_DragMomentHInc" VALUE 0x800A350C DATA_RECORD_UBYTE 255 I_1 0 255 /end CHARACTERISTIC
/begin CHARACTERISTIC FaultTCUCAP0_HLSinInvalidDec "FaultTCUCAP0_HLSinInvalidDec" VALUE 0x800A34A1 DATA_RECORD_UBYTE 255 I_1 0 255 /end CHARACTERISTIC
/begin CHARACTERISTIC FaultTCUCAP0_HLSinInvalidFailMod "FaultTCUCAP0_HLSinInvalidFailMod" VALUE 0x800A3579 DATA_RECORD_UBYTE 255 I_1 0 255 /end CHARACTERISTIC
/begin CHARACTERISTIC FaultTCUCAP0_HLSinInvalidInc "FaultTCUCAP0_HLSinInvalidInc" VALUE 0x800A350D DATA_RECORD_UBYTE 255 I_1 0 255 /end CHARACTERISTIC
/begin CHARACTERISTIC FaultTCUCAP0_HLSinUndefineDec "FaultTCUCAP0_HLSinUndefineDec" VALUE 0x800A34A2 DATA_RECORD_UBYTE 255 I_1 0 255 /end CHARACTERISTIC
/begin CHARACTERISTIC FaultTCUCAP0_HLSinUndefineFailMod "FaultTCUCAP0_HLSinUndefineFailMod" VALUE 0x800A357A DATA_RECORD_UBYTE 255 I_1 0 255 /end CHARACTERISTIC
/begin CHARACTERISTIC FaultTCUCAP0_HLSinUndefineInc "FaultTCUCAP0_HLSinUndefineInc" VALUE 0x800A350E DATA_RECORD_UBYTE 255 I_1 0 255 /end CHARACTERISTIC
/begin CHARACTERISTIC FaultTCUCAP0_HLSupplyHDec "FaultTCUCAP0_HLSupplyHDec" VALUE 0x800A34A3 DATA_RECORD_UBYTE 255 I_1 0 255 /end CHARACTERISTIC
/begin CHARACTERISTIC FaultTCUCAP0_HLSupplyHFailMod "FaultTCUCAP0_HLSupplyHFailMod" VALUE 0x800A357B DATA_RECORD_UBYTE 255 I_1 0 255 /end CHARACTERISTIC
/begin CHARACTERISTIC FaultTCUCAP0_HLSupplyHInc "FaultTCUCAP0_HLSupplyHInc" VALUE 0x800A350F DATA_RECORD_UBYTE 255 I_1 0 255 /end CHARACTERISTIC
/begin CHARACTERISTIC FaultTCUCAP0_HLSupplyLDec "FaultTCUCAP0_HLSupplyLDec" VALUE 0x800A34A4 DATA_RECORD_UBYTE 255 I_1 0 255 /end CHARACTERISTIC
/begin CHARACTERISTIC FaultTCUCAP0_HLSupplyLFailMod "FaultTCUCAP0_HLSupplyLFailMod" VALUE 0x800A357C DATA_RECORD_UBYTE 255 I_1 0 255 /end CHARACTERISTIC
/begin CHARACTERISTIC FaultTCUCAP0_HLSupplyLInc "FaultTCUCAP0_HLSupplyLInc" VALUE 0x800A3510 DATA_RECORD_UBYTE 255 I_1 0 255 /end CHARACTERISTIC
/begin CHARACTERISTIC FaultTCUCAP0_MotorPhaseVolHDec "FaultTCUCAP0_MotorPhaseVolHDec" VALUE 0x800A34A5 DATA_RECORD_UBYTE 255 I_1 0 255 /end CHARACTERISTIC
/begin CHARACTERISTIC FaultTCUCAP0_MotorPhaseVolHFailMod "FaultTCUCAP0_MotorPhaseVolHFailMod" VALUE 0x800A357D DATA_RECORD_UBYTE 255 I_1 0 255 /end CHARACTERISTIC
/begin CHARACTERISTIC FaultTCUCAP0_MotorPhaseVolHInc "FaultTCUCAP0_MotorPhaseVolHInc" VALUE 0x800A3511 DATA_RECORD_UBYTE 255 I_1 0 255 /end CHARACTERISTIC
/begin CHARACTERISTIC FaultTCUCAP0_PressureRationalDec "FaultTCUCAP0_PressureRationalDec" VALUE 0x800A34A6 DATA_RECORD_UBYTE 255 I_1 0 255 /end CHARACTERISTIC
/begin CHARACTERISTIC FaultTCUCAP0_PressureRationalFailMod "FaultTCUCAP0_PressureRationalFailMod" VALUE 0x800A357E DATA_RECORD_UBYTE 255 I_1 0 255 /end CHARACTERISTIC
/begin CHARACTERISTIC FaultTCUCAP0_PressureRationalInc "FaultTCUCAP0_PressureRationalInc" VALUE 0x800A3512 DATA_RECORD_UBYTE 255 I_1 0 255 /end CHARACTERISTIC
/begin CHARACTERISTIC FaultTCUCAP0_SenSigOpenOrGNDDec "FaultTCUCAP0_SenSigOpenOrGNDDec" VALUE 0x800A34A7 DATA_RECORD_UBYTE 255 I_1 0 255 /end CHARACTERISTIC
/begin CHARACTERISTIC FaultTCUCAP0_SenSigOpenOrGNDFailMod "FaultTCUCAP0_SenSigOpenOrGNDFailMod" VALUE 0x800A357F DATA_RECORD_UBYTE 255 I_1 0 255 /end CHARACTERISTIC
/begin CHARACTERISTIC FaultTCUCAP0_SenSigOpenOrGNDInc "FaultTCUCAP0_SenSigOpenOrGNDInc" VALUE 0x800A3513 DATA_RECORD_UBYTE 255 I_1 0 255 /end CHARACTERISTIC
/begin CHARACTERISTIC FaultTCUCAP0_SenSigVCCDec "FaultTCUCAP0_SenSigVCCDec" VALUE 0x800A34A8 DATA_RECORD_UBYTE 255 I_1 0 255 /end CHARACTERISTIC
/begin CHARACTERISTIC FaultTCUCAP0_SenSigVCCFailMod "FaultTCUCAP0_SenSigVCCFailMod" VALUE 0x800A3580 DATA_RECORD_UBYTE 255 I_1 0 255 /end CHARACTERISTIC
/begin CHARACTERISTIC FaultTCUCAP0_SenSigVCCInc "FaultTCUCAP0_SenSigVCCInc" VALUE 0x800A3514 DATA_RECORD_UBYTE 255 I_1 0 255 /end CHARACTERISTIC
/begin CHARACTERISTIC FaultTCUCAP0_SensorPerforErrDec "FaultTCUCAP0_SensorPerforErrDec" VALUE 0x800A34A9 DATA_RECORD_UBYTE 255 I_1 0 255 /end CHARACTERISTIC
/begin CHARACTERISTIC FaultTCUCAP0_SensorPerforErrFailMod "FaultTCUCAP0_SensorPerforErrFailMod" VALUE 0x800A3581 DATA_RECORD_UBYTE 255 I_1 0 255 /end CHARACTERISTIC
/begin CHARACTERISTIC FaultTCUCAP0_SensorPerforErrInc "FaultTCUCAP0_SensorPerforErrInc" VALUE 0x800A3515 DATA_RECORD_UBYTE 255 I_1 0 255 /end CHARACTERISTIC
/begin CHARACTERISTIC FaultTCUCAP1_COM_GCUDec "FaultTCUCAP1_COM_GCUDec" VALUE 0x800A34AA DATA_RECORD_UBYTE 255 I_1 0 255 /end CHARACTERISTIC
/begin CHARACTERISTIC FaultTCUCAP1_COM_GCUFailMod "FaultTCUCAP1_COM_GCUFailMod" VALUE 0x800A3582 DATA_RECORD_UBYTE 255 I_1 0 255 /end CHARACTERISTIC
/begin CHARACTERISTIC FaultTCUCAP1_COM_GCUInc "FaultTCUCAP1_COM_GCUInc" VALUE 0x800A3516 DATA_RECORD_UBYTE 255 I_1 0 255 /end CHARACTERISTIC
/begin CHARACTERISTIC FaultTCUCAP1_DriverTempHDec "FaultTCUCAP1_DriverTempHDec" VALUE 0x800A34AB DATA_RECORD_UBYTE 255 I_1 0 255 /end CHARACTERISTIC
/begin CHARACTERISTIC FaultTCUCAP1_DriverTempHFailMod "FaultTCUCAP1_DriverTempHFailMod" VALUE 0x800A3583 DATA_RECORD_UBYTE 255 I_1 0 255 /end CHARACTERISTIC
/begin CHARACTERISTIC FaultTCUCAP1_DriverTempHInc "FaultTCUCAP1_DriverTempHInc" VALUE 0x800A3517 DATA_RECORD_UBYTE 255 I_1 0 255 /end CHARACTERISTIC
/begin CHARACTERISTIC FaultTCUCAP1_FETShortDec "FaultTCUCAP1_FETShortDec" VALUE 0x800A34AC DATA_RECORD_UBYTE 255 I_1 0 255 /end CHARACTERISTIC
/begin CHARACTERISTIC FaultTCUCAP1_FETShortFailMod "FaultTCUCAP1_FETShortFailMod" VALUE 0x800A3584 DATA_RECORD_UBYTE 255 I_1 0 255 /end CHARACTERISTIC
/begin CHARACTERISTIC FaultTCUCAP1_FETShortInc "FaultTCUCAP1_FETShortInc" VALUE 0x800A3518 DATA_RECORD_UBYTE 255 I_1 0 255 /end CHARACTERISTIC
/begin CHARACTERISTIC FaultTCUCAP1_HWOverCurDec "FaultTCUCAP1_HWOverCurDec" VALUE 0x800A34AD DATA_RECORD_UBYTE 255 I_1 0 255 /end CHARACTERISTIC
/begin CHARACTERISTIC FaultTCUCAP1_HWOverCurFailMod "FaultTCUCAP1_HWOverCurFailMod" VALUE 0x800A3585 DATA_RECORD_UBYTE 255 I_1 0 255 /end CHARACTERISTIC
/begin CHARACTERISTIC FaultTCUCAP1_HWOverCurInc "FaultTCUCAP1_HWOverCurInc" VALUE 0x800A3519 DATA_RECORD_UBYTE 255 I_1 0 255 /end CHARACTERISTIC
/begin CHARACTERISTIC FaultTCUCAP1_MotorPhaseDriveErrDec "FaultTCUCAP1_MotorPhaseDriveErrDec" VALUE 0x800A34AE DATA_RECORD_UBYTE 255 I_1 0 255 /end CHARACTERISTIC
/begin CHARACTERISTIC FaultTCUCAP1_MotorPhaseDriveErrFailMod "FaultTCUCAP1_MotorPhaseDriveErrFailMod" VALUE 0x800A3586 DATA_RECORD_UBYTE 255 I_1 0 255 /end CHARACTERISTIC
/begin CHARACTERISTIC FaultTCUCAP1_MotorPhaseDriveErrInc "FaultTCUCAP1_MotorPhaseDriveErrInc" VALUE 0x800A351A DATA_RECORD_UBYTE 255 I_1 0 255 /end CHARACTERISTIC
/begin CHARACTERISTIC FaultTCUCAP1_MotorStallDec "FaultTCUCAP1_MotorStallDec" VALUE 0x800A34AF DATA_RECORD_UBYTE 255 I_1 0 255 /end CHARACTERISTIC
/begin CHARACTERISTIC FaultTCUCAP1_MotorStallFailMod "FaultTCUCAP1_MotorStallFailMod" VALUE 0x800A3587 DATA_RECORD_UBYTE 255 I_1 0 255 /end CHARACTERISTIC
/begin CHARACTERISTIC FaultTCUCAP1_MotorStallInc "FaultTCUCAP1_MotorStallInc" VALUE 0x800A351B DATA_RECORD_UBYTE 255 I_1 0 255 /end CHARACTERISTIC
/begin CHARACTERISTIC FaultTCUCAP1_OverVoltageDec "FaultTCUCAP1_OverVoltageDec" VALUE 0x800A34B0 DATA_RECORD_UBYTE 255 I_1 0 255 /end CHARACTERISTIC
/begin CHARACTERISTIC FaultTCUCAP1_OverVoltageFailMod "FaultTCUCAP1_OverVoltageFailMod" VALUE 0x800A3588 DATA_RECORD_UBYTE 255 I_1 0 255 /end CHARACTERISTIC
/begin CHARACTERISTIC FaultTCUCAP1_OverVoltageInc "FaultTCUCAP1_OverVoltageInc" VALUE 0x800A351C DATA_RECORD_UBYTE 255 I_1 0 255 /end CHARACTERISTIC
/begin CHARACTERISTIC FaultTCUCAP1_PhaseDetectGNDDec "FaultTCUCAP1_PhaseDetectGNDDec" VALUE 0x800A34B1 DATA_RECORD_UBYTE 255 I_1 0 255 /end CHARACTERISTIC
/begin CHARACTERISTIC FaultTCUCAP1_PhaseDetectGNDFailMod "FaultTCUCAP1_PhaseDetectGNDFailMod" VALUE 0x800A3589 DATA_RECORD_UBYTE 255 I_1 0 255 /end CHARACTERISTIC
/begin CHARACTERISTIC FaultTCUCAP1_PhaseDetectGNDInc "FaultTCUCAP1_PhaseDetectGNDInc" VALUE 0x800A351D DATA_RECORD_UBYTE 255 I_1 0 255 /end CHARACTERISTIC
/begin CHARACTERISTIC FaultTCUCAP1_PhaseDetectVCCDec "FaultTCUCAP1_PhaseDetectVCCDec" VALUE 0x800A34B2 DATA_RECORD_UBYTE 255 I_1 0 255 /end CHARACTERISTIC
/begin CHARACTERISTIC FaultTCUCAP1_PhaseDetectVCCFailMod "FaultTCUCAP1_PhaseDetectVCCFailMod" VALUE 0x800A358A DATA_RECORD_UBYTE 255 I_1 0 255 /end CHARACTERISTIC
/begin CHARACTERISTIC FaultTCUCAP1_PhaseDetectVCCInc "FaultTCUCAP1_PhaseDetectVCCInc" VALUE 0x800A351E DATA_RECORD_UBYTE 255 I_1 0 255 /end CHARACTERISTIC
/begin CHARACTERISTIC FaultTCUCAP1_SWOverCurDec "FaultTCUCAP1_SWOverCurDec" VALUE 0x800A34B3 DATA_RECORD_UBYTE 255 I_1 0 255 /end CHARACTERISTIC
/begin CHARACTERISTIC FaultTCUCAP1_SWOverCurFailMod "FaultTCUCAP1_SWOverCurFailMod" VALUE 0x800A358B DATA_RECORD_UBYTE 255 I_1 0 255 /end CHARACTERISTIC
/begin CHARACTERISTIC FaultTCUCAP1_SWOverCurInc "FaultTCUCAP1_SWOverCurInc" VALUE 0x800A351F DATA_RECORD_UBYTE 255 I_1 0 255 /end CHARACTERISTIC
/begin CHARACTERISTIC FaultTCUCAP1_ThermalShutDownDec "FaultTCUCAP1_ThermalShutDownDec" VALUE 0x800A34B4 DATA_RECORD_UBYTE 255 I_1 0 255 /end CHARACTERISTIC
/begin CHARACTERISTIC FaultTCUCAP1_ThermalShutDownFailMod "FaultTCUCAP1_ThermalShutDownFailMod" VALUE 0x800A358C DATA_RECORD_UBYTE 255 I_1 0 255 /end CHARACTERISTIC
/begin CHARACTERISTIC FaultTCUCAP1_ThermalShutDownInc "FaultTCUCAP1_ThermalShutDownInc" VALUE 0x800A3520 DATA_RECORD_UBYTE 255 I_1 0 255 /end CHARACTERISTIC
/begin CHARACTERISTIC FaultTCUCAP1_ThermalWarningDec "FaultTCUCAP1_ThermalWarningDec" VALUE 0x800A34B5 DATA_RECORD_UBYTE 255 I_1 0 255 /end CHARACTERISTIC
/begin CHARACTERISTIC FaultTCUCAP1_ThermalWarningFailMod "FaultTCUCAP1_ThermalWarningFailMod" VALUE 0x800A358D DATA_RECORD_UBYTE 255 I_1 0 255 /end CHARACTERISTIC
/begin CHARACTERISTIC FaultTCUCAP1_ThermalWarningInc "FaultTCUCAP1_ThermalWarningInc" VALUE 0x800A3521 DATA_RECORD_UBYTE 255 I_1 0 255 /end CHARACTERISTIC
/begin CHARACTERISTIC FaultTCUCAP1_UnderVoltageDec "FaultTCUCAP1_UnderVoltageDec" VALUE 0x800A34B6 DATA_RECORD_UBYTE 255 I_1 0 255 /end CHARACTERISTIC
/begin CHARACTERISTIC FaultTCUCAP1_UnderVoltageFailMod "FaultTCUCAP1_UnderVoltageFailMod" VALUE 0x800A358E DATA_RECORD_UBYTE 255 I_1 0 255 /end CHARACTERISTIC
/begin CHARACTERISTIC FaultTCUCAP1_UnderVoltageInc "FaultTCUCAP1_UnderVoltageInc" VALUE 0x800A3522 DATA_RECORD_UBYTE 255 I_1 0 255 /end CHARACTERISTIC
/begin CHARACTERISTIC FaultTCUCCP_OilMotorRationalDec "FaultTCUCCP_OilMotorRationalDec" VALUE 0x800A34B7 DATA_RECORD_UBYTE 255 I_1 0 255 /end CHARACTERISTIC
/begin CHARACTERISTIC FaultTCUCCP_OilMotorRationalFailMod "FaultTCUCCP_OilMotorRationalFailMod" VALUE 0x800A358F DATA_RECORD_UBYTE 255 I_1 0 255 /end CHARACTERISTIC
/begin CHARACTERISTIC FaultTCUCCP_OilMotorRationalInc "FaultTCUCCP_OilMotorRationalInc" VALUE 0x800A3523 DATA_RECORD_UBYTE 255 I_1 0 255 /end CHARACTERISTIC
/begin CHARACTERISTIC FaultTCUCCP_OilMotorStallDec "FaultTCUCCP_OilMotorStallDec" VALUE 0x800A34B8 DATA_RECORD_UBYTE 255 I_1 0 255 /end CHARACTERISTIC
/begin CHARACTERISTIC FaultTCUCCP_OilMotorStallFailMod "FaultTCUCCP_OilMotorStallFailMod" VALUE 0x800A3590 DATA_RECORD_UBYTE 255 I_1 0 255 /end CHARACTERISTIC
/begin CHARACTERISTIC FaultTCUCCP_OilMotorStallInc "FaultTCUCCP_OilMotorStallInc" VALUE 0x800A3524 DATA_RECORD_UBYTE 255 I_1 0 255 /end CHARACTERISTIC
/begin CHARACTERISTIC FaultTCUCCP_OilSenRationalL1Dec "FaultTCUCCP_OilSenRationalL1Dec" VALUE 0x800A34B9 DATA_RECORD_UBYTE 255 I_1 0 255 /end CHARACTERISTIC
/begin CHARACTERISTIC FaultTCUCCP_OilSenRationalL1FailMod "FaultTCUCCP_OilSenRationalL1FailMod" VALUE 0x800A3591 DATA_RECORD_UBYTE 255 I_1 0 255 /end CHARACTERISTIC
/begin CHARACTERISTIC FaultTCUCCP_OilSenRationalL1Inc "FaultTCUCCP_OilSenRationalL1Inc" VALUE 0x800A3525 DATA_RECORD_UBYTE 255 I_1 0 255 /end CHARACTERISTIC
/begin CHARACTERISTIC FaultTCUCCP_OilSenRationalL2Dec "FaultTCUCCP_OilSenRationalL2Dec" VALUE 0x800A34BA DATA_RECORD_UBYTE 255 I_1 0 255 /end CHARACTERISTIC
/begin CHARACTERISTIC FaultTCUCCP_OilSenRationalL2FailMod "FaultTCUCCP_OilSenRationalL2FailMod" VALUE 0x800A3592 DATA_RECORD_UBYTE 255 I_1 0 255 /end CHARACTERISTIC
/begin CHARACTERISTIC FaultTCUCCP_OilSenRationalL2Inc "FaultTCUCCP_OilSenRationalL2Inc" VALUE 0x800A3526 DATA_RECORD_UBYTE 255 I_1 0 255 /end CHARACTERISTIC
/begin CHARACTERISTIC FaultTCUCCP_OilTempRationalHDec "FaultTCUCCP_OilTempRationalHDec" VALUE 0x800A34BB DATA_RECORD_UBYTE 255 I_1 0 255 /end CHARACTERISTIC
/begin CHARACTERISTIC FaultTCUCCP_OilTempRationalHFailMod "FaultTCUCCP_OilTempRationalHFailMod" VALUE 0x800A3593 DATA_RECORD_UBYTE 255 I_1 0 255 /end CHARACTERISTIC
/begin CHARACTERISTIC FaultTCUCCP_OilTempRationalHInc "FaultTCUCCP_OilTempRationalHInc" VALUE 0x800A3527 DATA_RECORD_UBYTE 255 I_1 0 255 /end CHARACTERISTIC
/begin CHARACTERISTIC FaultTCUCCP_OilTempRationalLDec "FaultTCUCCP_OilTempRationalLDec" VALUE 0x800A34BC DATA_RECORD_UBYTE 255 I_1 0 255 /end CHARACTERISTIC
/begin CHARACTERISTIC FaultTCUCCP_OilTempRationalLFailMod "FaultTCUCCP_OilTempRationalLFailMod" VALUE 0x800A3594 DATA_RECORD_UBYTE 255 I_1 0 255 /end CHARACTERISTIC
/begin CHARACTERISTIC FaultTCUCCP_OilTempRationalLInc "FaultTCUCCP_OilTempRationalLInc" VALUE 0x800A3528 DATA_RECORD_UBYTE 255 I_1 0 255 /end CHARACTERISTIC
/begin CHARACTERISTIC GCCU6_bAlimFreqChgEnaC "..." VALUE 0x80058043 DATA_RECORD_UBYTE 1 Bool_ON_OFF 0 1 BIT_MASK 0x01 /end CHARACTERISTIC
/begin CHARACTERISTIC GCCU6_bDualSmpEnaC "..." VALUE 0x80058042 DATA_RECORD_UBYTE 1 Bool_ON_OFF 0 1 BIT_MASK 0x01 /end CHARACTERISTIC
/begin CHARACTERISTIC GCCU6_bHwOvcFltDetEnaC "..." VALUE 0x80058041 DATA_RECORD_UBYTE 1 Bool_ON_OFF 0 1 BIT_MASK 0x01 /end CHARACTERISTIC
/begin CHARACTERISTIC GCCU6_bHwPinAscEnaC "..." VALUE 0x80058040 DATA_RECORD_UBYTE 1 Bool_ON_OFF 0 1 BIT_MASK 0x01 /end CHARACTERISTIC
/begin CHARACTERISTIC GCCU6_f32DrvClkDutyThdHighC "..." VALUE 0x8005803C DATA_RECORD_FLOAT32_IEEE 3.402823466E+038 F_1_p0_5 -3.402823466E+038 3.402823466E+038 /end CHARACTERISTIC
/begin CHARACTERISTIC GCCU6_f32DrvClkDutyThdLowC "..." VALUE 0x80058038 DATA_RECORD_FLOAT32_IEEE 3.402823466E+038 F_1_p0_5 -3.402823466E+038 3.402823466E+038 /end CHARACTERISTIC
/begin CHARACTERISTIC GCCU6_kbDrvBdClkEnaC "..." VALUE 0x80058024 DATA_RECORD_UBYTE 1 Bool_ON_OFF 0 1 BIT_MASK 0x01 /end CHARACTERISTIC
/begin CHARACTERISTIC GCCU6_kf32MidPointDutyHC "..." VALUE 0x80058034 DATA_RECORD_FLOAT32_IEEE 3.402823466E+038 F_1_p0_5 -3.402823466E+038 3.402823466E+038 /end CHARACTERISTIC
/begin CHARACTERISTIC GCCU6_kf32MidPointDutyLC "..." VALUE 0x80058030 DATA_RECORD_FLOAT32_IEEE 3.402823466E+038 F_1_p0_5 -3.402823466E+038 3.402823466E+038 /end CHARACTERISTIC
/begin CHARACTERISTIC GCCU6_ku16AlimDutyCycRawC "..." VALUE 0x800580A8 DATA_RECORD_UWORD 65535 F_1_p0_5 0 65535 /end CHARACTERISTIC
/begin CHARACTERISTIC GCCU6_ku32AlimFreqRawC "..." VALUE 0x80058C20 DATA_RECORD_ULONG 4294967295 F_1_p0_5 0 4294967295 /end CHARACTERISTIC
/begin CHARACTERISTIC GCCU6_ku8AscRecoverCntMaxC "..." VALUE 0x8005802E DATA_RECORD_UBYTE 255 F_1_p0_5 0 255 /end CHARACTERISTIC
/begin CHARACTERISTIC GCCU6_ku8PwmMidPointFaultC "..." VALUE 0x80058026 DATA_RECORD_UBYTE 255 F_1_p0_5 0 255 /end CHARACTERISTIC
/begin CHARACTERISTIC HARDPTG_s16AmplitudeC "HARDPTG_s16AmplitudeC" VALUE 0x800580BA DATA_RECORD_SWORD 200 F_0v0030518044_p0_30 -100.0015259 99.9984741 /end CHARACTERISTIC
/begin CHARACTERISTIC HARDPTG_s16ContinuousRequestC "HARDPTG_s16ContinuousRequestC" VALUE 0x800580B8 DATA_RECORD_SWORD 100 F_0v0015259022_p0_31 -50.00076295 49.99923705 /end CHARACTERISTIC
/begin CHARACTERISTIC HARDPTG_s16OffsetC "HARDPTG_s16OffsetC" VALUE 0x800580B6 DATA_RECORD_SWORD 200 F_0v0030518044_p0_30 -100.0015259 99.9984741 /end CHARACTERISTIC
/begin CHARACTERISTIC HARDPTG_s16SlewRateC "HARDPTG_s16SlewRateC" VALUE 0x800580B4 DATA_RECORD_SWORD 200 F_0v0030518044_p0_30 -100.0015259 99.9984741 /end CHARACTERISTIC
/begin CHARACTERISTIC HARDPTG_u16PulseDutyCycleC "HARDPTG_u16PulseDutyCycleC" VALUE 0x800580AC DATA_RECORD_UWORD 99.9984741 D_2_0v01_p0_32 0.00152590219 100 /end CHARACTERISTIC
/begin CHARACTERISTIC HARDPTG_u32FrequenceC "Sous-multiple de la pï¿½riode SPI VSI" VALUE 0x80058C24 DATA_RECORD_ULONG 4294967295 F_1_p0_5 0 4294967295 /end CHARACTERISTIC
/begin CHARACTERISTIC HARD_bPtgEnablePhaseShiftingC "HARD_bPtgEnablePhaseShiftingC" VALUE 0x80058045 DATA_RECORD_UBYTE 1 Bool_ON_OFF 0 1 BIT_MASK 0x01 /end CHARACTERISTIC
/begin CHARACTERISTIC HARD_u16PtgUSignalShiftC "HARD_u16PtgUSignalShiftC" VALUE 0x800580B2 DATA_RECORD_UWORD 1.999969482 F_0v0000305176_p0_34 0 1.999969482 /end CHARACTERISTIC
/begin CHARACTERISTIC HARD_u16PtgVSignalShiftC "HARD_u16PtgVSignalShiftC" VALUE 0x800580B0 DATA_RECORD_UWORD 1.999969482 F_0v0000305176_p0_34 0 1.999969482 /end CHARACTERISTIC
/begin CHARACTERISTIC HARD_u16PtgWSignalShiftC "HARD_u16PtgWSignalShiftC" VALUE 0x800580AE DATA_RECORD_UWORD 1.999969482 F_0v0000305176_p0_34 0 1.999969482 /end CHARACTERISTIC
/begin CHARACTERISTIC IOHAL_u32MCUVOLPeriodMaxC "IOHAL_u32MCUVOLPeriodMaxC" VALUE 0x80058C28 DATA_RECORD_ULONG 4294967295 I_1 0 4294967295 /end CHARACTERISTIC
/begin MEASUREMENT FAULT_FF_bFrameLock_FF1 "FAULT_FF_bFrameLock_FF1" UBYTE Bool_ON_OFF 1 2 0 1 BIT_MASK 0x01 ECU_ADDRESS 0x70009B94 /end MEASUREMENT
/begin MEASUREMENT FF_FF1_BMS_HVBusVolt "FF_FF1_BMS_HVBusVolt" UWORD F_1_p0_5 1 2 0 65535 ECU_ADDRESS 0x70009BCE /end MEASUREMENT
/begin MEASUREMENT FF_FF1_BatteryVoltage "FF_FF1_BatteryVoltage" UWORD F_1_p0_5 1 2 0 65535 ECU_ADDRESS 0x70009B9A /end MEASUREMENT
/begin MEASUREMENT FF_FF1_CosScaled "FF_FF1_CosScaled" UWORD F_1_p0_5 1 2 0 65535 ECU_ADDRESS 0x70009BE6 /end MEASUREMENT
/begin MEASUREMENT FF_FF1_DC_Current "FF_FF1_DC_Current" UWORD F_1_p0_5 1 2 0 65535 ECU_ADDRESS 0x70009BC8 /end MEASUREMENT
/begin MEASUREMENT FF_FF1_DrivingPermission "FF_FF1_DrivingPermission" UBYTE F_1_p0_5 1 2 0 255 ECU_ADDRESS 0x70009BAA /end MEASUREMENT
/begin MEASUREMENT FF_FF1_EngineSpeed "FF_FF1_EngineSpeed" UWORD F_1_p0_5 1 2 0 65535 ECU_ADDRESS 0x70009BA8 /end MEASUREMENT
/begin MEASUREMENT FF_FF1_EstimTempSecFild "FF_FF1_EstimTempSecFild" UWORD F_1_p0_5 1 2 0 65535 ECU_ADDRESS 0x70009C08 /end MEASUREMENT
/begin MEASUREMENT FF_FF1_ExcVoltageFild "FF_FF1_ExcVoltageFild" UWORD F_1_p0_5 1 2 0 65535 ECU_ADDRESS 0x70009BE8 /end MEASUREMENT
/begin MEASUREMENT FF_FF1_ExcitationDiag "FF_FF1_ExcitationDiag" UWORD F_1_p0_5 1 2 0 65535 ECU_ADDRESS 0x70009BEA /end MEASUREMENT
/begin MEASUREMENT FF_FF1_FPGA_FaultA "FF_FF1_FPGA_FaultA" UWORD F_1_p0_5 1 2 0 65535 ECU_ADDRESS 0x70009BD2 /end MEASUREMENT
/begin MEASUREMENT FF_FF1_FPGA_FaultB "FF_FF1_FPGA_FaultB" UWORD F_1_p0_5 1 2 0 65535 ECU_ADDRESS 0x70009BD4 /end MEASUREMENT
/begin MEASUREMENT FF_FF1_FTModeReq "FF_FF1_FTModeReq" UWORD F_1_p0_5 1 2 0 65535 ECU_ADDRESS 0x70009BDE /end MEASUREMENT
/begin MEASUREMENT FF_FF1_FT_AclState "FF_FF1_FT_AclState" UWORD F_1_p0_5 1 2 0 65535 ECU_ADDRESS 0x70009BE0 /end MEASUREMENT
/begin MEASUREMENT FF_FF1_GlbRealTimeDay "FF_FF1_GlbRealTimeDay" UBYTE F_1_p0_5 1 2 0 255 ECU_ADDRESS 0x70009BA5 /end MEASUREMENT
/begin MEASUREMENT FF_FF1_GlbRealTimeHour "FF_FF1_GlbRealTimeHour" UBYTE F_1_p0_5 1 2 0 255 ECU_ADDRESS 0x70009BA4 /end MEASUREMENT
/begin MEASUREMENT FF_FF1_GlbRealTimeMinute "FF_FF1_GlbRealTimeMinute" UBYTE F_1_p0_5 1 2 0 255 ECU_ADDRESS 0x70009BA3 /end MEASUREMENT
/begin MEASUREMENT FF_FF1_GlbRealTimeMonth "FF_FF1_GlbRealTimeMonth" UBYTE F_1_p0_5 1 2 0 255 ECU_ADDRESS 0x70009BA6 /end MEASUREMENT
/begin MEASUREMENT FF_FF1_GlbRealTimeSec "FF_FF1_GlbRealTimeSec" UBYTE F_1_p0_5 1 2 0 255 ECU_ADDRESS 0x70009BA2 /end MEASUREMENT
/begin MEASUREMENT FF_FF1_GlbRealTimeYear "FF_FF1_GlbRealTimeYear" UBYTE F_1_p0_5 1 2 0 255 ECU_ADDRESS 0x70009BA7 /end MEASUREMENT
/begin MEASUREMENT FF_FF1_HV_VoltageFild "FF_FF1_HV_VoltageFild" UWORD F_1_p0_5 1 2 0 65535 ECU_ADDRESS 0x70009BB6 /end MEASUREMENT
/begin MEASUREMENT FF_FF1_I0dq3_1 "FF_FF1_I0dq3_1" UWORD F_1_p0_5 1 2 0 65535 ECU_ADDRESS 0x70009C00 /end MEASUREMENT
/begin MEASUREMENT FF_FF1_I0dq3_2 "FF_FF1_I0dq3_2" UWORD F_1_p0_5 1 2 0 65535 ECU_ADDRESS 0x70009C02 /end MEASUREMENT
/begin MEASUREMENT FF_FF1_IGBTStatus "FF_FF1_IGBTStatus" UBYTE F_1_p0_5 1 2 0 255 ECU_ADDRESS 0x70009BB4 /end MEASUREMENT
/begin MEASUREMENT FF_FF1_IPUMode "FF_FF1_IPUMode" UBYTE F_1_p0_5 1 2 0 255 ECU_ADDRESS 0x70009BBC /end MEASUREMENT
/begin MEASUREMENT FF_FF1_ISGCurrentTorq "FF_FF1_ISGCurrentTorq" UWORD F_1_p0_5 1 2 0 65535 ECU_ADDRESS 0x70009BCA /end MEASUREMENT
/begin MEASUREMENT FF_FF1_IgnitionSwSig "FF_FF1_IgnitionSwSig" UBYTE F_1_p0_5 1 2 0 255 ECU_ADDRESS 0x70009B98 /end MEASUREMENT
/begin MEASUREMENT FF_FF1_Iu "FF_FF1_Iu" UWORD F_1_p0_5 1 2 0 65535 ECU_ADDRESS 0x70009BAE /end MEASUREMENT
/begin MEASUREMENT FF_FF1_Iv "FF_FF1_Iv" UWORD F_1_p0_5 1 2 0 65535 ECU_ADDRESS 0x70009BB0 /end MEASUREMENT
/begin MEASUREMENT FF_FF1_Iw "FF_FF1_Iw" UWORD F_1_p0_5 1 2 0 65535 ECU_ADDRESS 0x70009BB2 /end MEASUREMENT
/begin MEASUREMENT FF_FF1_MCU_HVBusVolt "FF_FF1_MCU_HVBusVolt" UWORD F_1_p0_5 1 2 0 65535 ECU_ADDRESS 0x70009BD0 /end MEASUREMENT
/begin MEASUREMENT FF_FF1_MaxMinTorqueDrtVect "FF_FF1_MaxMinTorqueDrtVect" UWORD F_1_p0_5 1 2 0 65535 ECU_ADDRESS 0x70009BEC /end MEASUREMENT
/begin MEASUREMENT FF_FF1_MecaSpeedRpm "FF_FF1_MecaSpeedRpm" UWORD F_1_p0_5 1 2 0 65535 ECU_ADDRESS 0x70009BBA /end MEASUREMENT
/begin MEASUREMENT FF_FF1_MecaTorqueMaxMin "FF_FF1_MecaTorqueMaxMin" UWORD F_1_p0_5 1 2 0 65535 ECU_ADDRESS 0x70009BE2 /end MEASUREMENT
/begin MEASUREMENT FF_FF1_MotTemp "FF_FF1_MotTemp" UBYTE F_1_p0_5 1 2 0 255 ECU_ADDRESS 0x70009BB8 /end MEASUREMENT
/begin MEASUREMENT FF_FF1_ParkVoltageTgt "FF_FF1_ParkVoltageTgt" UWORD F_1_p0_5 1 2 0 65535 ECU_ADDRESS 0x70009BF4 /end MEASUREMENT
/begin MEASUREMENT FF_FF1_RMS_Cur_U "FF_FF1_RMS_Cur_U" UWORD F_1_p0_5 1 2 0 65535 ECU_ADDRESS 0x70009BC0 /end MEASUREMENT
/begin MEASUREMENT FF_FF1_RMS_Cur_V "FF_FF1_RMS_Cur_V" UWORD F_1_p0_5 1 2 0 65535 ECU_ADDRESS 0x70009BC2 /end MEASUREMENT
/begin MEASUREMENT FF_FF1_RMS_Cur_W "FF_FF1_RMS_Cur_W" UWORD F_1_p0_5 1 2 0 65535 ECU_ADDRESS 0x70009BC4 /end MEASUREMENT
/begin MEASUREMENT FF_FF1_ResolNext2ThetaRdByPi "FF_FF1_ResolNext2ThetaRdByPi" UWORD F_1_p0_5 1 2 0 65535 ECU_ADDRESS 0x70009BEE /end MEASUREMENT
/begin MEASUREMENT FF_FF1_RstStartUpCnt "FF_FF1_RstStartUpCnt" UWORD F_1_p0_5 1 2 0 65535 ECU_ADDRESS 0x70009BD6 /end MEASUREMENT
/begin MEASUREMENT FF_FF1_SOC "FF_FF1_SOC" UBYTE F_1_p0_5 1 2 0 255 ECU_ADDRESS 0x70009BAB /end MEASUREMENT
/begin MEASUREMENT FF_FF1_SinScaled "FF_FF1_SinScaled" UWORD F_1_p0_5 1 2 0 65535 ECU_ADDRESS 0x70009BE4 /end MEASUREMENT
/begin MEASUREMENT FF_FF1_TempCmdBoard "FF_FF1_TempCmdBoard" UBYTE F_1_p0_5 1 2 0 255 ECU_ADDRESS 0x70009BBE /end MEASUREMENT
/begin MEASUREMENT FF_FF1_TempCoolingFild "FF_FF1_TempCoolingFild" UBYTE F_1_p0_5 1 2 0 255 ECU_ADDRESS 0x70009BAC /end MEASUREMENT
/begin MEASUREMENT FF_FF1_TempDrvBoard "FF_FF1_TempDrvBoard" UWORD F_1_p0_5 1 2 0 65535 ECU_ADDRESS 0x70009C04 /end MEASUREMENT
/begin MEASUREMENT FF_FF1_TempIgbt "FF_FF1_TempIgbt" UWORD F_1_p0_5 1 2 0 65535 ECU_ADDRESS 0x70009C06 /end MEASUREMENT
/begin MEASUREMENT FF_FF1_TimestampIgn "FF_FF1_TimestampIgn" UWORD F_1_p0_5 1 2 0 65535 ECU_ADDRESS 0x70009BD8 /end MEASUREMENT
/begin MEASUREMENT FF_FF1_TimestampLife_H "FF_FF1_TimestampLife_H" UWORD F_1_p0_5 1 2 0 65535 ECU_ADDRESS 0x70009BDA /end MEASUREMENT
/begin MEASUREMENT FF_FF1_TimestampLife_L "FF_FF1_TimestampLife_L" UWORD F_1_p0_5 1 2 0 65535 ECU_ADDRESS 0x70009BDC /end MEASUREMENT
/begin MEASUREMENT FF_FF1_TotalMiles_H "FF_FF1_TotalMiles_H" UWORD F_1_p0_5 1 2 0 65535 ECU_ADDRESS 0x70009B9C /end MEASUREMENT
/begin MEASUREMENT FF_FF1_TotalMiles_L "FF_FF1_TotalMiles_L" UWORD F_1_p0_5 1 2 0 65535 ECU_ADDRESS 0x70009B9E /end MEASUREMENT
/begin MEASUREMENT FF_FF1_UM1dTgt "FF_FF1_UM1dTgt" UWORD F_1_p0_5 1 2 0 65535 ECU_ADDRESS 0x70009BF0 /end MEASUREMENT
/begin MEASUREMENT FF_FF1_UM1qTgt "FF_FF1_UM1qTgt" UWORD F_1_p0_5 1 2 0 65535 ECU_ADDRESS 0x70009BF2 /end MEASUREMENT
/begin MEASUREMENT FF_FF1_VCU_AllowTorq "FF_FF1_VCU_AllowTorq" UBYTE F_1_p0_5 1 2 0 255 ECU_ADDRESS 0x70009BCC /end MEASUREMENT
/begin MEASUREMENT FF_FF1_VCU_DCU_ModeReq "FF_FF1_VCU_DCU_ModeReq" UBYTE F_1_p0_5 1 2 0 255 ECU_ADDRESS 0x70009BBD /end MEASUREMENT
/begin MEASUREMENT FF_FF1_VCU_DCU_TorqSet "FF_FF1_VCU_DCU_TorqSet" UWORD F_1_p0_5 1 2 0 65535 ECU_ADDRESS 0x70009BC6 /end MEASUREMENT
/begin MEASUREMENT FF_FF1_VehicleSpd "FF_FF1_VehicleSpd" UWORD F_1_p0_5 1 2 0 65535 ECU_ADDRESS 0x70009BA0 /end MEASUREMENT
/begin MEASUREMENT FF_FF1_i0dqTgt3_1 "FF_FF1_i0dqTgt3_1" UWORD F_1_p0_5 1 2 0 65535 ECU_ADDRESS 0x70009BFC /end MEASUREMENT
/begin MEASUREMENT FF_FF1_i0dqTgt3_2 "FF_FF1_i0dqTgt3_2" UWORD F_1_p0_5 1 2 0 65535 ECU_ADDRESS 0x70009BFE /end MEASUREMENT
/begin MEASUREMENT FF_FF1_idCorTgt "FF_FF1_idCorTgt" UWORD F_1_p0_5 1 2 0 65535 ECU_ADDRESS 0x70009BFA /end MEASUREMENT
/begin MEASUREMENT FF_FF1_idLutTgt "FF_FF1_idLutTgt" UWORD F_1_p0_5 1 2 0 65535 ECU_ADDRESS 0x70009BF8 /end MEASUREMENT
/begin MEASUREMENT FF_FF1_iqLutTgt "FF_FF1_iqLutTgt" UWORD F_1_p0_5 1 2 0 65535 ECU_ADDRESS 0x70009BF6 /end MEASUREMENT
/begin MEASUREMENT FRecord_u8ClearReq "..." UBYTE I_1 1 2 0 255 ECU_ADDRESS 0x70009EB8 /end MEASUREMENT
/begin MEASUREMENT FRecord_u8EventWriteState "..." UBYTE I_1 1 2 0 255 ECU_ADDRESS 0x70009EB6 /end MEASUREMENT
/begin MEASUREMENT FRecord_u8FRStoreState "..." UBYTE I_1 1 2 0 255 ECU_ADDRESS 0x70009EB4 /end MEASUREMENT
/begin MEASUREMENT FRecord_u8HeadWriteState "..." UBYTE I_1 1 2 0 255 ECU_ADDRESS 0x70009EB5 /end MEASUREMENT
/begin MEASUREMENT GCCU6_au32PWMOnTime "." ULONG F_1_p0_5 1 2 0 4294967295 MATRIX_DIM 3 1 1 ECU_ADDRESS 0x70021F4C /end MEASUREMENT
/begin MEASUREMENT GCCU6_au32PWMOnTime[0] "GCCU6_au32PWMOnTime[0]" ULONG F_1_p0_5 1 2 0 4294967295 ECU_ADDRESS 0x70021F4C /end MEASUREMENT
/begin MEASUREMENT GCCU6_au32PWMOnTime[1] "GCCU6_au32PWMOnTime[1]" ULONG F_1_p0_5 1 2 0 4294967295 ECU_ADDRESS 0x70021F50 /end MEASUREMENT
/begin MEASUREMENT GCCU6_au32PWMOnTime[2] "GCCU6_au32PWMOnTime[2]" ULONG F_1_p0_5 1 2 0 4294967295 ECU_ADDRESS 0x70021F54 /end MEASUREMENT
/begin MEASUREMENT GCCU6_bAkdAfterAscReq "..." UBYTE Bool_ON_OFF 1 2 0 1 BIT_MASK 0x01 ECU_ADDRESS 0x70021F86 /end MEASUREMENT
/begin MEASUREMENT GCCU6_bClrTrapReq "..." UBYTE Bool_ON_OFF 1 2 0 1 BIT_MASK 0x01 ECU_ADDRESS 0x70021F85 /end MEASUREMENT
/begin MEASUREMENT GCCU6_bHwFaultDcOvVolt "..." UBYTE Bool_ON_OFF 1 2 0 1 BIT_MASK 0x01 ECU_ADDRESS 0x70021F84 /end MEASUREMENT
/begin MEASUREMENT GCCU6_bHwFaultIgbtH "..." UBYTE Bool_ON_OFF 1 2 0 1 BIT_MASK 0x01 ECU_ADDRESS 0x70021F83 /end MEASUREMENT
/begin MEASUREMENT GCCU6_bHwFaultIgbtL "..." UBYTE Bool_ON_OFF 1 2 0 1 BIT_MASK 0x01 ECU_ADDRESS 0x70021F82 /end MEASUREMENT
/begin MEASUREMENT GCCU6_bHwFaultOvcU "..." UBYTE Bool_ON_OFF 1 2 0 1 BIT_MASK 0x01 ECU_ADDRESS 0x70021F81 /end MEASUREMENT
/begin MEASUREMENT GCCU6_bHwFaultOvcV "..." UBYTE Bool_ON_OFF 1 2 0 1 BIT_MASK 0x01 ECU_ADDRESS 0x70021F80 /end MEASUREMENT
/begin MEASUREMENT GCCU6_bHwFaultOvcW "..." UBYTE Bool_ON_OFF 1 2 0 1 BIT_MASK 0x01 ECU_ADDRESS 0x70021F7F /end MEASUREMENT
/begin MEASUREMENT GCCU6_bIgbtHighSideShort "..." UBYTE Bool_ON_OFF 1 2 0 1 BIT_MASK 0x01 ECU_ADDRESS 0x70021F7E /end MEASUREMENT
/begin MEASUREMENT GCCU6_bIgbtLowSideShort "..." UBYTE Bool_ON_OFF 1 2 0 1 BIT_MASK 0x01 ECU_ADDRESS 0x70021F7D /end MEASUREMENT
/begin MEASUREMENT GCCU6_bIuvwCompReq "..." UBYTE Bool_ON_OFF 1 2 0 1 BIT_MASK 0x01 ECU_ADDRESS 0x70021F7B /end MEASUREMENT
/begin MEASUREMENT GCCU6_bMotorSpdRdy "..." UBYTE Bool_ON_OFF 1 2 0 1 BIT_MASK 0x01 ECU_ADDRESS 0x70021F7A /end MEASUREMENT
/begin MEASUREMENT GCCU6_bP5VDiagReinitCmd "..." UBYTE Bool_ON_OFF 1 2 0 1 BIT_MASK 0x01 ECU_ADDRESS 0x70021F79 /end MEASUREMENT
/begin MEASUREMENT GCCU6_bP5VHSFltFlg "..." UBYTE Bool_ON_OFF 1 2 0 1 BIT_MASK 0x01 ECU_ADDRESS 0x70021F78 /end MEASUREMENT
/begin MEASUREMENT GCCU6_bP5VLSFltFlg "..." UBYTE Bool_ON_OFF 1 2 0 1 BIT_MASK 0x01 ECU_ADDRESS 0x70021F77 /end MEASUREMENT
/begin MEASUREMENT GCCU6_bPwmMidPointU "..." UBYTE Bool_ON_OFF 1 2 0 1 BIT_MASK 0x01 ECU_ADDRESS 0x70021F76 /end MEASUREMENT
/begin MEASUREMENT GCCU6_bPwmMidPointV "..." UBYTE Bool_ON_OFF 1 2 0 1 BIT_MASK 0x01 ECU_ADDRESS 0x70021F75 /end MEASUREMENT
/begin MEASUREMENT GCCU6_bPwmMidPointW "..." UBYTE Bool_ON_OFF 1 2 0 1 BIT_MASK 0x01 ECU_ADDRESS 0x70021F74 /end MEASUREMENT
/begin MEASUREMENT GCCU6_bPwmOnGoingFlg "..." UBYTE Bool_ON_OFF 1 2 0 1 BIT_MASK 0x01 ECU_ADDRESS 0x70021F73 /end MEASUREMENT
/begin MEASUREMENT GCCU6_bT12ZeroMatchFlg "..." UBYTE Bool_ON_OFF 1 2 0 1 BIT_MASK 0x01 ECU_ADDRESS 0x70021F72 /end MEASUREMENT
/begin MEASUREMENT GCCU6_bTrapTrigger "..." UBYTE Bool_ON_OFF 1 2 0 1 BIT_MASK 0x01 ECU_ADDRESS 0x70021F71 /end MEASUREMENT
/begin MEASUREMENT GCCU6_f32DrvClkHsDuty "..." FLOAT32_IEEE I_1 1 2 -3.402823466E+038 3.402823466E+038 ECU_ADDRESS 0x70021F6C /end MEASUREMENT
/begin MEASUREMENT GCCU6_f32DrvClkLsDuty "..." FLOAT32_IEEE I_1 1 2 -3.402823466E+038 3.402823466E+038 ECU_ADDRESS 0x70021F68 /end MEASUREMENT
/begin MEASUREMENT GCCU6_f32HighVolPhys "..." FLOAT32_IEEE I_1 1 2 -3.402823466E+038 3.402823466E+038 ECU_ADDRESS 0x70021F64 /end MEASUREMENT
/begin MEASUREMENT GCCU6_f32PwmDutyPhysUZ "..." FLOAT32_IEEE I_1 1 2 -3.402823466E+038 3.402823466E+038 ECU_ADDRESS 0x70021F60 /end MEASUREMENT
/begin MEASUREMENT GCCU6_f32PwmDutyPhysVZ "..." FLOAT32_IEEE I_1 1 2 -3.402823466E+038 3.402823466E+038 ECU_ADDRESS 0x70021F5C /end MEASUREMENT
/begin MEASUREMENT GCCU6_f32PwmDutyPhysWZ "..." FLOAT32_IEEE I_1 1 2 -3.402823466E+038 3.402823466E+038 ECU_ADDRESS 0x70021F58 /end MEASUREMENT
/begin MEASUREMENT GCCU6_u16AlimPowerOnDelay "..." UWORD I_1 1 2 0 65535 ECU_ADDRESS 0x70021F2A /end MEASUREMENT
/begin MEASUREMENT GCCU6_u16HighVolAdc "..." UWORD I_1 1 2 0 65535 ECU_ADDRESS 0x70021F26 /end MEASUREMENT
/begin MEASUREMENT GCCU6_u16McuAscSttDelay "..." UWORD I_1 1 2 0 65535 ECU_ADDRESS 0x70021F24 /end MEASUREMENT
/begin MEASUREMENT GCCU6_u16P5VHSAdc "..." UWORD I_3 1 2 0 65535 ECU_ADDRESS 0x70021F22 /end MEASUREMENT
/begin MEASUREMENT GCCU6_u16PowerOnDelay "..." UWORD I_1 1 2 0 65535 ECU_ADDRESS 0x70021F20 /end MEASUREMENT
/begin MEASUREMENT GCCU6_u16PwmMaxDutyCyc "..." UWORD I_1 1 2 0 65535 ECU_ADDRESS 0x70021F1E /end MEASUREMENT
/begin MEASUREMENT GCCU6_u16PwmMidPointErrCnt "..." UWORD I_1 1 2 0 65535 ECU_ADDRESS 0x70021F1C /end MEASUREMENT
/begin MEASUREMENT GCCU6_u16PwmMinDutyCyc "..." UWORD I_1 1 2 0 65535 ECU_ADDRESS 0x70021F1A /end MEASUREMENT
/begin MEASUREMENT GCCU6_u16PwmModReq "..." UWORD I_1 1 2 0 65535 ECU_ADDRESS 0x70021F18 /end MEASUREMENT
/begin MEASUREMENT GCCU6_u16T12CntVal "..." UWORD I_1 1 2 0 65535 ECU_ADDRESS 0x70021F16 /end MEASUREMENT
/begin MEASUREMENT GCCU6_u16T12PeriodVal "..." UWORD I_1 1 2 0 65535 ECU_ADDRESS 0x70000F18 /end MEASUREMENT
/begin MEASUREMENT GCCU6_u16T13PeriodVal "..." UWORD I_1 1 2 0 65535 ECU_ADDRESS 0x70021F14 /end MEASUREMENT
/begin MEASUREMENT GCCU6_u32DrvClkHsDutyRaw "..." ULONG I_1 1 2 0 4294967295 ECU_ADDRESS 0x70021F48 /end MEASUREMENT
/begin MEASUREMENT GCCU6_u32DrvClkHsPerdRaw "..." ULONG I_1 1 2 0 4294967295 ECU_ADDRESS 0x70021F44 /end MEASUREMENT
/begin MEASUREMENT GCCU6_u32DrvClkLsDutyRaw "..." ULONG I_1 1 2 0 4294967295 ECU_ADDRESS 0x70021F40 /end MEASUREMENT
/begin MEASUREMENT GCCU6_u32DrvClkLsPerdRaw "..." ULONG I_1 1 2 0 4294967295 ECU_ADDRESS 0x70021F3C /end MEASUREMENT
/begin MEASUREMENT GCCU6_u32TrapCreq "..." ULONG I_1 1 2 0 4294967295 ECU_ADDRESS 0x70021F38 /end MEASUREMENT
/begin MEASUREMENT GCCU6_u8AscRecoverCnt "GCCU6 State" UBYTE I_1 1 2 0 255 ECU_ADDRESS 0x70021F36 /end MEASUREMENT
/begin MEASUREMENT GCCU6_u8McuAscSttStep "GCCU6 State" UBYTE I_1 1 2 0 255 ECU_ADDRESS 0x70021F34 /end MEASUREMENT
/begin MEASUREMENT GCCU6_u8McuAscType "GCCU6 ASC Type" UBYTE I_1 1 2 0 255 ECU_ADDRESS 0x70021F33 /end MEASUREMENT
/begin MEASUREMENT GCCU6_u8P5VHSFltCnt "..." UBYTE I_1 1 2 0 255 ECU_ADDRESS 0x70021F32 /end MEASUREMENT
/begin MEASUREMENT GCCU6_u8P5VLSFltCnt "..." UBYTE I_1 1 2 0 255 ECU_ADDRESS 0x70021F31 /end MEASUREMENT
/begin MEASUREMENT GCCU6_u8P5VPowerMngStt "..." UBYTE I_1 1 2 0 255 ECU_ADDRESS 0x70021F30 /end MEASUREMENT
/begin MEASUREMENT GCCU6_u8P5VSelfTstTimCnt "..." UBYTE I_1 1 2 0 255 ECU_ADDRESS 0x70021F2F /end MEASUREMENT
/begin MEASUREMENT GCCU6_u8PreTestStep "..." UBYTE I_1 1 2 0 255 ECU_ADDRESS 0x70021F2D /end MEASUREMENT
/begin MEASUREMENT GCCU6_u8PwmState "GCCU6 State" UBYTE I_1 1 2 0 255 ECU_ADDRESS 0x70021F2C /end MEASUREMENT
/begin MEASUREMENT HARD_ESM_FT_STATE_FT_SHUTDOWN "HARD_ESM_FT_STATE_FT_SHUTDOWN" UBYTE Bool_ON_OFF 1 2 0 1 BIT_MASK 0x08 ECU_ADDRESS 0x700220B4 /end MEASUREMENT
/begin MEASUREMENT HARD_ESM_FT_STATE_IDLE "HARD_ESM_FT_STATE_IDLE" UBYTE Bool_ON_OFF 1 2 0 1 BIT_MASK 0x40 ECU_ADDRESS 0x700220B4 /end MEASUREMENT
/begin MEASUREMENT HARD_ESM_FT_STATE_PWM_DIRECT "HARD_ESM_FT_STATE_PWM_DIRECT" UBYTE Bool_ON_OFF 1 2 0 1 BIT_MASK 0x01 ECU_ADDRESS 0x700220B4 /end MEASUREMENT
/begin MEASUREMENT HARD_ESM_FT_STATE_PWM_HARD "HARD_ESM_FT_STATE_PWM_HARD" UBYTE Bool_ON_OFF 1 2 0 1 BIT_MASK 0x02 ECU_ADDRESS 0x700220B4 /end MEASUREMENT
/begin MEASUREMENT HARD_ESM_FT_STATE_PWM_OFF "HARD_ESM_FT_STATE_PWM_OFF" UBYTE Bool_ON_OFF 1 2 0 1 BIT_MASK 0x04 ECU_ADDRESS 0x700220B4 /end MEASUREMENT
/begin MEASUREMENT HARD_ESM_NF_STATE_FT_START "HARD_ESM_NF_STATE_FT_START" UBYTE Bool_ON_OFF 1 2 0 1 BIT_MASK 0x01 ECU_ADDRESS 0x700220B2 /end MEASUREMENT
/begin MEASUREMENT HARD_ESM_NF_STATE_IDLE "HARD_ESM_NF_STATE_IDLE" UBYTE Bool_ON_OFF 1 2 0 1 BIT_MASK 0x40 ECU_ADDRESS 0x700220B2 /end MEASUREMENT
/begin MEASUREMENT HARD_ESM_NF_STATE_PWM_HARD "HARD_ESM_NF_STATE_PWM_HARD" UBYTE Bool_ON_OFF 1 2 0 1 BIT_MASK 0x08 ECU_ADDRESS 0x700220B2 /end MEASUREMENT
/begin MEASUREMENT HARD_ESM_NF_STATE_PWM_OFF "HARD_ESM_NF_STATE_PWM_OFF" UBYTE Bool_ON_OFF 1 2 0 1 BIT_MASK 0x10 ECU_ADDRESS 0x700220B2 /end MEASUREMENT
/begin MEASUREMENT HARD_ESM_NF_STATE_SW_SHUTDOWN "HARD_ESM_NF_STATE_SW_SHUTDOWN" UBYTE Bool_ON_OFF 1 2 0 1 BIT_MASK 0x04 ECU_ADDRESS 0x700220B2 /end MEASUREMENT
/begin MEASUREMENT HARD_EsmFtState "HARD_EsmFtState" UWORD HARD_EsmFtState_conv 1 2 1 64 ECU_ADDRESS 0x700220B4 /end MEASUREMENT
/begin MEASUREMENT HARD_EsmFtStateAut "HARD_EsmFtStateAut" UBYTE Bool_ON_OFF 1 2 0 1 BIT_MASK 0x01 ECU_ADDRESS 0x7002200F /end MEASUREMENT
/begin MEASUREMENT HARD_EsmNfState "HARD_EsmNfState" UWORD HARD_EsmNfState_conv 1 2 1 64 ECU_ADDRESS 0x700220B2 /end MEASUREMENT
/begin MEASUREMENT HARD_EsmNfStateAut "HARD_EsmNfStateAut" UBYTE Bool_ON_OFF 1 2 0 1 BIT_MASK 0x01 ECU_ADDRESS 0x7002200E /end MEASUREMENT
/begin MEASUREMENT HARD_PTG_CONTINUOUS_MODE "HARD_PTG_CONTINUOUS_MODE" UBYTE Bool_ON_OFF 1 2 0 1 BIT_MASK 0x10 ECU_ADDRESS 0x700220B0 /end MEASUREMENT
/begin MEASUREMENT HARD_PTG_DISJUNCTION_MODE "HARD_PTG_DISJUNCTION_MODE" UBYTE Bool_ON_OFF 1 2 0 1 BIT_MASK 0x40 ECU_ADDRESS 0x700220B0 /end MEASUREMENT
/begin MEASUREMENT HARD_PTG_LOOP_NB_MODE "HARD_PTG_LOOP_NB_MODE" UBYTE Bool_ON_OFF 1 2 0 1 BIT_MASK 0x80 ECU_ADDRESS 0x700220B0 /end MEASUREMENT
/begin MEASUREMENT HARD_PTG_PROFIL_MODE "HARD_PTG_PROFIL_MODE" UBYTE Bool_ON_OFF 1 2 0 1 BIT_MASK 0x20 ECU_ADDRESS 0x700220B0 /end MEASUREMENT
/begin MEASUREMENT HARD_PTG_PULSE_MODE "HARD_PTG_PULSE_MODE" UBYTE Bool_ON_OFF 1 2 0 1 BIT_MASK 0x01 ECU_ADDRESS 0x700220B0 /end MEASUREMENT
/begin MEASUREMENT HARD_PTG_SINUS_MODE "HARD_PTG_SINUS_MODE" UBYTE Bool_ON_OFF 1 2 0 1 BIT_MASK 0x02 ECU_ADDRESS 0x700220B0 /end MEASUREMENT
/begin MEASUREMENT HARD_PTG_SQUARE_MODE "HARD_PTG_SQUARE_MODE" UBYTE Bool_ON_OFF 1 2 0 1 BIT_MASK 0x08 ECU_ADDRESS 0x700220B0 /end MEASUREMENT
/begin MEASUREMENT HARD_PTG_TRIANGLE_MODE "HARD_PTG_TRIANGLE_MODE" UBYTE Bool_ON_OFF 1 2 0 1 BIT_MASK 0x04 ECU_ADDRESS 0x700220B0 /end MEASUREMENT
/begin MEASUREMENT HARD_PtgModeTest "HARD_PtgModeTest" UWORD HARD_PtgModeTest_conv 1 2 1 128 ECU_ADDRESS 0x700220B0 /end MEASUREMENT
/begin MEASUREMENT HARD_bDio_CAN1_EN "HARD_bDio_CAN1_EN" UBYTE Bool_ON_OFF 1 2 0 1 BIT_MASK 0x01 ECU_ADDRESS 0x700220A8 /end MEASUREMENT
/begin MEASUREMENT HARD_bDio_CAN4_EN "HARD_bDio_CAN4_EN" UBYTE Bool_ON_OFF 1 2 0 1 BIT_MASK 0x01 ECU_ADDRESS 0x700220A6 /end MEASUREMENT
/begin MEASUREMENT HARD_bDio_ENA_DO_P "HARD_bDio_ENA_DO_P" UBYTE Bool_ON_OFF 1 2 0 1 BIT_MASK 0x01 ECU_ADDRESS 0x700220AB /end MEASUREMENT
/begin MEASUREMENT HARD_bDio_ENA_PWM_OE_H "HARD_bDio_ENA_PWM_OE_H" UBYTE Bool_ON_OFF 1 2 0 1 BIT_MASK 0x01 ECU_ADDRESS 0x700220A4 /end MEASUREMENT
/begin MEASUREMENT HARD_bDio_ENA_PWM_OE_L "HARD_bDio_ENA_PWM_OE_L" UBYTE Bool_ON_OFF 1 2 0 1 BIT_MASK 0x01 ECU_ADDRESS 0x700220A3 /end MEASUREMENT
/begin MEASUREMENT HARD_bDio_F_AN_ENABLE_ASC "HARD_bDio_F_AN_ENABLE_ASC" UBYTE Bool_ON_OFF 1 2 0 1 BIT_MASK 0x01 ECU_ADDRESS 0x700220AF /end MEASUREMENT
/begin MEASUREMENT HARD_bDio_F_ENA_PWM_H "HARD_bDio_F_ENA_PWM_H" UBYTE Bool_ON_OFF 1 2 0 1 BIT_MASK 0x01 ECU_ADDRESS 0x70022099 /end MEASUREMENT
/begin MEASUREMENT HARD_bDio_F_ENA_PWM_L "HARD_bDio_F_ENA_PWM_L" UBYTE Bool_ON_OFF 1 2 0 1 BIT_MASK 0x01 ECU_ADDRESS 0x70022096 /end MEASUREMENT
/begin MEASUREMENT HARD_bDio_F_FAULT_DRV_LS_N_MCU "HARD_bDio_F_FAULT_DRV_LS_N_MCU" UBYTE Bool_ON_OFF 1 2 0 1 BIT_MASK 0x01 ECU_ADDRESS 0x700220AC /end MEASUREMENT
/begin MEASUREMENT HARD_bDio_ISO_EN1 "HARD_bDio_ISO_EN1" UBYTE Bool_ON_OFF 1 2 0 1 BIT_MASK 0x01 ECU_ADDRESS 0x7002209C /end MEASUREMENT
/begin MEASUREMENT HARD_bDio_ISO_EN2 "HARD_bDio_ISO_EN2" UBYTE Bool_ON_OFF 1 2 0 1 BIT_MASK 0x01 ECU_ADDRESS 0x7002209D /end MEASUREMENT
/begin MEASUREMENT HARD_bDio_ISO_EN3 "HARD_bDio_ISO_EN3" UBYTE Bool_ON_OFF 1 2 0 1 BIT_MASK 0x01 ECU_ADDRESS 0x7002209E /end MEASUREMENT
/begin MEASUREMENT HARD_bDio_ISO_IO "HARD_bDio_ISO_IO" UBYTE Bool_ON_OFF 1 2 0 1 BIT_MASK 0x01 ECU_ADDRESS 0x700220A9 /end MEASUREMENT
/begin MEASUREMENT HARD_bDio_KM10_DSP "HARD_bDio_KM10_DSP" UBYTE Bool_ON_OFF 1 2 0 1 BIT_MASK 0x01 ECU_ADDRESS 0x7002207F /end MEASUREMENT
/begin MEASUREMENT HARD_bDio_KM11_DSP "HARD_bDio_KM11_DSP" UBYTE Bool_ON_OFF 1 2 0 1 BIT_MASK 0x01 ECU_ADDRESS 0x7002208C /end MEASUREMENT
/begin MEASUREMENT HARD_bDio_KM12_DSP "HARD_bDio_KM12_DSP" UBYTE Bool_ON_OFF 1 2 0 1 BIT_MASK 0x01 ECU_ADDRESS 0x7002208D /end MEASUREMENT
/begin MEASUREMENT HARD_bDio_KM13_DSP "HARD_bDio_KM13_DSP" UBYTE Bool_ON_OFF 1 2 0 1 BIT_MASK 0x01 ECU_ADDRESS 0x70022080 /end MEASUREMENT
/begin MEASUREMENT HARD_bDio_KM16_DSP "HARD_bDio_KM16_DSP" UBYTE Bool_ON_OFF 1 2 0 1 BIT_MASK 0x01 ECU_ADDRESS 0x70022091 /end MEASUREMENT
/begin MEASUREMENT HARD_bDio_KM1_DSP "HARD_bDio_KM1_DSP" UBYTE Bool_ON_OFF 1 2 0 1 BIT_MASK 0x01 ECU_ADDRESS 0x7002207A /end MEASUREMENT
/begin MEASUREMENT HARD_bDio_KM2_DSP "HARD_bDio_KM2_DSP" UBYTE Bool_ON_OFF 1 2 0 1 BIT_MASK 0x01 ECU_ADDRESS 0x70022079 /end MEASUREMENT
/begin MEASUREMENT HARD_bDio_KM3_DSP "HARD_bDio_KM3_DSP" UBYTE Bool_ON_OFF 1 2 0 1 BIT_MASK 0x01 ECU_ADDRESS 0x70022078 /end MEASUREMENT
/begin MEASUREMENT HARD_bDio_KM4_DSP "HARD_bDio_KM4_DSP" UBYTE Bool_ON_OFF 1 2 0 1 BIT_MASK 0x01 ECU_ADDRESS 0x70022077 /end MEASUREMENT
/begin MEASUREMENT HARD_bDio_KM5_DSP "HARD_bDio_KM5_DSP" UBYTE Bool_ON_OFF 1 2 0 1 BIT_MASK 0x01 ECU_ADDRESS 0x70022076 /end MEASUREMENT
/begin MEASUREMENT HARD_bDio_KM6_DSP "HARD_bDio_KM6_DSP" UBYTE Bool_ON_OFF 1 2 0 1 BIT_MASK 0x01 ECU_ADDRESS 0x70022074 /end MEASUREMENT
/begin MEASUREMENT HARD_bDio_KM7_DSP "HARD_bDio_KM7_DSP" UBYTE Bool_ON_OFF 1 2 0 1 BIT_MASK 0x01 ECU_ADDRESS 0x7002207C /end MEASUREMENT
/begin MEASUREMENT HARD_bDio_KM8_DSP "HARD_bDio_KM8_DSP" UBYTE Bool_ON_OFF 1 2 0 1 BIT_MASK 0x01 ECU_ADDRESS 0x7002207B /end MEASUREMENT
/begin MEASUREMENT HARD_bDio_KM9_DSP "HARD_bDio_KM9_DSP" UBYTE Bool_ON_OFF 1 2 0 1 BIT_MASK 0x01 ECU_ADDRESS 0x7002208B /end MEASUREMENT
/begin MEASUREMENT HARD_bDio_MCU_ASC_STATE "HARD_bDio_MCU_ASC_STATE" UBYTE Bool_ON_OFF 1 2 0 1 BIT_MASK 0x01 ECU_ADDRESS 0x70022094 /end MEASUREMENT
/begin MEASUREMENT HARD_bDio_MDO_KEY3 "HARD_bDio_MDO_KEY3" UBYTE Bool_ON_OFF 1 2 0 1 BIT_MASK 0x01 ECU_ADDRESS 0x7002209F /end MEASUREMENT
/begin MEASUREMENT HARD_bDio_M_AN_ENABLE_ASC "HARD_bDio_M_AN_ENABLE_ASC" UBYTE Bool_ON_OFF 1 2 0 1 BIT_MASK 0x01 ECU_ADDRESS 0x700220AE /end MEASUREMENT
/begin MEASUREMENT HARD_bDio_M_CLK_HS "HARD_bDio_M_CLK_HS" UBYTE Bool_ON_OFF 1 2 0 1 BIT_MASK 0x01 ECU_ADDRESS 0x7002209A /end MEASUREMENT
/begin MEASUREMENT HARD_bDio_M_CLK_LS "HARD_bDio_M_CLK_LS" UBYTE Bool_ON_OFF 1 2 0 1 BIT_MASK 0x01 ECU_ADDRESS 0x70022098 /end MEASUREMENT
/begin MEASUREMENT HARD_bDio_M_DBG_4 "HARD_bDio_M_DBG_4" UBYTE Bool_ON_OFF 1 2 0 1 BIT_MASK 0x01 ECU_ADDRESS 0x700220A7 /end MEASUREMENT
/begin MEASUREMENT HARD_bDio_M_DI "HARD_bDio_M_DI" UBYTE Bool_ON_OFF 1 2 0 1 BIT_MASK 0x01 ECU_ADDRESS 0x7002207E /end MEASUREMENT
/begin MEASUREMENT HARD_bDio_M_DX1_A "HARD_bDio_M_DX1_A" UBYTE Bool_ON_OFF 1 2 0 1 BIT_MASK 0x01 ECU_ADDRESS 0x70022082 /end MEASUREMENT
/begin MEASUREMENT HARD_bDio_M_DX1_B "HARD_bDio_M_DX1_B" UBYTE Bool_ON_OFF 1 2 0 1 BIT_MASK 0x01 ECU_ADDRESS 0x70022083 /end MEASUREMENT
/begin MEASUREMENT HARD_bDio_M_DX1_C "HARD_bDio_M_DX1_C" UBYTE Bool_ON_OFF 1 2 0 1 BIT_MASK 0x01 ECU_ADDRESS 0x70022084 /end MEASUREMENT
/begin MEASUREMENT HARD_bDio_M_EXCITATION_IN_1 "HARD_bDio_M_EXCITATION_IN_1" UBYTE Bool_ON_OFF 1 2 0 1 BIT_MASK 0x01 ECU_ADDRESS 0x7002208E /end MEASUREMENT
/begin MEASUREMENT HARD_bDio_M_FAULT_DRV_HS_N "HARD_bDio_M_FAULT_DRV_HS_N" UBYTE Bool_ON_OFF 1 2 0 1 BIT_MASK 0x01 ECU_ADDRESS 0x70022092 /end MEASUREMENT
/begin MEASUREMENT HARD_bDio_M_FAULT_DRV_LS_N "HARD_bDio_M_FAULT_DRV_LS_N" UBYTE Bool_ON_OFF 1 2 0 1 BIT_MASK 0x01 ECU_ADDRESS 0x70022093 /end MEASUREMENT
/begin MEASUREMENT HARD_bDio_M_FAULT_HS "HARD_bDio_M_FAULT_HS" UBYTE Bool_ON_OFF 1 2 0 1 BIT_MASK 0x01 ECU_ADDRESS 0x70022095 /end MEASUREMENT
/begin MEASUREMENT HARD_bDio_M_FAULT_LS "HARD_bDio_M_FAULT_LS" UBYTE Bool_ON_OFF 1 2 0 1 BIT_MASK 0x01 ECU_ADDRESS 0x70022097 /end MEASUREMENT
/begin MEASUREMENT HARD_bDio_M_KEY_ON "HARD_bDio_M_KEY_ON" UBYTE Bool_ON_OFF 1 2 0 1 BIT_MASK 0x01 ECU_ADDRESS 0x7002207D /end MEASUREMENT
/begin MEASUREMENT HARD_bDio_M_LED_R1 "HARD_bDio_M_LED_R1" UBYTE Bool_ON_OFF 1 2 0 1 BIT_MASK 0x01 ECU_ADDRESS 0x70022075 /end MEASUREMENT
/begin MEASUREMENT HARD_bDio_M_PW_DOWN "HARD_bDio_M_PW_DOWN" UBYTE Bool_ON_OFF 1 2 0 1 BIT_MASK 0x01 ECU_ADDRESS 0x700220A1 /end MEASUREMENT
/begin MEASUREMENT HARD_bDio_M_SYNCHRO_POS "HARD_bDio_M_SYNCHRO_POS" UBYTE Bool_ON_OFF 1 2 0 1 BIT_MASK 0x01 ECU_ADDRESS 0x7002208F /end MEASUREMENT
/begin MEASUREMENT HARD_bDio_NTC100_30_EN1 "HARD_bDio_NTC100_30_EN1" UBYTE Bool_ON_OFF 1 2 0 1 BIT_MASK 0x01 ECU_ADDRESS 0x700220A0 /end MEASUREMENT
/begin MEASUREMENT HARD_bDio_NTC100_30_EN2 "HARD_bDio_NTC100_30_EN2" UBYTE Bool_ON_OFF 1 2 0 1 BIT_MASK 0x01 ECU_ADDRESS 0x7002208A /end MEASUREMENT
/begin MEASUREMENT HARD_bDio_NTC100_30_EN3 "HARD_bDio_NTC100_30_EN3" UBYTE Bool_ON_OFF 1 2 0 1 BIT_MASK 0x01 ECU_ADDRESS 0x70022088 /end MEASUREMENT
/begin MEASUREMENT HARD_bDio_NTC10_EN1 "HARD_bDio_NTC10_EN1" UBYTE Bool_ON_OFF 1 2 0 1 BIT_MASK 0x01 ECU_ADDRESS 0x700220AA /end MEASUREMENT
/begin MEASUREMENT HARD_bDio_NTC10_EN2 "HARD_bDio_NTC10_EN2" UBYTE Bool_ON_OFF 1 2 0 1 BIT_MASK 0x01 ECU_ADDRESS 0x7002209B /end MEASUREMENT
/begin MEASUREMENT HARD_bDio_NTC10_EN3 "HARD_bDio_NTC10_EN3" UBYTE Bool_ON_OFF 1 2 0 1 BIT_MASK 0x01 ECU_ADDRESS 0x70022089 /end MEASUREMENT
/begin MEASUREMENT HARD_bDio_PT1000_EN1 "HARD_bDio_PT1000_EN1" UBYTE Bool_ON_OFF 1 2 0 1 BIT_MASK 0x01 ECU_ADDRESS 0x700220A2 /end MEASUREMENT
/begin MEASUREMENT HARD_bDio_PT1000_EN2 "HARD_bDio_PT1000_EN2" UBYTE Bool_ON_OFF 1 2 0 1 BIT_MASK 0x01 ECU_ADDRESS 0x70022086 /end MEASUREMENT
/begin MEASUREMENT HARD_bDio_PT1000_EN3 "HARD_bDio_PT1000_EN3" UBYTE Bool_ON_OFF 1 2 0 1 BIT_MASK 0x01 ECU_ADDRESS 0x70022087 /end MEASUREMENT
/begin MEASUREMENT HARD_bDio_PT100_EN1 "HARD_bDio_PT100_EN1" UBYTE Bool_ON_OFF 1 2 0 1 BIT_MASK 0x01 ECU_ADDRESS 0x700220A5 /end MEASUREMENT
/begin MEASUREMENT HARD_bDio_PT100_EN2 "HARD_bDio_PT100_EN2" UBYTE Bool_ON_OFF 1 2 0 1 BIT_MASK 0x01 ECU_ADDRESS 0x70022085 /end MEASUREMENT
/begin MEASUREMENT HARD_bDio_PT100_EN3 "HARD_bDio_PT100_EN3" UBYTE Bool_ON_OFF 1 2 0 1 BIT_MASK 0x01 ECU_ADDRESS 0x70022081 /end MEASUREMENT
/begin MEASUREMENT HARD_bESMCmdFtShutdownReq "HARD_bESMCmdFtShutdownReq" UBYTE Bool_ON_OFF 1 2 0 1 BIT_MASK 0x01 ECU_ADDRESS 0x70022029 /end MEASUREMENT
/begin MEASUREMENT HARD_bESMCmdFtShutdownRes "HARD_bESMCmdFtShutdownRes" UBYTE Bool_ON_OFF 1 2 0 1 BIT_MASK 0x01 ECU_ADDRESS 0x70022028 /end MEASUREMENT
/begin MEASUREMENT HARD_bESMCmdFtStartReq "HARD_bESMCmdFtStartReq" UBYTE Bool_ON_OFF 1 2 0 1 BIT_MASK 0x01 ECU_ADDRESS 0x70022027 /end MEASUREMENT
/begin MEASUREMENT HARD_bESMCmdFtStartRes "HARD_bESMCmdFtStartRes" UBYTE Bool_ON_OFF 1 2 0 1 BIT_MASK 0x01 ECU_ADDRESS 0x70022026 /end MEASUREMENT
/begin MEASUREMENT HARD_bESMCmdPwmDirectReq "HARD_bESMCmdPwmDirectReq" UBYTE Bool_ON_OFF 1 2 0 1 BIT_MASK 0x01 ECU_ADDRESS 0x70022025 /end MEASUREMENT
/begin MEASUREMENT HARD_bESMCmdPwmDirectRes "HARD_bESMCmdPwmDirectRes" UBYTE Bool_ON_OFF 1 2 0 1 BIT_MASK 0x01 ECU_ADDRESS 0x70022024 /end MEASUREMENT
/begin MEASUREMENT HARD_bESMCmdPwmHardReq "HARD_bESMCmdPwmHardReq" UBYTE Bool_ON_OFF 1 2 0 1 BIT_MASK 0x01 ECU_ADDRESS 0x70022023 /end MEASUREMENT
/begin MEASUREMENT HARD_bESMCmdPwmHardRes "HARD_bESMCmdPwmHardRes" UBYTE Bool_ON_OFF 1 2 0 1 BIT_MASK 0x01 ECU_ADDRESS 0x70022022 /end MEASUREMENT
/begin MEASUREMENT HARD_bESMCmdPwmOffReq "HARD_bESMCmdPwmOffReq" UBYTE Bool_ON_OFF 1 2 0 1 BIT_MASK 0x01 ECU_ADDRESS 0x70022021 /end MEASUREMENT
/begin MEASUREMENT HARD_bESMCmdPwmOffRes "HARD_bESMCmdPwmOffRes" UBYTE Bool_ON_OFF 1 2 0 1 BIT_MASK 0x01 ECU_ADDRESS 0x70022020 /end MEASUREMENT
/begin MEASUREMENT HARD_bESMCmdSwShutdownReq "HARD_bESMCmdSwShutdownReq" UBYTE Bool_ON_OFF 1 2 0 1 BIT_MASK 0x01 ECU_ADDRESS 0x7002201F /end MEASUREMENT
/begin MEASUREMENT HARD_bESMCmdSwShutdownRes "HARD_bESMCmdSwShutdownRes" UBYTE Bool_ON_OFF 1 2 0 1 BIT_MASK 0x01 ECU_ADDRESS 0x7002201E /end MEASUREMENT
/begin MEASUREMENT HARD_bESMCmdSwStartReq "HARD_bESMCmdSwStartReq" UBYTE Bool_ON_OFF 1 2 0 1 BIT_MASK 0x01 ECU_ADDRESS 0x7002201D /end MEASUREMENT
/begin MEASUREMENT HARD_bESMCmdSwStartRes "HARD_bESMCmdSwStartRes" UBYTE Bool_ON_OFF 1 2 0 1 BIT_MASK 0x01 ECU_ADDRESS 0x7002201C /end MEASUREMENT
/begin MEASUREMENT HARD_bModSeq1FuncOn "Mode fonctionnel Hard mode #1: Functional stage: Test CEM traction (20/10/2015)" UBYTE Bool_ON_OFF 1 2 0 1 BIT_MASK 0x01 ECU_ADDRESS 0x7002201B /end MEASUREMENT
/begin MEASUREMENT HARD_bModSeq1InitOn "Mode fonctionnel Hard mode #1: Initialization stage : Test CEM traction (20/10/2015)" UBYTE Bool_ON_OFF 1 2 0 1 BIT_MASK 0x01 ECU_ADDRESS 0x7002201A /end MEASUREMENT
/begin MEASUREMENT HARD_bModSeq2FuncOn "Mode fonctionnel Hard mode #2: Functional stage: Test xx (xx/xx/xxxx)" UBYTE Bool_ON_OFF 1 2 0 1 BIT_MASK 0x01 ECU_ADDRESS 0x70022019 /end MEASUREMENT
/begin MEASUREMENT HARD_bModSeq2InitOn "Mode fonctionnel Hard mode #2: Initialization stage : Test xx (xx/xx/xxxx)" UBYTE Bool_ON_OFF 1 2 0 1 BIT_MASK 0x01 ECU_ADDRESS 0x70022018 /end MEASUREMENT
/begin MEASUREMENT HARD_bNMTestOn "Nm Test on" UBYTE Bool_ON_OFF 1 2 0 1 BIT_MASK 0x01 ECU_ADDRESS 0x70022016 /end MEASUREMENT
/begin MEASUREMENT HARD_bNmRxRepeatMsgReq "Nm Test on" UBYTE Bool_ON_OFF 1 2 0 1 BIT_MASK 0x01 ECU_ADDRESS 0x70022017 /end MEASUREMENT
/begin MEASUREMENT HARD_bNmTxRepeatMsgReq "Nm Test on" UBYTE Bool_ON_OFF 1 2 0 1 BIT_MASK 0x01 ECU_ADDRESS 0x70022015 /end MEASUREMENT
/begin MEASUREMENT HARD_bPtgEnable "HARD_bPtgEnable" UBYTE Bool_ON_OFF 1 2 0 1 BIT_MASK 0x01 ECU_ADDRESS 0x70022014 /end MEASUREMENT
/begin MEASUREMENT HARD_bPtgSignalsShiftControl "HARD_bPtgSignalsShiftControl" UBYTE Bool_ON_OFF 1 2 0 1 BIT_MASK 0x01 ECU_ADDRESS 0x70022013 /end MEASUREMENT
/begin MEASUREMENT HARD_bPtgUSignalEnable "HARD_bPtgUSignalEnable" UBYTE Bool_ON_OFF 1 2 0 1 BIT_MASK 0x01 ECU_ADDRESS 0x70022012 /end MEASUREMENT
/begin MEASUREMENT HARD_bPtgVSignalEnable "HARD_bPtgVSignalEnable" UBYTE Bool_ON_OFF 1 2 0 1 BIT_MASK 0x01 ECU_ADDRESS 0x70022011 /end MEASUREMENT
/begin MEASUREMENT HARD_bPtgWSignalEnable "HARD_bPtgWSignalEnable" UBYTE Bool_ON_OFF 1 2 0 1 BIT_MASK 0x01 ECU_ADDRESS 0x70022010 /end MEASUREMENT
/begin MEASUREMENT HARD_f32Icu_F_AN_VOL_DCLINK_DRV "HARD_f32Icu_F_AN_VOL_DCLINK_DRV" FLOAT32_IEEE I_1 1 2 -3.402823466E+038 3.402823466E+038 ECU_ADDRESS 0x70021FC8 /end MEASUREMENT
/begin MEASUREMENT HARD_f32Icu_F_TEMP_U "HARD_f32Icu_F_TEMP_U" FLOAT32_IEEE I_1 1 2 -3.402823466E+038 3.402823466E+038 ECU_ADDRESS 0x70021FD0 /end MEASUREMENT
/begin MEASUREMENT HARD_f32Icu_F_TEMP_V "HARD_f32Icu_F_TEMP_V" FLOAT32_IEEE I_1 1 2 -3.402823466E+038 3.402823466E+038 ECU_ADDRESS 0x70021FCC /end MEASUREMENT
/begin MEASUREMENT HARD_s16PtgRefSignalValue "HARD_s16PtgRefSignalValue" SWORD I_1 1 2 -32768 32767 ECU_ADDRESS 0x70021FEA /end MEASUREMENT
/begin MEASUREMENT HARD_s16PtgUSignalValue "HARD_s16PtgUSignalValue" SWORD I_1 1 2 -32768 32767 ECU_ADDRESS 0x70021FE8 /end MEASUREMENT
/begin MEASUREMENT HARD_s16PtgVSignalValue "HARD_s16PtgVSignalValue" SWORD I_1 1 2 -32768 32767 ECU_ADDRESS 0x70021FE6 /end MEASUREMENT
/begin MEASUREMENT HARD_s16PtgWSignalValue "HARD_s16PtgWSignalValue" SWORD I_1 1 2 -32768 32767 ECU_ADDRESS 0x70021FE4 /end MEASUREMENT
/begin MEASUREMENT HARD_u16Adc0An10_CTN_BOARD2Phys "HARD_u16Adc0An10_CTN_BOARD2Phys" UBYTE F_1_m40_33 1 2 -40 215 ECU_ADDRESS 0x7002200C /end MEASUREMENT
/begin MEASUREMENT HARD_u16Adc_15V_COM "HARD_u16Adc_15V_COM" UWORD I_1 1 2 0 65535 ECU_ADDRESS 0x70022034 /end MEASUREMENT
/begin MEASUREMENT HARD_u16Adc_AN_CTN_BOARD1 "HARD_u16Adc_AN_CTN_BOARD1" UWORD I_1 1 2 0 65535 ECU_ADDRESS 0x70022072 /end MEASUREMENT
/begin MEASUREMENT HARD_u16Adc_AN_DIAG_COS_H1 "HARD_u16Adc_AN_DIAG_COS_H1" UWORD I_1 1 2 0 65535 ECU_ADDRESS 0x7002205C /end MEASUREMENT
/begin MEASUREMENT HARD_u16Adc_AN_DIAG_COS_L1 "HARD_u16Adc_AN_DIAG_COS_L1" UWORD I_1 1 2 0 65535 ECU_ADDRESS 0x7002205E /end MEASUREMENT
/begin MEASUREMENT HARD_u16Adc_AN_DIAG_SIN_H1 "HARD_u16Adc_AN_DIAG_SIN_H1" UWORD I_1 1 2 0 65535 ECU_ADDRESS 0x70022060 /end MEASUREMENT
/begin MEASUREMENT HARD_u16Adc_AN_DIAG_SIN_L1 "HARD_u16Adc_AN_DIAG_SIN_L1" UWORD I_1 1 2 0 65535 ECU_ADDRESS 0x70022066 /end MEASUREMENT
/begin MEASUREMENT HARD_u16Adc_AN_MUX1 "HARD_u16Adc_AN_MUX1" UWORD I_1 1 2 0 65535 ECU_ADDRESS 0x70022062 /end MEASUREMENT
/begin MEASUREMENT HARD_u16Adc_AN_P12V_BATT "HARD_u16Adc_AN_P12V_BATT" UWORD I_1 1 2 0 65535 ECU_ADDRESS 0x70022048 /end MEASUREMENT
/begin MEASUREMENT HARD_u16Adc_AN_PSU_P5V_HS "HARD_u16Adc_AN_PSU_P5V_HS" UWORD I_1 1 2 0 65535 ECU_ADDRESS 0x7002206A /end MEASUREMENT
/begin MEASUREMENT HARD_u16Adc_AN_VOL_DCLINK_DRV "HARD_u16Adc_AN_VOL_DCLINK_DRV" UWORD I_1 1 2 0 65535 ECU_ADDRESS 0x7002206E /end MEASUREMENT
/begin MEASUREMENT HARD_u16Adc_DCS_AD "HARD_u16Adc_DCS_AD" UWORD I_1 1 2 0 65535 ECU_ADDRESS 0x70022030 /end MEASUREMENT
/begin MEASUREMENT HARD_u16Adc_DJR_AD "HARD_u16Adc_DJR_AD" UWORD I_1 1 2 0 65535 ECU_ADDRESS 0x70022042 /end MEASUREMENT
/begin MEASUREMENT HARD_u16Adc_F_CURRENT_U "HARD_u16Adc_F_CURRENT_U" UWORD I_1 1 2 0 65535 ECU_ADDRESS 0x70022050 /end MEASUREMENT
/begin MEASUREMENT HARD_u16Adc_F_CURRENT_V "HARD_u16Adc_F_CURRENT_V" UWORD I_1 1 2 0 65535 ECU_ADDRESS 0x70022052 /end MEASUREMENT
/begin MEASUREMENT HARD_u16Adc_F_CURRENT_W "HARD_u16Adc_F_CURRENT_W" UWORD I_1 1 2 0 65535 ECU_ADDRESS 0x70022054 /end MEASUREMENT
/begin MEASUREMENT HARD_u16Adc_F_PT_NTC_AD3 "HARD_u16Adc_F_PT_NTC_AD3" UWORD I_1 1 2 0 65535 ECU_ADDRESS 0x7002204A /end MEASUREMENT
/begin MEASUREMENT HARD_u16Adc_KM13_FB "HARD_u16Adc_KM13_FB" UWORD I_1 1 2 0 65535 ECU_ADDRESS 0x7002205A /end MEASUREMENT
/begin MEASUREMENT HARD_u16Adc_KM15_FB "HARD_u16Adc_KM15_FB" UWORD I_1 1 2 0 65535 ECU_ADDRESS 0x70022038 /end MEASUREMENT
/begin MEASUREMENT HARD_u16Adc_KM18_FB "HARD_u16Adc_KM18_FB" UWORD I_1 1 2 0 65535 ECU_ADDRESS 0x70022036 /end MEASUREMENT
/begin MEASUREMENT HARD_u16Adc_KM_FB "HARD_u16Adc_KM_FB" UWORD I_1 1 2 0 65535 ECU_ADDRESS 0x70022070 /end MEASUREMENT
/begin MEASUREMENT HARD_u16Adc_MOT_COS1 "HARD_u16Adc_MOT_COS1" UWORD I_1 1 2 0 65535 ECU_ADDRESS 0x7002202A /end MEASUREMENT
/begin MEASUREMENT HARD_u16Adc_MOT_SIN1 "HARD_u16Adc_MOT_SIN1" UWORD I_1 1 2 0 65535 ECU_ADDRESS 0x7002202C /end MEASUREMENT
/begin MEASUREMENT HARD_u16Adc_M_AN_T_IGBT_U "HARD_u16Adc_M_AN_T_IGBT_U" UWORD I_1 1 2 0 65535 ECU_ADDRESS 0x70022068 /end MEASUREMENT
/begin MEASUREMENT HARD_u16Adc_M_AN_T_IGBT_V "HARD_u16Adc_M_AN_T_IGBT_V" UWORD I_1 1 2 0 65535 ECU_ADDRESS 0x70022064 /end MEASUREMENT
/begin MEASUREMENT HARD_u16Adc_M_AN_T_IGBT_W "HARD_u16Adc_M_AN_T_IGBT_W" UWORD I_1 1 2 0 65535 ECU_ADDRESS 0x70022058 /end MEASUREMENT
/begin MEASUREMENT HARD_u16Adc_M_CURRENT_U "HARD_u16Adc_M_CURRENT_U" UWORD I_1 1 2 0 65535 ECU_ADDRESS 0x7002203A /end MEASUREMENT
/begin MEASUREMENT HARD_u16Adc_M_CURRENT_V "HARD_u16Adc_M_CURRENT_V" UWORD I_1 1 2 0 65535 ECU_ADDRESS 0x7002203C /end MEASUREMENT
/begin MEASUREMENT HARD_u16Adc_M_CURRENT_W "HARD_u16Adc_M_CURRENT_W" UWORD I_1 1 2 0 65535 ECU_ADDRESS 0x7002203E /end MEASUREMENT
/begin MEASUREMENT HARD_u16Adc_M_INTLOC1 "HARD_u16Adc_M_INTLOC1" UWORD I_1 1 2 0 65535 ECU_ADDRESS 0x70022046 /end MEASUREMENT
/begin MEASUREMENT HARD_u16Adc_M_INTLOC2 "HARD_u16Adc_M_INTLOC2" UWORD I_1 1 2 0 65535 ECU_ADDRESS 0x70022044 /end MEASUREMENT
/begin MEASUREMENT HARD_u16Adc_M_INTLOC3 "HARD_u16Adc_M_INTLOC3" UWORD I_1 1 2 0 65535 ECU_ADDRESS 0x7002206C /end MEASUREMENT
/begin MEASUREMENT HARD_u16Adc_M_PT_NTC_AD1 "HARD_u16Adc_M_PT_NTC_AD1" UWORD I_1 1 2 0 65535 ECU_ADDRESS 0x70022040 /end MEASUREMENT
/begin MEASUREMENT HARD_u16Adc_M_PT_NTC_AD2 "HARD_u16Adc_M_PT_NTC_AD2" UWORD I_1 1 2 0 65535 ECU_ADDRESS 0x70022032 /end MEASUREMENT
/begin MEASUREMENT HARD_u16Adc_P5V_HS_REF "HARD_u16Adc_P5V_HS_REF" UWORD I_1 1 2 0 65535 ECU_ADDRESS 0x7002204C /end MEASUREMENT
/begin MEASUREMENT HARD_u16Adc_P5V_LS_REF "HARD_u16Adc_P5V_LS_REF" UWORD I_1 1 2 0 65535 ECU_ADDRESS 0x7002204E /end MEASUREMENT
/begin MEASUREMENT HARD_u16Adc_PSU_P5V_LS "HARD_u16Adc_PSU_P5V_LS" UWORD I_1 1 2 0 65535 ECU_ADDRESS 0x70022056 /end MEASUREMENT
/begin MEASUREMENT HARD_u16PtgRefSignalNbPeriode "HARD_u16PtgRefSignalNbPeriode" UWORD I_1 1 2 0 65535 ECU_ADDRESS 0x70021FE2 /end MEASUREMENT
/begin MEASUREMENT HARD_u16PtgRefSignalTime "HARD_u16PtgRefSignalTime" UWORD I_1 1 2 0 65535 ECU_ADDRESS 0x70021FE0 /end MEASUREMENT
/begin MEASUREMENT HARD_u16PtgUSignalNbPeriode "HARD_u16PtgUSignalNbPeriode" UWORD I_1 1 2 0 65535 ECU_ADDRESS 0x70021FDE /end MEASUREMENT
/begin MEASUREMENT HARD_u16PtgUSignalTime "HARD_u16PtgUSignalTime" UWORD I_1 1 2 0 65535 ECU_ADDRESS 0x70021FDC /end MEASUREMENT
/begin MEASUREMENT HARD_u16PtgVSignalNbPeriode "HARD_u16PtgVSignalNbPeriode" UWORD I_1 1 2 0 65535 ECU_ADDRESS 0x70021FDA /end MEASUREMENT
/begin MEASUREMENT HARD_u16PtgVSignalTime "HARD_u16PtgVSignalTime" UWORD I_1 1 2 0 65535 ECU_ADDRESS 0x70021FD8 /end MEASUREMENT
/begin MEASUREMENT HARD_u16PtgWSignalNbPeriode "HARD_u16PtgWSignalNbPeriode" UWORD I_1 1 2 0 65535 ECU_ADDRESS 0x70021FD6 /end MEASUREMENT
/begin MEASUREMENT HARD_u16PtgWSignalTime "HARD_u16PtgWSignalTime" UWORD I_1 1 2 0 65535 ECU_ADDRESS 0x70021FD4 /end MEASUREMENT
/begin MEASUREMENT HARD_u8CanIfCtrlMode "Test Number of Nm Test" UBYTE I_1 1 2 0 255 ECU_ADDRESS 0x7002200B /end MEASUREMENT
/begin MEASUREMENT HARD_u8CanIfCtrlModeReq "Test Number of Nm Test" UBYTE I_1 1 2 0 255 ECU_ADDRESS 0x7002200A /end MEASUREMENT
/begin MEASUREMENT HARD_u8CanIfPduMode "Test Number of Nm Test" UBYTE I_1 1 2 0 255 ECU_ADDRESS 0x70022009 /end MEASUREMENT
/begin MEASUREMENT HARD_u8CanIfPduModeReq "Test Number of Nm Test" UBYTE I_1 1 2 0 255 ECU_ADDRESS 0x70022008 /end MEASUREMENT
/begin MEASUREMENT HARD_u8CanNmLocalNodeId "Test Number of Nm Test" UBYTE I_1 1 2 0 255 ECU_ADDRESS 0x70022007 /end MEASUREMENT
/begin MEASUREMENT HARD_u8CanNmMode "Test Number of Nm Test" UBYTE I_1 1 2 0 255 ECU_ADDRESS 0x70022006 /end MEASUREMENT
/begin MEASUREMENT HARD_u8CanNmNodeId "Test Number of Nm Test" UBYTE I_1 1 2 0 255 ECU_ADDRESS 0x70022005 /end MEASUREMENT
/begin MEASUREMENT HARD_u8CanNmState "Test Number of Nm Test" UBYTE I_1 1 2 0 255 ECU_ADDRESS 0x70022004 /end MEASUREMENT
/begin MEASUREMENT HARD_u8CanSmMode "Test Number of Nm Test" UBYTE F_1_p0_5 1 2 0 0 ECU_ADDRESS 0x70022003 /end MEASUREMENT
/begin MEASUREMENT HARD_u8CanSmModeReq "Test Number of Nm Test" UBYTE I_1 1 2 0 255 ECU_ADDRESS 0x70022002 /end MEASUREMENT
/begin MEASUREMENT HARD_u8ComMMode "Test Number of Nm Test" UBYTE I_1 1 2 0 255 ECU_ADDRESS 0x70022001 /end MEASUREMENT
/begin MEASUREMENT HARD_u8ComMState "Test Number of Nm Test" UBYTE I_1 1 2 0 255 ECU_ADDRESS 0x70022000 /end MEASUREMENT
/begin MEASUREMENT HARD_u8ComMStatus "Test Number of Nm Test" UBYTE I_1 1 2 0 255 ECU_ADDRESS 0x70021FFF /end MEASUREMENT
/begin MEASUREMENT HARD_u8NmMode "Test Number of Nm Test" UBYTE I_1 1 2 0 255 ECU_ADDRESS 0x70021FFE /end MEASUREMENT
/begin MEASUREMENT HARD_u8NmState "Test Number of Nm Test" UBYTE I_1 1 2 0 255 ECU_ADDRESS 0x70021FFD /end MEASUREMENT
/begin MEASUREMENT HARD_u8NmTestNum "Test Number of Nm Test" UBYTE I_1 1 2 0 255 ECU_ADDRESS 0x70021FFC /end MEASUREMENT
/begin MEASUREMENT HARD_u8NmUserDataRx "Test Number of Nm Test" UBYTE I_1 1 2 0 255 MATRIX_DIM 6 1 1 ECU_ADDRESS 0x70021FF6 /end MEASUREMENT
/begin MEASUREMENT HARD_u8NmUserDataRx[0] "HARD_u8NmUserDataRx[0]" UBYTE I_1 1 2 0 255 ECU_ADDRESS 0x70021FF6 /end MEASUREMENT
/begin MEASUREMENT HARD_u8NmUserDataRx[1] "HARD_u8NmUserDataRx[1]" UBYTE I_1 1 2 0 255 ECU_ADDRESS 0x70021FF7 /end MEASUREMENT
/begin MEASUREMENT HARD_u8NmUserDataRx[2] "HARD_u8NmUserDataRx[2]" UBYTE I_1 1 2 0 255 ECU_ADDRESS 0x70021FF8 /end MEASUREMENT
/begin MEASUREMENT HARD_u8NmUserDataRx[3] "HARD_u8NmUserDataRx[3]" UBYTE I_1 1 2 0 255 ECU_ADDRESS 0x70021FF9 /end MEASUREMENT
/begin MEASUREMENT HARD_u8NmUserDataRx[4] "HARD_u8NmUserDataRx[4]" UBYTE I_1 1 2 0 255 ECU_ADDRESS 0x70021FFA /end MEASUREMENT
/begin MEASUREMENT HARD_u8NmUserDataRx[5] "HARD_u8NmUserDataRx[5]" UBYTE I_1 1 2 0 255 ECU_ADDRESS 0x70021FFB /end MEASUREMENT
/begin MEASUREMENT HARD_u8NmUserDataTx "Test Number of Nm Test" UBYTE I_1 1 2 0 255 MATRIX_DIM 6 1 1 ECU_ADDRESS 0x70021FF0 /end MEASUREMENT
/begin MEASUREMENT HARD_u8NmUserDataTx[0] "HARD_u8NmUserDataTx[0]" UBYTE I_1 1 2 0 255 ECU_ADDRESS 0x70021FF0 /end MEASUREMENT
/begin MEASUREMENT HARD_u8NmUserDataTx[1] "HARD_u8NmUserDataTx[1]" UBYTE I_1 1 2 0 255 ECU_ADDRESS 0x70021FF1 /end MEASUREMENT
/begin MEASUREMENT HARD_u8NmUserDataTx[2] "HARD_u8NmUserDataTx[2]" UBYTE I_1 1 2 0 255 ECU_ADDRESS 0x70021FF2 /end MEASUREMENT
/begin MEASUREMENT HARD_u8NmUserDataTx[3] "HARD_u8NmUserDataTx[3]" UBYTE I_1 1 2 0 255 ECU_ADDRESS 0x70021FF3 /end MEASUREMENT
/begin MEASUREMENT HARD_u8NmUserDataTx[4] "HARD_u8NmUserDataTx[4]" UBYTE I_1 1 2 0 255 ECU_ADDRESS 0x70021FF4 /end MEASUREMENT
/begin MEASUREMENT HARD_u8NmUserDataTx[5] "HARD_u8NmUserDataTx[5]" UBYTE I_1 1 2 0 255 ECU_ADDRESS 0x70021FF5 /end MEASUREMENT
/begin MEASUREMENT HARD_u8NmWakeupReason "Test Number of Nm Test" UBYTE I_1 1 2 0 255 ECU_ADDRESS 0x70021FEF /end MEASUREMENT
/begin MEASUREMENT HARD_u8VSIRxaTempCtrlBdPhys "Physical value of MAIN_VSIRxaTempCtrlBd" UBYTE F_1_m40_33 1 2 -40 215 ECU_ADDRESS 0x70021FEE /end MEASUREMENT
/begin MEASUREMENT HARD_u8VSIRxaTempDrvBdPhys "Physical value of MAIN_VSIRxaTempDrvBd (MAJ OC140)" UBYTE F_1_m40_33 1 2 -40 215 ECU_ADDRESS 0x70021FED /end MEASUREMENT
/begin MEASUREMENT HARD_u8VSIRxaTempIgbtPhys "Physical value of MAIN_VSIRxaTempIgbt (MAJ OC140)" UBYTE F_1_m40_33 1 2 -40 215 ECU_ADDRESS 0x70021FEC /end MEASUREMENT
/begin MEASUREMENT IOHAL_f32GCUVOLDutyCycle "..." FLOAT32_IEEE F_100_p0_13 1 2 -3.402823466E+038 3.402823466E+038 ECU_ADDRESS 0x700220D4 /end MEASUREMENT
/begin MEASUREMENT IOHAL_f32MCUVOLDutyCycle "..." FLOAT32_IEEE F_100_p0_13 1 2 -3.402823466E+038 3.402823466E+038 ECU_ADDRESS 0x700220D8 /end MEASUREMENT
/begin MEASUREMENT IOHAL_u32MCUVOLPeriod "..." ULONG I_1 1 2 0 4294967295 ECU_ADDRESS 0x700220E4 /end MEASUREMENT
/begin COMPU_METHOD I_1 "" RAT_FUNC "%9.2" "-" COEFFS 0 1 0 0 0 1 /end COMPU_METHOD
/begin COMPU_METHOD I_3 "" RAT_FUNC "%9.2" "V" COEFFS 0 1 0 0 0 1 /end COMPU_METHOD
/begin COMPU_METHOD F_1_p0_5 "" RAT_FUNC "%9.2" "-" COEFFS 0 1 0 0 0 1 /end COMPU_METHOD
/begin COMPU_METHOD F_100_p0_13 "" RAT_FUNC "%9.2" "%" COEFFS 0 1 0 0 0 100 /end COMPU_METHOD
/begin COMPU_METHOD F_1_m20000_29 "" RAT_FUNC "%9.2" "-" COEFFS 0 1 20000 0 0 1 /end COMPU_METHOD
/begin COMPU_METHOD F_0v0030518044_p0_30 "" RAT_FUNC "%9.3" "%" COEFFS 0 1 0 0 0 0.0030518 /end COMPU_METHOD
/begin COMPU_METHOD F_0v0015259022_p0_31 "" RAT_FUNC "%9.3" "%" COEFFS 0 1 0 0 0 0.0015259 /end COMPU_METHOD
/begin COMPU_METHOD D_2_0v01_p0_32 "" RAT_FUNC "%9.2" "%" COEFFS 0 0 1 0 0.01 0 /end COMPU_METHOD
/begin COMPU_METHOD F_1_m40_33 "" RAT_FUNC "%9.2" "ï¿½C" COEFFS 0 1 40 0 0 1 /end COMPU_METHOD
/begin COMPU_METHOD F_0v0000305176_p0_34 "" RAT_FUNC "%9.5" "PI/RAD" COEFFS 0 1 0 0 0 3.05176e-005 /end COMPU_METHOD
/begin COMPU_METHOD Bool_ON_OFF "" TAB_VERB "%8.4" "." COMPU_TAB_REF Bool_ON_OFF_table /end COMPU_METHOD
/begin COMPU_VTAB Bool_ON_OFF_table "" TAB_VERB 2 0 "OFF" 1 "ON" /end COMPU_VTAB
/begin FUNCTION FAULT ""
 /begin DEF_CHARACTERISTIC FaultFSEVETA_UnderTempNTC1CmdBoardInc FaultFSMTMTA_OverTempWdgHead1Dec FaultFSMTMTA_OverTempWdgHead1FailMod FaultFSMTMTA_OverTempWdgHead1Inc FaultFSMTMTA_TempWindHead1OutRngHDec FaultFSMTMTA_TempWindHead1OutRngHFailMod FaultFSMTMTA_TempWindHead1OutRngHInc FaultFSMTMTA_TempWindHead1OutRngLDec FaultFSMTMTA_TempWindHead1OutRngLFailMod FaultFSMTMTA_TempWindHead1OutRngLInc FaultFSMTMTA_TempWindingHead1GndDec FaultFSMTMTA_TempWindingHead1GndFailMod FaultFSMTMTA_TempWindingHead1GndInc FaultFSMTMTA_TempWindingHead1VccDec FaultFSMTMTA_TempWindingHead1VccFailMod FaultFSMTMTA_TempWindingHead1VccInc FaultFSMTMTA_UnderTempWdgHead1Dec FaultFSMTMTA_UnderTempWdgHead1FailMod FaultFSMTMTA_UnderTempWdgHead1Inc FaultFSMTRDG_ExcGenerationDec FaultFSMTRDG_ExcGenerationFailMod FaultFSMTRDG_ExcGenerationInc FaultFSMTRDG_ExcSignalGNDDec FaultFSMTRDG_ExcSignalGNDFailMod FaultFSMTRDG_ExcSignalGNDInc FaultFSMTRDG_ExcSignalVCCDec FaultFSMTRDG_ExcSignalVCCFailMod FaultFSMTRDG_ExcSignalVCCInc FaultFSMTRDG_SinCosHLGndDec FaultFSMTRDG_SinCosHLGndFailMod FaultFSMTRDG_SinCosHLGndInc FaultFSMTRDG_SinCosHLOpenDec FaultFSMTRDG_SinCosHLOpenFailMod FaultFSMTRDG_SinCosHLOpenInc FaultFSMTRDG_SinCosHLVccDec FaultFSMTRDG_SinCosHLVccFailMod FaultFSMTRDG_SinCosHLVccInc FaultFSSMACS_AkdFailFlagDec FaultFSSMACS_AkdFailFlagFailMod FaultFSSMACS_AkdFailFlagInc FaultFTASBDS_BattVoltDeratingActDec FaultFTASBDS_BattVoltDeratingActFailMod FaultFTASBDS_BattVoltDeratingActInc FaultFTASETP_EstPmDeratingActDec FaultFTASETP_EstPmDeratingActFailMod FaultFTASETP_EstPmDeratingActInc FaultFTASETP_PmDeratingActDec FaultFTASETP_PmDeratingActFailMod FaultFTASETP_PmDeratingActInc FaultFTASMTP_Wndg1DeratingActDec FaultFTASMTP_Wndg1DeratingActFailMod FaultFTASMTP_Wndg1DeratingActInc FaultFTASOSP_MotorSpdDeratingActDec FaultFTASOSP_MotorSpdDeratingActFailMod FaultFTASOSP_MotorSpdDeratingActInc FaultFTCMSCS_CtrlSatTimoutDec FaultFTCMSCS_CtrlSatTimoutFailMod FaultFTCMSCS_CtrlSatTimoutInc FaultFTCMSCS_SpdOvershootDec FaultFTCMSCS_SpdOvershootFailMod FaultFTCMSCS_SpdOvershootInc FaultFTCMSCS_ZeroSpeedTimoutDec FaultFTCMSCS_ZeroSpeedTimoutFailMod FaultFTCMSCS_ZeroSpeedTimoutInc FaultFTCMTCS_VoltageMarginLowDec FaultFTCMTCS_VoltageMarginLowFailMod FaultFTCMTCS_VoltageMarginLowInc FaultFTEVEIT_EstOverTempDec FaultFTEVEIT_EstOverTempFailMod FaultFTEVEIT_EstOverTempInc FaultFTMTLCS_CurrentSumErrorDec FaultFTMTLCS_CurrentSumErrorFailMod FaultFTMTLCS_CurrentSumErrorInc FaultFTMTLCS_CurSenrPhaU_GNDDec FaultFTMTLCS_CurSenrPhaU_GNDFailMod FaultFTMTLCS_CurSenrPhaU_GNDInc FaultFTMTLCS_CurSenrPhaU_OutRngHDec FaultFTMTLCS_CurSenrPhaU_OutRngHFailMod FaultFTMTLCS_CurSenrPhaU_OutRngHInc FaultFTMTLCS_CurSenrPhaU_OutRngLDec FaultFTMTLCS_CurSenrPhaU_OutRngLFailMod FaultFTMTLCS_CurSenrPhaU_OutRngLInc FaultFTMTLCS_CurSenrPhaU_VCCDec FaultFTMTLCS_CurSenrPhaU_VCCFailMod FaultFTMTLCS_CurSenrPhaU_VCCInc FaultFTMTLCS_CurSenrPhaV_GNDDec FaultFTMTLCS_CurSenrPhaV_GNDFailMod FaultFTMTLCS_CurSenrPhaV_GNDInc FaultFTMTLCS_CurSenrPhaV_OutRngHDec FaultFTMTLCS_CurSenrPhaV_OutRngHFailMod FaultFTMTLCS_CurSenrPhaV_OutRngHInc FaultFTMTLCS_CurSenrPhaV_OutRngLDec FaultFTMTLCS_CurSenrPhaV_OutRngLFailMod FaultFTMTLCS_CurSenrPhaV_OutRngLInc FaultFTMTLCS_CurSenrPhaV_VCCDec FaultFTMTLCS_CurSenrPhaV_VCCFailMod FaultFTMTLCS_CurSenrPhaV_VCCInc FaultFTMTLCS_CurSenrPhaW_GNDDec FaultFTMTLCS_CurSenrPhaW_GNDFailMod FaultFTMTLCS_CurSenrPhaW_GNDInc FaultFTMTLCS_CurSenrPhaW_OutRngHDec FaultFTMTLCS_CurSenrPhaW_OutRngHFailMod FaultFTMTLCS_CurSenrPhaW_OutRngHInc FaultFTMTLCS_CurSenrPhaW_OutRngLDec FaultFTMTLCS_CurSenrPhaW_OutRngLFailMod FaultFTMTLCS_CurSenrPhaW_OutRngLInc FaultFTMTLCS_CurSenrPhaW_VCCDec FaultFTMTLCS_CurSenrPhaW_VCCFailMod FaultFTMTLCS_CurSenrPhaW_VCCInc FaultSDMTMEP_CosGndDec FaultSDMTMEP_CosGndFailMod FaultSDMTMEP_CosGndInc FaultSDMTMEP_CosOutRangeHighDec FaultSDMTMEP_CosOutRangeHighFailMod FaultSDMTMEP_CosOutRangeHighInc FaultSDMTMEP_CosOutRangeLowDec FaultSDMTMEP_CosOutRangeLowFailMod FaultSDMTMEP_CosOutRangeLowInc FaultSDMTMEP_CosVccDec FaultSDMTMEP_CosVccFailMod FaultSDMTMEP_CosVccInc FaultSDMTMEP_OverSpeedDec FaultSDMTMEP_OverSpeedFailMod FaultSDMTMEP_OverSpeedInc FaultSDMTMEP_ResSquaSumErrByFTDec FaultSDMTMEP_ResSquaSumErrByFTFailMod FaultSDMTMEP_ResSquaSumErrByFTInc FaultSDMTMEP_SinGndDec FaultSDMTMEP_SinGndFailMod FaultSDMTMEP_SinGndInc FaultSDMTMEP_SinOutRangeHighDec FaultSDMTMEP_SinOutRangeHighFailMod FaultSDMTMEP_SinOutRangeHighInc FaultSDMTMEP_SinOutRangeLowDec FaultSDMTMEP_SinOutRangeLowFailMod FaultSDMTMEP_SinOutRangeLowInc FaultSDMTMEP_SinVccDec FaultSDMTMEP_SinVccFailMod FaultSDMTMEP_SinVccInc FaultSDMTMEP_UnderSpeedDec FaultSDMTMEP_UnderSpeedFailMod FaultSDMTMEP_UnderSpeedInc FaultTCUCAP0_CAPPressureHDec FaultTCUCAP0_CAPPressureHFailMod FaultTCUCAP0_CAPPressureHInc FaultTCUCAP0_CAPPressureLDec FaultTCUCAP0_CAPPressureLFailMod FaultTCUCAP0_CAPPressureLInc FaultTCUCAP0_CAPPressureOverHDec FaultTCUCAP0_CAPPressureOverHFailMod FaultTCUCAP0_CAPPressureOverHInc FaultTCUCAP0_CAPSlipDec FaultTCUCAP0_CAPSlipFailMod FaultTCUCAP0_CAPSlipInc FaultTCUCAP0_DragMomentHDec FaultTCUCAP0_DragMomentHFailMod FaultTCUCAP0_DragMomentHInc FaultTCUCAP0_HLSinInvalidDec FaultTCUCAP0_HLSinInvalidFailMod FaultTCUCAP0_HLSinInvalidInc FaultTCUCAP0_HLSinUndefineDec FaultTCUCAP0_HLSinUndefineFailMod FaultTCUCAP0_HLSinUndefineInc FaultTCUCAP0_HLSupplyHDec FaultTCUCAP0_HLSupplyHFailMod FaultTCUCAP0_HLSupplyHInc FaultTCUCAP0_HLSupplyLDec FaultTCUCAP0_HLSupplyLFailMod FaultTCUCAP0_HLSupplyLInc FaultTCUCAP0_MotorPhaseVolHDec FaultTCUCAP0_MotorPhaseVolHFailMod FaultTCUCAP0_MotorPhaseVolHInc FaultTCUCAP0_PressureRationalDec FaultTCUCAP0_PressureRationalFailMod FaultTCUCAP0_PressureRationalInc FaultTCUCAP0_SenSigOpenOrGNDDec FaultTCUCAP0_SenSigOpenOrGNDFailMod FaultTCUCAP0_SenSigOpenOrGNDInc FaultTCUCAP0_SenSigVCCDec FaultTCUCAP0_SenSigVCCFailMod FaultTCUCAP0_SenSigVCCInc FaultTCUCAP0_SensorPerforErrDec FaultTCUCAP0_SensorPerforErrFailMod FaultTCUCAP0_SensorPerforErrInc FaultTCUCAP1_COM_GCUDec FaultTCUCAP1_COM_GCUFailMod FaultTCUCAP1_COM_GCUInc FaultTCUCAP1_DriverTempHDec FaultTCUCAP1_DriverTempHFailMod FaultTCUCAP1_DriverTempHInc FaultTCUCAP1_FETShortDec FaultTCUCAP1_FETShortFailMod FaultTCUCAP1_FETShortInc FaultTCUCAP1_HWOverCurDec FaultTCUCAP1_HWOverCurFailMod FaultTCUCAP1_HWOverCurInc FaultTCUCAP1_MotorPhaseDriveErrDec FaultTCUCAP1_MotorPhaseDriveErrFailMod FaultTCUCAP1_MotorPhaseDriveErrInc FaultTCUCAP1_MotorStallDec FaultTCUCAP1_MotorStallFailMod FaultTCUCAP1_MotorStallInc FaultTCUCAP1_OverVoltageDec FaultTCUCAP1_OverVoltageFailMod FaultTCUCAP1_OverVoltageInc FaultTCUCAP1_PhaseDetectGNDDec FaultTCUCAP1_PhaseDetectGNDFailMod FaultTCUCAP1_PhaseDetectGNDInc FaultTCUCAP1_PhaseDetectVCCDec FaultTCUCAP1_PhaseDetectVCCFailMod FaultTCUCAP1_PhaseDetectVCCInc FaultTCUCAP1_SWOverCurDec FaultTCUCAP1_SWOverCurFailMod FaultTCUCAP1_SWOverCurInc FaultTCUCAP1_ThermalShutDownDec FaultTCUCAP1_ThermalShutDownFailMod FaultTCUCAP1_ThermalShutDownInc FaultTCUCAP1_ThermalWarningDec FaultTCUCAP1_ThermalWarningFailMod FaultTCUCAP1_ThermalWarningInc FaultTCUCAP1_UnderVoltageDec FaultTCUCAP1_UnderVoltageFailMod FaultTCUCAP1_UnderVoltageInc FaultTCUCCP_OilMotorRationalDec FaultTCUCCP_OilMotorRationalFailMod FaultTCUCCP_OilMotorRationalInc FaultTCUCCP_OilMotorStallDec FaultTCUCCP_OilMotorStallFailMod FaultTCUCCP_OilMotorStallInc FaultTCUCCP_OilSenRationalL1Dec FaultTCUCCP_OilSenRationalL1FailMod FaultTCUCCP_OilSenRationalL1Inc FaultTCUCCP_OilSenRationalL2Dec FaultTCUCCP_OilSenRationalL2FailMod FaultTCUCCP_OilSenRationalL2Inc FaultTCUCCP_OilTempRationalHDec FaultTCUCCP_OilTempRationalHFailMod FaultTCUCCP_OilTempRationalHInc FaultTCUCCP_OilTempRationalLDec FaultTCUCCP_OilTempRationalLFailMod FaultTCUCCP_OilTempRationalLInc /end DEF_CHARACTERISTIC
/end FUNCTION
/begin FUNCTION FAULT_FF ""
 /begin OUT_MEASUREMENT FAULT_FF_bFrameLock_FF1 FF_FF1_BatteryVoltage FF_FF1_BMS_HVBusVolt FF_FF1_CosScaled FF_FF1_DC_Current FF_FF1_DrivingPermission FF_FF1_EngineSpeed FF_FF1_EstimTempSecFild FF_FF1_ExcitationDiag FF_FF1_ExcVoltageFild FF_FF1_FPGA_FaultA FF_FF1_FPGA_FaultB FF_FF1_FT_AclState FF_FF1_FTModeReq FF_FF1_GlbRealTimeDay FF_FF1_GlbRealTimeHour FF_FF1_GlbRealTimeMinute FF_FF1_GlbRealTimeMonth FF_FF1_GlbRealTimeSec FF_FF1_GlbRealTimeYear FF_FF1_HV_VoltageFild FF_FF1_I0dq3_1 FF_FF1_I0dq3_2 FF_FF1_i0dqTgt3_1 FF_FF1_i0dqTgt3_2 FF_FF1_idCorTgt FF_FF1_idLutTgt FF_FF1_IGBTStatus FF_FF1_IgnitionSwSig FF_FF1_IPUMode FF_FF1_iqLutTgt FF_FF1_ISGCurrentTorq FF_FF1_Iu FF_FF1_Iv FF_FF1_Iw FF_FF1_MaxMinTorqueDrtVect FF_FF1_MCU_HVBusVolt FF_FF1_MecaSpeedRpm FF_FF1_MecaTorqueMaxMin FF_FF1_MotTemp FF_FF1_ParkVoltageTgt FF_FF1_ResolNext2ThetaRdByPi FF_FF1_RMS_Cur_U FF_FF1_RMS_Cur_V FF_FF1_RMS_Cur_W FF_FF1_RstStartUpCnt FF_FF1_SinScaled FF_FF1_SOC FF_FF1_TempCmdBoard FF_FF1_TempCoolingFild FF_FF1_TempDrvBoard FF_FF1_TempIgbt FF_FF1_TimestampIgn FF_FF1_TimestampLife_H FF_FF1_TimestampLife_L FF_FF1_TotalMiles_H FF_FF1_TotalMiles_L FF_FF1_UM1dTgt FF_FF1_UM1qTgt FF_FF1_VCU_AllowTorq FF_FF1_VCU_DCU_ModeReq FF_FF1_VCU_DCU_TorqSet FF_FF1_VehicleSpd /end OUT_MEASUREMENT
/end FUNCTION
/begin FUNCTION FRecord "" /begin DEF_CHARACTERISTIC FRecord_ku32TimeBeforeFaultOccurC /end DEF_CHARACTERISTIC
 /begin OUT_MEASUREMENT FRecord_u8ClearReq FRecord_u8EventWriteState FRecord_u8FRStoreState FRecord_u8HeadWriteState /end OUT_MEASUREMENT
/end FUNCTION
/begin FUNCTION GCCU6 ""
 /begin DEF_CHARACTERISTIC GCCU6_bAlimFreqChgEnaC GCCU6_bDualSmpEnaC GCCU6_bHwOvcFltDetEnaC GCCU6_bHwPinAscEnaC GCCU6_f32DrvClkDutyThdHighC GCCU6_f32DrvClkDutyThdLowC GCCU6_kbDrvBdClkEnaC GCCU6_kf32MidPointDutyHC GCCU6_kf32MidPointDutyLC GCCU6_ku16AlimDutyCycRawC GCCU6_ku32AlimFreqRawC GCCU6_ku8AscRecoverCntMaxC GCCU6_ku8PwmMidPointFaultC /end DEF_CHARACTERISTIC
 /begin OUT_MEASUREMENT GCCU6_au32PWMOnTime GCCU6_au32PWMOnTime[0] GCCU6_au32PWMOnTime[1] GCCU6_au32PWMOnTime[2] GCCU6_bAkdAfterAscReq GCCU6_bClrTrapReq GCCU6_bHwFaultDcOvVolt GCCU6_bHwFaultIgbtH GCCU6_bHwFaultIgbtL GCCU6_bHwFaultOvcU GCCU6_bHwFaultOvcV GCCU6_bHwFaultOvcW GCCU6_bIgbtHighSideShort GCCU6_bIgbtLowSideShort GCCU6_bIuvwCompReq GCCU6_bMotorSpdRdy GCCU6_bP5VDiagReinitCmd GCCU6_bP5VHSFltFlg GCCU6_bP5VLSFltFlg GCCU6_bPwmMidPointU GCCU6_bPwmMidPointV GCCU6_bPwmMidPointW GCCU6_bPwmOnGoingFlg GCCU6_bT12ZeroMatchFlg GCCU6_bTrapTrigger GCCU6_f32DrvClkHsDuty GCCU6_f32DrvClkLsDuty GCCU6_f32HighVolPhys GCCU6_f32PwmDutyPhysUZ GCCU6_f32PwmDutyPhysVZ GCCU6_f32PwmDutyPhysWZ GCCU6_u16AlimPowerOnDelay GCCU6_u16HighVolAdc GCCU6_u16McuAscSttDelay GCCU6_u16P5VHSAdc GCCU6_u16PowerOnDelay GCCU6_u16PwmMaxDutyCyc GCCU6_u16PwmMidPointErrCnt GCCU6_u16PwmMinDutyCyc GCCU6_u16PwmModReq GCCU6_u16T12CntVal GCCU6_u16T12PeriodVal GCCU6_u16T13PeriodVal GCCU6_u32DrvClkHsDutyRaw GCCU6_u32DrvClkHsPerdRaw GCCU6_u32DrvClkLsDutyRaw GCCU6_u32DrvClkLsPerdRaw GCCU6_u32TrapCreq GCCU6_u8AscRecoverCnt GCCU6_u8McuAscSttStep GCCU6_u8McuAscType GCCU6_u8P5VHSFltCnt GCCU6_u8P5VLSFltCnt GCCU6_u8P5VPowerMngStt GCCU6_u8P5VSelfTstTimCnt GCCU6_u8PreTestStep GCCU6_u8PwmState /end OUT_MEASUREMENT
/end FUNCTION
/begin FUNCTION HARD ""
 /begin DEF_CHARACTERISTIC HARD_bPtgEnablePhaseShiftingC HARD_u16PtgUSignalShiftC HARD_u16PtgVSignalShiftC HARD_u16PtgWSignalShiftC HARDPTG_s16AmplitudeC HARDPTG_s16ContinuousRequestC HARDPTG_s16OffsetC HARDPTG_s16SlewRateC HARDPTG_u16PulseDutyCycleC HARDPTG_u32FrequenceC /end DEF_CHARACTERISTIC
 /begin OUT_MEASUREMENT HARD_bDio_CAN1_EN HARD_bDio_CAN4_EN HARD_bDio_ENA_DO_P HARD_bDio_ENA_PWM_OE_H HARD_bDio_ENA_PWM_OE_L HARD_bDio_F_AN_ENABLE_ASC HARD_bDio_F_ENA_PWM_H HARD_bDio_F_ENA_PWM_L HARD_bDio_F_FAULT_DRV_LS_N_MCU HARD_bDio_ISO_EN1 HARD_bDio_ISO_EN2 HARD_bDio_ISO_EN3 HARD_bDio_ISO_IO HARD_bDio_KM10_DSP HARD_bDio_KM11_DSP HARD_bDio_KM12_DSP HARD_bDio_KM13_DSP HARD_bDio_KM16_DSP HARD_bDio_KM1_DSP HARD_bDio_KM2_DSP HARD_bDio_KM3_DSP HARD_bDio_KM4_DSP HARD_bDio_KM5_DSP HARD_bDio_KM6_DSP HARD_bDio_KM7_DSP HARD_bDio_KM8_DSP HARD_bDio_KM9_DSP HARD_bDio_M_AN_ENABLE_ASC HARD_bDio_M_CLK_HS HARD_bDio_M_CLK_LS HARD_bDio_M_DBG_4 HARD_bDio_M_DI HARD_bDio_M_DX1_A HARD_bDio_M_DX1_B HARD_bDio_M_DX1_C HARD_bDio_M_EXCITATION_IN_1 HARD_bDio_M_FAULT_DRV_HS_N HARD_bDio_M_FAULT_DRV_LS_N HARD_bDio_M_FAULT_HS HARD_bDio_M_FAULT_LS HARD_bDio_M_KEY_ON HARD_bDio_M_LED_R1 HARD_bDio_M_PW_DOWN HARD_bDio_M_SYNCHRO_POS HARD_bDio_MCU_ASC_STATE HARD_bDio_MDO_KEY3 HARD_bDio_NTC100_30_EN1 HARD_bDio_NTC100_30_EN2 HARD_bDio_NTC100_30_EN3 HARD_bDio_NTC10_EN1 HARD_bDio_NTC10_EN2 HARD_bDio_NTC10_EN3 HARD_bDio_PT1000_EN1 HARD_bDio_PT1000_EN2 HARD_bDio_PT1000_EN3 HARD_bDio_PT100_EN1 HARD_bDio_PT100_EN2 HARD_bDio_PT100_EN3 HARD_bESMCmdFtShutdownReq HARD_bESMCmdFtShutdownRes HARD_bESMCmdFtStartReq HARD_bESMCmdFtStartRes HARD_bESMCmdPwmDirectReq HARD_bESMCmdPwmDirectRes HARD_bESMCmdPwmHardReq HARD_bESMCmdPwmHardRes HARD_bESMCmdPwmOffReq HARD_bESMCmdPwmOffRes HARD_bESMCmdSwShutdownReq HARD_bESMCmdSwShutdownRes HARD_bESMCmdSwStartReq HARD_bESMCmdSwStartRes HARD_bModSeq1FuncOn HARD_bModSeq1InitOn HARD_bModSeq2FuncOn HARD_bModSeq2InitOn HARD_bNmRxRepeatMsgReq HARD_bNMTestOn HARD_bNmTxRepeatMsgReq HARD_bPtgEnable HARD_bPtgSignalsShiftControl HARD_bPtgUSignalEnable HARD_bPtgVSignalEnable HARD_bPtgWSignalEnable HARD_ESM_FT_STATE_FT_SHUTDOWN HARD_ESM_FT_STATE_IDLE HARD_ESM_FT_STATE_PWM_DIRECT HARD_ESM_FT_STATE_PWM_HARD HARD_ESM_FT_STATE_PWM_OFF HARD_ESM_NF_STATE_FT_START HARD_ESM_NF_STATE_IDLE HARD_ESM_NF_STATE_PWM_HARD HARD_ESM_NF_STATE_PWM_OFF HARD_ESM_NF_STATE_SW_SHUTDOWN HARD_EsmFtState HARD_EsmFtStateAut HARD_EsmNfState HARD_EsmNfStateAut HARD_f32Icu_F_AN_VOL_DCLINK_DRV HARD_f32Icu_F_TEMP_U HARD_f32Icu_F_TEMP_V HARD_PTG_CONTINUOUS_MODE HARD_PTG_DISJUNCTION_MODE HARD_PTG_LOOP_NB_MODE HARD_PTG_PROFIL_MODE HARD_PTG_PULSE_MODE HARD_PTG_SINUS_MODE HARD_PTG_SQUARE_MODE HARD_PTG_TRIANGLE_MODE HARD_PtgModeTest HARD_s16PtgRefSignalValue HARD_s16PtgUSignalValue HARD_s16PtgVSignalValue HARD_s16PtgWSignalValue HARD_u16Adc0An10_CTN_BOARD2Phys HARD_u16Adc_15V_COM HARD_u16Adc_AN_CTN_BOARD1 HARD_u16Adc_AN_DIAG_COS_H1 HARD_u16Adc_AN_DIAG_COS_L1 HARD_u16Adc_AN_DIAG_SIN_H1 HARD_u16Adc_AN_DIAG_SIN_L1 HARD_u16Adc_AN_MUX1 HARD_u16Adc_AN_P12V_BATT HARD_u16Adc_AN_PSU_P5V_HS HARD_u16Adc_AN_VOL_DCLINK_DRV HARD_u16Adc_DCS_AD HARD_u16Adc_DJR_AD HARD_u16Adc_F_CURRENT_U HARD_u16Adc_F_CURRENT_V HARD_u16Adc_F_CURRENT_W HARD_u16Adc_F_PT_NTC_AD3 HARD_u16Adc_KM13_FB HARD_u16Adc_KM15_FB HARD_u16Adc_KM18_FB HARD_u16Adc_KM_FB HARD_u16Adc_M_AN_T_IGBT_U HARD_u16Adc_M_AN_T_IGBT_V HARD_u16Adc_M_AN_T_IGBT_W HARD_u16Adc_M_CURRENT_U HARD_u16Adc_M_CURRENT_V HARD_u16Adc_M_CURRENT_W HARD_u16Adc_M_INTLOC1 HARD_u16Adc_M_INTLOC2 HARD_u16Adc_M_INTLOC3 HARD_u16Adc_M_PT_NTC_AD1 HARD_u16Adc_M_PT_NTC_AD2 HARD_u16Adc_MOT_COS1 HARD_u16Adc_MOT_SIN1 HARD_u16Adc_P5V_HS_REF HARD_u16Adc_P5V_LS_REF HARD_u16Adc_PSU_P5V_LS HARD_u16PtgRefSignalNbPeriode HARD_u16PtgRefSignalTime HARD_u16PtgUSignalNbPeriode HARD_u16PtgUSignalTime HARD_u16PtgVSignalNbPeriode HARD_u16PtgVSignalTime HARD_u16PtgWSignalNbPeriode HARD_u16PtgWSignalTime HARD_u8CanIfCtrlMode HARD_u8CanIfCtrlModeReq HARD_u8CanIfPduMode HARD_u8CanIfPduModeReq HARD_u8CanNmLocalNodeId HARD_u8CanNmMode HARD_u8CanNmNodeId HARD_u8CanNmState HARD_u8CanSmMode HARD_u8CanSmModeReq HARD_u8ComMMode HARD_u8ComMState HARD_u8ComMStatus HARD_u8NmMode HARD_u8NmState HARD_u8NmTestNum HARD_u8NmUserDataRx HARD_u8NmUserDataRx[0] HARD_u8NmUserDataRx[1] HARD_u8NmUserDataRx[2] HARD_u8NmUserDataRx[3] HARD_u8NmUserDataRx[4] HARD_u8NmUserDataRx[5] HARD_u8NmUserDataTx HARD_u8NmUserDataTx[0] HARD_u8NmUserDataTx[1] HARD_u8NmUserDataTx[2] HARD_u8NmUserDataTx[3] HARD_u8NmUserDataTx[4] HARD_u8NmUserDataTx[5] HARD_u8NmWakeupReason HARD_u8VSIRxaTempCtrlBdPhys HARD_u8VSIRxaTempDrvBdPhys HARD_u8VSIRxaTempIgbtPhys /end OUT_MEASUREMENT
/end FUNCTION
/begin FUNCTION IOHAL "" /begin DEF_CHARACTERISTIC IOHAL_u32MCUVOLPeriodMaxC /end DEF_CHARACTERISTIC
 /begin OUT_MEASUREMENT IOHAL_f32GCUVOLDutyCycle IOHAL_f32MCUVOLDutyCycle IOHAL_u32MCUVOLPeriod /end OUT_MEASUREMENT
/end FUNCTION
/begin COMPU_METHOD HARD_EsmFtState_conv "" TAB_VERB "%8.4" "." COMPU_TAB_REF HARD_EsmFtState_table /end COMPU_METHOD
/begin COMPU_VTAB HARD_EsmFtState_table "" TAB_VERB 5 1 "HARD_ESM_FT_STATE_PWM_DIRECT" 2 "HARD_ESM_FT_STATE_PWM_HARD" 4 "HARD_ESM_FT_STATE_PWM_OFF" 8 "HARD_ESM_FT_STATE_FT_SHUTDOWN" 64 "HARD_ESM_FT_STATE_IDLE" /end COMPU_VTAB
/begin COMPU_METHOD HARD_EsmNfState_conv "" TAB_VERB "%8.4" "." COMPU_TAB_REF HARD_EsmNfState_table /end COMPU_METHOD
/begin COMPU_VTAB HARD_EsmNfState_table "" TAB_VERB 5 1 "HARD_ESM_NF_STATE_FT_START" 4 "HARD_ESM_NF_STATE_SW_SHUTDOWN" 8 "HARD_ESM_NF_STATE_PWM_HARD" 16 "HARD_ESM_NF_STATE_PWM_OFF" 64 "HARD_ESM_NF_STATE_IDLE" /end COMPU_VTAB
/begin COMPU_METHOD HARD_PtgModeTest_conv "" TAB_VERB "%8.4" "." COMPU_TAB_REF HARD_PtgModeTest_table /end COMPU_METHOD
/begin COMPU_VTAB HARD_PtgModeTest_table "" TAB_VERB 8 1 "HARD_PTG_PULSE_MODE" 2 "HARD_PTG_SINUS_MODE" 4 "HARD_PTG_TRIANGLE_MODE" 8 "HARD_PTG_SQUARE_MODE" 16 "HARD_PTG_CONTINUOUS_MODE" 32 "HARD_PTG_PROFIL_MODE" 64 "HARD_PTG_DISJUNCTION_MODE" 128 "HARD_PTG_LOOP_NB_MODE" /end COMPU_VTAB
/end MODULE
/end PROJECT
