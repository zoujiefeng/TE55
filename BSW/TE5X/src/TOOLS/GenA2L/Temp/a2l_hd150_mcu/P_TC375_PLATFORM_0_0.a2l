ASAP2_VERSION 1 3
/begin PROJECT P_TC375_PLATFORM_0_0 "P_TC375_PLATFORM_0_0"
/begin HEADER "" VERSION "5210.00" PROJECT_NO D0 /end HEADER
/begin MODULE P_TC375_PLATFORM_0_0 "Invt"
/begin MOD_COMMON "" DEPOSIT ABSOLUTE ALIGNMENT_BYTE 1 ALIGNMENT_WORD 2 ALIGNMENT_LONG 4 ALIGNMENT_FLOAT32_IEEE 4 ALIGNMENT_FLOAT64_IEEE 8 BYTE_ORDER MSB_LAST /end MOD_COMMON
/begin RECORD_LAYOUT DATA_RECORD_UBYTE FNC_VALUES 1 UBYTE ROW_DIR DIRECT /end RECORD_LAYOUT
/begin RECORD_LAYOUT DATA_RECORD_UWORD FNC_VALUES 1 UWORD ROW_DIR DIRECT /end RECORD_LAYOUT
/begin RECORD_LAYOUT DATA_RECORD_ULONG FNC_VALUES 1 ULONG ROW_DIR DIRECT /end RECORD_LAYOUT
/begin RECORD_LAYOUT DATA_RECORD_SLONG FNC_VALUES 1 SLONG ROW_DIR DIRECT /end RECORD_LAYOUT
/begin RECORD_LAYOUT DATA_RECORD_FLOAT32_IEEE FNC_VALUES 1 FLOAT32_IEEE ROW_DIR DIRECT /end RECORD_LAYOUT
/begin RECORD_LAYOUT AXIS_PTS_X_SBYTE_VEMS AXIS_PTS_X 1 SBYTE INDEX_INCR DIRECT /end RECORD_LAYOUT
/begin CHARACTERISTIC AMAIN_HARDBenchOnC "HARD activation" VALUE 0x80058AF4 DATA_RECORD_UBYTE 1 Bool_ON_OFF 0 1 BIT_MASK 0x01 /end CHARACTERISTIC
/begin CHARACTERISTIC AMAIN_MSGRxBenchOnC "Rx MSG activation" VALUE 0x80058AF0 DATA_RECORD_UBYTE 1 Bool_ON_OFF 0 1 BIT_MASK 0x01 /end CHARACTERISTIC
/begin CHARACTERISTIC AMAIN_MSGTxBenchOnC "Tx MSG activation" VALUE 0x80058AEC DATA_RECORD_UBYTE 1 Bool_ON_OFF 0 1 BIT_MASK 0x01 /end CHARACTERISTIC
/begin CHARACTERISTIC AMAIN_MSGu8PwModFiltCntC "Spare" VALUE 0x80058047 DATA_RECORD_UBYTE 255 I_1 0 255 /end CHARACTERISTIC
/begin CHARACTERISTIC AMAIN_TSTBenchOnC "TST activation" VALUE 0x80058AE0 DATA_RECORD_UBYTE 1 Bool_ON_OFF 0 1 BIT_MASK 0x01 /end CHARACTERISTIC
/begin CHARACTERISTIC AMAIN_VSIBenchOnWriteDataC "Bench VSI write datas" VALUE 0x80058ADC DATA_RECORD_UBYTE 1 Bool_ON_OFF 0 1 BIT_MASK 0x01 /end CHARACTERISTIC
/begin CHARACTERISTIC AMAIN_VSIBenchOnWriteEmergSwC "Bench VSI write EmergencySW" VALUE 0x80058AD8 DATA_RECORD_UBYTE 1 Bool_ON_OFF 0 1 BIT_MASK 0x01 /end CHARACTERISTIC
/begin CHARACTERISTIC AMAIN_bMSGRxToutBenchOnC "COM MSG Rx activation" VALUE 0x80058AF8 DATA_RECORD_UBYTE 1 Bool_ON_OFF 0 1 BIT_MASK 0x01 /end CHARACTERISTIC
/begin CHARACTERISTIC AMAIN_f32AccPosClrSSTimC "Spare" VALUE 0x80058B60 DATA_RECORD_FLOAT32_IEEE 3.402823466E+038 F_1_p0_6 -3.402823466E+038 3.402823466E+038 /end CHARACTERISTIC
/begin CHARACTERISTIC AMAIN_f32AntiSlopExitSpdC "Spare" VALUE 0x80058B5C DATA_RECORD_FLOAT32_IEEE 3.402823466E+038 F_1_p0_7 -3.402823466E+038 3.402823466E+038 /end CHARACTERISTIC
/begin CHARACTERISTIC AMAIN_f32AntiSsGapDrtGainC "Spare" VALUE 0x80058B58 DATA_RECORD_FLOAT32_IEEE 3.402823466E+038 F_1_p0_5 -3.402823466E+038 3.402823466E+038 /end CHARACTERISTIC
/begin CHARACTERISTIC AMAIN_f32AntiSsValidTrqC "Spare" VALUE 0x80058B54 DATA_RECORD_FLOAT32_IEEE 3.402823466E+038 F_1_p0_9 -3.402823466E+038 3.402823466E+038 /end CHARACTERISTIC
/begin CHARACTERISTIC AMAIN_f32BldcStuckDutyC "Spare" VALUE 0x8009ADF8 DATA_RECORD_FLOAT32_IEEE 3.402823466E+038 F_1_p0_5 -3.402823466E+038 3.402823466E+038 /end CHARACTERISTIC
/begin CHARACTERISTIC AMAIN_f32BrakDeratGainC "Spare" VALUE 0x80058B50 DATA_RECORD_FLOAT32_IEEE 3.402823466E+038 F_1_p0_5 -3.402823466E+038 3.402823466E+038 /end CHARACTERISTIC
/begin CHARACTERISTIC AMAIN_f32BrakPedPosHighC "Spare" VALUE 0x80058B48 DATA_RECORD_FLOAT32_IEEE 3.402823466E+038 F_1_p0_6 -3.402823466E+038 3.402823466E+038 /end CHARACTERISTIC
/begin CHARACTERISTIC AMAIN_f32BrakPedalPosLowC "Spare" VALUE 0x80058B4C DATA_RECORD_FLOAT32_IEEE 3.402823466E+038 F_1_p0_6 -3.402823466E+038 3.402823466E+038 /end CHARACTERISTIC
/begin CHARACTERISTIC AMAIN_f32OcAutophsGainC "Spare" VALUE 0x80058B40 DATA_RECORD_FLOAT32_IEEE 3.402823466E+038 F_1_p0_5 -3.402823466E+038 3.402823466E+038 /end CHARACTERISTIC
/begin CHARACTERISTIC AMAIN_f32OcAutophsOffstC "Spare" VALUE 0x80058B3C DATA_RECORD_FLOAT32_IEEE 3.402823466E+038 F_1_p0_5 -3.402823466E+038 3.402823466E+038 /end CHARACTERISTIC
/begin CHARACTERISTIC AMAIN_f32PowerdownVoltC "Spare" VALUE 0x80058B00 DATA_RECORD_FLOAT32_IEEE 3.402823466E+038 F_1_p0_5 -3.402823466E+038 3.402823466E+038 /end CHARACTERISTIC
/begin CHARACTERISTIC AMAIN_f32PwmFreqHighThrdC "Spare" VALUE 0x80058B20 DATA_RECORD_FLOAT32_IEEE 3.402823466E+038 F_1_p0_14 -3.402823466E+038 3.402823466E+038 /end CHARACTERISTIC
/begin CHARACTERISTIC AMAIN_f32PwmMaxDutyPhysC "Spare" VALUE 0x80058B34 DATA_RECORD_FLOAT32_IEEE 3.402823466E+038 F_1_p0_5 -3.402823466E+038 3.402823466E+038 /end CHARACTERISTIC
/begin CHARACTERISTIC AMAIN_f32PwmMinDutyPhysC "Spare" VALUE 0x80058B30 DATA_RECORD_FLOAT32_IEEE 3.402823466E+038 F_1_p0_5 -3.402823466E+038 3.402823466E+038 /end CHARACTERISTIC
/begin CHARACTERISTIC AMAIN_f32PwmRatioReduceC "Spare" VALUE 0x80058B1C DATA_RECORD_FLOAT32_IEEE 3.402823466E+038 F_1_p0_14 -3.402823466E+038 3.402823466E+038 /end CHARACTERISTIC
/begin CHARACTERISTIC AMAIN_f32SlopOrRoadSpdDiffC "Spare" VALUE 0x80058B2C DATA_RECORD_FLOAT32_IEEE 3.402823466E+038 F_1_p0_7 -3.402823466E+038 3.402823466E+038 /end CHARACTERISTIC
/begin CHARACTERISTIC AMAIN_f32UvwOvCurrThdC "Spare" VALUE 0x80058B28 DATA_RECORD_FLOAT32_IEEE 3.402823466E+038 F_1_p0_14 -3.402823466E+038 3.402823466E+038 /end CHARACTERISTIC
/begin CHARACTERISTIC AMAIN_f32VsiPwmPeriodC "Spare" VALUE 0x80058B18 DATA_RECORD_FLOAT32_IEEE 3.402823466E+038 F_1000000_p0_15 -3.402823466E+038 3.402823466E+038 /end CHARACTERISTIC
/begin CHARACTERISTIC AMAIN_ku16PwmPerdInitValC "AMAIN_ku16PwmPerdInitValC" VALUE 0x8005806A DATA_RECORD_UWORD 65535 I_1 0 65535 /end CHARACTERISTIC
/begin CHARACTERISTIC AMAIN_ku16SpdReadyEstConfirmC "Spare" VALUE 0x80058068 DATA_RECORD_UWORD 65535 F_1_p0_5 0 65535 /end CHARACTERISTIC
/begin CHARACTERISTIC AMAIN_s32CurHardDelayC "Spare" VALUE 0x80058B0C DATA_RECORD_SLONG 4294967295 F_1_p0_5 -2147483648 2147483647 /end CHARACTERISTIC
/begin CHARACTERISTIC AMAIN_s32ResHardDelayC "Spare" VALUE 0x80058B08 DATA_RECORD_SLONG 4294967295 F_1_p0_5 -2147483648 2147483647 /end CHARACTERISTIC
/begin CHARACTERISTIC AMAIN_s32SampleDelayC "Spare" VALUE 0x80058B04 DATA_RECORD_SLONG 4294967295 F_1_p0_5 -2147483648 2147483647 /end CHARACTERISTIC
/begin CHARACTERISTIC AMAIN_u16AntiSsChkTimC "Spare" VALUE 0x80058066 DATA_RECORD_UWORD 65535 F_1_p0_5 0 65535 /end CHARACTERISTIC
/begin CHARACTERISTIC AMAIN_u16AntiSsEnaBrakTimC "Spare" VALUE 0x80058064 DATA_RECORD_UWORD 65535 F_1_p0_18 0 65535 /end CHARACTERISTIC
/begin CHARACTERISTIC AMAIN_u16AntiSsGapTimC "Spare" VALUE 0x80058062 DATA_RECORD_UWORD 65535 F_1_p0_18 0 65535 /end CHARACTERISTIC
/begin CHARACTERISTIC AMAIN_u16BrakRelsDelayC "Spare" VALUE 0x80058060 DATA_RECORD_UWORD 65535 F_1_p0_18 0 65535 /end CHARACTERISTIC
/begin CHARACTERISTIC AMAIN_u16FpgaFltClrTimoutC "Spare" VALUE 0x8005805E DATA_RECORD_UWORD 65535 F_1_p0_5 0 65535 /end CHARACTERISTIC
/begin CHARACTERISTIC AMAIN_u16IdqDeltaCntMaxC "Spare" VALUE 0x8005805C DATA_RECORD_UWORD 65535 F_1_p0_5 0 65535 /end CHARACTERISTIC
/begin CHARACTERISTIC AMAIN_u16PwmRatioPerd0C "Spare" VALUE 0x8005805A DATA_RECORD_UWORD 2621.4 F_0v04_p1_19 1 2622.4 /end CHARACTERISTIC
/begin CHARACTERISTIC AMAIN_u16PwmRatioPerd1C "Spare" VALUE 0x80058058 DATA_RECORD_UWORD 2621.4 F_0v04_p1_19 1 2622.4 /end CHARACTERISTIC
/begin CHARACTERISTIC AMAIN_u16PwmRatioPerd2C "Spare" VALUE 0x80058056 DATA_RECORD_UWORD 2621.4 F_0v04_p1_19 1 2622.4 /end CHARACTERISTIC
/begin CHARACTERISTIC AMAIN_u16PwmRatioPerd3C "Spare" VALUE 0x80058054 DATA_RECORD_UWORD 2621.4 F_0v04_p1_19 1 2622.4 /end CHARACTERISTIC
/begin CHARACTERISTIC AMAIN_u16SlopSlideTim1C "Spare" VALUE 0x80058052 DATA_RECORD_UWORD 65535 F_1_p0_18 0 65535 /end CHARACTERISTIC
/begin CHARACTERISTIC AMAIN_u16SlopSlideTim2C "Spare" VALUE 0x80058050 DATA_RECORD_UWORD 65535 F_1_p0_18 0 65535 /end CHARACTERISTIC
/begin CHARACTERISTIC AMAIN_u16SlopSlideTimoutC "Spare" VALUE 0x8005804E DATA_RECORD_UWORD 65535 F_1_p0_18 0 65535 /end CHARACTERISTIC
/begin CHARACTERISTIC AMAIN_u16SlopSpdConfirmC "Spare" VALUE 0x8005804C DATA_RECORD_UWORD 65535 F_1_p0_5 0 65535 /end CHARACTERISTIC
/begin CHARACTERISTIC AMAIN_u32VSICntCkreqESMStartedC "AMAIN_u32VSICntCkreqESMStartedC" VALUE 0x80058B14 DATA_RECORD_ULONG 4294967295 I_1 0 4294967295 /end CHARACTERISTIC
/begin CHARACTERISTIC AMAIN_u32VSICntCkreqVSIStartedC "AMAIN_u32VSICntCkreqVSIStartedC" VALUE 0x80058B10 DATA_RECORD_ULONG 4294967295 I_1 0 4294967295 /end CHARACTERISTIC
/begin CHARACTERISTIC BSW_ku16CCPReinitTriggerC "Spare" VALUE 0x80058094 DATA_RECORD_UWORD 2621.4 F_0v04_p1_20 1 2622.4 /end CHARACTERISTIC
/begin CHARACTERISTIC BSW_ku16MotorVariantC "Spare" VALUE 0x80058092 DATA_RECORD_UWORD 2621.4 F_0v04_p1_20 1 2622.4 /end CHARACTERISTIC
/begin CHARACTERISTIC MAIN_HARDBenchOnC "HARD activation" VALUE 0x80058B90 DATA_RECORD_UBYTE 1 Bool_ON_OFF 0 1 BIT_MASK 0x01 /end CHARACTERISTIC
/begin CHARACTERISTIC MAIN_MSGRxBenchOnC "Rx MSG activation" VALUE 0x80058B84 DATA_RECORD_UBYTE 1 Bool_ON_OFF 0 1 BIT_MASK 0x01 /end CHARACTERISTIC
/begin CHARACTERISTIC MAIN_MSGTxBenchOnC "Tx MSG activation" VALUE 0x80058B80 DATA_RECORD_UBYTE 1 Bool_ON_OFF 0 1 BIT_MASK 0x01 /end CHARACTERISTIC
/begin CHARACTERISTIC MAIN_MSGbBenchTestOnC "Tx MSG activation" VALUE 0x80058B8C DATA_RECORD_UBYTE 1 Bool_ON_OFF 0 1 BIT_MASK 0x01 /end CHARACTERISTIC
/begin CHARACTERISTIC MAIN_MSGbDbgFrameOnC "Tx MSG activation" VALUE 0x80058B88 DATA_RECORD_UBYTE 1 Bool_ON_OFF 0 1 BIT_MASK 0x01 /end CHARACTERISTIC
/begin CHARACTERISTIC MAIN_MSGu8PwModFiltCntC "Spare" VALUE 0x80058048 DATA_RECORD_UBYTE 255 I_1 0 255 /end CHARACTERISTIC
/begin CHARACTERISTIC MAIN_SampleSequenceEnC "Tx MSG activation" VALUE 0x80058B64 DATA_RECORD_UBYTE 1 Bool_ON_OFF 0 1 BIT_MASK 0x01 /end CHARACTERISTIC
/begin CHARACTERISTIC MAIN_TSTBenchOnC "TST activation" VALUE 0x80058B74 DATA_RECORD_UBYTE 1 Bool_ON_OFF 0 1 BIT_MASK 0x01 /end CHARACTERISTIC
/begin CHARACTERISTIC MAIN_VSIBenchOnWriteDataC "Bench VSI write datas" VALUE 0x80058B70 DATA_RECORD_UBYTE 1 Bool_ON_OFF 0 1 BIT_MASK 0x01 /end CHARACTERISTIC
/begin CHARACTERISTIC MAIN_VSIBenchOnWriteEmergSwC "Bench VSI write EmergencySW" VALUE 0x80058B6C DATA_RECORD_UBYTE 1 Bool_ON_OFF 0 1 BIT_MASK 0x01 /end CHARACTERISTIC
/begin CHARACTERISTIC MAIN_bMSGRxToutBenchOnC "COM MSG Rx activation" VALUE 0x80058B98 DATA_RECORD_UBYTE 1 Bool_ON_OFF 0 1 BIT_MASK 0x01 /end CHARACTERISTIC
/begin CHARACTERISTIC MAIN_f32AccPosClrSSTimC "Spare" VALUE 0x80058C08 DATA_RECORD_FLOAT32_IEEE 3.402823466E+038 F_1_p0_6 -3.402823466E+038 3.402823466E+038 /end CHARACTERISTIC
/begin CHARACTERISTIC MAIN_f32AntiSlopExitSpdC "Spare" VALUE 0x80058C04 DATA_RECORD_FLOAT32_IEEE 3.402823466E+038 F_1_p0_7 -3.402823466E+038 3.402823466E+038 /end CHARACTERISTIC
/begin CHARACTERISTIC MAIN_f32AntiSsGapDrtGainC "Spare" VALUE 0x80058C00 DATA_RECORD_FLOAT32_IEEE 3.402823466E+038 F_1_p0_5 -3.402823466E+038 3.402823466E+038 /end CHARACTERISTIC
/begin CHARACTERISTIC MAIN_f32AntiSsValidTrqC "Spare" VALUE 0x80058BFC DATA_RECORD_FLOAT32_IEEE 3.402823466E+038 F_1_p0_9 -3.402823466E+038 3.402823466E+038 /end CHARACTERISTIC
/begin CHARACTERISTIC MAIN_f32BrakDeratGainC "Spare" VALUE 0x80058BF8 DATA_RECORD_FLOAT32_IEEE 3.402823466E+038 F_1_p0_5 -3.402823466E+038 3.402823466E+038 /end CHARACTERISTIC
/begin CHARACTERISTIC MAIN_f32BrakPedPosHighC "Spare" VALUE 0x80058BF0 DATA_RECORD_FLOAT32_IEEE 3.402823466E+038 F_1_p0_6 -3.402823466E+038 3.402823466E+038 /end CHARACTERISTIC
/begin CHARACTERISTIC MAIN_f32BrakPedalPosLowC "Spare" VALUE 0x80058BF4 DATA_RECORD_FLOAT32_IEEE 3.402823466E+038 F_1_p0_6 -3.402823466E+038 3.402823466E+038 /end CHARACTERISTIC
/begin CHARACTERISTIC MAIN_f32OcAutophsGainC "Spare" VALUE 0x80058BEC DATA_RECORD_FLOAT32_IEEE 3.402823466E+038 F_1_p0_5 -3.402823466E+038 3.402823466E+038 /end CHARACTERISTIC
/begin CHARACTERISTIC MAIN_f32OcAutophsOffstC "Spare" VALUE 0x80058BE8 DATA_RECORD_FLOAT32_IEEE 3.402823466E+038 F_1_p0_5 -3.402823466E+038 3.402823466E+038 /end CHARACTERISTIC
/begin CHARACTERISTIC MAIN_f32PowerdownVoltC "Spare" VALUE 0x80058BA8 DATA_RECORD_FLOAT32_IEEE 3.402823466E+038 F_1_p0_5 -3.402823466E+038 3.402823466E+038 /end CHARACTERISTIC
/begin CHARACTERISTIC MAIN_f32PwmFreqHighThrdC "Spare" VALUE 0x80058BD0 DATA_RECORD_FLOAT32_IEEE 3.402823466E+038 F_1_p0_14 -3.402823466E+038 3.402823466E+038 /end CHARACTERISTIC
/begin CHARACTERISTIC MAIN_f32PwmMaxDutyPhysC "Spare" VALUE 0x80058BE4 DATA_RECORD_FLOAT32_IEEE 3.402823466E+038 F_1_p0_5 -3.402823466E+038 3.402823466E+038 /end CHARACTERISTIC
/begin CHARACTERISTIC MAIN_f32PwmMinDutyPhysC "Spare" VALUE 0x80058BE0 DATA_RECORD_FLOAT32_IEEE 3.402823466E+038 F_1_p0_5 -3.402823466E+038 3.402823466E+038 /end CHARACTERISTIC
/begin CHARACTERISTIC MAIN_f32PwmRatioReduceC "Spare" VALUE 0x80058BCC DATA_RECORD_FLOAT32_IEEE 3.402823466E+038 F_1_p0_14 -3.402823466E+038 3.402823466E+038 /end CHARACTERISTIC
/begin CHARACTERISTIC MAIN_f32RandomFrecMecaSpdMaxC "Spare" VALUE 0x80058BAC DATA_RECORD_FLOAT32_IEEE 3.402823466E+038 F_1_p0_7 -3.402823466E+038 3.402823466E+038 /end CHARACTERISTIC
/begin CHARACTERISTIC MAIN_f32RandomFrecMecaSpdMinC "Spare" VALUE 0x80058BB0 DATA_RECORD_FLOAT32_IEEE 3.402823466E+038 F_1_p0_7 -3.402823466E+038 3.402823466E+038 /end CHARACTERISTIC
/begin CHARACTERISTIC MAIN_f32SlopOrRoadSpdDiffC "Spare" VALUE 0x80058BDC DATA_RECORD_FLOAT32_IEEE 3.402823466E+038 F_1_p0_7 -3.402823466E+038 3.402823466E+038 /end CHARACTERISTIC
/begin CHARACTERISTIC MAIN_f32UvwOvCurrThdC "Spare" VALUE 0x80058BD8 DATA_RECORD_FLOAT32_IEEE 3.402823466E+038 F_1_p0_14 -3.402823466E+038 3.402823466E+038 /end CHARACTERISTIC
/begin CHARACTERISTIC MAIN_f32VsiPwmPeriodC "Spare" VALUE 0x80058BC8 DATA_RECORD_FLOAT32_IEEE 3.402823466E+038 F_1000000_p0_15 -3.402823466E+038 3.402823466E+038 /end CHARACTERISTIC
/begin CHARACTERISTIC MAIN_ku16PwmPerdInitValC "MAIN_ku16PwmPerdInitValC" VALUE 0x80058090 DATA_RECORD_UWORD 65535 I_1 0 65535 /end CHARACTERISTIC
/begin CHARACTERISTIC MAIN_ku16SpdReadyEstConfirmC "Spare" VALUE 0x8005808E DATA_RECORD_UWORD 65535 F_1_p0_5 0 65535 /end CHARACTERISTIC
/begin CHARACTERISTIC MAIN_s32CurHardDelayC "Spare" VALUE 0x80058BBC DATA_RECORD_SLONG 4294967295 F_1_p0_5 -2147483648 2147483647 /end CHARACTERISTIC
/begin CHARACTERISTIC MAIN_s32ResHardDelayC "Spare" VALUE 0x80058BB8 DATA_RECORD_SLONG 4294967295 F_1_p0_5 -2147483648 2147483647 /end CHARACTERISTIC
/begin CHARACTERISTIC MAIN_s32SampleDelayC "Spare" VALUE 0x80058BB4 DATA_RECORD_SLONG 4294967295 F_1_p0_5 -2147483648 2147483647 /end CHARACTERISTIC
/begin CHARACTERISTIC MAIN_u16AntiSsChkTimC "Spare" VALUE 0x8005808C DATA_RECORD_UWORD 65535 F_1_p0_5 0 65535 /end CHARACTERISTIC
/begin CHARACTERISTIC MAIN_u16AntiSsEnaBrakTimC "Spare" VALUE 0x8005808A DATA_RECORD_UWORD 65535 F_1_p0_18 0 65535 /end CHARACTERISTIC
/begin CHARACTERISTIC MAIN_u16AntiSsGapTimC "Spare" VALUE 0x80058088 DATA_RECORD_UWORD 65535 F_1_p0_18 0 65535 /end CHARACTERISTIC
/begin CHARACTERISTIC MAIN_u16BrakRelsDelayC "Spare" VALUE 0x80058086 DATA_RECORD_UWORD 65535 F_1_p0_18 0 65535 /end CHARACTERISTIC
/begin CHARACTERISTIC MAIN_u16FpgaFltClrTimoutC "Spare" VALUE 0x80058084 DATA_RECORD_UWORD 65535 F_1_p0_5 0 65535 /end CHARACTERISTIC
/begin CHARACTERISTIC MAIN_u16IdqDeltaCntMaxC "Spare" VALUE 0x80058082 DATA_RECORD_UWORD 65535 F_1_p0_5 0 65535 /end CHARACTERISTIC
/begin CHARACTERISTIC MAIN_u16OverBhvThdC "Spare" VALUE 0x8005806E DATA_RECORD_UWORD 65535 F_1_p0_14 0 65535 /end CHARACTERISTIC
/begin CHARACTERISTIC MAIN_u16PwmRatioPerd0C "Spare" VALUE 0x80058080 DATA_RECORD_UWORD 2621.4 F_0v04_p1_19 1 2622.4 /end CHARACTERISTIC
/begin CHARACTERISTIC MAIN_u16PwmRatioPerd1C "Spare" VALUE 0x8005807E DATA_RECORD_UWORD 2621.4 F_0v04_p1_19 1 2622.4 /end CHARACTERISTIC
/begin CHARACTERISTIC MAIN_u16PwmRatioPerd2C "Spare" VALUE 0x8005807C DATA_RECORD_UWORD 2621.4 F_0v04_p1_19 1 2622.4 /end CHARACTERISTIC
/begin CHARACTERISTIC MAIN_u16PwmRatioPerd3C "Spare" VALUE 0x8005807A DATA_RECORD_UWORD 2621.4 F_0v04_p1_19 1 2622.4 /end CHARACTERISTIC
/begin CHARACTERISTIC MAIN_u16RandomFrecMaxC "Spare" VALUE 0x80058070 DATA_RECORD_UWORD 65535 F_1_p0_18 0 65535 /end CHARACTERISTIC
/begin CHARACTERISTIC MAIN_u16SlopSlideTim1C "Spare" VALUE 0x80058078 DATA_RECORD_UWORD 65535 F_1_p0_18 0 65535 /end CHARACTERISTIC
/begin CHARACTERISTIC MAIN_u16SlopSlideTim2C "Spare" VALUE 0x80058076 DATA_RECORD_UWORD 65535 F_1_p0_18 0 65535 /end CHARACTERISTIC
/begin CHARACTERISTIC MAIN_u16SlopSlideTimoutC "Spare" VALUE 0x80058074 DATA_RECORD_UWORD 65535 F_1_p0_18 0 65535 /end CHARACTERISTIC
/begin CHARACTERISTIC MAIN_u16SlopSpdConfirmC "Spare" VALUE 0x80058072 DATA_RECORD_UWORD 65535 F_1_p0_5 0 65535 /end CHARACTERISTIC
/begin CHARACTERISTIC MAIN_u32VSICntCkreqESMStartedC "MAIN_u32VSICntCkreqESMStartedC" VALUE 0x80058BC4 DATA_RECORD_ULONG 4294967295 I_1 0 4294967295 /end CHARACTERISTIC
/begin CHARACTERISTIC MAIN_u32VSICntCkreqVSIStartedC "MAIN_u32VSICntCkreqVSIStartedC" VALUE 0x80058BC0 DATA_RECORD_ULONG 4294967295 I_1 0 4294967295 /end CHARACTERISTIC
/begin CHARACTERISTIC MosSWOverCurrentTestOnC "..." VALUE 0x80058B68 DATA_RECORD_UBYTE 1 Bool_ON_OFF 0 1 BIT_MASK 0x01 /end CHARACTERISTIC
/begin CHARACTERISTIC RES_bGenerateSyncPosC "Enable generation of the SyncPos signal" VALUE 0x80058046 DATA_RECORD_UBYTE 1 Bool_ON_OFF 0 1 BIT_MASK 0x01 /end CHARACTERISTIC
/begin CHARACTERISTIC RES_u16ExcitDelayC "Resolver excitation delay" VALUE 0x80058ACC DATA_RECORD_UWORD 6553.5 F_0v1_p0_38 0 6553.5 /end CHARACTERISTIC
/begin CHARACTERISTIC RES_u16SyncDelay2C "Delay time between the failing eadg of the CS to the generation of SyncPos signal" VALUE 0x80058AC8 DATA_RECORD_UWORD 6553.5 F_0v1_p0_38 0 6553.5 /end CHARACTERISTIC
/begin CHARACTERISTIC RES_u16SyncDelayC "Delay time between the failing eadg of the CS to the generation of SyncPos signal" VALUE 0x80058ACA DATA_RECORD_UWORD 6553.5 F_0v1_p0_38 0 6553.5 /end CHARACTERISTIC
/begin CHARACTERISTIC RES_u16VSICkreqPeriodDefC "Resolver default value for VSI Ckreq period" VALUE 0x80058AC6 DATA_RECORD_UWORD 6553.5 F_0v1_p0_38 0 6553.5 /end CHARACTERISTIC
/begin CHARACTERISTIC RES_u8ExcitDutyPercentC "Resolver excitation duty cycle value" VALUE 0x8005804B DATA_RECORD_UBYTE 255 F_1_p0_6 0 255 /end CHARACTERISTIC
/begin CHARACTERISTIC RES_u8SyncDutyPercentC "Resolver excitation duty cycle value" VALUE 0x8005804A DATA_RECORD_UBYTE 255 F_1_p0_6 0 255 /end CHARACTERISTIC
/begin MEASUREMENT ADCTotalTime "ADCTotalTime" ULONG I_1 1 2 0 4294967295 ECU_ADDRESS 0x700055C4 /end MEASUREMENT
/begin MEASUREMENT AMAIN_ESMGo2StartupIEvent "Evï¿½nement pour rï¿½initialiser lautomate ESM" UBYTE Bool_ON_OFF 1 2 0 1 BIT_MASK 0x01 ECU_ADDRESS 0x70004D85 /end MEASUREMENT
/begin MEASUREMENT AMAIN_MSGf32MCU_LvVoltPhys "..." FLOAT32_IEEE I_3 1 2 -3.402823466E+038 3.402823466E+038 ECU_ADDRESS 0x70004C98 /end MEASUREMENT
/begin MEASUREMENT AMAIN_MSGu8BMS_MainNegConnSts "..." UBYTE I_1 1 2 0 255 ECU_ADDRESS 0x70004C61 /end MEASUREMENT
/begin MEASUREMENT AMAIN_MSGu8BMS_MainPosConnSts "..." UBYTE I_1 1 2 0 255 ECU_ADDRESS 0x70004C60 /end MEASUREMENT
/begin MEASUREMENT AMAIN_MSGu8DCU_OfsAlCalSts "..." UBYTE I_1 1 2 0 255 ECU_ADDRESS 0x70004C27 /end MEASUREMENT
/begin MEASUREMENT AMAIN_MSGu8DEV_Fault0 "..." UBYTE I_1 1 2 0 255 ECU_ADDRESS 0x70004C5F /end MEASUREMENT
/begin MEASUREMENT AMAIN_MSGu8DEV_Fault1 "..." UBYTE I_1 1 2 0 255 ECU_ADDRESS 0x70004C5E /end MEASUREMENT
/begin MEASUREMENT AMAIN_MSGu8DEV_Fault10 "..." UBYTE I_1 1 2 0 255 ECU_ADDRESS 0x70004C5D /end MEASUREMENT
/begin MEASUREMENT AMAIN_MSGu8DEV_Fault11 "..." UBYTE I_1 1 2 0 255 ECU_ADDRESS 0x70004C5C /end MEASUREMENT
/begin MEASUREMENT AMAIN_MSGu8DEV_Fault12 "..." UBYTE I_1 1 2 0 255 ECU_ADDRESS 0x70004C5B /end MEASUREMENT
/begin MEASUREMENT AMAIN_MSGu8DEV_Fault13 "..." UBYTE I_1 1 2 0 255 ECU_ADDRESS 0x70004C5A /end MEASUREMENT
/begin MEASUREMENT AMAIN_MSGu8DEV_Fault14 "..." UBYTE I_1 1 2 0 255 ECU_ADDRESS 0x70004C59 /end MEASUREMENT
/begin MEASUREMENT AMAIN_MSGu8DEV_Fault15 "..." UBYTE I_1 1 2 0 255 ECU_ADDRESS 0x70004C58 /end MEASUREMENT
/begin MEASUREMENT AMAIN_MSGu8DEV_Fault2 "..." UBYTE I_1 1 2 0 255 ECU_ADDRESS 0x70004C57 /end MEASUREMENT
/begin MEASUREMENT AMAIN_MSGu8DEV_Fault3 "..." UBYTE I_1 1 2 0 255 ECU_ADDRESS 0x70004C56 /end MEASUREMENT
/begin MEASUREMENT AMAIN_MSGu8DEV_Fault4 "..." UBYTE I_1 1 2 0 255 ECU_ADDRESS 0x70004C55 /end MEASUREMENT
/begin MEASUREMENT AMAIN_MSGu8DEV_Fault5 "..." UBYTE I_1 1 2 0 255 ECU_ADDRESS 0x70004C54 /end MEASUREMENT
/begin MEASUREMENT AMAIN_MSGu8DEV_Fault6 "..." UBYTE I_1 1 2 0 255 ECU_ADDRESS 0x70004C53 /end MEASUREMENT
/begin MEASUREMENT AMAIN_MSGu8DEV_Fault7 "..." UBYTE I_1 1 2 0 255 ECU_ADDRESS 0x70004C52 /end MEASUREMENT
/begin MEASUREMENT AMAIN_MSGu8DEV_Fault8 "..." UBYTE I_1 1 2 0 255 ECU_ADDRESS 0x70004C51 /end MEASUREMENT
/begin MEASUREMENT AMAIN_MSGu8DEV_Fault9 "..." UBYTE I_1 1 2 0 255 ECU_ADDRESS 0x70004C50 /end MEASUREMENT
/begin MEASUREMENT AMAIN_MSGu8MCU_McuEnableSts "..." UBYTE I_1 1 2 0 255 ECU_ADDRESS 0x70004BF7 /end MEASUREMENT
/begin MEASUREMENT AMAIN_MSGu8McuHVLoopFlt "..." UBYTE I_1 1 2 0 255 ECU_ADDRESS 0x70004BF4 /end MEASUREMENT
/begin MEASUREMENT AMAIN_MSGu8McuHwCapOVFlt "..." UBYTE I_1 1 2 0 255 ECU_ADDRESS 0x70004BF3 /end MEASUREMENT
/begin MEASUREMENT AMAIN_MSGu8McuIgbtFlt "..." UBYTE I_1 1 2 0 255 ECU_ADDRESS 0x70004BF2 /end MEASUREMENT
/begin MEASUREMENT AMAIN_MSGu8McuInvtTempSensErr "..." UBYTE I_1 1 2 0 255 ECU_ADDRESS 0x70004BF1 /end MEASUREMENT
/begin MEASUREMENT AMAIN_MSGu8McuLVVoltFlt "..." UBYTE I_1 1 2 0 255 ECU_ADDRESS 0x70004BF0 /end MEASUREMENT
/begin MEASUREMENT AMAIN_MSGu8McuMemoryFlt "..." UBYTE I_1 1 2 0 255 ECU_ADDRESS 0x70004BEF /end MEASUREMENT
/begin MEASUREMENT AMAIN_MSGu8McuMotLockRotErr "..." UBYTE I_1 1 2 0 255 ECU_ADDRESS 0x70004BEE /end MEASUREMENT
/begin MEASUREMENT AMAIN_MSGu8McuMotSN "..." UBYTE I_1 1 2 0 255 ECU_ADDRESS 0x70004BED /end MEASUREMENT
/begin MEASUREMENT AMAIN_MSGu8McuMotSpdHighAlarm "..." UBYTE I_1 1 2 0 255 ECU_ADDRESS 0x70004BEC /end MEASUREMENT
/begin MEASUREMENT AMAIN_MSGu8McuMotSubFltLevel "..." UBYTE I_1 1 2 0 255 ECU_ADDRESS 0x70004BEB /end MEASUREMENT
/begin MEASUREMENT AMAIN_MSGu8McuMotSysOVCAlarm "..." UBYTE I_1 1 2 0 255 ECU_ADDRESS 0x70004BEA /end MEASUREMENT
/begin MEASUREMENT AMAIN_MSGu8McuMotTempHighAlarm "..." UBYTE I_1 1 2 0 255 ECU_ADDRESS 0x70004BE9 /end MEASUREMENT
/begin MEASUREMENT AMAIN_MSGu8McuMotTempSensErr "..." UBYTE I_1 1 2 0 255 ECU_ADDRESS 0x70004BE8 /end MEASUREMENT
/begin MEASUREMENT AMAIN_MSGu8McuResolverFlt "..." UBYTE I_1 1 2 0 255 ECU_ADDRESS 0x70004BE7 /end MEASUREMENT
/begin MEASUREMENT AMAIN_MSGu8McuSoftCapOVFlt "..." UBYTE I_1 1 2 0 255 ECU_ADDRESS 0x70004BE6 /end MEASUREMENT
/begin MEASUREMENT AMAIN_MSGu8McuSoftMajorVer "..." UBYTE I_1 1 2 0 255 ECU_ADDRESS 0x70004BE5 /end MEASUREMENT
/begin MEASUREMENT AMAIN_MSGu8McuSoftMinorVer "..." UBYTE I_1 1 2 0 255 ECU_ADDRESS 0x70004BE4 /end MEASUREMENT
/begin MEASUREMENT AMAIN_MSGu8McuTempHighAlarm "..." UBYTE I_1 1 2 0 255 ECU_ADDRESS 0x70004BE3 /end MEASUREMENT
/begin MEASUREMENT AMAIN_MSGu8McuUCurSensFlt "..." UBYTE I_1 1 2 0 255 ECU_ADDRESS 0x70004BE2 /end MEASUREMENT
/begin MEASUREMENT AMAIN_MSGu8McuVCurSensFlt "..." UBYTE I_1 1 2 0 255 ECU_ADDRESS 0x70004BE1 /end MEASUREMENT
/begin MEASUREMENT AMAIN_MSGu8McuWCurSensFlt "..." UBYTE I_1 1 2 0 255 ECU_ADDRESS 0x70004BE0 /end MEASUREMENT
/begin MEASUREMENT AMAIN_MSGu8VCU_AccPedPosRaw "..." UBYTE I_1 1 2 0 255 ECU_ADDRESS 0x70004BD6 /end MEASUREMENT
/begin MEASUREMENT AMAIN_MSGu8VCU_EMWorkMod "..." UBYTE I_1 1 2 0 255 ECU_ADDRESS 0x70004BD2 /end MEASUREMENT
/begin MEASUREMENT AMAIN_MSGu8VCU_HandBrakSts "..." UBYTE I_1 1 2 0 255 ECU_ADDRESS 0x70004BCF /end MEASUREMENT
/begin MEASUREMENT AMAIN_MSGu8VCU_McuEnableReq "..." UBYTE I_1 1 2 0 255 ECU_ADDRESS 0x70004BCE /end MEASUREMENT
/begin MEASUREMENT AMAIN_MSGu8VCU_ePTReady "..." UBYTE I_1 1 2 0 255 ECU_ADDRESS 0x70004BD1 /end MEASUREMENT
/begin MEASUREMENT AMAIN_TotalTime "AMAIN_TotalTime" ULONG I_1 1 2 0 4294967295 ECU_ADDRESS 0x70004B24 /end MEASUREMENT
/begin MEASUREMENT AMAIN_VSITxsPwmUl "AMAIN_VSITxsPwmUl" UWORD F_0v0061035156_p0_4 1 2 0 399.9938965 ECU_ADDRESS 0x70004B3A /end MEASUREMENT
/begin MEASUREMENT AMAIN_VSITxsPwmUlOn "AMAIN_VSITxsPwmUlOn" UBYTE Bool_ON_OFF 1 2 0 1 BIT_MASK 0x01 ECU_ADDRESS 0x70004D40 /end MEASUREMENT
/begin MEASUREMENT AMAIN_VSITxsPwmUr "AMAIN_VSITxsPwmUr" UWORD F_0v0061035156_p0_4 1 2 0 399.9938965 ECU_ADDRESS 0x70004B38 /end MEASUREMENT
/begin MEASUREMENT AMAIN_VSITxsPwmUrOn "AMAIN_VSITxsPwmUrOn" UBYTE Bool_ON_OFF 1 2 0 1 BIT_MASK 0x01 ECU_ADDRESS 0x70004D3F /end MEASUREMENT
/begin MEASUREMENT AMAIN_VSITxsPwmVl "AMAIN_VSITxsPwmVl" UWORD F_0v0061035156_p0_4 1 2 0 399.9938965 ECU_ADDRESS 0x70004B36 /end MEASUREMENT
/begin MEASUREMENT AMAIN_VSITxsPwmVlOn "AMAIN_VSITxsPwmVlOn" UBYTE Bool_ON_OFF 1 2 0 1 BIT_MASK 0x01 ECU_ADDRESS 0x70004D3E /end MEASUREMENT
/begin MEASUREMENT AMAIN_VSITxsPwmVr "AMAIN_VSITxsPwmVr" UWORD F_0v0061035156_p0_4 1 2 0 399.9938965 ECU_ADDRESS 0x70004B34 /end MEASUREMENT
/begin MEASUREMENT AMAIN_VSITxsPwmVrOn "AMAIN_VSITxsPwmVrOn" UBYTE Bool_ON_OFF 1 2 0 1 BIT_MASK 0x01 ECU_ADDRESS 0x70004D3D /end MEASUREMENT
/begin MEASUREMENT AMAIN_VSITxsPwmWl "AMAIN_VSITxsPwmWl" UWORD F_0v0061035156_p0_4 1 2 0 399.9938965 ECU_ADDRESS 0x70004B32 /end MEASUREMENT
/begin MEASUREMENT AMAIN_VSITxsPwmWlOn "AMAIN_VSITxsPwmWlOn" UBYTE Bool_ON_OFF 1 2 0 1 BIT_MASK 0x01 ECU_ADDRESS 0x70004D3C /end MEASUREMENT
/begin MEASUREMENT AMAIN_VSITxsPwmWr "AMAIN_VSITxsPwmWr" UWORD F_0v0061035156_p0_4 1 2 0 399.9938965 ECU_ADDRESS 0x70004B30 /end MEASUREMENT
/begin MEASUREMENT AMAIN_VSITxsPwmWrOn "AMAIN_VSITxsPwmWrOn" UBYTE Bool_ON_OFF 1 2 0 1 BIT_MASK 0x01 ECU_ADDRESS 0x70004D3B /end MEASUREMENT
/begin MEASUREMENT AMAIN_as32OCTrimNvm "-" SLONG Id_0x00 1 2 -2147483648 2147483647 MATRIX_DIM 5 1 1 ECU_ADDRESS 0x70004B04 /end MEASUREMENT
/begin MEASUREMENT AMAIN_as32OCTrimNvm[0] "AMAIN_as32OCTrimNvm[0]" SLONG Id_0x00 1 2 -2147483648 2147483647 ECU_ADDRESS 0x70004B04 /end MEASUREMENT
/begin MEASUREMENT AMAIN_as32OCTrimNvm[1] "AMAIN_as32OCTrimNvm[1]" SLONG Id_0x00 1 2 -2147483648 2147483647 ECU_ADDRESS 0x70004B08 /end MEASUREMENT
/begin MEASUREMENT AMAIN_as32OCTrimNvm[2] "AMAIN_as32OCTrimNvm[2]" SLONG Id_0x00 1 2 -2147483648 2147483647 ECU_ADDRESS 0x70004B0C /end MEASUREMENT
/begin MEASUREMENT AMAIN_as32OCTrimNvm[3] "AMAIN_as32OCTrimNvm[3]" SLONG Id_0x00 1 2 -2147483648 2147483647 ECU_ADDRESS 0x70004B10 /end MEASUREMENT
/begin MEASUREMENT AMAIN_as32OCTrimNvm[4] "AMAIN_as32OCTrimNvm[4]" SLONG Id_0x00 1 2 -2147483648 2147483647 ECU_ADDRESS 0x70004B14 /end MEASUREMENT
/begin MEASUREMENT AMAIN_au16CalibParamNvm[0] "-" UWORD F_1_p0_5 1 2 0 65535 ECU_ADDRESS 0x70004D9E /end MEASUREMENT
/begin MEASUREMENT AMAIN_au16CalibParamNvm[1] "-" UWORD F_1_p0_5 1 2 0 65535 ECU_ADDRESS 0x70004DA0 /end MEASUREMENT
/begin MEASUREMENT AMAIN_au16CalibParamNvm[2] "-" UWORD F_1_p0_5 1 2 0 65535 ECU_ADDRESS 0x70004DA2 /end MEASUREMENT
/begin MEASUREMENT AMAIN_au16CalibParamNvm[3] "-" UWORD F_1_p0_5 1 2 0 65535 ECU_ADDRESS 0x70004DA4 /end MEASUREMENT
/begin MEASUREMENT AMAIN_au16CalibParamNvm[4] "-" UWORD F_1_p0_5 1 2 0 65535 ECU_ADDRESS 0x70004DA6 /end MEASUREMENT
/begin MEASUREMENT AMAIN_au16CalibParamNvm[5] "-" UWORD F_1_p0_5 1 2 0 65535 ECU_ADDRESS 0x70004DA8 /end MEASUREMENT
/begin MEASUREMENT AMAIN_au16CalibParamNvm[6] "-" UWORD F_1_p0_5 1 2 0 65535 ECU_ADDRESS 0x70004DAA /end MEASUREMENT
/begin MEASUREMENT AMAIN_au16CalibParamNvm[7] "-" UWORD F_1_p0_5 1 2 0 65535 ECU_ADDRESS 0x70004DAC /end MEASUREMENT
/begin MEASUREMENT AMAIN_au16CalibParamNvm[8] "-" UWORD F_1_p0_5 1 2 0 65535 ECU_ADDRESS 0x70004DAE /end MEASUREMENT
/begin MEASUREMENT AMAIN_au8ErrCode "-" UBYTE F_1_p0_5 1 2 0 255 MATRIX_DIM 20 1 1 ECU_ADDRESS 0x70004C3A /end MEASUREMENT
/begin MEASUREMENT AMAIN_au8ErrCode[0] "AMAIN_au8ErrCode[0]" UBYTE F_1_p0_5 1 2 0 255 ECU_ADDRESS 0x70004C3A /end MEASUREMENT
/begin MEASUREMENT AMAIN_au8ErrCode[10] "AMAIN_au8ErrCode[10]" UBYTE F_1_p0_5 1 2 0 255 ECU_ADDRESS 0x70004C44 /end MEASUREMENT
/begin MEASUREMENT AMAIN_au8ErrCode[11] "AMAIN_au8ErrCode[11]" UBYTE F_1_p0_5 1 2 0 255 ECU_ADDRESS 0x70004C45 /end MEASUREMENT
/begin MEASUREMENT AMAIN_au8ErrCode[12] "AMAIN_au8ErrCode[12]" UBYTE F_1_p0_5 1 2 0 255 ECU_ADDRESS 0x70004C46 /end MEASUREMENT
/begin MEASUREMENT AMAIN_au8ErrCode[13] "AMAIN_au8ErrCode[13]" UBYTE F_1_p0_5 1 2 0 255 ECU_ADDRESS 0x70004C47 /end MEASUREMENT
/begin MEASUREMENT AMAIN_au8ErrCode[14] "AMAIN_au8ErrCode[14]" UBYTE F_1_p0_5 1 2 0 255 ECU_ADDRESS 0x70004C48 /end MEASUREMENT
/begin MEASUREMENT AMAIN_au8ErrCode[15] "AMAIN_au8ErrCode[15]" UBYTE F_1_p0_5 1 2 0 255 ECU_ADDRESS 0x70004C49 /end MEASUREMENT
/begin MEASUREMENT AMAIN_au8ErrCode[16] "AMAIN_au8ErrCode[16]" UBYTE F_1_p0_5 1 2 0 255 ECU_ADDRESS 0x70004C4A /end MEASUREMENT
/begin MEASUREMENT AMAIN_au8ErrCode[17] "AMAIN_au8ErrCode[17]" UBYTE F_1_p0_5 1 2 0 255 ECU_ADDRESS 0x70004C4B /end MEASUREMENT
/begin MEASUREMENT AMAIN_au8ErrCode[18] "AMAIN_au8ErrCode[18]" UBYTE F_1_p0_5 1 2 0 255 ECU_ADDRESS 0x70004C4C /end MEASUREMENT
/begin MEASUREMENT AMAIN_au8ErrCode[19] "AMAIN_au8ErrCode[19]" UBYTE F_1_p0_5 1 2 0 255 ECU_ADDRESS 0x70004C4D /end MEASUREMENT
/begin MEASUREMENT AMAIN_au8ErrCode[1] "AMAIN_au8ErrCode[1]" UBYTE F_1_p0_5 1 2 0 255 ECU_ADDRESS 0x70004C3B /end MEASUREMENT
/begin MEASUREMENT AMAIN_au8ErrCode[2] "AMAIN_au8ErrCode[2]" UBYTE F_1_p0_5 1 2 0 255 ECU_ADDRESS 0x70004C3C /end MEASUREMENT
/begin MEASUREMENT AMAIN_au8ErrCode[3] "AMAIN_au8ErrCode[3]" UBYTE F_1_p0_5 1 2 0 255 ECU_ADDRESS 0x70004C3D /end MEASUREMENT
/begin MEASUREMENT AMAIN_au8ErrCode[4] "AMAIN_au8ErrCode[4]" UBYTE F_1_p0_5 1 2 0 255 ECU_ADDRESS 0x70004C3E /end MEASUREMENT
/begin MEASUREMENT AMAIN_au8ErrCode[5] "AMAIN_au8ErrCode[5]" UBYTE F_1_p0_5 1 2 0 255 ECU_ADDRESS 0x70004C3F /end MEASUREMENT
/begin MEASUREMENT AMAIN_au8ErrCode[6] "AMAIN_au8ErrCode[6]" UBYTE F_1_p0_5 1 2 0 255 ECU_ADDRESS 0x70004C40 /end MEASUREMENT
/begin MEASUREMENT AMAIN_au8ErrCode[7] "AMAIN_au8ErrCode[7]" UBYTE F_1_p0_5 1 2 0 255 ECU_ADDRESS 0x70004C41 /end MEASUREMENT
/begin MEASUREMENT AMAIN_au8ErrCode[8] "AMAIN_au8ErrCode[8]" UBYTE F_1_p0_5 1 2 0 255 ECU_ADDRESS 0x70004C42 /end MEASUREMENT
/begin MEASUREMENT AMAIN_au8ErrCode[9] "AMAIN_au8ErrCode[9]" UBYTE F_1_p0_5 1 2 0 255 ECU_ADDRESS 0x70004C43 /end MEASUREMENT
/begin MEASUREMENT AMAIN_bAntiSlopGearEna "..." UBYTE Bool_ON_OFF 1 2 0 1 BIT_MASK 0x01 ECU_ADDRESS 0x70004D9D /end MEASUREMENT
/begin MEASUREMENT AMAIN_bAscFlag "Flag ESM started" UBYTE Bool_ON_OFF 1 2 0 1 BIT_MASK 0x01 ECU_ADDRESS 0x70004D9C /end MEASUREMENT
/begin MEASUREMENT AMAIN_bBswReadySts "BSW Power on check finish flag." UBYTE Bool_ON_OFF 1 2 0 1 BIT_MASK 0x01 ECU_ADDRESS 0x70004D9B /end MEASUREMENT
/begin MEASUREMENT AMAIN_bESMStarted "Flag ESM started" UBYTE Bool_ON_OFF 1 2 0 1 BIT_MASK 0x01 ECU_ADDRESS 0x70004D9A /end MEASUREMENT
/begin MEASUREMENT AMAIN_bFTInitFinshFlg "FT Initilize finished flag" UBYTE Bool_ON_OFF 1 2 0 1 BIT_MASK 0x01 ECU_ADDRESS 0x70004D99 /end MEASUREMENT
/begin MEASUREMENT AMAIN_bOCStoreManualReq "..." UBYTE Bool_ON_OFF 1 2 0 1 BIT_MASK 0x01 ECU_ADDRESS 0x70004D39 /end MEASUREMENT
/begin MEASUREMENT AMAIN_bOcDataStoreEna "..." UBYTE Bool_ON_OFF 1 2 0 1 BIT_MASK 0x01 ECU_ADDRESS 0x70004AF0 /end MEASUREMENT
/begin MEASUREMENT AMAIN_bOcFailureFlg "..." UBYTE Bool_ON_OFF 1 2 0 1 BIT_MASK 0x01 ECU_ADDRESS 0x70004D98 /end MEASUREMENT
/begin MEASUREMENT AMAIN_bOcFinshFlg "..." UBYTE Bool_ON_OFF 1 2 0 1 BIT_MASK 0x01 ECU_ADDRESS 0x70004D97 /end MEASUREMENT
/begin MEASUREMENT AMAIN_bOcModeEna "OC mode enable flag" UBYTE Bool_ON_OFF 1 2 0 1 BIT_MASK 0x01 ECU_ADDRESS 0x70004D96 /end MEASUREMENT
/begin MEASUREMENT AMAIN_bOcNotRatFlg "..." UBYTE Bool_ON_OFF 1 2 0 1 BIT_MASK 0x01 ECU_ADDRESS 0x70004D95 /end MEASUREMENT
/begin MEASUREMENT AMAIN_bOcRdResultFlag "..." UBYTE Bool_ON_OFF 1 2 0 1 BIT_MASK 0x01 ECU_ADDRESS 0x70004D94 /end MEASUREMENT
/begin MEASUREMENT AMAIN_bOcStartFlag "..." UBYTE Bool_ON_OFF 1 2 0 1 BIT_MASK 0x01 ECU_ADDRESS 0x70004D93 /end MEASUREMENT
/begin MEASUREMENT AMAIN_bPosAccessLock "Must be Volatile variable." UBYTE Bool_ON_OFF 1 2 0 1 BIT_MASK 0x01 ECU_ADDRESS 0x70004D90 /end MEASUREMENT
/begin MEASUREMENT AMAIN_bProgConditionOk "..." UBYTE Bool_ON_OFF 1 2 0 1 BIT_MASK 0x01 ECU_ADDRESS 0x70004D38 /end MEASUREMENT
/begin MEASUREMENT AMAIN_bResExcFltDetEna "..." UBYTE Bool_ON_OFF 1 2 0 1 BIT_MASK 0x01 ECU_ADDRESS 0x70004D8F /end MEASUREMENT
/begin MEASUREMENT AMAIN_bSlopSlideTimoutFlg "..." UBYTE Bool_ON_OFF 1 2 0 1 BIT_MASK 0x01 ECU_ADDRESS 0x70004D8E /end MEASUREMENT
/begin MEASUREMENT AMAIN_bSoftOvBhvFlg "..." UBYTE Bool_ON_OFF 1 2 0 1 BIT_MASK 0x01 ECU_ADDRESS 0x70004D8D /end MEASUREMENT
/begin MEASUREMENT AMAIN_bSoftOvCurrPhsUFlg "..." UBYTE Bool_ON_OFF 1 2 0 1 BIT_MASK 0x01 ECU_ADDRESS 0x70004D8C /end MEASUREMENT
/begin MEASUREMENT AMAIN_bSoftOvCurrPhsVFlg "..." UBYTE Bool_ON_OFF 1 2 0 1 BIT_MASK 0x01 ECU_ADDRESS 0x70004D8B /end MEASUREMENT
/begin MEASUREMENT AMAIN_bSoftOvCurrPhsWFlg "..." UBYTE Bool_ON_OFF 1 2 0 1 BIT_MASK 0x01 ECU_ADDRESS 0x70004D8A /end MEASUREMENT
/begin MEASUREMENT AMAIN_bSpdReadyEst "..." UBYTE Bool_ON_OFF 1 2 0 1 BIT_MASK 0x01 ECU_ADDRESS 0x70004D89 /end MEASUREMENT
/begin MEASUREMENT AMAIN_bSpeedReadyFlg "..." UBYTE Bool_ON_OFF 1 2 0 1 BIT_MASK 0x01 ECU_ADDRESS 0x70004D88 /end MEASUREMENT
/begin MEASUREMENT AMAIN_bTeachInCompleteFlg "..." UBYTE Bool_ON_OFF 1 2 0 1 BIT_MASK 0x01 ECU_ADDRESS 0x70004D87 /end MEASUREMENT
/begin MEASUREMENT AMAIN_bVSIStarted "Flag VSI started" UBYTE Bool_ON_OFF 1 2 0 1 BIT_MASK 0x01 ECU_ADDRESS 0x70004D86 /end MEASUREMENT
/begin MEASUREMENT AMAIN_f32AntiSsEnaBrakPos "..." FLOAT32_IEEE I_8 1 2 -3.402823466E+038 3.402823466E+038 ECU_ADDRESS 0x70004D34 /end MEASUREMENT
/begin MEASUREMENT AMAIN_f32ElecSpeedRds "..." FLOAT32_IEEE F_1_p0_10 1 2 -3.402823466E+038 3.402823466E+038 ECU_ADDRESS 0x70004D30 /end MEASUREMENT
/begin MEASUREMENT AMAIN_f32EmailElecSpeedRds "..." FLOAT32_IEEE F_1_p0_10 1 2 -3.402823466E+038 3.402823466E+038 ECU_ADDRESS 0x70004D2C /end MEASUREMENT
/begin MEASUREMENT AMAIN_f32EmailErrThetaRdSurPi "..." FLOAT32_IEEE F_1_p0_10 1 2 -3.402823466E+038 3.402823466E+038 ECU_ADDRESS 0x70004D28 /end MEASUREMENT
/begin MEASUREMENT AMAIN_f32EmailMecaSpeedRds "..." FLOAT32_IEEE F_1_p0_10 1 2 -3.402823466E+038 3.402823466E+038 ECU_ADDRESS 0x70004D24 /end MEASUREMENT
/begin MEASUREMENT AMAIN_f32EmailMecaSpeedRpm "..." FLOAT32_IEEE F_1_p0_10 1 2 -3.402823466E+038 3.402823466E+038 ECU_ADDRESS 0x70004D20 /end MEASUREMENT
/begin MEASUREMENT AMAIN_f32EmailNextThetaElecRdSurPi "..." FLOAT32_IEEE F_1_p0_10 1 2 -3.402823466E+038 3.402823466E+038 ECU_ADDRESS 0x70004D1C /end MEASUREMENT
/begin MEASUREMENT AMAIN_f32EmailThetaElecRdSurPi "..." FLOAT32_IEEE F_1_p0_10 1 2 -3.402823466E+038 3.402823466E+038 ECU_ADDRESS 0x70004D18 /end MEASUREMENT
/begin MEASUREMENT AMAIN_f32ErrThetaRdSurPi "..." FLOAT32_IEEE F_1_p0_10 1 2 -3.402823466E+038 3.402823466E+038 ECU_ADDRESS 0x70004D14 /end MEASUREMENT
/begin MEASUREMENT AMAIN_f32EstTempRatioScale "..." FLOAT32_IEEE F_1_p0_5 1 2 -3.402823466E+038 3.402823466E+038 ECU_ADDRESS 0x70004D10 /end MEASUREMENT
/begin MEASUREMENT AMAIN_f32IdDeltaAvg "..." FLOAT32_IEEE F_1_p0_5 1 2 -3.402823466E+038 3.402823466E+038 ECU_ADDRESS 0x70004D0C /end MEASUREMENT
/begin MEASUREMENT AMAIN_f32IdDeltaSum "..." FLOAT32_IEEE F_1_p0_5 1 2 -3.402823466E+038 3.402823466E+038 ECU_ADDRESS 0x70004D08 /end MEASUREMENT
/begin MEASUREMENT AMAIN_f32IdQuality "..." FLOAT32_IEEE F_1_p0_6 1 2 -3.402823466E+038 3.402823466E+038 ECU_ADDRESS 0x70004D04 /end MEASUREMENT
/begin MEASUREMENT AMAIN_f32IqDeltaAvg "..." FLOAT32_IEEE F_1_p0_5 1 2 -3.402823466E+038 3.402823466E+038 ECU_ADDRESS 0x70004D00 /end MEASUREMENT
/begin MEASUREMENT AMAIN_f32IqDeltaSum "..." FLOAT32_IEEE F_1_p0_5 1 2 -3.402823466E+038 3.402823466E+038 ECU_ADDRESS 0x70004CFC /end MEASUREMENT
/begin MEASUREMENT AMAIN_f32IqQuality "..." FLOAT32_IEEE F_1_p0_6 1 2 -3.402823466E+038 3.402823466E+038 ECU_ADDRESS 0x70004CF8 /end MEASUREMENT
/begin MEASUREMENT AMAIN_f32IuFrequency "..." FLOAT32_IEEE F_1_p0_11 1 2 -3.402823466E+038 3.402823466E+038 ECU_ADDRESS 0x70004CF4 /end MEASUREMENT
/begin MEASUREMENT AMAIN_f32IuPeriod "..." FLOAT32_IEEE F_1_p0_12 1 2 -3.402823466E+038 3.402823466E+038 ECU_ADDRESS 0x70004CF0 /end MEASUREMENT
/begin MEASUREMENT AMAIN_f32MecaSpeedRds "..." FLOAT32_IEEE F_1_p0_10 1 2 -3.402823466E+038 3.402823466E+038 ECU_ADDRESS 0x70004CEC /end MEASUREMENT
/begin MEASUREMENT AMAIN_f32MecaSpeedRpm "..." FLOAT32_IEEE F_1_p0_10 1 2 -3.402823466E+038 3.402823466E+038 ECU_ADDRESS 0x70004CE8 /end MEASUREMENT
/begin MEASUREMENT AMAIN_f32MotSpdEst "..." FLOAT32_IEEE F_1_p0_12 1 2 -3.402823466E+038 3.402823466E+038 ECU_ADDRESS 0x70004CE4 /end MEASUREMENT
/begin MEASUREMENT AMAIN_f32PWMDutyUPhys "..." FLOAT32_IEEE F_100_p0_13 1 2 -3.402823466E+038 3.402823466E+038 ECU_ADDRESS 0x70004CE0 /end MEASUREMENT
/begin MEASUREMENT AMAIN_f32PWMDutyVPhys "..." FLOAT32_IEEE F_100_p0_13 1 2 -3.402823466E+038 3.402823466E+038 ECU_ADDRESS 0x70004CDC /end MEASUREMENT
/begin MEASUREMENT AMAIN_f32PWMDutyWPhys "..." FLOAT32_IEEE F_100_p0_13 1 2 -3.402823466E+038 3.402823466E+038 ECU_ADDRESS 0x70004CD8 /end MEASUREMENT
/begin MEASUREMENT AMAIN_f32ThetaElecRdSurPi "..." FLOAT32_IEEE F_1_p0_10 1 2 -3.402823466E+038 3.402823466E+038 ECU_ADDRESS 0x70004CD4 /end MEASUREMENT
/begin MEASUREMENT AMAIN_f32VsiPwmPeriod "..." FLOAT32_IEEE F_1000000_p0_15 1 2 -3.402823466E+038 3.402823466E+038 ECU_ADDRESS 0x70004CD0 /end MEASUREMENT
/begin MEASUREMENT AMAIN_s32DeltTimDiff "..." SLONG F_0v01_p0_16 1 2 -21474836.48 21474836.47 ECU_ADDRESS 0x70004B00 /end MEASUREMENT
/begin MEASUREMENT AMAIN_s32Email2PosTreqDiff "..." SLONG I_1 1 2 -2147483648 2147483647 ECU_ADDRESS 0x70004AFC /end MEASUREMENT
/begin MEASUREMENT AMAIN_s32PosA2BDeltTimMax "..." SLONG F_0v1_p0_17 1 2 -214748364.8 214748364.7 ECU_ADDRESS 0x70004AF8 /end MEASUREMENT
/begin MEASUREMENT AMAIN_s32PosA2BDeltTimMin "..." SLONG F_0v1_p0_17 1 2 -214748364.8 214748364.7 ECU_ADDRESS 0x70004AF4 /end MEASUREMENT
/begin MEASUREMENT AMAIN_u16AntiSsBrakTimCnt "..." UWORD I_1 1 2 0 65535 ECU_ADDRESS 0x70004B90 /end MEASUREMENT
/begin MEASUREMENT AMAIN_u16AntiSsEnaBrakCnt "..." UWORD I_1 1 2 0 65535 ECU_ADDRESS 0x70004B8E /end MEASUREMENT
/begin MEASUREMENT AMAIN_u16AntiSsValidCnt "..." UWORD I_1 1 2 0 65535 ECU_ADDRESS 0x70004B8C /end MEASUREMENT
/begin MEASUREMENT AMAIN_u16BrakRelsDelayCnt "..." UWORD I_1 1 2 0 65535 ECU_ADDRESS 0x70004B8A /end MEASUREMENT
/begin MEASUREMENT AMAIN_u16Cnt20 "AMAIN_u16Cnt20" UWORD I_1 1 2 0 65535 ECU_ADDRESS 0x70004B82 /end MEASUREMENT
/begin MEASUREMENT AMAIN_u16Cnt2000 "AMAIN_u16Cnt2000" UWORD I_1 1 2 0 65535 ECU_ADDRESS 0x70004B80 /end MEASUREMENT
/begin MEASUREMENT AMAIN_u16Cnt30 "AMAIN_u16Cnt30" UWORD I_1 1 2 0 65535 ECU_ADDRESS 0x70004B7E /end MEASUREMENT
/begin MEASUREMENT AMAIN_u16Cnt4 "AMAIN_u16Cnt4" UWORD I_1 1 2 0 65535 ECU_ADDRESS 0x70004B7C /end MEASUREMENT
/begin MEASUREMENT AMAIN_u16Cnt50 "AMAIN_u16Cnt50" UWORD I_1 1 2 0 65535 ECU_ADDRESS 0x70004B7A /end MEASUREMENT
/begin MEASUREMENT AMAIN_u16Cnt500 "AMAIN_u16Cnt500" UWORD I_1 1 2 0 65535 ECU_ADDRESS 0x70004B78 /end MEASUREMENT
/begin MEASUREMENT AMAIN_u16Core1Cnt1 "AMAIN_u16Core1Cnt1" UWORD I_1 1 2 0 65535 ECU_ADDRESS 0x70004B76 /end MEASUREMENT
/begin MEASUREMENT AMAIN_u16Core1Cnt100 "AMAIN_u16Core1Cnt100" UWORD I_1 1 2 0 65535 ECU_ADDRESS 0x70004B74 /end MEASUREMENT
/begin MEASUREMENT AMAIN_u16Core1Cnt200 "AMAIN_u16Core1Cnt200" UWORD I_1 1 2 0 65535 ECU_ADDRESS 0x70004B72 /end MEASUREMENT
/begin MEASUREMENT AMAIN_u16Core2Cnt1 "AMAIN_u16Core2Cnt1" UWORD I_1 1 2 0 65535 ECU_ADDRESS 0x70004B88 /end MEASUREMENT
/begin MEASUREMENT AMAIN_u16Core2Cnt10 "AMAIN_u16Core2Cnt10" UWORD I_1 1 2 0 65535 ECU_ADDRESS 0x70004B70 /end MEASUREMENT
/begin MEASUREMENT AMAIN_u16Core2Cnt2 "AMAIN_u16Core2Cnt2" UWORD I_1 1 2 0 65535 ECU_ADDRESS 0x70004B86 /end MEASUREMENT
/begin MEASUREMENT AMAIN_u16Core2Cnt5 "AMAIN_u16Core2Cnt5" UWORD I_1 1 2 0 65535 ECU_ADDRESS 0x70004B84 /end MEASUREMENT
/begin MEASUREMENT AMAIN_u16FaultDelayCnt "AMAIN_u16FaultDelayCnt" UWORD I_1 1 2 0 65535 ECU_ADDRESS 0x70004B6C /end MEASUREMENT
/begin MEASUREMENT AMAIN_u16FpgaFltClrCnt "AMAIN_u16FpgaFltClrCnt" UWORD I_1 1 2 0 65535 ECU_ADDRESS 0x70004B6A /end MEASUREMENT
/begin MEASUREMENT AMAIN_u16HandBrkRelsDelay "..." UWORD I_1 1 2 0 65535 ECU_ADDRESS 0x70004B68 /end MEASUREMENT
/begin MEASUREMENT AMAIN_u16IdqDeltaSumCnt "AMAIN_u16IdqDeltaSumCnt" UWORD I_1 1 2 0 65535 ECU_ADDRESS 0x70004B66 /end MEASUREMENT
/begin MEASUREMENT AMAIN_u16IuCycleCnt "..." UWORD I_1 1 2 0 65535 ECU_ADDRESS 0x70004B64 /end MEASUREMENT
/begin MEASUREMENT AMAIN_u16IuMiddleCnt "..." UWORD I_1 1 2 0 65535 ECU_ADDRESS 0x70004B62 /end MEASUREMENT
/begin MEASUREMENT AMAIN_u16IuMiddleSum "..." UWORD I_1 1 2 0 65535 ECU_ADDRESS 0x70004B60 /end MEASUREMENT
/begin MEASUREMENT AMAIN_u16IuNegtiveCnt "..." UWORD I_1 1 2 0 65535 ECU_ADDRESS 0x70004B5E /end MEASUREMENT
/begin MEASUREMENT AMAIN_u16IuNegtiveSum "..." UWORD I_1 1 2 0 65535 ECU_ADDRESS 0x70004B5C /end MEASUREMENT
/begin MEASUREMENT AMAIN_u16IuPositiveCnt "..." UWORD I_1 1 2 0 65535 ECU_ADDRESS 0x70004B5A /end MEASUREMENT
/begin MEASUREMENT AMAIN_u16IuPositiveSum "..." UWORD I_1 1 2 0 65535 ECU_ADDRESS 0x70004B58 /end MEASUREMENT
/begin MEASUREMENT AMAIN_u16MotorStallCnt "..." UWORD I_1 1 2 0 65535 ECU_ADDRESS 0x70004B56 /end MEASUREMENT
/begin MEASUREMENT AMAIN_u16OverVolHighDelay "AMAIN_u16OverVolHighDelay" UWORD I_1 1 2 0 65535 ECU_ADDRESS 0x70004B54 /end MEASUREMENT
/begin MEASUREMENT AMAIN_u16OverVolLowDelay "AMAIN_u16OverVolLowDelay" UWORD I_1 1 2 0 65535 ECU_ADDRESS 0x70004B52 /end MEASUREMENT
/begin MEASUREMENT AMAIN_u16OverVolMidDelay "AMAIN_u16OverVolMidDelay" UWORD I_1 1 2 0 65535 ECU_ADDRESS 0x70004B50 /end MEASUREMENT
/begin MEASUREMENT AMAIN_u16PWMPeriodVal "AMAIN_u16PWMPeriodVal" UWORD I_1 1 2 0 65535 ECU_ADDRESS 0x70000AA6 /end MEASUREMENT
/begin MEASUREMENT AMAIN_u16ResCosADVal "AMAIN_u16ResCosADVal" UWORD I_1 1 2 0 65535 ECU_ADDRESS 0x70004B4E /end MEASUREMENT
/begin MEASUREMENT AMAIN_u16ResSinADVal "AMAIN_u16ResSinADVal" UWORD I_1 1 2 0 65535 ECU_ADDRESS 0x70004B4C /end MEASUREMENT
/begin MEASUREMENT AMAIN_u16SlopSlideTimCnt "..." UWORD I_1 1 2 0 65535 ECU_ADDRESS 0x70004B4A /end MEASUREMENT
/begin MEASUREMENT AMAIN_u16SlopSpdConfirmCnt "..." UWORD I_1 1 2 0 65535 ECU_ADDRESS 0x70004B48 /end MEASUREMENT
/begin MEASUREMENT AMAIN_u16SpdReadyEstCnt "..." UWORD I_1 1 2 0 65535 ECU_ADDRESS 0x70004B46 /end MEASUREMENT
/begin MEASUREMENT AMAIN_u16T12CntVal "AMAIN_u16T12CntVal" UWORD I_1 1 2 0 65535 ECU_ADDRESS 0x70004B44 /end MEASUREMENT
/begin MEASUREMENT AMAIN_u16TeachInWrtDelayCnt "AMAIN_u16TeachInWrtDelayCnt" UWORD I_1 1 2 0 65535 ECU_ADDRESS 0x70004B42 /end MEASUREMENT
/begin MEASUREMENT AMAIN_u16VadcPhaseCurU "AMAIN_u16VadcPhaseCurU" UWORD I_1 1 2 0 65535 ECU_ADDRESS 0x70004B40 /end MEASUREMENT
/begin MEASUREMENT AMAIN_u16VadcPhaseCurV "AMAIN_u16VadcPhaseCurV" UWORD I_1 1 2 0 65535 ECU_ADDRESS 0x70004B3E /end MEASUREMENT
/begin MEASUREMENT AMAIN_u16VadcPhaseCurW "AMAIN_u16VadcPhaseCurW" UWORD I_1 1 2 0 65535 ECU_ADDRESS 0x70004B3C /end MEASUREMENT
/begin MEASUREMENT AMAIN_u32EmailCkreq "..." ULONG I_1 1 2 0 4294967295 ECU_ADDRESS 0x70004C7C /end MEASUREMENT
/begin MEASUREMENT AMAIN_u32EmailPosATimeStamp "..." ULONG I_1 1 2 0 4294967295 ECU_ADDRESS 0x70004C78 /end MEASUREMENT
/begin MEASUREMENT AMAIN_u32IuCycleTim "..." ULONG I_1 1 2 0 4294967295 ECU_ADDRESS 0x70004C74 /end MEASUREMENT
/begin MEASUREMENT AMAIN_u32PosATimeStamp "..." ULONG I_1 1 2 0 4294967295 ECU_ADDRESS 0x70004C70 /end MEASUREMENT
/begin MEASUREMENT AMAIN_u32PosBTimeStamp "..." ULONG I_1 1 2 0 4294967295 ECU_ADDRESS 0x70004C6C /end MEASUREMENT
/begin MEASUREMENT AMAIN_u32PosTreatCkreq "..." ULONG I_1 1 2 0 4294967295 ECU_ADDRESS 0x70004C68 /end MEASUREMENT
/begin MEASUREMENT AMAIN_u32TestVar2 "AMAIN_u32TestVar2" ULONG I_1 1 2 0 4294967295 ECU_ADDRESS 0x70004C64 /end MEASUREMENT
/begin MEASUREMENT AMAIN_u8DEV_Fault "-" UBYTE F_1_p0_5 1 2 0 255 MATRIX_DIM 16 1 1 ECU_ADDRESS 0x70004C2A /end MEASUREMENT
/begin MEASUREMENT AMAIN_u8DEV_Fault[0] "AMAIN_u8DEV_Fault[0]" UBYTE F_1_p0_5 1 2 0 255 ECU_ADDRESS 0x70004C2A /end MEASUREMENT
/begin MEASUREMENT AMAIN_u8DEV_Fault[10] "AMAIN_u8DEV_Fault[10]" UBYTE F_1_p0_5 1 2 0 255 ECU_ADDRESS 0x70004C34 /end MEASUREMENT
/begin MEASUREMENT AMAIN_u8DEV_Fault[11] "AMAIN_u8DEV_Fault[11]" UBYTE F_1_p0_5 1 2 0 255 ECU_ADDRESS 0x70004C35 /end MEASUREMENT
/begin MEASUREMENT AMAIN_u8DEV_Fault[12] "AMAIN_u8DEV_Fault[12]" UBYTE F_1_p0_5 1 2 0 255 ECU_ADDRESS 0x70004C36 /end MEASUREMENT
/begin MEASUREMENT AMAIN_u8DEV_Fault[13] "AMAIN_u8DEV_Fault[13]" UBYTE F_1_p0_5 1 2 0 255 ECU_ADDRESS 0x70004C37 /end MEASUREMENT
/begin MEASUREMENT AMAIN_u8DEV_Fault[14] "AMAIN_u8DEV_Fault[14]" UBYTE F_1_p0_5 1 2 0 255 ECU_ADDRESS 0x70004C38 /end MEASUREMENT
/begin MEASUREMENT AMAIN_u8DEV_Fault[15] "AMAIN_u8DEV_Fault[15]" UBYTE F_1_p0_5 1 2 0 255 ECU_ADDRESS 0x70004C39 /end MEASUREMENT
/begin MEASUREMENT AMAIN_u8DEV_Fault[1] "AMAIN_u8DEV_Fault[1]" UBYTE F_1_p0_5 1 2 0 255 ECU_ADDRESS 0x70004C2B /end MEASUREMENT
/begin MEASUREMENT AMAIN_u8DEV_Fault[2] "AMAIN_u8DEV_Fault[2]" UBYTE F_1_p0_5 1 2 0 255 ECU_ADDRESS 0x70004C2C /end MEASUREMENT
/begin MEASUREMENT AMAIN_u8DEV_Fault[3] "AMAIN_u8DEV_Fault[3]" UBYTE F_1_p0_5 1 2 0 255 ECU_ADDRESS 0x70004C2D /end MEASUREMENT
/begin MEASUREMENT AMAIN_u8DEV_Fault[4] "AMAIN_u8DEV_Fault[4]" UBYTE F_1_p0_5 1 2 0 255 ECU_ADDRESS 0x70004C2E /end MEASUREMENT
/begin MEASUREMENT AMAIN_u8DEV_Fault[5] "AMAIN_u8DEV_Fault[5]" UBYTE F_1_p0_5 1 2 0 255 ECU_ADDRESS 0x70004C2F /end MEASUREMENT
/begin MEASUREMENT AMAIN_u8DEV_Fault[6] "AMAIN_u8DEV_Fault[6]" UBYTE F_1_p0_5 1 2 0 255 ECU_ADDRESS 0x70004C30 /end MEASUREMENT
/begin MEASUREMENT AMAIN_u8DEV_Fault[7] "AMAIN_u8DEV_Fault[7]" UBYTE F_1_p0_5 1 2 0 255 ECU_ADDRESS 0x70004C31 /end MEASUREMENT
/begin MEASUREMENT AMAIN_u8DEV_Fault[8] "AMAIN_u8DEV_Fault[8]" UBYTE F_1_p0_5 1 2 0 255 ECU_ADDRESS 0x70004C32 /end MEASUREMENT
/begin MEASUREMENT AMAIN_u8DEV_Fault[9] "AMAIN_u8DEV_Fault[9]" UBYTE F_1_p0_5 1 2 0 255 ECU_ADDRESS 0x70004C33 /end MEASUREMENT
/begin MEASUREMENT AMAIN_u8ErrCodNum "AMAIN_u8ErrCodNum" UBYTE I_1 1 2 0 255 ECU_ADDRESS 0x70004BCB /end MEASUREMENT
/begin MEASUREMENT AMAIN_u8ErrCodRdIdx "AMAIN_u8ErrCodRdIdx" UBYTE I_1 1 2 0 255 ECU_ADDRESS 0x70004BCA /end MEASUREMENT
/begin MEASUREMENT AMAIN_u8ErrCodWrIdx "AMAIN_u8ErrCodWrIdx" UBYTE I_1 1 2 0 255 ECU_ADDRESS 0x70004BC9 /end MEASUREMENT
/begin MEASUREMENT AMAIN_u8FaultSum "..." UBYTE I_1 1 2 0 255 ECU_ADDRESS 0x70004C4E /end MEASUREMENT
/begin MEASUREMENT AMAIN_u8OcState "AMAIN_u8OcState" UBYTE I_1 1 2 0 255 ECU_ADDRESS 0x70004BC8 /end MEASUREMENT
/begin MEASUREMENT AMAIN_u8OcStsRptDelayCnt "AMAIN_u8OcStsRptDelayCnt" UBYTE I_1 1 2 0 255 ECU_ADDRESS 0x70004BC7 /end MEASUREMENT
/begin MEASUREMENT AMAIN_u8OverVolIndex "AMAIN_u8OverVolIndex" UBYTE I_1 1 2 0 255 ECU_ADDRESS 0x70004BC6 /end MEASUREMENT
/begin MEASUREMENT AMAIN_u8PrevGearPos "..." UBYTE I_1 1 2 0 255 ECU_ADDRESS 0x70004BC5 /end MEASUREMENT
/begin MEASUREMENT AMAIN_u8TcFaultCodeL3 "AMAIN_u8TcFaultCodeL3" UBYTE I_1 1 2 0 255 ECU_ADDRESS 0x70004BC4 /end MEASUREMENT
/begin MEASUREMENT AMAIN_u8TcFaultCodeL5 "AMAIN_u8TcFaultCodeL5" UBYTE I_1 1 2 0 255 ECU_ADDRESS 0x70004BC3 /end MEASUREMENT
/begin MEASUREMENT AMAIN_u8TestVar1 "AMAIN_u8TestVar1" UBYTE I_1 1 2 0 255 ECU_ADDRESS 0x70004BC2 /end MEASUREMENT
/begin MEASUREMENT AMAIN_u8TrigOcByUser "AMAIN_u8TrigOcByUser" UBYTE I_1 1 2 0 255 ECU_ADDRESS 0x70004C4F /end MEASUREMENT
/begin MEASUREMENT ASWNM_bFullComSts "..." UBYTE Bool_ON_OFF 1 2 0 1 BIT_MASK 0x01 ECU_ADDRESS 0x70000A9C /end MEASUREMENT
/begin MEASUREMENT ASWNM_u8CurrentState "..." UBYTE Id_0x00 1 2 0 255 MATRIX_DIM 21 1 1 ECU_ADDRESS 0x700015BC /end MEASUREMENT
/begin MEASUREMENT ASWNM_u8CurrentState[0] "ASWNM_u8CurrentState[0]" UBYTE Id_0x00 1 2 0 255 ECU_ADDRESS 0x700015BC /end MEASUREMENT
/begin MEASUREMENT ASWNM_u8CurrentState[10] "ASWNM_u8CurrentState[10]" UBYTE Id_0x00 1 2 0 255 ECU_ADDRESS 0x700015C6 /end MEASUREMENT
/begin MEASUREMENT ASWNM_u8CurrentState[11] "ASWNM_u8CurrentState[11]" UBYTE Id_0x00 1 2 0 255 ECU_ADDRESS 0x700015C7 /end MEASUREMENT
/begin MEASUREMENT ASWNM_u8CurrentState[12] "ASWNM_u8CurrentState[12]" UBYTE Id_0x00 1 2 0 255 ECU_ADDRESS 0x700015C8 /end MEASUREMENT
/begin MEASUREMENT ASWNM_u8CurrentState[13] "ASWNM_u8CurrentState[13]" UBYTE Id_0x00 1 2 0 255 ECU_ADDRESS 0x700015C9 /end MEASUREMENT
/begin MEASUREMENT ASWNM_u8CurrentState[14] "ASWNM_u8CurrentState[14]" UBYTE Id_0x00 1 2 0 255 ECU_ADDRESS 0x700015CA /end MEASUREMENT
/begin MEASUREMENT ASWNM_u8CurrentState[15] "ASWNM_u8CurrentState[15]" UBYTE Id_0x00 1 2 0 255 ECU_ADDRESS 0x700015CB /end MEASUREMENT
/begin MEASUREMENT ASWNM_u8CurrentState[16] "ASWNM_u8CurrentState[16]" UBYTE Id_0x00 1 2 0 255 ECU_ADDRESS 0x700015CC /end MEASUREMENT
/begin MEASUREMENT ASWNM_u8CurrentState[17] "ASWNM_u8CurrentState[17]" UBYTE Id_0x00 1 2 0 255 ECU_ADDRESS 0x700015CD /end MEASUREMENT
/begin MEASUREMENT ASWNM_u8CurrentState[18] "ASWNM_u8CurrentState[18]" UBYTE Id_0x00 1 2 0 255 ECU_ADDRESS 0x700015CE /end MEASUREMENT
/begin MEASUREMENT ASWNM_u8CurrentState[19] "ASWNM_u8CurrentState[19]" UBYTE Id_0x00 1 2 0 255 ECU_ADDRESS 0x700015CF /end MEASUREMENT
/begin MEASUREMENT ASWNM_u8CurrentState[1] "ASWNM_u8CurrentState[1]" UBYTE Id_0x00 1 2 0 255 ECU_ADDRESS 0x700015BD /end MEASUREMENT
/begin MEASUREMENT ASWNM_u8CurrentState[20] "ASWNM_u8CurrentState[20]" UBYTE Id_0x00 1 2 0 255 ECU_ADDRESS 0x700015D0 /end MEASUREMENT
/begin MEASUREMENT ASWNM_u8CurrentState[2] "ASWNM_u8CurrentState[2]" UBYTE Id_0x00 1 2 0 255 ECU_ADDRESS 0x700015BE /end MEASUREMENT
/begin MEASUREMENT ASWNM_u8CurrentState[3] "ASWNM_u8CurrentState[3]" UBYTE Id_0x00 1 2 0 255 ECU_ADDRESS 0x700015BF /end MEASUREMENT
/begin MEASUREMENT ASWNM_u8CurrentState[4] "ASWNM_u8CurrentState[4]" UBYTE Id_0x00 1 2 0 255 ECU_ADDRESS 0x700015C0 /end MEASUREMENT
/begin MEASUREMENT ASWNM_u8CurrentState[5] "ASWNM_u8CurrentState[5]" UBYTE Id_0x00 1 2 0 255 ECU_ADDRESS 0x700015C1 /end MEASUREMENT
/begin MEASUREMENT ASWNM_u8CurrentState[6] "ASWNM_u8CurrentState[6]" UBYTE Id_0x00 1 2 0 255 ECU_ADDRESS 0x700015C2 /end MEASUREMENT
/begin MEASUREMENT ASWNM_u8CurrentState[7] "ASWNM_u8CurrentState[7]" UBYTE Id_0x00 1 2 0 255 ECU_ADDRESS 0x700015C3 /end MEASUREMENT
/begin MEASUREMENT ASWNM_u8CurrentState[8] "ASWNM_u8CurrentState[8]" UBYTE Id_0x00 1 2 0 255 ECU_ADDRESS 0x700015C4 /end MEASUREMENT
/begin MEASUREMENT ASWNM_u8CurrentState[9] "ASWNM_u8CurrentState[9]" UBYTE Id_0x00 1 2 0 255 ECU_ADDRESS 0x700015C5 /end MEASUREMENT
/begin MEASUREMENT CPU0_MaximumUtilization "..." FLOAT32_IEEE F_1_p0_10 1 2 -3.402823466E+038 3.402823466E+038 ECU_ADDRESS 0x700012C8 /end MEASUREMENT
/begin MEASUREMENT CPU0_PercentUtilization "..." FLOAT32_IEEE F_1_p0_10 1 2 -3.402823466E+038 3.402823466E+038 ECU_ADDRESS 0x700012CC /end MEASUREMENT
/begin MEASUREMENT CPU1_MaximumUtilization "..." FLOAT32_IEEE F_1_p0_10 1 2 -3.402823466E+038 3.402823466E+038 ECU_ADDRESS 0x70001470 /end MEASUREMENT
/begin MEASUREMENT CPU1_PercentUtilization "..." FLOAT32_IEEE F_1_p0_10 1 2 -3.402823466E+038 3.402823466E+038 ECU_ADDRESS 0x70001474 /end MEASUREMENT
/begin MEASUREMENT CPU2_MaximumUtilization "..." FLOAT32_IEEE F_1_p0_10 1 2 -3.402823466E+038 3.402823466E+038 ECU_ADDRESS 0x70001548 /end MEASUREMENT
/begin MEASUREMENT CPU2_PercentUtilization "..." FLOAT32_IEEE F_1_p0_10 1 2 -3.402823466E+038 3.402823466E+038 ECU_ADDRESS 0x7000154C /end MEASUREMENT
/begin MEASUREMENT Calibration_debut "Calibration_debut" UWORD I_1 1 2 0 65535 ECU_ADDRESS 0x80058000 /end MEASUREMENT
/begin MEASUREMENT Core0_Asw100msStartTime "..." ULONG F_0v01_p0_24 1 2 0 42949672.95 ECU_ADDRESS 0x70005214 /end MEASUREMENT
/begin MEASUREMENT Core0_Asw100msStopTime "..." ULONG F_0v01_p0_24 1 2 0 42949672.95 ECU_ADDRESS 0x70005210 /end MEASUREMENT
/begin MEASUREMENT Core0_Asw100msTotalTime "..." ULONG F_0v01_p0_24 1 2 0 42949672.95 ECU_ADDRESS 0x7000520C /end MEASUREMENT
/begin MEASUREMENT Core0_Asw10msStartTime "..." ULONG F_0v01_p0_24 1 2 0 42949672.95 ECU_ADDRESS 0x70005208 /end MEASUREMENT
/begin MEASUREMENT Core0_Asw10msStopTime "..." ULONG F_0v01_p0_24 1 2 0 42949672.95 ECU_ADDRESS 0x70005204 /end MEASUREMENT
/begin MEASUREMENT Core0_Asw10msTotalTime "..." ULONG F_0v01_p0_24 1 2 0 42949672.95 ECU_ADDRESS 0x70005200 /end MEASUREMENT
/begin MEASUREMENT Core0_Bsw100msStartTime "..." ULONG F_0v01_p0_24 1 2 0 42949672.95 ECU_ADDRESS 0x700051FC /end MEASUREMENT
/begin MEASUREMENT Core0_Bsw100msStopTime "..." ULONG F_0v01_p0_24 1 2 0 42949672.95 ECU_ADDRESS 0x700051F8 /end MEASUREMENT
/begin MEASUREMENT Core0_Bsw100msTotalTime "..." ULONG F_0v01_p0_24 1 2 0 42949672.95 ECU_ADDRESS 0x700051F4 /end MEASUREMENT
/begin MEASUREMENT Core0_Bsw10msStartTime "..." ULONG F_0v01_p0_24 1 2 0 42949672.95 ECU_ADDRESS 0x700051F0 /end MEASUREMENT
/begin MEASUREMENT Core0_Bsw10msStopTime "..." ULONG F_0v01_p0_24 1 2 0 42949672.95 ECU_ADDRESS 0x700051EC /end MEASUREMENT
/begin MEASUREMENT Core0_Bsw10msTotalTime "..." ULONG F_0v01_p0_24 1 2 0 42949672.95 ECU_ADDRESS 0x700051E8 /end MEASUREMENT
/begin MEASUREMENT Core0_Bsw1msStartTime "..." ULONG F_0v01_p0_24 1 2 0 42949672.95 ECU_ADDRESS 0x700051E4 /end MEASUREMENT
/begin MEASUREMENT Core0_Bsw1msStopTime "..." ULONG F_0v01_p0_24 1 2 0 42949672.95 ECU_ADDRESS 0x700051E0 /end MEASUREMENT
/begin MEASUREMENT Core0_Bsw1msTotalTime "..." ULONG F_0v01_p0_24 1 2 0 42949672.95 ECU_ADDRESS 0x700051DC /end MEASUREMENT
/begin MEASUREMENT Core0_Bsw50msStartTime "..." ULONG F_0v01_p0_24 1 2 0 42949672.95 ECU_ADDRESS 0x700051D8 /end MEASUREMENT
/begin MEASUREMENT Core0_Bsw50msStopTime "..." ULONG F_0v01_p0_24 1 2 0 42949672.95 ECU_ADDRESS 0x700051D4 /end MEASUREMENT
/begin MEASUREMENT Core0_Bsw50msTotalTime "..." ULONG F_0v01_p0_24 1 2 0 42949672.95 ECU_ADDRESS 0x700051D0 /end MEASUREMENT
/begin MEASUREMENT Core0_f32Asw100msLoad "..." FLOAT32_IEEE F_1_p0_10 1 2 -3.402823466E+038 3.402823466E+038 ECU_ADDRESS 0x7000515C /end MEASUREMENT
/begin MEASUREMENT Core0_f32Asw10msLoad "..." FLOAT32_IEEE F_1_p0_10 1 2 -3.402823466E+038 3.402823466E+038 ECU_ADDRESS 0x70005158 /end MEASUREMENT
/begin MEASUREMENT Core0_f32Bsw100msLoad "..." FLOAT32_IEEE F_1_p0_10 1 2 -3.402823466E+038 3.402823466E+038 ECU_ADDRESS 0x70005154 /end MEASUREMENT
/begin MEASUREMENT Core0_f32Bsw10msLoad "..." FLOAT32_IEEE F_1_p0_10 1 2 -3.402823466E+038 3.402823466E+038 ECU_ADDRESS 0x70005150 /end MEASUREMENT
/begin MEASUREMENT Core0_f32Bsw1msLoad "..." FLOAT32_IEEE F_1_p0_10 1 2 -3.402823466E+038 3.402823466E+038 ECU_ADDRESS 0x7000514C /end MEASUREMENT
/begin MEASUREMENT Core0_f32Bsw50msLoad "..." FLOAT32_IEEE F_1_p0_10 1 2 -3.402823466E+038 3.402823466E+038 ECU_ADDRESS 0x70005148 /end MEASUREMENT
/begin MEASUREMENT Core0_f32ModReqLoad "..." FLOAT32_IEEE F_1_p0_10 1 2 -3.402823466E+038 3.402823466E+038 ECU_ADDRESS 0x70005160 /end MEASUREMENT
/begin MEASUREMENT Core0_f32VsiTreatmentLoad "..." FLOAT32_IEEE F_1_p0_10 1 2 -3.402823466E+038 3.402823466E+038 ECU_ADDRESS 0x70005144 /end MEASUREMENT
/begin MEASUREMENT Core1_Asw10msStartTime "..." ULONG F_0v01_p0_24 1 2 0 42949672.95 ECU_ADDRESS 0x700051C0 /end MEASUREMENT
/begin MEASUREMENT Core1_Asw10msStopTime "..." ULONG F_0v01_p0_24 1 2 0 42949672.95 ECU_ADDRESS 0x700051BC /end MEASUREMENT
/begin MEASUREMENT Core1_Asw10msTotalTime "..." ULONG F_0v01_p0_24 1 2 0 42949672.95 ECU_ADDRESS 0x700051B8 /end MEASUREMENT
/begin MEASUREMENT Core1_Asw1msStartTime "..." ULONG F_0v01_p0_24 1 2 0 42949672.95 ECU_ADDRESS 0x700051B4 /end MEASUREMENT
/begin MEASUREMENT Core1_Asw1msStopTime "..." ULONG F_0v01_p0_24 1 2 0 42949672.95 ECU_ADDRESS 0x700051B0 /end MEASUREMENT
/begin MEASUREMENT Core1_Asw1msTotalTime "..." ULONG F_0v01_p0_24 1 2 0 42949672.95 ECU_ADDRESS 0x700051AC /end MEASUREMENT
/begin MEASUREMENT Core1_Bsw10msStartTime "..." ULONG F_0v01_p0_24 1 2 0 42949672.95 ECU_ADDRESS 0x700051A8 /end MEASUREMENT
/begin MEASUREMENT Core1_Bsw10msStopTime "..." ULONG F_0v01_p0_24 1 2 0 42949672.95 ECU_ADDRESS 0x700051A4 /end MEASUREMENT
/begin MEASUREMENT Core1_Bsw10msTotalTime "..." ULONG F_0v01_p0_24 1 2 0 42949672.95 ECU_ADDRESS 0x700051A0 /end MEASUREMENT
/begin MEASUREMENT Core1_f32Asw10msLoad "..." FLOAT32_IEEE F_1_p0_10 1 2 -3.402823466E+038 3.402823466E+038 ECU_ADDRESS 0x70005140 /end MEASUREMENT
/begin MEASUREMENT Core1_f32Asw1msLoad "..." FLOAT32_IEEE F_1_p0_10 1 2 -3.402823466E+038 3.402823466E+038 ECU_ADDRESS 0x7000513C /end MEASUREMENT
/begin MEASUREMENT Core1_f32Bsw10msLoad "..." FLOAT32_IEEE F_1_p0_10 1 2 -3.402823466E+038 3.402823466E+038 ECU_ADDRESS 0x70005138 /end MEASUREMENT
/begin MEASUREMENT Core1_f32PosTreatmentLoad "..." FLOAT32_IEEE F_1_p0_10 1 2 -3.402823466E+038 3.402823466E+038 ECU_ADDRESS 0x70005134 /end MEASUREMENT
/begin MEASUREMENT Core2_Asw10msStartTime "..." ULONG F_0v01_p0_24 1 2 0 42949672.95 ECU_ADDRESS 0x70005190 /end MEASUREMENT
/begin MEASUREMENT Core2_Asw10msStopTime "..." ULONG F_0v01_p0_24 1 2 0 42949672.95 ECU_ADDRESS 0x7000518C /end MEASUREMENT
/begin MEASUREMENT Core2_Asw10msTotalTime "..." ULONG F_0v01_p0_24 1 2 0 42949672.95 ECU_ADDRESS 0x70005188 /end MEASUREMENT
/begin MEASUREMENT Core2_Asw1msStartTime "..." ULONG F_0v01_p0_24 1 2 0 42949672.95 ECU_ADDRESS 0x70005184 /end MEASUREMENT
/begin MEASUREMENT Core2_Asw1msStopTime "..." ULONG F_0v01_p0_24 1 2 0 42949672.95 ECU_ADDRESS 0x70005180 /end MEASUREMENT
/begin MEASUREMENT Core2_Asw1msTotalTime "..." ULONG F_0v01_p0_24 1 2 0 42949672.95 ECU_ADDRESS 0x7000517C /end MEASUREMENT
/begin MEASUREMENT Core2_Bsw10msStartTime "..." ULONG F_0v01_p0_24 1 2 0 42949672.95 ECU_ADDRESS 0x70005178 /end MEASUREMENT
/begin MEASUREMENT Core2_Bsw10msStopTime "..." ULONG F_0v01_p0_24 1 2 0 42949672.95 ECU_ADDRESS 0x70005174 /end MEASUREMENT
/begin MEASUREMENT Core2_Bsw10msTotalTime "..." ULONG F_0v01_p0_24 1 2 0 42949672.95 ECU_ADDRESS 0x70005170 /end MEASUREMENT
/begin MEASUREMENT Core2_f32Asw10msLoad "..." FLOAT32_IEEE F_1_p0_10 1 2 -3.402823466E+038 3.402823466E+038 ECU_ADDRESS 0x70005130 /end MEASUREMENT
/begin MEASUREMENT Core2_f32Asw1msLoad "..." FLOAT32_IEEE F_1_p0_10 1 2 -3.402823466E+038 3.402823466E+038 ECU_ADDRESS 0x7000512C /end MEASUREMENT
/begin MEASUREMENT Core2_f32Bsw10msLoad "..." FLOAT32_IEEE F_1_p0_10 1 2 -3.402823466E+038 3.402823466E+038 ECU_ADDRESS 0x70005128 /end MEASUREMENT
/begin MEASUREMENT HARD_bDioWriteTestEna "HARD activation" UBYTE Bool_ON_OFF 1 2 0 1 BIT_MASK 0x01 ECU_ADDRESS 0x7002200D /end MEASUREMENT
/begin MEASUREMENT MAIN_ESMGo2StartupIEvent "Evï¿½nement pour rï¿½initialiser lautomate ESM" UBYTE Bool_ON_OFF 1 2 0 1 BIT_MASK 0x01 ECU_ADDRESS 0x70005594 /end MEASUREMENT
/begin MEASUREMENT MAIN_MSGbACP_APTCTempSts "MAIN_MSGbACP_APTCTempSts" UBYTE Bool_ON_OFF 1 2 0 1 BIT_MASK 0x01 ECU_ADDRESS 0x70004EF9 /end MEASUREMENT
/begin MEASUREMENT MAIN_MSGbACP_EACEnaCmd "MAIN_MSGbACP_EACEnaCmd" UBYTE Bool_ON_OFF 1 2 0 1 BIT_MASK 0x01 ECU_ADDRESS 0x70004F10 /end MEASUREMENT
/begin MEASUREMENT MAIN_MSGbACP_EvaporatorTempSts "MAIN_MSGbACP_EvaporatorTempSts" UBYTE Bool_ON_OFF 1 2 0 1 BIT_MASK 0x01 ECU_ADDRESS 0x70004EFA /end MEASUREMENT
/begin MEASUREMENT MAIN_MSGbAirPumpRelayEnableSignal "MAIN_MSGbAirPumpRelayEnableSignal" UBYTE Bool_ON_OFF 1 2 0 1 BIT_MASK 0x01 ECU_ADDRESS 0x70004ED1 /end MEASUREMENT
/begin MEASUREMENT MAIN_MSGbBMS_BattCellEqualizationSts "MAIN_MSGbBMS_BattCellEqualizationSts" UBYTE Bool_ON_OFF 1 2 0 1 BIT_MASK 0x01 ECU_ADDRESS 0x70004F22 /end MEASUREMENT
/begin MEASUREMENT MAIN_MSGbBMS_BattConstantSts "MAIN_MSGbBMS_BattConstantSts" UBYTE Bool_ON_OFF 1 2 0 1 BIT_MASK 0x01 ECU_ADDRESS 0x70004F2A /end MEASUREMENT
/begin MEASUREMENT MAIN_MSGbBMS_PTCSts "MAIN_MSGbBMS_PTCSts" UBYTE Bool_ON_OFF 1 2 0 1 BIT_MASK 0x01 ECU_ADDRESS 0x70004F2C /end MEASUREMENT
/begin MEASUREMENT MAIN_MSGbBMS_Powerdown "MAIN_MSGbBMS_Powerdown" UBYTE Bool_ON_OFF 1 2 0 1 BIT_MASK 0x01 ECU_ADDRESS 0x70004F25 /end MEASUREMENT
/begin MEASUREMENT MAIN_MSGbBMS_QuickchargeStsRequest "MAIN_MSGbBMS_QuickchargeStsRequest" UBYTE Bool_ON_OFF 1 2 0 1 BIT_MASK 0x01 ECU_ADDRESS 0x70004E5C /end MEASUREMENT
/begin MEASUREMENT MAIN_MSGbBMS_RequestQuickcharge "MAIN_MSGbBMS_RequestQuickcharge" UBYTE Bool_ON_OFF 1 2 0 1 BIT_MASK 0x01 ECU_ADDRESS 0x70004F1D /end MEASUREMENT
/begin MEASUREMENT MAIN_MSGbBMS_bKeepWarmSet "MAIN_MSGbBMS_bKeepWarmSet" UBYTE Bool_ON_OFF 1 2 0 1 BIT_MASK 0x01 ECU_ADDRESS 0x70004F24 /end MEASUREMENT
/begin MEASUREMENT MAIN_MSGbElevation_Valid "MAIN_MSGbElevation_Valid" UBYTE Bool_ON_OFF 1 2 0 1 BIT_MASK 0x01 ECU_ADDRESS 0x70004E94 /end MEASUREMENT
/begin MEASUREMENT MAIN_MSGbFMCU1_ActTrqValid "BSW Power on check finish flag." UBYTE Bool_ON_OFF 1 2 0 1 BIT_MASK 0x01 ECU_ADDRESS 0x7000558A /end MEASUREMENT
/begin MEASUREMENT MAIN_MSGbFMCU2_DischrgAllowed "BSW Power on check finish flag." UBYTE Bool_ON_OFF 1 2 0 1 BIT_MASK 0x01 ECU_ADDRESS 0x70005589 /end MEASUREMENT
/begin MEASUREMENT MAIN_MSGbMCU_ActiveAntiShake "MAIN_MSGbMCU_ActiveAntiShake" UBYTE Bool_ON_OFF 1 2 0 1 BIT_MASK 0x01 ECU_ADDRESS 0x70004E08 /end MEASUREMENT
/begin MEASUREMENT MAIN_MSGbMCU_CoderFault "MAIN_MSGbMCU_CoderFault" UBYTE Bool_ON_OFF 1 2 0 1 BIT_MASK 0x01 ECU_ADDRESS 0x70004E20 /end MEASUREMENT
/begin MEASUREMENT MAIN_MSGbMCU_CoverProtectionErr "MAIN_MSGbMCU_CoverProtectionErr" UBYTE Bool_ON_OFF 1 2 0 1 BIT_MASK 0x01 ECU_ADDRESS 0x70004DEF /end MEASUREMENT
/begin MEASUREMENT MAIN_MSGbMCU_DischrgFault "MAIN_MSGbMCU_DischrgFault" UBYTE Bool_ON_OFF 1 2 0 1 BIT_MASK 0x01 ECU_ADDRESS 0x70004E13 /end MEASUREMENT
/begin MEASUREMENT MAIN_MSGbMCU_EcuEepromFault "MAIN_MSGbMCU_EcuEepromFault" UBYTE Bool_ON_OFF 1 2 0 1 BIT_MASK 0x01 ECU_ADDRESS 0x70004E12 /end MEASUREMENT
/begin MEASUREMENT MAIN_MSGbMCU_EstimatedJunTemp "MAIN_MSGbMCU_EstimatedJunTemp" UBYTE Bool_ON_OFF 1 2 0 1 BIT_MASK 0x01 ECU_ADDRESS 0x70004DE8 /end MEASUREMENT
/begin MEASUREMENT MAIN_MSGbMCU_HSBiasAlarmFault "MAIN_MSGbMCU_HSBiasAlarmFault" UBYTE Bool_ON_OFF 1 2 0 1 BIT_MASK 0x01 ECU_ADDRESS 0x70004E1C /end MEASUREMENT
/begin MEASUREMENT MAIN_MSGbMCU_HWOverCrntFault "MAIN_MSGbMCU_HWOverCrntFault" UBYTE Bool_ON_OFF 1 2 0 1 BIT_MASK 0x01 ECU_ADDRESS 0x70004E23 /end MEASUREMENT
/begin MEASUREMENT MAIN_MSGbMCU_HWOverVoltFault "MAIN_MSGbMCU_HWOverVoltFault" UBYTE Bool_ON_OFF 1 2 0 1 BIT_MASK 0x01 ECU_ADDRESS 0x70004E22 /end MEASUREMENT
/begin MEASUREMENT MAIN_MSGbMCU_HWUnderVoltFault "MAIN_MSGbMCU_HWUnderVoltFault" UBYTE Bool_ON_OFF 1 2 0 1 BIT_MASK 0x01 ECU_ADDRESS 0x70004E21 /end MEASUREMENT
/begin MEASUREMENT MAIN_MSGbMCU_IGBTFault "MAIN_MSGbMCU_IGBTFault" UBYTE Bool_ON_OFF 1 2 0 1 BIT_MASK 0x01 ECU_ADDRESS 0x70004E24 /end MEASUREMENT
/begin MEASUREMENT MAIN_MSGbMCU_IGBTready "MAIN_MSGbMCU_IGBTready" UBYTE Bool_ON_OFF 1 2 0 1 BIT_MASK 0x01 ECU_ADDRESS 0x70004E0B /end MEASUREMENT
/begin MEASUREMENT MAIN_MSGbMCU_InvOvertempHigh "MAIN_MSGbMCU_InvOvertempHigh" UBYTE Bool_ON_OFF 1 2 0 1 BIT_MASK 0x01 ECU_ADDRESS 0x70004E0F /end MEASUREMENT
/begin MEASUREMENT MAIN_MSGbMCU_InvOvertempLow "MAIN_MSGbMCU_InvOvertempLow" UBYTE Bool_ON_OFF 1 2 0 1 BIT_MASK 0x01 ECU_ADDRESS 0x70004E10 /end MEASUREMENT
/begin MEASUREMENT MAIN_MSGbMCU_InverterOverTemp "MAIN_MSGbMCU_InverterOverTemp" UBYTE Bool_ON_OFF 1 2 0 1 BIT_MASK 0x01 ECU_ADDRESS 0x70004DFC /end MEASUREMENT
/begin MEASUREMENT MAIN_MSGbMCU_Level1EstimTorqReve "MAIN_MSGbMCU_Level1EstimTorqReve" UBYTE Bool_ON_OFF 1 2 0 1 BIT_MASK 0x01 ECU_ADDRESS 0x70004DED /end MEASUREMENT
/begin MEASUREMENT MAIN_MSGbMCU_Level1ExcEstimTorqDev "MAIN_MSGbMCU_Level1ExcEstimTorqDev" UBYTE Bool_ON_OFF 1 2 0 1 BIT_MASK 0x01 ECU_ADDRESS 0x70004DEC /end MEASUREMENT
/begin MEASUREMENT MAIN_MSGbMCU_Level2EstimTorqReve "MAIN_MSGbMCU_Level2EstimTorqReve" UBYTE Bool_ON_OFF 1 2 0 1 BIT_MASK 0x01 ECU_ADDRESS 0x70004DEA /end MEASUREMENT
/begin MEASUREMENT MAIN_MSGbMCU_Level2ExcEstimTorq "MAIN_MSGbMCU_Level2ExcEstimTorq" UBYTE Bool_ON_OFF 1 2 0 1 BIT_MASK 0x01 ECU_ADDRESS 0x70004DE9 /end MEASUREMENT
/begin MEASUREMENT MAIN_MSGbMCU_LosePhaseFault "MAIN_MSGbMCU_LosePhaseFault" UBYTE Bool_ON_OFF 1 2 0 1 BIT_MASK 0x01 ECU_ADDRESS 0x70004E1D /end MEASUREMENT
/begin MEASUREMENT MAIN_MSGbMCU_MCU_Bus_Fault "MAIN_MSGbMCU_MCU_Bus_Fault" UBYTE Bool_ON_OFF 1 2 0 1 BIT_MASK 0x01 ECU_ADDRESS 0x70004E27 /end MEASUREMENT
/begin MEASUREMENT MAIN_MSGbMCU_MOTLOCK_OL "MAIN_MSGbMCU_MOTLOCK_OL" UBYTE Bool_ON_OFF 1 2 0 1 BIT_MASK 0x01 ECU_ADDRESS 0x70004E00 /end MEASUREMENT
/begin MEASUREMENT MAIN_MSGbMCU_ModeError "MAIN_MSGbMCU_ModeError" UBYTE Bool_ON_OFF 1 2 0 1 BIT_MASK 0x01 ECU_ADDRESS 0x70004E09 /end MEASUREMENT
/begin MEASUREMENT MAIN_MSGbMCU_MotorOverLoadDerat "MAIN_MSGbMCU_MotorOverLoadDerat" UBYTE Bool_ON_OFF 1 2 0 1 BIT_MASK 0x01 ECU_ADDRESS 0x70004DEB /end MEASUREMENT
/begin MEASUREMENT MAIN_MSGbMCU_MotorOverTempA "MAIN_MSGbMCU_MotorOverTempA" UBYTE Bool_ON_OFF 1 2 0 1 BIT_MASK 0x01 ECU_ADDRESS 0x70004DFD /end MEASUREMENT
/begin MEASUREMENT MAIN_MSGbMCU_MotorTempBreakFault "MAIN_MSGbMCU_MotorTempBreakFault" UBYTE Bool_ON_OFF 1 2 0 1 BIT_MASK 0x01 ECU_ADDRESS 0x70004E15 /end MEASUREMENT
/begin MEASUREMENT MAIN_MSGbMCU_OverLoadFault "MAIN_MSGbMCU_OverLoadFault" UBYTE Bool_ON_OFF 1 2 0 1 BIT_MASK 0x01 ECU_ADDRESS 0x70004E18 /end MEASUREMENT
/begin MEASUREMENT MAIN_MSGbMCU_OverSpeedHighFault "MAIN_MSGbMCU_OverSpeedHighFault" UBYTE Bool_ON_OFF 1 2 0 1 BIT_MASK 0x01 ECU_ADDRESS 0x70004E16 /end MEASUREMENT
/begin MEASUREMENT MAIN_MSGbMCU_OverSpeedLowFault "MAIN_MSGbMCU_OverSpeedLowFault" UBYTE Bool_ON_OFF 1 2 0 1 BIT_MASK 0x01 ECU_ADDRESS 0x70004E17 /end MEASUREMENT
/begin MEASUREMENT MAIN_MSGbMCU_PassDischgTimeFault "MAIN_MSGbMCU_PassDischgTimeFault" UBYTE Bool_ON_OFF 1 2 0 1 BIT_MASK 0x01 ECU_ADDRESS 0x70004DEE /end MEASUREMENT
/begin MEASUREMENT MAIN_MSGbMCU_PhaseOverVoltFa "MAIN_MSGbMCU_PhaseOverVoltFa" UBYTE Bool_ON_OFF 1 2 0 1 BIT_MASK 0x01 ECU_ADDRESS 0x70004E1E /end MEASUREMENT
/begin MEASUREMENT MAIN_MSGbMCU_PhaseOverVoltFau "MAIN_MSGbMCU_PhaseOverVoltFau" UBYTE Bool_ON_OFF 1 2 0 1 BIT_MASK 0x01 ECU_ADDRESS 0x70004E1F /end MEASUREMENT
/begin MEASUREMENT MAIN_MSGbMCU_SWOverCrntFault "MAIN_MSGbMCU_SWOverCrntFault" UBYTE Bool_ON_OFF 1 2 0 1 BIT_MASK 0x01 ECU_ADDRESS 0x70004E1B /end MEASUREMENT
/begin MEASUREMENT MAIN_MSGbMCU_ShutdownAllowed "MAIN_MSGbMCU_ShutdownAllowed" UBYTE Bool_ON_OFF 1 2 0 1 BIT_MASK 0x01 ECU_ADDRESS 0x70004E0D /end MEASUREMENT
/begin MEASUREMENT MAIN_MSGbMCU_UnderVoltHighFault "MAIN_MSGbMCU_UnderVoltHighFault" UBYTE Bool_ON_OFF 1 2 0 1 BIT_MASK 0x01 ECU_ADDRESS 0x70004E19 /end MEASUREMENT
/begin MEASUREMENT MAIN_MSGbMCU_UnderVoltLowFault "MAIN_MSGbMCU_UnderVoltLowFault" UBYTE Bool_ON_OFF 1 2 0 1 BIT_MASK 0x01 ECU_ADDRESS 0x70004E1A /end MEASUREMENT
/begin MEASUREMENT MAIN_MSGbMCU_VoltBattOverVolta "MAIN_MSGbMCU_VoltBattOverVolta" UBYTE Bool_ON_OFF 1 2 0 1 BIT_MASK 0x01 ECU_ADDRESS 0x70004DF0 /end MEASUREMENT
/begin MEASUREMENT MAIN_MSGbMCU_alarmHighSpeedDir "MAIN_MSGbMCU_alarmHighSpeedDir" UBYTE Bool_ON_OFF 1 2 0 1 BIT_MASK 0x01 ECU_ADDRESS 0x70004E0E /end MEASUREMENT
/begin MEASUREMENT MAIN_MSGbMCU_alarmHighSpeedStop "MAIN_MSGbMCU_alarmHighSpeedStop" UBYTE Bool_ON_OFF 1 2 0 1 BIT_MASK 0x01 ECU_ADDRESS 0x70004E14 /end MEASUREMENT
/begin MEASUREMENT MAIN_MSGbMCU_alarmHighTorStop "MAIN_MSGbMCU_alarmHighTorStop" UBYTE Bool_ON_OFF 1 2 0 1 BIT_MASK 0x01 ECU_ADDRESS 0x70004E01 /end MEASUREMENT
/begin MEASUREMENT MAIN_MSGbMCU_alarmOperOrder "MAIN_MSGbMCU_alarmOperOrder" UBYTE Bool_ON_OFF 1 2 0 1 BIT_MASK 0x01 ECU_ADDRESS 0x70004DFE /end MEASUREMENT
/begin MEASUREMENT MAIN_MSGbMCU_errorCanBRcv "MAIN_MSGbMCU_errorCanBRcv" UBYTE Bool_ON_OFF 1 2 0 1 BIT_MASK 0x01 ECU_ADDRESS 0x70004DFF /end MEASUREMENT
/begin MEASUREMENT MAIN_MSGbPEPS_ACCRelaySts "MAIN_MSGbPEPS_ACCRelaySts" UBYTE Bool_ON_OFF 1 2 0 1 BIT_MASK 0x01 ECU_ADDRESS 0x70004E6C /end MEASUREMENT
/begin MEASUREMENT MAIN_MSGbPEPS_BrakeSts "MAIN_MSGbPEPS_BrakeSts" UBYTE Bool_ON_OFF 1 2 0 1 BIT_MASK 0x01 ECU_ADDRESS 0x70004E61 /end MEASUREMENT
/begin MEASUREMENT MAIN_MSGbPEPS_IGN1RelaySts "MAIN_MSGbPEPS_IGN1RelaySts" UBYTE Bool_ON_OFF 1 2 0 1 BIT_MASK 0x01 ECU_ADDRESS 0x70004E6B /end MEASUREMENT
/begin MEASUREMENT MAIN_MSGbPEPS_IGN1RelayValidity "MAIN_MSGbPEPS_IGN1RelayValidity" UBYTE Bool_ON_OFF 1 2 0 1 BIT_MASK 0x01 ECU_ADDRESS 0x70004E6D /end MEASUREMENT
/begin MEASUREMENT MAIN_MSGbPEPS_IGN2RelaySts "MAIN_MSGbPEPS_IGN2RelaySts" UBYTE Bool_ON_OFF 1 2 0 1 BIT_MASK 0x01 ECU_ADDRESS 0x70004E6A /end MEASUREMENT
/begin MEASUREMENT MAIN_MSGbPEPS_SW1 "MAIN_MSGbPEPS_SW1" UBYTE Bool_ON_OFF 1 2 0 1 BIT_MASK 0x01 ECU_ADDRESS 0x70004E64 /end MEASUREMENT
/begin MEASUREMENT MAIN_MSGbPEPS_SW2 "MAIN_MSGbPEPS_SW2" UBYTE Bool_ON_OFF 1 2 0 1 BIT_MASK 0x01 ECU_ADDRESS 0x70004E62 /end MEASUREMENT
/begin MEASUREMENT MAIN_MSGbPTCPowerLimt "MAIN_MSGbPTCPowerLimt" UBYTE Bool_ON_OFF 1 2 0 1 BIT_MASK 0x01 ECU_ADDRESS 0x70004ED0 /end MEASUREMENT
/begin MEASUREMENT MAIN_MSGbPower_ON_Permit "MAIN_MSGbPower_ON_Permit" UBYTE Bool_ON_OFF 1 2 0 1 BIT_MASK 0x01 ECU_ADDRESS 0x70004F45 /end MEASUREMENT
/begin MEASUREMENT MAIN_MSGbPumpupthesignal "MAIN_MSGbPumpupthesignal" UBYTE Bool_ON_OFF 1 2 0 1 BIT_MASK 0x01 ECU_ADDRESS 0x70004ED2 /end MEASUREMENT
/begin MEASUREMENT MAIN_MSGbRMCU4_MilReq "BSW Power on check finish flag." UBYTE Bool_ON_OFF 1 2 0 1 BIT_MASK 0x01 ECU_ADDRESS 0x70005559 /end MEASUREMENT
/begin MEASUREMENT MAIN_MSGbRMCU4_MoterFault "BSW Power on check finish flag." UBYTE Bool_ON_OFF 1 2 0 1 BIT_MASK 0x01 ECU_ADDRESS 0x70005558 /end MEASUREMENT
/begin MEASUREMENT MAIN_MSGbRemote_LowBeamCon_Req "MAIN_MSGbRemote_LowBeamCon_Req" UBYTE Bool_ON_OFF 1 2 0 1 BIT_MASK 0x01 ECU_ADDRESS 0x70004EA0 /end MEASUREMENT
/begin MEASUREMENT MAIN_MSGbRemote_SmaChrgReq "MAIN_MSGbRemote_SmaChrgReq" UBYTE Bool_ON_OFF 1 2 0 1 BIT_MASK 0x01 ECU_ADDRESS 0x70004E98 /end MEASUREMENT
/begin MEASUREMENT MAIN_MSGbRemoveTheFortifiedState "MAIN_MSGbRemoveTheFortifiedState" UBYTE Bool_ON_OFF 1 2 0 1 BIT_MASK 0x01 ECU_ADDRESS 0x70004E66 /end MEASUREMENT
/begin MEASUREMENT MAIN_MSGbSmartSystemWarning1_0 "MAIN_MSGbSmartSystemWarning1_0" UBYTE Bool_ON_OFF 1 2 0 1 BIT_MASK 0x01 ECU_ADDRESS 0x70004E69 /end MEASUREMENT
/begin MEASUREMENT MAIN_MSGbSmartSystemWarning4_3 "MAIN_MSGbSmartSystemWarning4_3" UBYTE Bool_ON_OFF 1 2 0 1 BIT_MASK 0x01 ECU_ADDRESS 0x70004E68 /end MEASUREMENT
/begin MEASUREMENT MAIN_MSGbSmartsystemwarning5_2 "MAIN_MSGbSmartsystemwarning5_2" UBYTE Bool_ON_OFF 1 2 0 1 BIT_MASK 0x01 ECU_ADDRESS 0x70004E67 /end MEASUREMENT
/begin MEASUREMENT MAIN_MSGbTBOX_4GSts "MAIN_MSGbTBOX_4GSts" UBYTE Bool_ON_OFF 1 2 0 1 BIT_MASK 0x01 ECU_ADDRESS 0x70004E9D /end MEASUREMENT
/begin MEASUREMENT MAIN_MSGbTBOX_GPSSts "MAIN_MSGbTBOX_GPSSts" UBYTE Bool_ON_OFF 1 2 0 1 BIT_MASK 0x01 ECU_ADDRESS 0x70004E9E /end MEASUREMENT
/begin MEASUREMENT MAIN_MSGbTBOX_IGNSts "MAIN_MSGbTBOX_IGNSts" UBYTE Bool_ON_OFF 1 2 0 1 BIT_MASK 0x01 ECU_ADDRESS 0x70004EA3 /end MEASUREMENT
/begin MEASUREMENT MAIN_MSGbTBOX_PowerSts "MAIN_MSGbTBOX_PowerSts" UBYTE Bool_ON_OFF 1 2 0 1 BIT_MASK 0x01 ECU_ADDRESS 0x70004E9F /end MEASUREMENT
/begin MEASUREMENT MAIN_MSGbTBOX_RemoteACReq "MAIN_MSGbTBOX_RemoteACReq" UBYTE Bool_ON_OFF 1 2 0 1 BIT_MASK 0x01 ECU_ADDRESS 0x70004EA4 /end MEASUREMENT
/begin MEASUREMENT MAIN_MSGbTBOX_RemotePowerOnOffReq "MAIN_MSGbTBOX_RemotePowerOnOffReq" UBYTE Bool_ON_OFF 1 2 0 1 BIT_MASK 0x01 ECU_ADDRESS 0x70004E7C /end MEASUREMENT
/begin MEASUREMENT MAIN_MSGbTBOX_RemoteWU "MAIN_MSGbTBOX_RemoteWU" UBYTE Bool_ON_OFF 1 2 0 1 BIT_MASK 0x01 ECU_ADDRESS 0x70004E9C /end MEASUREMENT
/begin MEASUREMENT MAIN_MSGbTBOX_StopChrgReq "MAIN_MSGbTBOX_StopChrgReq" UBYTE Bool_ON_OFF 1 2 0 1 BIT_MASK 0x01 ECU_ADDRESS 0x70004EA1 /end MEASUREMENT
/begin MEASUREMENT MAIN_MSGbTBOX_TimeValidity "MAIN_MSGbTBOX_TimeValidity" UBYTE Bool_ON_OFF 1 2 0 1 BIT_MASK 0x01 ECU_ADDRESS 0x70004F12 /end MEASUREMENT
/begin MEASUREMENT MAIN_MSGbTMS_APTCTempSts "MAIN_MSGbTMS_APTCTempSts" UBYTE Bool_ON_OFF 1 2 0 1 BIT_MASK 0x01 ECU_ADDRESS 0x70004ED6 /end MEASUREMENT
/begin MEASUREMENT MAIN_MSGbTMS_EACEnaCmd "MAIN_MSGbTMS_EACEnaCmd" UBYTE Bool_ON_OFF 1 2 0 1 BIT_MASK 0x01 ECU_ADDRESS 0x70004ED5 /end MEASUREMENT
/begin MEASUREMENT MAIN_MSGbTMS_EvaporatorTempSts "MAIN_MSGbTMS_EvaporatorTempSts" UBYTE Bool_ON_OFF 1 2 0 1 BIT_MASK 0x01 ECU_ADDRESS 0x70004ED7 /end MEASUREMENT
/begin MEASUREMENT MAIN_MSGbTMS_WPTCEnaCmd "MAIN_MSGbTMS_WPTCEnaCmd" UBYTE Bool_ON_OFF 1 2 0 1 BIT_MASK 0x01 ECU_ADDRESS 0x70004ED4 /end MEASUREMENT
/begin MEASUREMENT MAIN_MSGbVCU_12VChrgFaultLightSts "MAIN_MSGbVCU_12VChrgFaultLightSts" UBYTE Bool_ON_OFF 1 2 0 1 BIT_MASK 0x01 ECU_ADDRESS 0x70004F69 /end MEASUREMENT
/begin MEASUREMENT MAIN_MSGbVCU_BMS_EmergencyCmd "MAIN_MSGbVCU_BMS_EmergencyCmd" UBYTE Bool_ON_OFF 1 2 0 1 BIT_MASK 0x01 ECU_ADDRESS 0x70004F34 /end MEASUREMENT
/begin MEASUREMENT MAIN_MSGbVCU_BrakeSts "MAIN_MSGbVCU_BrakeSts" UBYTE Bool_ON_OFF 1 2 0 1 BIT_MASK 0x01 ECU_ADDRESS 0x70004F5E /end MEASUREMENT
/begin MEASUREMENT MAIN_MSGbVCU_ChargeAllow "MAIN_MSGbVCU_ChargeAllow" UBYTE Bool_ON_OFF 1 2 0 1 BIT_MASK 0x01 ECU_ADDRESS 0x70004F42 /end MEASUREMENT
/begin MEASUREMENT MAIN_MSGbVCU_CrashOutputSts "MAIN_MSGbVCU_CrashOutputSts" UBYTE Bool_ON_OFF 1 2 0 1 BIT_MASK 0x01 ECU_ADDRESS 0x70004F5A /end MEASUREMENT
/begin MEASUREMENT MAIN_MSGbVCU_DCDCStatus "MAIN_MSGbVCU_DCDCStatus" UBYTE Bool_ON_OFF 1 2 0 1 BIT_MASK 0x01 ECU_ADDRESS 0x70004EB8 /end MEASUREMENT
/begin MEASUREMENT MAIN_MSGbVCU_DrumTest "MAIN_MSGbVCU_DrumTest" UBYTE Bool_ON_OFF 1 2 0 1 BIT_MASK 0x01 ECU_ADDRESS 0x70004F47 /end MEASUREMENT
/begin MEASUREMENT MAIN_MSGbVCU_ECOSts "MAIN_MSGbVCU_ECOSts" UBYTE Bool_ON_OFF 1 2 0 1 BIT_MASK 0x01 ECU_ADDRESS 0x70004EB7 /end MEASUREMENT
/begin MEASUREMENT MAIN_MSGbVCU_FmcuAkdReq "BSW Power on check finish flag." UBYTE Bool_ON_OFF 1 2 0 1 BIT_MASK 0x01 ECU_ADDRESS 0x70005556 /end MEASUREMENT
/begin MEASUREMENT MAIN_MSGbVCU_HVIL_3 "MAIN_MSGbVCU_HVIL_3" UBYTE Bool_ON_OFF 1 2 0 1 BIT_MASK 0x01 ECU_ADDRESS 0x70004F59 /end MEASUREMENT
/begin MEASUREMENT MAIN_MSGbVCU_HvEmgyStatus "MAIN_MSGbVCU_HvEmgyStatus" UBYTE Bool_ON_OFF 1 2 0 1 BIT_MASK 0x01 ECU_ADDRESS 0x70004EB6 /end MEASUREMENT
/begin MEASUREMENT MAIN_MSGbVCU_InterlockSts "MAIN_MSGbVCU_InterlockSts" UBYTE Bool_ON_OFF 1 2 0 1 BIT_MASK 0x01 ECU_ADDRESS 0x70004EAB /end MEASUREMENT
/begin MEASUREMENT MAIN_MSGbVCU_MCEnable "MAIN_MSGbVCU_MCEnable" UBYTE Bool_ON_OFF 1 2 0 1 BIT_MASK 0x01 ECU_ADDRESS 0x70004F44 /end MEASUREMENT
/begin MEASUREMENT MAIN_MSGbVCU_MCUActDischarCmd "MAIN_MSGbVCU_MCUActDischarCmd" UBYTE Bool_ON_OFF 1 2 0 1 BIT_MASK 0x01 ECU_ADDRESS 0x70004F40 /end MEASUREMENT
/begin MEASUREMENT MAIN_MSGbVCU_MCUPowerOff "MAIN_MSGbVCU_MCUPowerOff" UBYTE Bool_ON_OFF 1 2 0 1 BIT_MASK 0x01 ECU_ADDRESS 0x70004F3F /end MEASUREMENT
/begin MEASUREMENT MAIN_MSGbVCU_MCUSkid "MAIN_MSGbVCU_MCUSkid" UBYTE Bool_ON_OFF 1 2 0 1 BIT_MASK 0x01 ECU_ADDRESS 0x70004EAC /end MEASUREMENT
/begin MEASUREMENT MAIN_MSGbVCU_MaintainLightSts "MAIN_MSGbVCU_MaintainLightSts" UBYTE Bool_ON_OFF 1 2 0 1 BIT_MASK 0x01 ECU_ADDRESS 0x70004F6A /end MEASUREMENT
/begin MEASUREMENT MAIN_MSGbVCU_MotorFaultLightSts "MAIN_MSGbVCU_MotorFaultLightSts" UBYTE Bool_ON_OFF 1 2 0 1 BIT_MASK 0x01 ECU_ADDRESS 0x70004F70 /end MEASUREMENT
/begin MEASUREMENT MAIN_MSGbVCU_MotorOverTempLightSts "MAIN_MSGbVCU_MotorOverTempLightSts" UBYTE Bool_ON_OFF 1 2 0 1 BIT_MASK 0x01 ECU_ADDRESS 0x70004F6D /end MEASUREMENT
/begin MEASUREMENT MAIN_MSGbVCU_PowerBattFaultsLightSts "MAIN_MSGbVCU_PowerBattFaultsLightSts" UBYTE Bool_ON_OFF 1 2 0 1 BIT_MASK 0x01 ECU_ADDRESS 0x70004F6E /end MEASUREMENT
/begin MEASUREMENT MAIN_MSGbVCU_READYLightSts "MAIN_MSGbVCU_READYLightSts" UBYTE Bool_ON_OFF 1 2 0 1 BIT_MASK 0x01 ECU_ADDRESS 0x70004F6B /end MEASUREMENT
/begin MEASUREMENT MAIN_MSGbVCU_RemoteEAC_COMFault "MAIN_MSGbVCU_RemoteEAC_COMFault" UBYTE Bool_ON_OFF 1 2 0 1 BIT_MASK 0x01 ECU_ADDRESS 0x70004F5C /end MEASUREMENT
/begin MEASUREMENT MAIN_MSGbVCU_RemoteEAC_SystemFault "MAIN_MSGbVCU_RemoteEAC_SystemFault" UBYTE Bool_ON_OFF 1 2 0 1 BIT_MASK 0x01 ECU_ADDRESS 0x70004F5B /end MEASUREMENT
/begin MEASUREMENT MAIN_MSGbVCU_SOCWarnLightSts "MAIN_MSGbVCU_SOCWarnLightSts" UBYTE Bool_ON_OFF 1 2 0 1 BIT_MASK 0x01 ECU_ADDRESS 0x70004F6C /end MEASUREMENT
/begin MEASUREMENT MAIN_MSGbVCU_StSmartCharge "MAIN_MSGbVCU_StSmartCharge" UBYTE Bool_ON_OFF 1 2 0 1 BIT_MASK 0x01 ECU_ADDRESS 0x70004EA7 /end MEASUREMENT
/begin MEASUREMENT MAIN_MSGbVCU_SystemFaultsLightSts "MAIN_MSGbVCU_SystemFaultsLightSts" UBYTE Bool_ON_OFF 1 2 0 1 BIT_MASK 0x01 ECU_ADDRESS 0x70004F68 /end MEASUREMENT
/begin MEASUREMENT MAIN_MSGbVCU_SystemWarnLightSts "MAIN_MSGbVCU_SystemWarnLightSts" UBYTE Bool_ON_OFF 1 2 0 1 BIT_MASK 0x01 ECU_ADDRESS 0x70004F6F /end MEASUREMENT
/begin MEASUREMENT MAIN_MSGbVCU_bGrLevErr "MAIN_MSGbVCU_bGrLevErr" UBYTE Bool_ON_OFF 1 2 0 1 BIT_MASK 0x01 ECU_ADDRESS 0x70004F5D /end MEASUREMENT
/begin MEASUREMENT MAIN_MSGbVCU_stPTC "MAIN_MSGbVCU_stPTC" UBYTE Bool_ON_OFF 1 2 0 1 BIT_MASK 0x01 ECU_ADDRESS 0x70004F41 /end MEASUREMENT
/begin MEASUREMENT MAIN_MSGbVCU_stPompe "MAIN_MSGbVCU_stPompe" UBYTE Bool_ON_OFF 1 2 0 1 BIT_MASK 0x01 ECU_ADDRESS 0x70004F3C /end MEASUREMENT
/begin MEASUREMENT MAIN_MSGbVcu_Shift_allow "MAIN_MSGbVcu_Shift_allow" UBYTE Bool_ON_OFF 1 2 0 1 BIT_MASK 0x01 ECU_ADDRESS 0x70004F48 /end MEASUREMENT
/begin MEASUREMENT MAIN_MSGbWithrelayrequest "MAIN_MSGbWithrelayrequest" UBYTE Bool_ON_OFF 1 2 0 1 BIT_MASK 0x01 ECU_ADDRESS 0x70004F35 /end MEASUREMENT
/begin MEASUREMENT MAIN_MSGf32ACP_APTCPowerAllowed "..." FLOAT32_IEEE I_1 1 2 -3.402823466E+038 3.402823466E+038 ECU_ADDRESS 0x70004F04 /end MEASUREMENT
/begin MEASUREMENT MAIN_MSGf32ACP_APTCTemp "..." FLOAT32_IEEE I_1 1 2 -3.402823466E+038 3.402823466E+038 ECU_ADDRESS 0x70004EFC /end MEASUREMENT
/begin MEASUREMENT MAIN_MSGf32ACP_EACPowerAllowed "..." FLOAT32_IEEE I_1 1 2 -3.402823466E+038 3.402823466E+038 ECU_ADDRESS 0x70004F0C /end MEASUREMENT
/begin MEASUREMENT MAIN_MSGf32ACP_EACSpdReq "..." FLOAT32_IEEE I_1 1 2 -3.402823466E+038 3.402823466E+038 ECU_ADDRESS 0x70004F08 /end MEASUREMENT
/begin MEASUREMENT MAIN_MSGf32ACP_EvaporatorTemp "..." FLOAT32_IEEE I_1 1 2 -3.402823466E+038 3.402823466E+038 ECU_ADDRESS 0x70004F00 /end MEASUREMENT
/begin MEASUREMENT MAIN_MSGf32ACP_TargetEvapTempSts "..." FLOAT32_IEEE I_1 1 2 -3.402823466E+038 3.402823466E+038 ECU_ADDRESS 0x70004EF4 /end MEASUREMENT
/begin MEASUREMENT MAIN_MSGf32ACPowerLimt "..." FLOAT32_IEEE I_1 1 2 -3.402823466E+038 3.402823466E+038 ECU_ADDRESS 0x70004ECC /end MEASUREMENT
/begin MEASUREMENT MAIN_MSGf32BMS_RequestOutputCrnt "..." FLOAT32_IEEE I_1 1 2 -3.402823466E+038 3.402823466E+038 ECU_ADDRESS 0x70004E58 /end MEASUREMENT
/begin MEASUREMENT MAIN_MSGf32BMS_RequestOutputVolt "..." FLOAT32_IEEE I_1 1 2 -3.402823466E+038 3.402823466E+038 ECU_ADDRESS 0x70004E54 /end MEASUREMENT
/begin MEASUREMENT MAIN_MSGf32EAC_Input_Current "..." FLOAT32_IEEE I_1 1 2 -3.402823466E+038 3.402823466E+038 ECU_ADDRESS 0x70004DB0 /end MEASUREMENT
/begin MEASUREMENT MAIN_MSGf32EAC_Input_Voltage "..." FLOAT32_IEEE I_1 1 2 -3.402823466E+038 3.402823466E+038 ECU_ADDRESS 0x70004DCC /end MEASUREMENT
/begin MEASUREMENT MAIN_MSGf32EAC_Motor_Spd "..." FLOAT32_IEEE I_1 1 2 -3.402823466E+038 3.402823466E+038 ECU_ADDRESS 0x70004DBC /end MEASUREMENT
/begin MEASUREMENT MAIN_MSGf32EAC_Motor_Temperature "..." FLOAT32_IEEE I_1 1 2 -3.402823466E+038 3.402823466E+038 ECU_ADDRESS 0x70004DC8 /end MEASUREMENT
/begin MEASUREMENT MAIN_MSGf32EAC_Output_Current "..." FLOAT32_IEEE I_1 1 2 -3.402823466E+038 3.402823466E+038 ECU_ADDRESS 0x70004DB4 /end MEASUREMENT
/begin MEASUREMENT MAIN_MSGf32EAC_Output_Voltage "..." FLOAT32_IEEE I_1 1 2 -3.402823466E+038 3.402823466E+038 ECU_ADDRESS 0x70004DB8 /end MEASUREMENT
/begin MEASUREMENT MAIN_MSGf32EAC_inverter_Temperature "..." FLOAT32_IEEE I_1 1 2 -3.402823466E+038 3.402823466E+038 ECU_ADDRESS 0x70004DC4 /end MEASUREMENT
/begin MEASUREMENT MAIN_MSGf32Elevation "..." FLOAT32_IEEE I_1 1 2 -3.402823466E+038 3.402823466E+038 ECU_ADDRESS 0x70004E90 /end MEASUREMENT
/begin MEASUREMENT MAIN_MSGf32LowerTemperatureWarningLimit "..." FLOAT32_IEEE I_1 1 2 -3.402823466E+038 3.402823466E+038 ECU_ADDRESS 0x70004E74 /end MEASUREMENT
/begin MEASUREMENT MAIN_MSGf32MCU_AC_Valid "..." FLOAT32_IEEE I_1 1 2 -3.402823466E+038 3.402823466E+038 ECU_ADDRESS 0x70004E30 /end MEASUREMENT
/begin MEASUREMENT MAIN_MSGf32MCU_ContrTemp_NTC "..." FLOAT32_IEEE I_1 1 2 -3.402823466E+038 3.402823466E+038 ECU_ADDRESS 0x70004E40 /end MEASUREMENT
/begin MEASUREMENT MAIN_MSGf32MCU_ControllerTemp "..." FLOAT32_IEEE I_1 1 2 -3.402823466E+038 3.402823466E+038 ECU_ADDRESS 0x70004DF4 /end MEASUREMENT
/begin MEASUREMENT MAIN_MSGf32MCU_ControllerTorque "..." FLOAT32_IEEE I_1 1 2 -3.402823466E+038 3.402823466E+038 ECU_ADDRESS 0x70004E44 /end MEASUREMENT
/begin MEASUREMENT MAIN_MSGf32MCU_DC_link_Crnt "..." FLOAT32_IEEE I_1 1 2 -3.402823466E+038 3.402823466E+038 ECU_ADDRESS 0x70004E34 /end MEASUREMENT
/begin MEASUREMENT MAIN_MSGf32MCU_DC_link_Volt "..." FLOAT32_IEEE I_1 1 2 -3.402823466E+038 3.402823466E+038 ECU_ADDRESS 0x70004E38 /end MEASUREMENT
/begin MEASUREMENT MAIN_MSGf32MCU_LvVoltPhys "..." FLOAT32_IEEE I_3 1 2 -3.402823466E+038 3.402823466E+038 ECU_ADDRESS 0x70005480 /end MEASUREMENT
/begin MEASUREMENT MAIN_MSGf32MCU_MaxAvailPower "..." FLOAT32_IEEE I_1 1 2 -3.402823466E+038 3.402823466E+038 ECU_ADDRESS 0x70004DF8 /end MEASUREMENT
/begin MEASUREMENT MAIN_MSGf32MCU_MaxTorque "..." FLOAT32_IEEE I_1 1 2 -3.402823466E+038 3.402823466E+038 ECU_ADDRESS 0x70004E2C /end MEASUREMENT
/begin MEASUREMENT MAIN_MSGf32MCU_MotorMaxSpeed "..." FLOAT32_IEEE I_1 1 2 -3.402823466E+038 3.402823466E+038 ECU_ADDRESS 0x70004E04 /end MEASUREMENT
/begin MEASUREMENT MAIN_MSGf32MCU_MotorSpeed "..." FLOAT32_IEEE I_1 1 2 -3.402823466E+038 3.402823466E+038 ECU_ADDRESS 0x70004E48 /end MEASUREMENT
/begin MEASUREMENT MAIN_MSGf32MCU_MotorTemp "..." FLOAT32_IEEE I_1 1 2 -3.402823466E+038 3.402823466E+038 ECU_ADDRESS 0x70004E3C /end MEASUREMENT
/begin MEASUREMENT MAIN_MSGf32MCU_VechileSpeed "..." FLOAT32_IEEE I_1 1 2 -3.402823466E+038 3.402823466E+038 ECU_ADDRESS 0x70004E4C /end MEASUREMENT
/begin MEASUREMENT MAIN_MSGf32Motor_Percent_torque "..." FLOAT32_IEEE I_1 1 2 -3.402823466E+038 3.402823466E+038 ECU_ADDRESS 0x70004DE4 /end MEASUREMENT
/begin MEASUREMENT MAIN_MSGf32SettingTemperature "..." FLOAT32_IEEE I_1 1 2 -3.402823466E+038 3.402823466E+038 ECU_ADDRESS 0x70004E80 /end MEASUREMENT
/begin MEASUREMENT MAIN_MSGf32TBOX_TempSet "..." FLOAT32_IEEE I_1 1 2 -3.402823466E+038 3.402823466E+038 ECU_ADDRESS 0x70004E88 /end MEASUREMENT
/begin MEASUREMENT MAIN_MSGf32TMS_APTCPowerAllowed "..." FLOAT32_IEEE I_1 1 2 -3.402823466E+038 3.402823466E+038 ECU_ADDRESS 0x70004EE4 /end MEASUREMENT
/begin MEASUREMENT MAIN_MSGf32TMS_APTCTemp "..." FLOAT32_IEEE I_1 1 2 -3.402823466E+038 3.402823466E+038 ECU_ADDRESS 0x70004ED8 /end MEASUREMENT
/begin MEASUREMENT MAIN_MSGf32TMS_EACPowerAllowed "..." FLOAT32_IEEE I_1 1 2 -3.402823466E+038 3.402823466E+038 ECU_ADDRESS 0x70004EEC /end MEASUREMENT
/begin MEASUREMENT MAIN_MSGf32TMS_EACSpdReq "..." FLOAT32_IEEE I_1 1 2 -3.402823466E+038 3.402823466E+038 ECU_ADDRESS 0x70004EE8 /end MEASUREMENT
/begin MEASUREMENT MAIN_MSGf32TMS_EvaporatorTemp "..." FLOAT32_IEEE I_1 1 2 -3.402823466E+038 3.402823466E+038 ECU_ADDRESS 0x70004EDC /end MEASUREMENT
/begin MEASUREMENT MAIN_MSGf32TMS_TargetEvaporatorTemp "..." FLOAT32_IEEE I_1 1 2 -3.402823466E+038 3.402823466E+038 ECU_ADDRESS 0x70004EF0 /end MEASUREMENT
/begin MEASUREMENT MAIN_MSGf32TMS_WPTCPowerAllowed "..." FLOAT32_IEEE I_1 1 2 -3.402823466E+038 3.402823466E+038 ECU_ADDRESS 0x70004EE0 /end MEASUREMENT
/begin MEASUREMENT MAIN_MSGf32UpperTemperatureWarningLimit "..." FLOAT32_IEEE I_1 1 2 -3.402823466E+038 3.402823466E+038 ECU_ADDRESS 0x70004E78 /end MEASUREMENT
/begin MEASUREMENT MAIN_MSGf32Upper_Limit_Torque "..." FLOAT32_IEEE I_1 1 2 -3.402823466E+038 3.402823466E+038 ECU_ADDRESS 0x70004DE0 /end MEASUREMENT
/begin MEASUREMENT MAIN_MSGf32VCU7_12VBatVoltPhys "..." FLOAT32_IEEE F_1_p0_9 1 2 -3.402823466E+038 3.402823466E+038 ECU_ADDRESS 0x70005388 /end MEASUREMENT
/begin MEASUREMENT MAIN_MSGf32VCU_AccPedPosPhys "..." FLOAT32_IEEE F_1_p0_6 1 2 -3.402823466E+038 3.402823466E+038 ECU_ADDRESS 0x70005390 /end MEASUREMENT
/begin MEASUREMENT MAIN_MSGf32VCU_AvailResidPower "..." FLOAT32_IEEE I_1 1 2 -3.402823466E+038 3.402823466E+038 ECU_ADDRESS 0x70004EC4 /end MEASUREMENT
/begin MEASUREMENT MAIN_MSGf32VCU_BrakPedPosPhys "..." FLOAT32_IEEE I_35 1 2 -3.402823466E+038 3.402823466E+038 ECU_ADDRESS 0x7000538C /end MEASUREMENT
/begin MEASUREMENT MAIN_MSGf32VCU_ChrgHVLoadPower "..." FLOAT32_IEEE I_1 1 2 -3.402823466E+038 3.402823466E+038 ECU_ADDRESS 0x70004F30 /end MEASUREMENT
/begin MEASUREMENT MAIN_MSGf32VCU_DCDCTargetVolt "..." FLOAT32_IEEE I_1 1 2 -3.402823466E+038 3.402823466E+038 ECU_ADDRESS 0x70004F38 /end MEASUREMENT
/begin MEASUREMENT MAIN_MSGf32VCU_DCDCTemp "..." FLOAT32_IEEE I_1 1 2 -3.402823466E+038 3.402823466E+038 ECU_ADDRESS 0x70004EB0 /end MEASUREMENT
/begin MEASUREMENT MAIN_MSGf32VCU_GasPedalPosition "..." FLOAT32_IEEE I_1 1 2 -3.402823466E+038 3.402823466E+038 ECU_ADDRESS 0x70004F54 /end MEASUREMENT
/begin MEASUREMENT MAIN_MSGf32VCU_InstPowerConsum "..." FLOAT32_IEEE I_1 1 2 -3.402823466E+038 3.402823466E+038 ECU_ADDRESS 0x70004F50 /end MEASUREMENT
/begin MEASUREMENT MAIN_MSGf32VCU_InstantPower "..." FLOAT32_IEEE I_1 1 2 -3.402823466E+038 3.402823466E+038 ECU_ADDRESS 0x70004EC8 /end MEASUREMENT
/begin MEASUREMENT MAIN_MSGf32VCU_MotorMaxPower "..." FLOAT32_IEEE I_1 1 2 -3.402823466E+038 3.402823466E+038 ECU_ADDRESS 0x70004EBC /end MEASUREMENT
/begin MEASUREMENT MAIN_MSGf32VCU_ResidualOdometer "..." FLOAT32_IEEE I_1 1 2 -3.402823466E+038 3.402823466E+038 ECU_ADDRESS 0x70004F60 /end MEASUREMENT
/begin MEASUREMENT MAIN_MSGf32VCU_TorqueCommand "..." FLOAT32_IEEE I_1 1 2 -3.402823466E+038 3.402823466E+038 ECU_ADDRESS 0x70004F4C /end MEASUREMENT
/begin MEASUREMENT MAIN_MSGf32VCU_VehicleSpeedVSOSig "..." FLOAT32_IEEE I_1 1 2 -3.402823466E+038 3.402823466E+038 ECU_ADDRESS 0x70004F64 /end MEASUREMENT
/begin MEASUREMENT MAIN_MSGu16BMS_ChargeTime "..." UWORD I_1 1 2 0 65535 ECU_ADDRESS 0x70004E50 /end MEASUREMENT
/begin MEASUREMENT MAIN_MSGu16BMS_RequestOutputCrntRaw "..." UWORD I_1 1 2 0 65535 ECU_ADDRESS 0x70004F98 /end MEASUREMENT
/begin MEASUREMENT MAIN_MSGu16BMS_RequestOutputVoltRaw "..." UWORD I_1 1 2 0 65535 ECU_ADDRESS 0x70004F96 /end MEASUREMENT
/begin MEASUREMENT MAIN_MSGu16EAC_Input_CurrentRaw "..." UWORD I_1 1 2 0 65535 ECU_ADDRESS 0x70004F72 /end MEASUREMENT
/begin MEASUREMENT MAIN_MSGu16EAC_Input_VoltageRaw "..." UWORD I_1 1 2 0 65535 ECU_ADDRESS 0x70004F7C /end MEASUREMENT
/begin MEASUREMENT MAIN_MSGu16EAC_Motor_SpdRaw "..." UWORD I_1 1 2 0 65535 ECU_ADDRESS 0x70004F78 /end MEASUREMENT
/begin MEASUREMENT MAIN_MSGu16EAC_Output_CurrentRaw "..." UWORD I_1 1 2 0 65535 ECU_ADDRESS 0x70004F74 /end MEASUREMENT
/begin MEASUREMENT MAIN_MSGu16EAC_Output_VoltageRaw "..." UWORD I_1 1 2 0 65535 ECU_ADDRESS 0x70004F76 /end MEASUREMENT
/begin MEASUREMENT MAIN_MSGu16EMS_EngActualFlwTorqueRaw "..." UWORD I_1 1 2 0 65535 ECU_ADDRESS 0x700052CC /end MEASUREMENT
/begin MEASUREMENT MAIN_MSGu16ElevationRaw "..." UWORD I_1 1 2 0 65535 ECU_ADDRESS 0x70004F9E /end MEASUREMENT
/begin MEASUREMENT MAIN_MSGu16MCU_AC_ValidRaw "..." UWORD I_1 1 2 0 65535 ECU_ADDRESS 0x70004F88 /end MEASUREMENT
/begin MEASUREMENT MAIN_MSGu16MCU_ControllerTorqueRaw "..." UWORD I_1 1 2 0 65535 ECU_ADDRESS 0x70004F90 /end MEASUREMENT
/begin MEASUREMENT MAIN_MSGu16MCU_DC_link_CrntRaw "..." UWORD I_1 1 2 0 65535 ECU_ADDRESS 0x70004F8A /end MEASUREMENT
/begin MEASUREMENT MAIN_MSGu16MCU_DC_link_VoltRaw "..." UWORD I_1 1 2 0 65535 ECU_ADDRESS 0x70004F8C /end MEASUREMENT
/begin MEASUREMENT MAIN_MSGu16MCU_MaxAvailPowerRaw "..." UWORD I_1 1 2 0 65535 ECU_ADDRESS 0x70004F82 /end MEASUREMENT
/begin MEASUREMENT MAIN_MSGu16MCU_MaxTorqueRaw "..." UWORD I_1 1 2 0 65535 ECU_ADDRESS 0x70004F86 /end MEASUREMENT
/begin MEASUREMENT MAIN_MSGu16MCU_MotorMaxSpeedRaw "..." UWORD I_1 1 2 0 65535 ECU_ADDRESS 0x70004F84 /end MEASUREMENT
/begin MEASUREMENT MAIN_MSGu16MCU_MotorSpeedRaw "..." UWORD I_1 1 2 0 65535 ECU_ADDRESS 0x70004F92 /end MEASUREMENT
/begin MEASUREMENT MAIN_MSGu16MCU_VechileSpeedRaw "..." UWORD I_1 1 2 0 65535 ECU_ADDRESS 0x70004F94 /end MEASUREMENT
/begin MEASUREMENT MAIN_MSGu16Upper_Limit_TorqueRaw "..." UWORD I_1 1 2 0 65535 ECU_ADDRESS 0x70004F7E /end MEASUREMENT
/begin MEASUREMENT MAIN_MSGu16VCU_AvailResidPowerRaw "..." UWORD I_1 1 2 0 65535 ECU_ADDRESS 0x70004FA4 /end MEASUREMENT
/begin MEASUREMENT MAIN_MSGu16VCU_InstantPowerRaw "..." UWORD I_1 1 2 0 65535 ECU_ADDRESS 0x70004FA6 /end MEASUREMENT
/begin MEASUREMENT MAIN_MSGu16VCU_MotorMaxPowerRaw "..." UWORD I_1 1 2 0 65535 ECU_ADDRESS 0x70004FA2 /end MEASUREMENT
/begin MEASUREMENT MAIN_MSGu16VCU_ResidualOdometerRaw "..." UWORD I_1 1 2 0 65535 ECU_ADDRESS 0x70004FBC /end MEASUREMENT
/begin MEASUREMENT MAIN_MSGu16VCU_TorqueCommandRaw "..." UWORD I_1 1 2 0 65535 ECU_ADDRESS 0x70004FB8 /end MEASUREMENT
/begin MEASUREMENT MAIN_MSGu16VCU_VehicleSpeedVSOSigRaw "..." UWORD I_1 1 2 0 65535 ECU_ADDRESS 0x70004FBE /end MEASUREMENT
/begin MEASUREMENT MAIN_MSGu8ACP_2_buf "-" UBYTE Id_0x00 1 2 0 255 MATRIX_DIM 8 1 1 ECU_ADDRESS 0x70005030 /end MEASUREMENT
/begin MEASUREMENT MAIN_MSGu8ACP_2_buf[0] "MAIN_MSGu8ACP_2_buf[0]" UBYTE Id_0x00 1 2 0 255 ECU_ADDRESS 0x70005030 /end MEASUREMENT
/begin MEASUREMENT MAIN_MSGu8ACP_2_buf[1] "MAIN_MSGu8ACP_2_buf[1]" UBYTE Id_0x00 1 2 0 255 ECU_ADDRESS 0x70005031 /end MEASUREMENT
/begin MEASUREMENT MAIN_MSGu8ACP_2_buf[2] "MAIN_MSGu8ACP_2_buf[2]" UBYTE Id_0x00 1 2 0 255 ECU_ADDRESS 0x70005032 /end MEASUREMENT
/begin MEASUREMENT MAIN_MSGu8ACP_2_buf[3] "MAIN_MSGu8ACP_2_buf[3]" UBYTE Id_0x00 1 2 0 255 ECU_ADDRESS 0x70005033 /end MEASUREMENT
/begin MEASUREMENT MAIN_MSGu8ACP_2_buf[4] "MAIN_MSGu8ACP_2_buf[4]" UBYTE Id_0x00 1 2 0 255 ECU_ADDRESS 0x70005034 /end MEASUREMENT
/begin MEASUREMENT MAIN_MSGu8ACP_2_buf[5] "MAIN_MSGu8ACP_2_buf[5]" UBYTE Id_0x00 1 2 0 255 ECU_ADDRESS 0x70005035 /end MEASUREMENT
/begin MEASUREMENT MAIN_MSGu8ACP_2_buf[6] "MAIN_MSGu8ACP_2_buf[6]" UBYTE Id_0x00 1 2 0 255 ECU_ADDRESS 0x70005036 /end MEASUREMENT
/begin MEASUREMENT MAIN_MSGu8ACP_2_buf[7] "MAIN_MSGu8ACP_2_buf[7]" UBYTE Id_0x00 1 2 0 255 ECU_ADDRESS 0x70005037 /end MEASUREMENT
/begin MEASUREMENT MAIN_MSGu8ACP_APTCPowerAllowedRaw "..." UBYTE I_1 1 2 0 255 ECU_ADDRESS 0x70004FB3 /end MEASUREMENT
/begin MEASUREMENT MAIN_MSGu8ACP_APTCTempRaw "..." UBYTE I_1 1 2 0 255 ECU_ADDRESS 0x70004FB1 /end MEASUREMENT
/begin MEASUREMENT MAIN_MSGu8ACP_EACPowerAllowedRaw "..." UBYTE I_1 1 2 0 255 ECU_ADDRESS 0x70004FB5 /end MEASUREMENT
/begin MEASUREMENT MAIN_MSGu8ACP_EACSpdReqRaw "..." UBYTE I_1 1 2 0 255 ECU_ADDRESS 0x70004FB4 /end MEASUREMENT
/begin MEASUREMENT MAIN_MSGu8ACP_EvaporatorTempRaw "..." UBYTE I_1 1 2 0 255 ECU_ADDRESS 0x70004FB2 /end MEASUREMENT
/begin MEASUREMENT MAIN_MSGu8ACP_MsgAliveCounter "..." UBYTE I_1 1 2 0 255 ECU_ADDRESS 0x70004EF8 /end MEASUREMENT
/begin MEASUREMENT MAIN_MSGu8ACP_TargetEvapTempStsRaw "..." UBYTE I_1 1 2 0 255 ECU_ADDRESS 0x70004FB0 /end MEASUREMENT
/begin MEASUREMENT MAIN_MSGu8ACPowerLimtRaw "..." UBYTE I_1 1 2 0 255 ECU_ADDRESS 0x70004FA8 /end MEASUREMENT
/begin MEASUREMENT MAIN_MSGu8BMS_6_buf "-" UBYTE Id_0x00 1 2 0 255 MATRIX_DIM 8 1 1 ECU_ADDRESS 0x70005040 /end MEASUREMENT
/begin MEASUREMENT MAIN_MSGu8BMS_6_buf[0] "MAIN_MSGu8BMS_6_buf[0]" UBYTE Id_0x00 1 2 0 255 ECU_ADDRESS 0x70005040 /end MEASUREMENT
/begin MEASUREMENT MAIN_MSGu8BMS_6_buf[1] "MAIN_MSGu8BMS_6_buf[1]" UBYTE Id_0x00 1 2 0 255 ECU_ADDRESS 0x70005041 /end MEASUREMENT
/begin MEASUREMENT MAIN_MSGu8BMS_6_buf[2] "MAIN_MSGu8BMS_6_buf[2]" UBYTE Id_0x00 1 2 0 255 ECU_ADDRESS 0x70005042 /end MEASUREMENT
/begin MEASUREMENT MAIN_MSGu8BMS_6_buf[3] "MAIN_MSGu8BMS_6_buf[3]" UBYTE Id_0x00 1 2 0 255 ECU_ADDRESS 0x70005043 /end MEASUREMENT
/begin MEASUREMENT MAIN_MSGu8BMS_6_buf[4] "MAIN_MSGu8BMS_6_buf[4]" UBYTE Id_0x00 1 2 0 255 ECU_ADDRESS 0x70005044 /end MEASUREMENT
/begin MEASUREMENT MAIN_MSGu8BMS_6_buf[5] "MAIN_MSGu8BMS_6_buf[5]" UBYTE Id_0x00 1 2 0 255 ECU_ADDRESS 0x70005045 /end MEASUREMENT
/begin MEASUREMENT MAIN_MSGu8BMS_6_buf[6] "MAIN_MSGu8BMS_6_buf[6]" UBYTE Id_0x00 1 2 0 255 ECU_ADDRESS 0x70005046 /end MEASUREMENT
/begin MEASUREMENT MAIN_MSGu8BMS_6_buf[7] "MAIN_MSGu8BMS_6_buf[7]" UBYTE Id_0x00 1 2 0 255 ECU_ADDRESS 0x70005047 /end MEASUREMENT
/begin MEASUREMENT MAIN_MSGu8BMS_8_buf "-" UBYTE Id_0x00 1 2 0 255 MATRIX_DIM 8 1 1 ECU_ADDRESS 0x70004FF8 /end MEASUREMENT
/begin MEASUREMENT MAIN_MSGu8BMS_8_buf[0] "MAIN_MSGu8BMS_8_buf[0]" UBYTE Id_0x00 1 2 0 255 ECU_ADDRESS 0x70004FF8 /end MEASUREMENT
/begin MEASUREMENT MAIN_MSGu8BMS_8_buf[1] "MAIN_MSGu8BMS_8_buf[1]" UBYTE Id_0x00 1 2 0 255 ECU_ADDRESS 0x70004FF9 /end MEASUREMENT
/begin MEASUREMENT MAIN_MSGu8BMS_8_buf[2] "MAIN_MSGu8BMS_8_buf[2]" UBYTE Id_0x00 1 2 0 255 ECU_ADDRESS 0x70004FFA /end MEASUREMENT
/begin MEASUREMENT MAIN_MSGu8BMS_8_buf[3] "MAIN_MSGu8BMS_8_buf[3]" UBYTE Id_0x00 1 2 0 255 ECU_ADDRESS 0x70004FFB /end MEASUREMENT
/begin MEASUREMENT MAIN_MSGu8BMS_8_buf[4] "MAIN_MSGu8BMS_8_buf[4]" UBYTE Id_0x00 1 2 0 255 ECU_ADDRESS 0x70004FFC /end MEASUREMENT
/begin MEASUREMENT MAIN_MSGu8BMS_8_buf[5] "MAIN_MSGu8BMS_8_buf[5]" UBYTE Id_0x00 1 2 0 255 ECU_ADDRESS 0x70004FFD /end MEASUREMENT
/begin MEASUREMENT MAIN_MSGu8BMS_8_buf[6] "MAIN_MSGu8BMS_8_buf[6]" UBYTE Id_0x00 1 2 0 255 ECU_ADDRESS 0x70004FFE /end MEASUREMENT
/begin MEASUREMENT MAIN_MSGu8BMS_8_buf[7] "MAIN_MSGu8BMS_8_buf[7]" UBYTE Id_0x00 1 2 0 255 ECU_ADDRESS 0x70004FFF /end MEASUREMENT
/begin MEASUREMENT MAIN_MSGu8BMS_BMSSts "..." UBYTE I_1 1 2 0 255 ECU_ADDRESS 0x70004F2E /end MEASUREMENT
/begin MEASUREMENT MAIN_MSGu8BMS_BattReady "..." UBYTE I_1 1 2 0 255 ECU_ADDRESS 0x70004F1B /end MEASUREMENT
/begin MEASUREMENT MAIN_MSGu8BMS_BattVTMSReq "..." UBYTE I_1 1 2 0 255 ECU_ADDRESS 0x70004F1C /end MEASUREMENT
/begin MEASUREMENT MAIN_MSGu8BMS_ChrgActiveFaultGrade "..." UBYTE I_1 1 2 0 255 ECU_ADDRESS 0x70004F1E /end MEASUREMENT
/begin MEASUREMENT MAIN_MSGu8BMS_DischrgActiveFaultGrade "..." UBYTE I_1 1 2 0 255 ECU_ADDRESS 0x70004F1F /end MEASUREMENT
/begin MEASUREMENT MAIN_MSGu8BMS_NegBattContSts "..." UBYTE I_1 1 2 0 255 ECU_ADDRESS 0x70004F28 /end MEASUREMENT
/begin MEASUREMENT MAIN_MSGu8BMS_PosBattContSts "..." UBYTE I_1 1 2 0 255 ECU_ADDRESS 0x70004F29 /end MEASUREMENT
/begin MEASUREMENT MAIN_MSGu8BMS_PrechargeContSts "..." UBYTE I_1 1 2 0 255 ECU_ADDRESS 0x70004F26 /end MEASUREMENT
/begin MEASUREMENT MAIN_MSGu8BMS_PrechargeSts "..." UBYTE I_1 1 2 0 255 ECU_ADDRESS 0x70004F27 /end MEASUREMENT
/begin MEASUREMENT MAIN_MSGu8BMS_QUICKChargeSts "..." UBYTE I_1 1 2 0 255 ECU_ADDRESS 0x70004F2D /end MEASUREMENT
/begin MEASUREMENT MAIN_MSGu8BMS_QuickChargeGunSts "..." UBYTE I_1 1 2 0 255 ECU_ADDRESS 0x70004F2B /end MEASUREMENT
/begin MEASUREMENT MAIN_MSGu8BMS_RequestOutputMode "..." UBYTE I_1 1 2 0 255 ECU_ADDRESS 0x70004E5D /end MEASUREMENT
/begin MEASUREMENT MAIN_MSGu8BMS_RunMode_TBOX "..." UBYTE I_1 1 2 0 255 ECU_ADDRESS 0x70004F21 /end MEASUREMENT
/begin MEASUREMENT MAIN_MSGu8BMS_TotalFautlCount_N1 "..." UBYTE I_1 1 2 0 255 ECU_ADDRESS 0x70004F1A /end MEASUREMENT
/begin MEASUREMENT MAIN_MSGu8BMS_VehicleChrgMode "..." UBYTE I_1 1 2 0 255 ECU_ADDRESS 0x70004F20 /end MEASUREMENT
/begin MEASUREMENT MAIN_MSGu8BMS_workingMode "..." UBYTE I_1 1 2 0 255 ECU_ADDRESS 0x70004F23 /end MEASUREMENT
/begin MEASUREMENT MAIN_MSGu8ColdMachineWorkMode "..." UBYTE I_1 1 2 0 255 ECU_ADDRESS 0x70004E86 /end MEASUREMENT
/begin MEASUREMENT MAIN_MSGu8Control_Mode_sts "..." UBYTE I_1 1 2 0 255 ECU_ADDRESS 0x70004EB4 /end MEASUREMENT
/begin MEASUREMENT MAIN_MSGu8DCAC_1_buf "-" UBYTE Id_0x00 1 2 0 255 MATRIX_DIM 8 1 1 ECU_ADDRESS 0x70004FC8 /end MEASUREMENT
/begin MEASUREMENT MAIN_MSGu8DCAC_1_buf[0] "MAIN_MSGu8DCAC_1_buf[0]" UBYTE Id_0x00 1 2 0 255 ECU_ADDRESS 0x70004FC8 /end MEASUREMENT
/begin MEASUREMENT MAIN_MSGu8DCAC_1_buf[1] "MAIN_MSGu8DCAC_1_buf[1]" UBYTE Id_0x00 1 2 0 255 ECU_ADDRESS 0x70004FC9 /end MEASUREMENT
/begin MEASUREMENT MAIN_MSGu8DCAC_1_buf[2] "MAIN_MSGu8DCAC_1_buf[2]" UBYTE Id_0x00 1 2 0 255 ECU_ADDRESS 0x70004FCA /end MEASUREMENT
/begin MEASUREMENT MAIN_MSGu8DCAC_1_buf[3] "MAIN_MSGu8DCAC_1_buf[3]" UBYTE Id_0x00 1 2 0 255 ECU_ADDRESS 0x70004FCB /end MEASUREMENT
/begin MEASUREMENT MAIN_MSGu8DCAC_1_buf[4] "MAIN_MSGu8DCAC_1_buf[4]" UBYTE Id_0x00 1 2 0 255 ECU_ADDRESS 0x70004FCC /end MEASUREMENT
/begin MEASUREMENT MAIN_MSGu8DCAC_1_buf[5] "MAIN_MSGu8DCAC_1_buf[5]" UBYTE Id_0x00 1 2 0 255 ECU_ADDRESS 0x70004FCD /end MEASUREMENT
/begin MEASUREMENT MAIN_MSGu8DCAC_1_buf[6] "MAIN_MSGu8DCAC_1_buf[6]" UBYTE Id_0x00 1 2 0 255 ECU_ADDRESS 0x70004FCE /end MEASUREMENT
/begin MEASUREMENT MAIN_MSGu8DCAC_1_buf[7] "MAIN_MSGu8DCAC_1_buf[7]" UBYTE Id_0x00 1 2 0 255 ECU_ADDRESS 0x70004FCF /end MEASUREMENT
/begin MEASUREMENT MAIN_MSGu8DCAC_2_buf "-" UBYTE Id_0x00 1 2 0 255 MATRIX_DIM 8 1 1 ECU_ADDRESS 0x70004FC0 /end MEASUREMENT
/begin MEASUREMENT MAIN_MSGu8DCAC_2_buf[0] "MAIN_MSGu8DCAC_2_buf[0]" UBYTE Id_0x00 1 2 0 255 ECU_ADDRESS 0x70004FC0 /end MEASUREMENT
/begin MEASUREMENT MAIN_MSGu8DCAC_2_buf[1] "MAIN_MSGu8DCAC_2_buf[1]" UBYTE Id_0x00 1 2 0 255 ECU_ADDRESS 0x70004FC1 /end MEASUREMENT
/begin MEASUREMENT MAIN_MSGu8DCAC_2_buf[2] "MAIN_MSGu8DCAC_2_buf[2]" UBYTE Id_0x00 1 2 0 255 ECU_ADDRESS 0x70004FC2 /end MEASUREMENT
/begin MEASUREMENT MAIN_MSGu8DCAC_2_buf[3] "MAIN_MSGu8DCAC_2_buf[3]" UBYTE Id_0x00 1 2 0 255 ECU_ADDRESS 0x70004FC3 /end MEASUREMENT
/begin MEASUREMENT MAIN_MSGu8DCAC_2_buf[4] "MAIN_MSGu8DCAC_2_buf[4]" UBYTE Id_0x00 1 2 0 255 ECU_ADDRESS 0x70004FC4 /end MEASUREMENT
/begin MEASUREMENT MAIN_MSGu8DCAC_2_buf[5] "MAIN_MSGu8DCAC_2_buf[5]" UBYTE Id_0x00 1 2 0 255 ECU_ADDRESS 0x70004FC5 /end MEASUREMENT
/begin MEASUREMENT MAIN_MSGu8DCAC_2_buf[6] "MAIN_MSGu8DCAC_2_buf[6]" UBYTE Id_0x00 1 2 0 255 ECU_ADDRESS 0x70004FC6 /end MEASUREMENT
/begin MEASUREMENT MAIN_MSGu8DCAC_2_buf[7] "MAIN_MSGu8DCAC_2_buf[7]" UBYTE Id_0x00 1 2 0 255 ECU_ADDRESS 0x70004FC7 /end MEASUREMENT
/begin MEASUREMENT MAIN_MSGu8DCU_FltLev "..." UBYTE I_1 1 2 0 255 ECU_ADDRESS 0x70005328 /end MEASUREMENT
/begin MEASUREMENT MAIN_MSGu8DCU_OfsAlCalSts "..." UBYTE I_1 1 2 0 255 ECU_ADDRESS 0x70005327 /end MEASUREMENT
/begin MEASUREMENT MAIN_MSGu8DEV_Fault0 "..." UBYTE I_1 1 2 0 255 ECU_ADDRESS 0x70005326 /end MEASUREMENT
/begin MEASUREMENT MAIN_MSGu8DEV_Fault1 "..." UBYTE I_1 1 2 0 255 ECU_ADDRESS 0x70005325 /end MEASUREMENT
/begin MEASUREMENT MAIN_MSGu8DEV_Fault10 "..." UBYTE I_1 1 2 0 255 ECU_ADDRESS 0x70005324 /end MEASUREMENT
/begin MEASUREMENT MAIN_MSGu8DEV_Fault11 "..." UBYTE I_1 1 2 0 255 ECU_ADDRESS 0x70005323 /end MEASUREMENT
/begin MEASUREMENT MAIN_MSGu8DEV_Fault12 "..." UBYTE I_1 1 2 0 255 ECU_ADDRESS 0x70005322 /end MEASUREMENT
/begin MEASUREMENT MAIN_MSGu8DEV_Fault13 "..." UBYTE I_1 1 2 0 255 ECU_ADDRESS 0x70005321 /end MEASUREMENT
/begin MEASUREMENT MAIN_MSGu8DEV_Fault14 "..." UBYTE I_1 1 2 0 255 ECU_ADDRESS 0x70005320 /end MEASUREMENT
/begin MEASUREMENT MAIN_MSGu8DEV_Fault15 "..." UBYTE I_1 1 2 0 255 ECU_ADDRESS 0x7000531F /end MEASUREMENT
/begin MEASUREMENT MAIN_MSGu8DEV_Fault2 "..." UBYTE I_1 1 2 0 255 ECU_ADDRESS 0x7000531E /end MEASUREMENT
/begin MEASUREMENT MAIN_MSGu8DEV_Fault3 "..." UBYTE I_1 1 2 0 255 ECU_ADDRESS 0x7000531D /end MEASUREMENT
/begin MEASUREMENT MAIN_MSGu8DEV_Fault4 "..." UBYTE I_1 1 2 0 255 ECU_ADDRESS 0x7000531C /end MEASUREMENT
/begin MEASUREMENT MAIN_MSGu8DEV_Fault5 "..." UBYTE I_1 1 2 0 255 ECU_ADDRESS 0x7000531B /end MEASUREMENT
/begin MEASUREMENT MAIN_MSGu8DEV_Fault6 "..." UBYTE I_1 1 2 0 255 ECU_ADDRESS 0x7000531A /end MEASUREMENT
/begin MEASUREMENT MAIN_MSGu8DEV_Fault7 "..." UBYTE I_1 1 2 0 255 ECU_ADDRESS 0x70005319 /end MEASUREMENT
/begin MEASUREMENT MAIN_MSGu8DEV_Fault8 "..." UBYTE I_1 1 2 0 255 ECU_ADDRESS 0x70005318 /end MEASUREMENT
/begin MEASUREMENT MAIN_MSGu8DEV_Fault9 "..." UBYTE I_1 1 2 0 255 ECU_ADDRESS 0x70005317 /end MEASUREMENT
/begin MEASUREMENT MAIN_MSGu8DVD_SET_HORNcmd "..." UBYTE I_1 1 2 0 255 ECU_ADDRESS 0x70004E95 /end MEASUREMENT
/begin MEASUREMENT MAIN_MSGu8EACPowerStatus "..." UBYTE I_1 1 2 0 255 ECU_ADDRESS 0x70004DD2 /end MEASUREMENT
/begin MEASUREMENT MAIN_MSGu8EAC_Err_Code "..." UBYTE I_1 1 2 0 255 ECU_ADDRESS 0x70004DD4 /end MEASUREMENT
/begin MEASUREMENT MAIN_MSGu8EAC_Err_Level "..." UBYTE I_1 1 2 0 255 ECU_ADDRESS 0x70004DD3 /end MEASUREMENT
/begin MEASUREMENT MAIN_MSGu8EAC_Fault_Status "..." UBYTE I_1 1 2 0 255 ECU_ADDRESS 0x70004DD0 /end MEASUREMENT
/begin MEASUREMENT MAIN_MSGu8EAC_Life "..." UBYTE I_1 1 2 0 255 ECU_ADDRESS 0x70004DC0 /end MEASUREMENT
/begin MEASUREMENT MAIN_MSGu8EAC_Motor_TemperatureRaw "..." UBYTE I_1 1 2 0 255 ECU_ADDRESS 0x70004F7B /end MEASUREMENT
/begin MEASUREMENT MAIN_MSGu8EAC_Work_Status "..." UBYTE I_1 1 2 0 255 ECU_ADDRESS 0x70004DD1 /end MEASUREMENT
/begin MEASUREMENT MAIN_MSGu8EAC_inverter_TemperatureRaw "..." UBYTE I_1 1 2 0 255 ECU_ADDRESS 0x70004F7A /end MEASUREMENT
/begin MEASUREMENT MAIN_MSGu8Financial_services_reminder "..." UBYTE I_1 1 2 0 255 ECU_ADDRESS 0x70004E96 /end MEASUREMENT
/begin MEASUREMENT MAIN_MSGu8GearRequest "..." UBYTE I_1 1 2 0 255 ECU_ADDRESS 0x70004F46 /end MEASUREMENT
/begin MEASUREMENT MAIN_MSGu8HumidityWarningLowerLimit "..." UBYTE I_1 1 2 0 255 ECU_ADDRESS 0x70004E70 /end MEASUREMENT
/begin MEASUREMENT MAIN_MSGu8HumidityWarningUpperLimit "..." UBYTE I_1 1 2 0 255 ECU_ADDRESS 0x70004E71 /end MEASUREMENT
/begin MEASUREMENT MAIN_MSGu8InformationSource "..." UBYTE I_1 1 2 0 255 ECU_ADDRESS 0x70004E60 /end MEASUREMENT
/begin MEASUREMENT MAIN_MSGu8LowerTemperatureWarningLimitRaw "..." UBYTE I_1 1 2 0 255 ECU_ADDRESS 0x70004F9A /end MEASUREMENT
/begin MEASUREMENT MAIN_MSGu8MCUF_Cali1 "..." UBYTE I_1 1 2 0 255 MATRIX_DIM 8 1 1 ECU_ADDRESS 0x70005308 /end MEASUREMENT
/begin MEASUREMENT MAIN_MSGu8MCUF_Cali1[0] "MAIN_MSGu8MCUF_Cali1[0]" UBYTE I_1 1 2 0 255 ECU_ADDRESS 0x70005308 /end MEASUREMENT
/begin MEASUREMENT MAIN_MSGu8MCUF_Cali1[1] "MAIN_MSGu8MCUF_Cali1[1]" UBYTE I_1 1 2 0 255 ECU_ADDRESS 0x70005309 /end MEASUREMENT
/begin MEASUREMENT MAIN_MSGu8MCUF_Cali1[2] "MAIN_MSGu8MCUF_Cali1[2]" UBYTE I_1 1 2 0 255 ECU_ADDRESS 0x7000530A /end MEASUREMENT
/begin MEASUREMENT MAIN_MSGu8MCUF_Cali1[3] "MAIN_MSGu8MCUF_Cali1[3]" UBYTE I_1 1 2 0 255 ECU_ADDRESS 0x7000530B /end MEASUREMENT
/begin MEASUREMENT MAIN_MSGu8MCUF_Cali1[4] "MAIN_MSGu8MCUF_Cali1[4]" UBYTE I_1 1 2 0 255 ECU_ADDRESS 0x7000530C /end MEASUREMENT
/begin MEASUREMENT MAIN_MSGu8MCUF_Cali1[5] "MAIN_MSGu8MCUF_Cali1[5]" UBYTE I_1 1 2 0 255 ECU_ADDRESS 0x7000530D /end MEASUREMENT
/begin MEASUREMENT MAIN_MSGu8MCUF_Cali1[6] "MAIN_MSGu8MCUF_Cali1[6]" UBYTE I_1 1 2 0 255 ECU_ADDRESS 0x7000530E /end MEASUREMENT
/begin MEASUREMENT MAIN_MSGu8MCUF_Cali1[7] "MAIN_MSGu8MCUF_Cali1[7]" UBYTE I_1 1 2 0 255 ECU_ADDRESS 0x7000530F /end MEASUREMENT
/begin MEASUREMENT MAIN_MSGu8MCUF_Cali2 "..." UBYTE I_1 1 2 0 255 MATRIX_DIM 8 1 1 ECU_ADDRESS 0x70005300 /end MEASUREMENT
/begin MEASUREMENT MAIN_MSGu8MCUF_Cali2[0] "MAIN_MSGu8MCUF_Cali2[0]" UBYTE I_1 1 2 0 255 ECU_ADDRESS 0x70005300 /end MEASUREMENT
/begin MEASUREMENT MAIN_MSGu8MCUF_Cali2[1] "MAIN_MSGu8MCUF_Cali2[1]" UBYTE I_1 1 2 0 255 ECU_ADDRESS 0x70005301 /end MEASUREMENT
/begin MEASUREMENT MAIN_MSGu8MCUF_Cali2[2] "MAIN_MSGu8MCUF_Cali2[2]" UBYTE I_1 1 2 0 255 ECU_ADDRESS 0x70005302 /end MEASUREMENT
/begin MEASUREMENT MAIN_MSGu8MCUF_Cali2[3] "MAIN_MSGu8MCUF_Cali2[3]" UBYTE I_1 1 2 0 255 ECU_ADDRESS 0x70005303 /end MEASUREMENT
/begin MEASUREMENT MAIN_MSGu8MCUF_Cali2[4] "MAIN_MSGu8MCUF_Cali2[4]" UBYTE I_1 1 2 0 255 ECU_ADDRESS 0x70005304 /end MEASUREMENT
/begin MEASUREMENT MAIN_MSGu8MCUF_Cali2[5] "MAIN_MSGu8MCUF_Cali2[5]" UBYTE I_1 1 2 0 255 ECU_ADDRESS 0x70005305 /end MEASUREMENT
/begin MEASUREMENT MAIN_MSGu8MCUF_Cali2[6] "MAIN_MSGu8MCUF_Cali2[6]" UBYTE I_1 1 2 0 255 ECU_ADDRESS 0x70005306 /end MEASUREMENT
/begin MEASUREMENT MAIN_MSGu8MCUF_Cali2[7] "MAIN_MSGu8MCUF_Cali2[7]" UBYTE I_1 1 2 0 255 ECU_ADDRESS 0x70005307 /end MEASUREMENT
/begin MEASUREMENT MAIN_MSGu8MCUF_Cali3 "..." UBYTE I_1 1 2 0 255 MATRIX_DIM 8 1 1 ECU_ADDRESS 0x700052F8 /end MEASUREMENT
/begin MEASUREMENT MAIN_MSGu8MCUF_Cali3[0] "MAIN_MSGu8MCUF_Cali3[0]" UBYTE I_1 1 2 0 255 ECU_ADDRESS 0x700052F8 /end MEASUREMENT
/begin MEASUREMENT MAIN_MSGu8MCUF_Cali3[1] "MAIN_MSGu8MCUF_Cali3[1]" UBYTE I_1 1 2 0 255 ECU_ADDRESS 0x700052F9 /end MEASUREMENT
/begin MEASUREMENT MAIN_MSGu8MCUF_Cali3[2] "MAIN_MSGu8MCUF_Cali3[2]" UBYTE I_1 1 2 0 255 ECU_ADDRESS 0x700052FA /end MEASUREMENT
/begin MEASUREMENT MAIN_MSGu8MCUF_Cali3[3] "MAIN_MSGu8MCUF_Cali3[3]" UBYTE I_1 1 2 0 255 ECU_ADDRESS 0x700052FB /end MEASUREMENT
/begin MEASUREMENT MAIN_MSGu8MCUF_Cali3[4] "MAIN_MSGu8MCUF_Cali3[4]" UBYTE I_1 1 2 0 255 ECU_ADDRESS 0x700052FC /end MEASUREMENT
/begin MEASUREMENT MAIN_MSGu8MCUF_Cali3[5] "MAIN_MSGu8MCUF_Cali3[5]" UBYTE I_1 1 2 0 255 ECU_ADDRESS 0x700052FD /end MEASUREMENT
/begin MEASUREMENT MAIN_MSGu8MCUF_Cali3[6] "MAIN_MSGu8MCUF_Cali3[6]" UBYTE I_1 1 2 0 255 ECU_ADDRESS 0x700052FE /end MEASUREMENT
/begin MEASUREMENT MAIN_MSGu8MCUF_Cali3[7] "MAIN_MSGu8MCUF_Cali3[7]" UBYTE I_1 1 2 0 255 ECU_ADDRESS 0x700052FF /end MEASUREMENT
/begin MEASUREMENT MAIN_MSGu8MCUF_Cali4 "..." UBYTE I_1 1 2 0 255 MATRIX_DIM 8 1 1 ECU_ADDRESS 0x700052F0 /end MEASUREMENT
/begin MEASUREMENT MAIN_MSGu8MCUF_Cali4[0] "MAIN_MSGu8MCUF_Cali4[0]" UBYTE I_1 1 2 0 255 ECU_ADDRESS 0x700052F0 /end MEASUREMENT
/begin MEASUREMENT MAIN_MSGu8MCUF_Cali4[1] "MAIN_MSGu8MCUF_Cali4[1]" UBYTE I_1 1 2 0 255 ECU_ADDRESS 0x700052F1 /end MEASUREMENT
/begin MEASUREMENT MAIN_MSGu8MCUF_Cali4[2] "MAIN_MSGu8MCUF_Cali4[2]" UBYTE I_1 1 2 0 255 ECU_ADDRESS 0x700052F2 /end MEASUREMENT
/begin MEASUREMENT MAIN_MSGu8MCUF_Cali4[3] "MAIN_MSGu8MCUF_Cali4[3]" UBYTE I_1 1 2 0 255 ECU_ADDRESS 0x700052F3 /end MEASUREMENT
/begin MEASUREMENT MAIN_MSGu8MCUF_Cali4[4] "MAIN_MSGu8MCUF_Cali4[4]" UBYTE I_1 1 2 0 255 ECU_ADDRESS 0x700052F4 /end MEASUREMENT
/begin MEASUREMENT MAIN_MSGu8MCUF_Cali4[5] "MAIN_MSGu8MCUF_Cali4[5]" UBYTE I_1 1 2 0 255 ECU_ADDRESS 0x700052F5 /end MEASUREMENT
/begin MEASUREMENT MAIN_MSGu8MCUF_Cali4[6] "MAIN_MSGu8MCUF_Cali4[6]" UBYTE I_1 1 2 0 255 ECU_ADDRESS 0x700052F6 /end MEASUREMENT
/begin MEASUREMENT MAIN_MSGu8MCUF_Cali4[7] "MAIN_MSGu8MCUF_Cali4[7]" UBYTE I_1 1 2 0 255 ECU_ADDRESS 0x700052F7 /end MEASUREMENT
/begin MEASUREMENT MAIN_MSGu8MCUR_Cali "..." UBYTE I_1 1 2 0 255 MATRIX_DIM 8 1 1 ECU_ADDRESS 0x700052E3 /end MEASUREMENT
/begin MEASUREMENT MAIN_MSGu8MCUR_Cali[0] "MAIN_MSGu8MCUR_Cali[0]" UBYTE I_1 1 2 0 255 ECU_ADDRESS 0x700052E3 /end MEASUREMENT
/begin MEASUREMENT MAIN_MSGu8MCUR_Cali[1] "MAIN_MSGu8MCUR_Cali[1]" UBYTE I_1 1 2 0 255 ECU_ADDRESS 0x700052E4 /end MEASUREMENT
/begin MEASUREMENT MAIN_MSGu8MCUR_Cali[2] "MAIN_MSGu8MCUR_Cali[2]" UBYTE I_1 1 2 0 255 ECU_ADDRESS 0x700052E5 /end MEASUREMENT
/begin MEASUREMENT MAIN_MSGu8MCUR_Cali[3] "MAIN_MSGu8MCUR_Cali[3]" UBYTE I_1 1 2 0 255 ECU_ADDRESS 0x700052E6 /end MEASUREMENT
/begin MEASUREMENT MAIN_MSGu8MCUR_Cali[4] "MAIN_MSGu8MCUR_Cali[4]" UBYTE I_1 1 2 0 255 ECU_ADDRESS 0x700052E7 /end MEASUREMENT
/begin MEASUREMENT MAIN_MSGu8MCUR_Cali[5] "MAIN_MSGu8MCUR_Cali[5]" UBYTE I_1 1 2 0 255 ECU_ADDRESS 0x700052E8 /end MEASUREMENT
/begin MEASUREMENT MAIN_MSGu8MCUR_Cali[6] "MAIN_MSGu8MCUR_Cali[6]" UBYTE I_1 1 2 0 255 ECU_ADDRESS 0x700052E9 /end MEASUREMENT
/begin MEASUREMENT MAIN_MSGu8MCUR_Cali[7] "MAIN_MSGu8MCUR_Cali[7]" UBYTE I_1 1 2 0 255 ECU_ADDRESS 0x700052EA /end MEASUREMENT
/begin MEASUREMENT MAIN_MSGu8MCU_1_buf "-" UBYTE Id_0x00 1 2 0 255 MATRIX_DIM 8 1 1 ECU_ADDRESS 0x70004FF0 /end MEASUREMENT
/begin MEASUREMENT MAIN_MSGu8MCU_1_buf[0] "MAIN_MSGu8MCU_1_buf[0]" UBYTE Id_0x00 1 2 0 255 ECU_ADDRESS 0x70004FF0 /end MEASUREMENT
/begin MEASUREMENT MAIN_MSGu8MCU_1_buf[1] "MAIN_MSGu8MCU_1_buf[1]" UBYTE Id_0x00 1 2 0 255 ECU_ADDRESS 0x70004FF1 /end MEASUREMENT
/begin MEASUREMENT MAIN_MSGu8MCU_1_buf[2] "MAIN_MSGu8MCU_1_buf[2]" UBYTE Id_0x00 1 2 0 255 ECU_ADDRESS 0x70004FF2 /end MEASUREMENT
/begin MEASUREMENT MAIN_MSGu8MCU_1_buf[3] "MAIN_MSGu8MCU_1_buf[3]" UBYTE Id_0x00 1 2 0 255 ECU_ADDRESS 0x70004FF3 /end MEASUREMENT
/begin MEASUREMENT MAIN_MSGu8MCU_1_buf[4] "MAIN_MSGu8MCU_1_buf[4]" UBYTE Id_0x00 1 2 0 255 ECU_ADDRESS 0x70004FF4 /end MEASUREMENT
/begin MEASUREMENT MAIN_MSGu8MCU_1_buf[5] "MAIN_MSGu8MCU_1_buf[5]" UBYTE Id_0x00 1 2 0 255 ECU_ADDRESS 0x70004FF5 /end MEASUREMENT
/begin MEASUREMENT MAIN_MSGu8MCU_1_buf[6] "MAIN_MSGu8MCU_1_buf[6]" UBYTE Id_0x00 1 2 0 255 ECU_ADDRESS 0x70004FF6 /end MEASUREMENT
/begin MEASUREMENT MAIN_MSGu8MCU_1_buf[7] "MAIN_MSGu8MCU_1_buf[7]" UBYTE Id_0x00 1 2 0 255 ECU_ADDRESS 0x70004FF7 /end MEASUREMENT
/begin MEASUREMENT MAIN_MSGu8MCU_2_buf "-" UBYTE Id_0x00 1 2 0 255 MATRIX_DIM 8 1 1 ECU_ADDRESS 0x70004FE8 /end MEASUREMENT
/begin MEASUREMENT MAIN_MSGu8MCU_2_buf[0] "MAIN_MSGu8MCU_2_buf[0]" UBYTE Id_0x00 1 2 0 255 ECU_ADDRESS 0x70004FE8 /end MEASUREMENT
/begin MEASUREMENT MAIN_MSGu8MCU_2_buf[1] "MAIN_MSGu8MCU_2_buf[1]" UBYTE Id_0x00 1 2 0 255 ECU_ADDRESS 0x70004FE9 /end MEASUREMENT
/begin MEASUREMENT MAIN_MSGu8MCU_2_buf[2] "MAIN_MSGu8MCU_2_buf[2]" UBYTE Id_0x00 1 2 0 255 ECU_ADDRESS 0x70004FEA /end MEASUREMENT
/begin MEASUREMENT MAIN_MSGu8MCU_2_buf[3] "MAIN_MSGu8MCU_2_buf[3]" UBYTE Id_0x00 1 2 0 255 ECU_ADDRESS 0x70004FEB /end MEASUREMENT
/begin MEASUREMENT MAIN_MSGu8MCU_2_buf[4] "MAIN_MSGu8MCU_2_buf[4]" UBYTE Id_0x00 1 2 0 255 ECU_ADDRESS 0x70004FEC /end MEASUREMENT
/begin MEASUREMENT MAIN_MSGu8MCU_2_buf[5] "MAIN_MSGu8MCU_2_buf[5]" UBYTE Id_0x00 1 2 0 255 ECU_ADDRESS 0x70004FED /end MEASUREMENT
/begin MEASUREMENT MAIN_MSGu8MCU_2_buf[6] "MAIN_MSGu8MCU_2_buf[6]" UBYTE Id_0x00 1 2 0 255 ECU_ADDRESS 0x70004FEE /end MEASUREMENT
/begin MEASUREMENT MAIN_MSGu8MCU_2_buf[7] "MAIN_MSGu8MCU_2_buf[7]" UBYTE Id_0x00 1 2 0 255 ECU_ADDRESS 0x70004FEF /end MEASUREMENT
/begin MEASUREMENT MAIN_MSGu8MCU_3_buf "-" UBYTE Id_0x00 1 2 0 255 MATRIX_DIM 8 1 1 ECU_ADDRESS 0x70004FE0 /end MEASUREMENT
/begin MEASUREMENT MAIN_MSGu8MCU_3_buf[0] "MAIN_MSGu8MCU_3_buf[0]" UBYTE Id_0x00 1 2 0 255 ECU_ADDRESS 0x70004FE0 /end MEASUREMENT
/begin MEASUREMENT MAIN_MSGu8MCU_3_buf[1] "MAIN_MSGu8MCU_3_buf[1]" UBYTE Id_0x00 1 2 0 255 ECU_ADDRESS 0x70004FE1 /end MEASUREMENT
/begin MEASUREMENT MAIN_MSGu8MCU_3_buf[2] "MAIN_MSGu8MCU_3_buf[2]" UBYTE Id_0x00 1 2 0 255 ECU_ADDRESS 0x70004FE2 /end MEASUREMENT
/begin MEASUREMENT MAIN_MSGu8MCU_3_buf[3] "MAIN_MSGu8MCU_3_buf[3]" UBYTE Id_0x00 1 2 0 255 ECU_ADDRESS 0x70004FE3 /end MEASUREMENT
/begin MEASUREMENT MAIN_MSGu8MCU_3_buf[4] "MAIN_MSGu8MCU_3_buf[4]" UBYTE Id_0x00 1 2 0 255 ECU_ADDRESS 0x70004FE4 /end MEASUREMENT
/begin MEASUREMENT MAIN_MSGu8MCU_3_buf[5] "MAIN_MSGu8MCU_3_buf[5]" UBYTE Id_0x00 1 2 0 255 ECU_ADDRESS 0x70004FE5 /end MEASUREMENT
/begin MEASUREMENT MAIN_MSGu8MCU_3_buf[6] "MAIN_MSGu8MCU_3_buf[6]" UBYTE Id_0x00 1 2 0 255 ECU_ADDRESS 0x70004FE6 /end MEASUREMENT
/begin MEASUREMENT MAIN_MSGu8MCU_3_buf[7] "MAIN_MSGu8MCU_3_buf[7]" UBYTE Id_0x00 1 2 0 255 ECU_ADDRESS 0x70004FE7 /end MEASUREMENT
/begin MEASUREMENT MAIN_MSGu8MCU_4_buf "-" UBYTE Id_0x00 1 2 0 255 MATRIX_DIM 8 1 1 ECU_ADDRESS 0x70004FD8 /end MEASUREMENT
/begin MEASUREMENT MAIN_MSGu8MCU_4_buf[0] "MAIN_MSGu8MCU_4_buf[0]" UBYTE Id_0x00 1 2 0 255 ECU_ADDRESS 0x70004FD8 /end MEASUREMENT
/begin MEASUREMENT MAIN_MSGu8MCU_4_buf[1] "MAIN_MSGu8MCU_4_buf[1]" UBYTE Id_0x00 1 2 0 255 ECU_ADDRESS 0x70004FD9 /end MEASUREMENT
/begin MEASUREMENT MAIN_MSGu8MCU_4_buf[2] "MAIN_MSGu8MCU_4_buf[2]" UBYTE Id_0x00 1 2 0 255 ECU_ADDRESS 0x70004FDA /end MEASUREMENT
/begin MEASUREMENT MAIN_MSGu8MCU_4_buf[3] "MAIN_MSGu8MCU_4_buf[3]" UBYTE Id_0x00 1 2 0 255 ECU_ADDRESS 0x70004FDB /end MEASUREMENT
/begin MEASUREMENT MAIN_MSGu8MCU_4_buf[4] "MAIN_MSGu8MCU_4_buf[4]" UBYTE Id_0x00 1 2 0 255 ECU_ADDRESS 0x70004FDC /end MEASUREMENT
/begin MEASUREMENT MAIN_MSGu8MCU_4_buf[5] "MAIN_MSGu8MCU_4_buf[5]" UBYTE Id_0x00 1 2 0 255 ECU_ADDRESS 0x70004FDD /end MEASUREMENT
/begin MEASUREMENT MAIN_MSGu8MCU_4_buf[6] "MAIN_MSGu8MCU_4_buf[6]" UBYTE Id_0x00 1 2 0 255 ECU_ADDRESS 0x70004FDE /end MEASUREMENT
/begin MEASUREMENT MAIN_MSGu8MCU_4_buf[7] "MAIN_MSGu8MCU_4_buf[7]" UBYTE Id_0x00 1 2 0 255 ECU_ADDRESS 0x70004FDF /end MEASUREMENT
/begin MEASUREMENT MAIN_MSGu8MCU_ContrTemp_NTCRaw "..." UBYTE I_1 1 2 0 255 ECU_ADDRESS 0x70004F8F /end MEASUREMENT
/begin MEASUREMENT MAIN_MSGu8MCU_ControllerTempRaw "..." UBYTE I_1 1 2 0 255 ECU_ADDRESS 0x70004F81 /end MEASUREMENT
/begin MEASUREMENT MAIN_MSGu8MCU_FaultGrade "..." UBYTE I_1 1 2 0 255 ECU_ADDRESS 0x70004E0A /end MEASUREMENT
/begin MEASUREMENT MAIN_MSGu8MCU_InvOverTemp "..." UBYTE I_1 1 2 0 255 ECU_ADDRESS 0x70004E25 /end MEASUREMENT
/begin MEASUREMENT MAIN_MSGu8MCU_MCUMode "..." UBYTE I_1 1 2 0 255 ECU_ADDRESS 0x70004E11 /end MEASUREMENT
/begin MEASUREMENT MAIN_MSGu8MCU_MotorOverTemp "..." UBYTE I_1 1 2 0 255 ECU_ADDRESS 0x70004E26 /end MEASUREMENT
/begin MEASUREMENT MAIN_MSGu8MCU_MotorTempRaw "..." UBYTE I_1 1 2 0 255 ECU_ADDRESS 0x70004F8E /end MEASUREMENT
/begin MEASUREMENT MAIN_MSGu8MCU_Motor_FAULTNum "..." UBYTE I_1 1 2 0 255 ECU_ADDRESS 0x70004E29 /end MEASUREMENT
/begin MEASUREMENT MAIN_MSGu8MCU_Motor_Sts "..." UBYTE I_1 1 2 0 255 ECU_ADDRESS 0x70004E28 /end MEASUREMENT
/begin MEASUREMENT MAIN_MSGu8MCU_SelfCheck "..." UBYTE I_1 1 2 0 255 ECU_ADDRESS 0x70004E0C /end MEASUREMENT
/begin MEASUREMENT MAIN_MSGu8McuDTC "..." UBYTE I_1 1 2 0 255 ECU_ADDRESS 0x70005310 /end MEASUREMENT
/begin MEASUREMENT MAIN_MSGu8McuMotSubFltLevel "..." UBYTE I_1 1 2 0 255 ECU_ADDRESS 0x700052EB /end MEASUREMENT
/begin MEASUREMENT MAIN_MSGu8Motor_Percent_torqueRaw "..." UBYTE I_1 1 2 0 255 ECU_ADDRESS 0x70004F80 /end MEASUREMENT
/begin MEASUREMENT MAIN_MSGu8OrderInformation "..." UBYTE I_1 1 2 0 255 ECU_ADDRESS 0x70004E63 /end MEASUREMENT
/begin MEASUREMENT MAIN_MSGu8PDU_1_buf "-" UBYTE Id_0x00 1 2 0 255 MATRIX_DIM 8 1 1 ECU_ADDRESS 0x70004FD0 /end MEASUREMENT
/begin MEASUREMENT MAIN_MSGu8PDU_1_buf[0] "MAIN_MSGu8PDU_1_buf[0]" UBYTE Id_0x00 1 2 0 255 ECU_ADDRESS 0x70004FD0 /end MEASUREMENT
/begin MEASUREMENT MAIN_MSGu8PDU_1_buf[1] "MAIN_MSGu8PDU_1_buf[1]" UBYTE Id_0x00 1 2 0 255 ECU_ADDRESS 0x70004FD1 /end MEASUREMENT
/begin MEASUREMENT MAIN_MSGu8PDU_1_buf[2] "MAIN_MSGu8PDU_1_buf[2]" UBYTE Id_0x00 1 2 0 255 ECU_ADDRESS 0x70004FD2 /end MEASUREMENT
/begin MEASUREMENT MAIN_MSGu8PDU_1_buf[3] "MAIN_MSGu8PDU_1_buf[3]" UBYTE Id_0x00 1 2 0 255 ECU_ADDRESS 0x70004FD3 /end MEASUREMENT
/begin MEASUREMENT MAIN_MSGu8PDU_1_buf[4] "MAIN_MSGu8PDU_1_buf[4]" UBYTE Id_0x00 1 2 0 255 ECU_ADDRESS 0x70004FD4 /end MEASUREMENT
/begin MEASUREMENT MAIN_MSGu8PDU_1_buf[5] "MAIN_MSGu8PDU_1_buf[5]" UBYTE Id_0x00 1 2 0 255 ECU_ADDRESS 0x70004FD5 /end MEASUREMENT
/begin MEASUREMENT MAIN_MSGu8PDU_1_buf[6] "MAIN_MSGu8PDU_1_buf[6]" UBYTE Id_0x00 1 2 0 255 ECU_ADDRESS 0x70004FD6 /end MEASUREMENT
/begin MEASUREMENT MAIN_MSGu8PDU_1_buf[7] "MAIN_MSGu8PDU_1_buf[7]" UBYTE Id_0x00 1 2 0 255 ECU_ADDRESS 0x70004FD7 /end MEASUREMENT
/begin MEASUREMENT MAIN_MSGu8PDU_FaultCode "..." UBYTE I_1 1 2 0 255 ECU_ADDRESS 0x70004DD5 /end MEASUREMENT
/begin MEASUREMENT MAIN_MSGu8PDU_FaultGrade "..." UBYTE I_1 1 2 0 255 ECU_ADDRESS 0x70004DD7 /end MEASUREMENT
/begin MEASUREMENT MAIN_MSGu8PDU_InterlockSts "..." UBYTE I_1 1 2 0 255 ECU_ADDRESS 0x70004DD6 /end MEASUREMENT
/begin MEASUREMENT MAIN_MSGu8PEPS_1_buf "-" UBYTE Id_0x00 1 2 0 255 MATRIX_DIM 8 1 1 ECU_ADDRESS 0x70005000 /end MEASUREMENT
/begin MEASUREMENT MAIN_MSGu8PEPS_1_buf[0] "MAIN_MSGu8PEPS_1_buf[0]" UBYTE Id_0x00 1 2 0 255 ECU_ADDRESS 0x70005000 /end MEASUREMENT
/begin MEASUREMENT MAIN_MSGu8PEPS_1_buf[1] "MAIN_MSGu8PEPS_1_buf[1]" UBYTE Id_0x00 1 2 0 255 ECU_ADDRESS 0x70005001 /end MEASUREMENT
/begin MEASUREMENT MAIN_MSGu8PEPS_1_buf[2] "MAIN_MSGu8PEPS_1_buf[2]" UBYTE Id_0x00 1 2 0 255 ECU_ADDRESS 0x70005002 /end MEASUREMENT
/begin MEASUREMENT MAIN_MSGu8PEPS_1_buf[3] "MAIN_MSGu8PEPS_1_buf[3]" UBYTE Id_0x00 1 2 0 255 ECU_ADDRESS 0x70005003 /end MEASUREMENT
/begin MEASUREMENT MAIN_MSGu8PEPS_1_buf[4] "MAIN_MSGu8PEPS_1_buf[4]" UBYTE Id_0x00 1 2 0 255 ECU_ADDRESS 0x70005004 /end MEASUREMENT
/begin MEASUREMENT MAIN_MSGu8PEPS_1_buf[5] "MAIN_MSGu8PEPS_1_buf[5]" UBYTE Id_0x00 1 2 0 255 ECU_ADDRESS 0x70005005 /end MEASUREMENT
/begin MEASUREMENT MAIN_MSGu8PEPS_1_buf[6] "MAIN_MSGu8PEPS_1_buf[6]" UBYTE Id_0x00 1 2 0 255 ECU_ADDRESS 0x70005006 /end MEASUREMENT
/begin MEASUREMENT MAIN_MSGu8PEPS_1_buf[7] "MAIN_MSGu8PEPS_1_buf[7]" UBYTE Id_0x00 1 2 0 255 ECU_ADDRESS 0x70005007 /end MEASUREMENT
/begin MEASUREMENT MAIN_MSGu8PEPS_Learning_Status "..." UBYTE I_1 1 2 0 255 ECU_ADDRESS 0x70004E65 /end MEASUREMENT
/begin MEASUREMENT MAIN_MSGu8PEPS_Message_CheckSum "..." UBYTE I_1 1 2 0 255 ECU_ADDRESS 0x70004E5E /end MEASUREMENT
/begin MEASUREMENT MAIN_MSGu8PEPS_Message_Counter "..." UBYTE I_1 1 2 0 255 ECU_ADDRESS 0x70004E5F /end MEASUREMENT
/begin MEASUREMENT MAIN_MSGu8PEPS_PowerMode "..." UBYTE I_1 1 2 0 255 ECU_ADDRESS 0x70004E6E /end MEASUREMENT
/begin MEASUREMENT MAIN_MSGu8PEPS_PowerModeValidity "..." UBYTE I_1 1 2 0 255 ECU_ADDRESS 0x70004E6F /end MEASUREMENT
/begin MEASUREMENT MAIN_MSGu8PTCrelay1status "..." UBYTE I_1 1 2 0 255 ECU_ADDRESS 0x70004DDB /end MEASUREMENT
/begin MEASUREMENT MAIN_MSGu8PTCrelay2status "..." UBYTE I_1 1 2 0 255 ECU_ADDRESS 0x70004DDA /end MEASUREMENT
/begin MEASUREMENT MAIN_MSGu8Pre_chargedrelaystatus "..." UBYTE I_1 1 2 0 255 ECU_ADDRESS 0x70004DD9 /end MEASUREMENT
/begin MEASUREMENT MAIN_MSGu8Pumprelaystatus "..." UBYTE I_1 1 2 0 255 ECU_ADDRESS 0x70004DDC /end MEASUREMENT
/begin MEASUREMENT MAIN_MSGu8PwModOffCnt "MAIN_MSGu8PwModOffCnt" UBYTE I_1 1 2 0 255 ECU_ADDRESS 0x700050C1 /end MEASUREMENT
/begin MEASUREMENT MAIN_MSGu8PwModOnCnt "MAIN_MSGu8PwModOnCnt" UBYTE I_1 1 2 0 255 ECU_ADDRESS 0x700050C2 /end MEASUREMENT
/begin MEASUREMENT MAIN_MSGu8QUICKChargeSts "..." UBYTE I_1 1 2 0 255 ECU_ADDRESS 0x70004DDD /end MEASUREMENT
/begin MEASUREMENT MAIN_MSGu8RemoteCoolingRequest "..." UBYTE I_1 1 2 0 255 ECU_ADDRESS 0x70004E87 /end MEASUREMENT
/begin MEASUREMENT MAIN_MSGu8Remote_BattConstantStsReq "..." UBYTE I_1 1 2 0 255 ECU_ADDRESS 0x70004E97 /end MEASUREMENT
/begin MEASUREMENT MAIN_MSGu8Remote_KeepWarmReq "..." UBYTE I_1 1 2 0 255 ECU_ADDRESS 0x70004EA2 /end MEASUREMENT
/begin MEASUREMENT MAIN_MSGu8SettingTemperatureRaw "..." UBYTE I_1 1 2 0 255 ECU_ADDRESS 0x70004F9C /end MEASUREMENT
/begin MEASUREMENT MAIN_MSGu8TBOX_1_buf "-" UBYTE Id_0x00 1 2 0 255 MATRIX_DIM 8 1 1 ECU_ADDRESS 0x70005010 /end MEASUREMENT
/begin MEASUREMENT MAIN_MSGu8TBOX_1_buf[0] "MAIN_MSGu8TBOX_1_buf[0]" UBYTE Id_0x00 1 2 0 255 ECU_ADDRESS 0x70005010 /end MEASUREMENT
/begin MEASUREMENT MAIN_MSGu8TBOX_1_buf[1] "MAIN_MSGu8TBOX_1_buf[1]" UBYTE Id_0x00 1 2 0 255 ECU_ADDRESS 0x70005011 /end MEASUREMENT
/begin MEASUREMENT MAIN_MSGu8TBOX_1_buf[2] "MAIN_MSGu8TBOX_1_buf[2]" UBYTE Id_0x00 1 2 0 255 ECU_ADDRESS 0x70005012 /end MEASUREMENT
/begin MEASUREMENT MAIN_MSGu8TBOX_1_buf[3] "MAIN_MSGu8TBOX_1_buf[3]" UBYTE Id_0x00 1 2 0 255 ECU_ADDRESS 0x70005013 /end MEASUREMENT
/begin MEASUREMENT MAIN_MSGu8TBOX_1_buf[4] "MAIN_MSGu8TBOX_1_buf[4]" UBYTE Id_0x00 1 2 0 255 ECU_ADDRESS 0x70005014 /end MEASUREMENT
/begin MEASUREMENT MAIN_MSGu8TBOX_1_buf[5] "MAIN_MSGu8TBOX_1_buf[5]" UBYTE Id_0x00 1 2 0 255 ECU_ADDRESS 0x70005015 /end MEASUREMENT
/begin MEASUREMENT MAIN_MSGu8TBOX_1_buf[6] "MAIN_MSGu8TBOX_1_buf[6]" UBYTE Id_0x00 1 2 0 255 ECU_ADDRESS 0x70005016 /end MEASUREMENT
/begin MEASUREMENT MAIN_MSGu8TBOX_1_buf[7] "MAIN_MSGu8TBOX_1_buf[7]" UBYTE Id_0x00 1 2 0 255 ECU_ADDRESS 0x70005017 /end MEASUREMENT
/begin MEASUREMENT MAIN_MSGu8TBOX_2_buf "-" UBYTE Id_0x00 1 2 0 255 MATRIX_DIM 8 1 1 ECU_ADDRESS 0x70005038 /end MEASUREMENT
/begin MEASUREMENT MAIN_MSGu8TBOX_2_buf[0] "MAIN_MSGu8TBOX_2_buf[0]" UBYTE Id_0x00 1 2 0 255 ECU_ADDRESS 0x70005038 /end MEASUREMENT
/begin MEASUREMENT MAIN_MSGu8TBOX_2_buf[1] "MAIN_MSGu8TBOX_2_buf[1]" UBYTE Id_0x00 1 2 0 255 ECU_ADDRESS 0x70005039 /end MEASUREMENT
/begin MEASUREMENT MAIN_MSGu8TBOX_2_buf[2] "MAIN_MSGu8TBOX_2_buf[2]" UBYTE Id_0x00 1 2 0 255 ECU_ADDRESS 0x7000503A /end MEASUREMENT
/begin MEASUREMENT MAIN_MSGu8TBOX_2_buf[3] "MAIN_MSGu8TBOX_2_buf[3]" UBYTE Id_0x00 1 2 0 255 ECU_ADDRESS 0x7000503B /end MEASUREMENT
/begin MEASUREMENT MAIN_MSGu8TBOX_2_buf[4] "MAIN_MSGu8TBOX_2_buf[4]" UBYTE Id_0x00 1 2 0 255 ECU_ADDRESS 0x7000503C /end MEASUREMENT
/begin MEASUREMENT MAIN_MSGu8TBOX_2_buf[5] "MAIN_MSGu8TBOX_2_buf[5]" UBYTE Id_0x00 1 2 0 255 ECU_ADDRESS 0x7000503D /end MEASUREMENT
/begin MEASUREMENT MAIN_MSGu8TBOX_2_buf[6] "MAIN_MSGu8TBOX_2_buf[6]" UBYTE Id_0x00 1 2 0 255 ECU_ADDRESS 0x7000503E /end MEASUREMENT
/begin MEASUREMENT MAIN_MSGu8TBOX_2_buf[7] "MAIN_MSGu8TBOX_2_buf[7]" UBYTE Id_0x00 1 2 0 255 ECU_ADDRESS 0x7000503F /end MEASUREMENT
/begin MEASUREMENT MAIN_MSGu8TBOX_4_buf "-" UBYTE Id_0x00 1 2 0 255 MATRIX_DIM 8 1 1 ECU_ADDRESS 0x70005008 /end MEASUREMENT
/begin MEASUREMENT MAIN_MSGu8TBOX_4_buf[0] "MAIN_MSGu8TBOX_4_buf[0]" UBYTE Id_0x00 1 2 0 255 ECU_ADDRESS 0x70005008 /end MEASUREMENT
/begin MEASUREMENT MAIN_MSGu8TBOX_4_buf[1] "MAIN_MSGu8TBOX_4_buf[1]" UBYTE Id_0x00 1 2 0 255 ECU_ADDRESS 0x70005009 /end MEASUREMENT
/begin MEASUREMENT MAIN_MSGu8TBOX_4_buf[2] "MAIN_MSGu8TBOX_4_buf[2]" UBYTE Id_0x00 1 2 0 255 ECU_ADDRESS 0x7000500A /end MEASUREMENT
/begin MEASUREMENT MAIN_MSGu8TBOX_4_buf[3] "MAIN_MSGu8TBOX_4_buf[3]" UBYTE Id_0x00 1 2 0 255 ECU_ADDRESS 0x7000500B /end MEASUREMENT
/begin MEASUREMENT MAIN_MSGu8TBOX_4_buf[4] "MAIN_MSGu8TBOX_4_buf[4]" UBYTE Id_0x00 1 2 0 255 ECU_ADDRESS 0x7000500C /end MEASUREMENT
/begin MEASUREMENT MAIN_MSGu8TBOX_4_buf[5] "MAIN_MSGu8TBOX_4_buf[5]" UBYTE Id_0x00 1 2 0 255 ECU_ADDRESS 0x7000500D /end MEASUREMENT
/begin MEASUREMENT MAIN_MSGu8TBOX_4_buf[6] "MAIN_MSGu8TBOX_4_buf[6]" UBYTE Id_0x00 1 2 0 255 ECU_ADDRESS 0x7000500E /end MEASUREMENT
/begin MEASUREMENT MAIN_MSGu8TBOX_4_buf[7] "MAIN_MSGu8TBOX_4_buf[7]" UBYTE Id_0x00 1 2 0 255 ECU_ADDRESS 0x7000500F /end MEASUREMENT
/begin MEASUREMENT MAIN_MSGu8TBOX_AliveCounter "..." UBYTE I_1 1 2 0 255 ECU_ADDRESS 0x70004EA6 /end MEASUREMENT
/begin MEASUREMENT MAIN_MSGu8TBOX_Checksum "..." UBYTE I_1 1 2 0 255 ECU_ADDRESS 0x70004E8C /end MEASUREMENT
/begin MEASUREMENT MAIN_MSGu8TBOX_DiagSts "..." UBYTE I_1 1 2 0 255 ECU_ADDRESS 0x70004EA5 /end MEASUREMENT
/begin MEASUREMENT MAIN_MSGu8TBOX_Message_Days "..." UBYTE I_1 1 2 0 255 ECU_ADDRESS 0x70004F16 /end MEASUREMENT
/begin MEASUREMENT MAIN_MSGu8TBOX_Message_Hours "..." UBYTE I_1 1 2 0 255 ECU_ADDRESS 0x70004F15 /end MEASUREMENT
/begin MEASUREMENT MAIN_MSGu8TBOX_Message_Minutes "..." UBYTE I_1 1 2 0 255 ECU_ADDRESS 0x70004F14 /end MEASUREMENT
/begin MEASUREMENT MAIN_MSGu8TBOX_Message_Months "..." UBYTE I_1 1 2 0 255 ECU_ADDRESS 0x70004F17 /end MEASUREMENT
/begin MEASUREMENT MAIN_MSGu8TBOX_Message_Seconds "..." UBYTE I_1 1 2 0 255 ECU_ADDRESS 0x70004F13 /end MEASUREMENT
/begin MEASUREMENT MAIN_MSGu8TBOX_Message_Years1 "..." UBYTE I_1 1 2 0 255 ECU_ADDRESS 0x70004F19 /end MEASUREMENT
/begin MEASUREMENT MAIN_MSGu8TBOX_Message_Years2 "..." UBYTE I_1 1 2 0 255 ECU_ADDRESS 0x70004F18 /end MEASUREMENT
/begin MEASUREMENT MAIN_MSGu8TBOX_OTA_Sts "..." UBYTE I_1 1 2 0 255 ECU_ADDRESS 0x70004E84 /end MEASUREMENT
/begin MEASUREMENT MAIN_MSGu8TBOX_Rem12VchargReqSts "..." UBYTE I_1 1 2 0 255 ECU_ADDRESS 0x70004E85 /end MEASUREMENT
/begin MEASUREMENT MAIN_MSGu8TBOX_RemoteControlLock "..." UBYTE I_1 1 2 0 255 ECU_ADDRESS 0x70004E9B /end MEASUREMENT
/begin MEASUREMENT MAIN_MSGu8TBOX_SpeedLimit "..." UBYTE I_1 1 2 0 255 ECU_ADDRESS 0x70004E99 /end MEASUREMENT
/begin MEASUREMENT MAIN_MSGu8TBOX_SpeedLimitSource "..." UBYTE I_1 1 2 0 255 ECU_ADDRESS 0x70004E9A /end MEASUREMENT
/begin MEASUREMENT MAIN_MSGu8TBOX_TempSetRaw "..." UBYTE I_1 1 2 0 255 ECU_ADDRESS 0x70004F9D /end MEASUREMENT
/begin MEASUREMENT MAIN_MSGu8TMS_4_buf "-" UBYTE Id_0x00 1 2 0 255 MATRIX_DIM 8 1 1 ECU_ADDRESS 0x70005028 /end MEASUREMENT
/begin MEASUREMENT MAIN_MSGu8TMS_4_buf[0] "MAIN_MSGu8TMS_4_buf[0]" UBYTE Id_0x00 1 2 0 255 ECU_ADDRESS 0x70005028 /end MEASUREMENT
/begin MEASUREMENT MAIN_MSGu8TMS_4_buf[1] "MAIN_MSGu8TMS_4_buf[1]" UBYTE Id_0x00 1 2 0 255 ECU_ADDRESS 0x70005029 /end MEASUREMENT
/begin MEASUREMENT MAIN_MSGu8TMS_4_buf[2] "MAIN_MSGu8TMS_4_buf[2]" UBYTE Id_0x00 1 2 0 255 ECU_ADDRESS 0x7000502A /end MEASUREMENT
/begin MEASUREMENT MAIN_MSGu8TMS_4_buf[3] "MAIN_MSGu8TMS_4_buf[3]" UBYTE Id_0x00 1 2 0 255 ECU_ADDRESS 0x7000502B /end MEASUREMENT
/begin MEASUREMENT MAIN_MSGu8TMS_4_buf[4] "MAIN_MSGu8TMS_4_buf[4]" UBYTE Id_0x00 1 2 0 255 ECU_ADDRESS 0x7000502C /end MEASUREMENT
/begin MEASUREMENT MAIN_MSGu8TMS_4_buf[5] "MAIN_MSGu8TMS_4_buf[5]" UBYTE Id_0x00 1 2 0 255 ECU_ADDRESS 0x7000502D /end MEASUREMENT
/begin MEASUREMENT MAIN_MSGu8TMS_4_buf[6] "MAIN_MSGu8TMS_4_buf[6]" UBYTE Id_0x00 1 2 0 255 ECU_ADDRESS 0x7000502E /end MEASUREMENT
/begin MEASUREMENT MAIN_MSGu8TMS_4_buf[7] "MAIN_MSGu8TMS_4_buf[7]" UBYTE Id_0x00 1 2 0 255 ECU_ADDRESS 0x7000502F /end MEASUREMENT
/begin MEASUREMENT MAIN_MSGu8TMS_APTCPowerAllowedRaw "..." UBYTE I_1 1 2 0 255 ECU_ADDRESS 0x70004FAC /end MEASUREMENT
/begin MEASUREMENT MAIN_MSGu8TMS_APTCTempRaw "..." UBYTE I_1 1 2 0 255 ECU_ADDRESS 0x70004FA9 /end MEASUREMENT
/begin MEASUREMENT MAIN_MSGu8TMS_EACPowerAllowedRaw "..." UBYTE I_1 1 2 0 255 ECU_ADDRESS 0x70004FAE /end MEASUREMENT
/begin MEASUREMENT MAIN_MSGu8TMS_EACSpdReqRaw "..." UBYTE I_1 1 2 0 255 ECU_ADDRESS 0x70004FAD /end MEASUREMENT
/begin MEASUREMENT MAIN_MSGu8TMS_EvaporatorTempRaw "..." UBYTE I_1 1 2 0 255 ECU_ADDRESS 0x70004FAA /end MEASUREMENT
/begin MEASUREMENT MAIN_MSGu8TMS_MsgAliveCounter "..." UBYTE I_1 1 2 0 255 ECU_ADDRESS 0x70004ED3 /end MEASUREMENT
/begin MEASUREMENT MAIN_MSGu8TMS_TargetEvaporatorTempRaw "..." UBYTE I_1 1 2 0 255 ECU_ADDRESS 0x70004FAF /end MEASUREMENT
/begin MEASUREMENT MAIN_MSGu8TMS_WPTCPowerAllowedRaw "..." UBYTE I_1 1 2 0 255 ECU_ADDRESS 0x70004FAB /end MEASUREMENT
/begin MEASUREMENT MAIN_MSGu8Unused "..." UBYTE I_1 1 2 0 255 ECU_ADDRESS 0x70004F11 /end MEASUREMENT
/begin MEASUREMENT MAIN_MSGu8Unused1 "..." UBYTE I_1 1 2 0 255 ECU_ADDRESS 0x70004EC0 /end MEASUREMENT
/begin MEASUREMENT MAIN_MSGu8UpperTemperatureWarningLimitRaw "..." UBYTE I_1 1 2 0 255 ECU_ADDRESS 0x70004F9B /end MEASUREMENT
/begin MEASUREMENT MAIN_MSGu8VCU_1_buf "-" UBYTE Id_0x00 1 2 0 255 MATRIX_DIM 8 1 1 ECU_ADDRESS 0x70005058 /end MEASUREMENT
/begin MEASUREMENT MAIN_MSGu8VCU_1_buf[0] "MAIN_MSGu8VCU_1_buf[0]" UBYTE Id_0x00 1 2 0 255 ECU_ADDRESS 0x70005058 /end MEASUREMENT
/begin MEASUREMENT MAIN_MSGu8VCU_1_buf[1] "MAIN_MSGu8VCU_1_buf[1]" UBYTE Id_0x00 1 2 0 255 ECU_ADDRESS 0x70005059 /end MEASUREMENT
/begin MEASUREMENT MAIN_MSGu8VCU_1_buf[2] "MAIN_MSGu8VCU_1_buf[2]" UBYTE Id_0x00 1 2 0 255 ECU_ADDRESS 0x7000505A /end MEASUREMENT
/begin MEASUREMENT MAIN_MSGu8VCU_1_buf[3] "MAIN_MSGu8VCU_1_buf[3]" UBYTE Id_0x00 1 2 0 255 ECU_ADDRESS 0x7000505B /end MEASUREMENT
/begin MEASUREMENT MAIN_MSGu8VCU_1_buf[4] "MAIN_MSGu8VCU_1_buf[4]" UBYTE Id_0x00 1 2 0 255 ECU_ADDRESS 0x7000505C /end MEASUREMENT
/begin MEASUREMENT MAIN_MSGu8VCU_1_buf[5] "MAIN_MSGu8VCU_1_buf[5]" UBYTE Id_0x00 1 2 0 255 ECU_ADDRESS 0x7000505D /end MEASUREMENT
/begin MEASUREMENT MAIN_MSGu8VCU_1_buf[6] "MAIN_MSGu8VCU_1_buf[6]" UBYTE Id_0x00 1 2 0 255 ECU_ADDRESS 0x7000505E /end MEASUREMENT
/begin MEASUREMENT MAIN_MSGu8VCU_1_buf[7] "MAIN_MSGu8VCU_1_buf[7]" UBYTE Id_0x00 1 2 0 255 ECU_ADDRESS 0x7000505F /end MEASUREMENT
/begin MEASUREMENT MAIN_MSGu8VCU_2_buf "-" UBYTE Id_0x00 1 2 0 255 MATRIX_DIM 8 1 1 ECU_ADDRESS 0x70005050 /end MEASUREMENT
/begin MEASUREMENT MAIN_MSGu8VCU_2_buf[0] "MAIN_MSGu8VCU_2_buf[0]" UBYTE Id_0x00 1 2 0 255 ECU_ADDRESS 0x70005050 /end MEASUREMENT
/begin MEASUREMENT MAIN_MSGu8VCU_2_buf[1] "MAIN_MSGu8VCU_2_buf[1]" UBYTE Id_0x00 1 2 0 255 ECU_ADDRESS 0x70005051 /end MEASUREMENT
/begin MEASUREMENT MAIN_MSGu8VCU_2_buf[2] "MAIN_MSGu8VCU_2_buf[2]" UBYTE Id_0x00 1 2 0 255 ECU_ADDRESS 0x70005052 /end MEASUREMENT
/begin MEASUREMENT MAIN_MSGu8VCU_2_buf[3] "MAIN_MSGu8VCU_2_buf[3]" UBYTE Id_0x00 1 2 0 255 ECU_ADDRESS 0x70005053 /end MEASUREMENT
/begin MEASUREMENT MAIN_MSGu8VCU_2_buf[4] "MAIN_MSGu8VCU_2_buf[4]" UBYTE Id_0x00 1 2 0 255 ECU_ADDRESS 0x70005054 /end MEASUREMENT
/begin MEASUREMENT MAIN_MSGu8VCU_2_buf[5] "MAIN_MSGu8VCU_2_buf[5]" UBYTE Id_0x00 1 2 0 255 ECU_ADDRESS 0x70005055 /end MEASUREMENT
/begin MEASUREMENT MAIN_MSGu8VCU_2_buf[6] "MAIN_MSGu8VCU_2_buf[6]" UBYTE Id_0x00 1 2 0 255 ECU_ADDRESS 0x70005056 /end MEASUREMENT
/begin MEASUREMENT MAIN_MSGu8VCU_2_buf[7] "MAIN_MSGu8VCU_2_buf[7]" UBYTE Id_0x00 1 2 0 255 ECU_ADDRESS 0x70005057 /end MEASUREMENT
/begin MEASUREMENT MAIN_MSGu8VCU_3_buf "-" UBYTE Id_0x00 1 2 0 255 MATRIX_DIM 8 1 1 ECU_ADDRESS 0x70005018 /end MEASUREMENT
/begin MEASUREMENT MAIN_MSGu8VCU_3_buf[0] "MAIN_MSGu8VCU_3_buf[0]" UBYTE Id_0x00 1 2 0 255 ECU_ADDRESS 0x70005018 /end MEASUREMENT
/begin MEASUREMENT MAIN_MSGu8VCU_3_buf[1] "MAIN_MSGu8VCU_3_buf[1]" UBYTE Id_0x00 1 2 0 255 ECU_ADDRESS 0x70005019 /end MEASUREMENT
/begin MEASUREMENT MAIN_MSGu8VCU_3_buf[2] "MAIN_MSGu8VCU_3_buf[2]" UBYTE Id_0x00 1 2 0 255 ECU_ADDRESS 0x7000501A /end MEASUREMENT
/begin MEASUREMENT MAIN_MSGu8VCU_3_buf[3] "MAIN_MSGu8VCU_3_buf[3]" UBYTE Id_0x00 1 2 0 255 ECU_ADDRESS 0x7000501B /end MEASUREMENT
/begin MEASUREMENT MAIN_MSGu8VCU_3_buf[4] "MAIN_MSGu8VCU_3_buf[4]" UBYTE Id_0x00 1 2 0 255 ECU_ADDRESS 0x7000501C /end MEASUREMENT
/begin MEASUREMENT MAIN_MSGu8VCU_3_buf[5] "MAIN_MSGu8VCU_3_buf[5]" UBYTE Id_0x00 1 2 0 255 ECU_ADDRESS 0x7000501D /end MEASUREMENT
/begin MEASUREMENT MAIN_MSGu8VCU_3_buf[6] "MAIN_MSGu8VCU_3_buf[6]" UBYTE Id_0x00 1 2 0 255 ECU_ADDRESS 0x7000501E /end MEASUREMENT
/begin MEASUREMENT MAIN_MSGu8VCU_3_buf[7] "MAIN_MSGu8VCU_3_buf[7]" UBYTE Id_0x00 1 2 0 255 ECU_ADDRESS 0x7000501F /end MEASUREMENT
/begin MEASUREMENT MAIN_MSGu8VCU_5_buf "-" UBYTE Id_0x00 1 2 0 255 MATRIX_DIM 8 1 1 ECU_ADDRESS 0x70005020 /end MEASUREMENT
/begin MEASUREMENT MAIN_MSGu8VCU_5_buf[0] "MAIN_MSGu8VCU_5_buf[0]" UBYTE Id_0x00 1 2 0 255 ECU_ADDRESS 0x70005020 /end MEASUREMENT
/begin MEASUREMENT MAIN_MSGu8VCU_5_buf[1] "MAIN_MSGu8VCU_5_buf[1]" UBYTE Id_0x00 1 2 0 255 ECU_ADDRESS 0x70005021 /end MEASUREMENT
/begin MEASUREMENT MAIN_MSGu8VCU_5_buf[2] "MAIN_MSGu8VCU_5_buf[2]" UBYTE Id_0x00 1 2 0 255 ECU_ADDRESS 0x70005022 /end MEASUREMENT
/begin MEASUREMENT MAIN_MSGu8VCU_5_buf[3] "MAIN_MSGu8VCU_5_buf[3]" UBYTE Id_0x00 1 2 0 255 ECU_ADDRESS 0x70005023 /end MEASUREMENT
/begin MEASUREMENT MAIN_MSGu8VCU_5_buf[4] "MAIN_MSGu8VCU_5_buf[4]" UBYTE Id_0x00 1 2 0 255 ECU_ADDRESS 0x70005024 /end MEASUREMENT
/begin MEASUREMENT MAIN_MSGu8VCU_5_buf[5] "MAIN_MSGu8VCU_5_buf[5]" UBYTE Id_0x00 1 2 0 255 ECU_ADDRESS 0x70005025 /end MEASUREMENT
/begin MEASUREMENT MAIN_MSGu8VCU_5_buf[6] "MAIN_MSGu8VCU_5_buf[6]" UBYTE Id_0x00 1 2 0 255 ECU_ADDRESS 0x70005026 /end MEASUREMENT
/begin MEASUREMENT MAIN_MSGu8VCU_5_buf[7] "MAIN_MSGu8VCU_5_buf[7]" UBYTE Id_0x00 1 2 0 255 ECU_ADDRESS 0x70005027 /end MEASUREMENT
/begin MEASUREMENT MAIN_MSGu8VCU_7_buf "-" UBYTE Id_0x00 1 2 0 255 MATRIX_DIM 8 1 1 ECU_ADDRESS 0x70005048 /end MEASUREMENT
/begin MEASUREMENT MAIN_MSGu8VCU_7_buf[0] "MAIN_MSGu8VCU_7_buf[0]" UBYTE Id_0x00 1 2 0 255 ECU_ADDRESS 0x70005048 /end MEASUREMENT
/begin MEASUREMENT MAIN_MSGu8VCU_7_buf[1] "MAIN_MSGu8VCU_7_buf[1]" UBYTE Id_0x00 1 2 0 255 ECU_ADDRESS 0x70005049 /end MEASUREMENT
/begin MEASUREMENT MAIN_MSGu8VCU_7_buf[2] "MAIN_MSGu8VCU_7_buf[2]" UBYTE Id_0x00 1 2 0 255 ECU_ADDRESS 0x7000504A /end MEASUREMENT
/begin MEASUREMENT MAIN_MSGu8VCU_7_buf[3] "MAIN_MSGu8VCU_7_buf[3]" UBYTE Id_0x00 1 2 0 255 ECU_ADDRESS 0x7000504B /end MEASUREMENT
/begin MEASUREMENT MAIN_MSGu8VCU_7_buf[4] "MAIN_MSGu8VCU_7_buf[4]" UBYTE Id_0x00 1 2 0 255 ECU_ADDRESS 0x7000504C /end MEASUREMENT
/begin MEASUREMENT MAIN_MSGu8VCU_7_buf[5] "MAIN_MSGu8VCU_7_buf[5]" UBYTE Id_0x00 1 2 0 255 ECU_ADDRESS 0x7000504D /end MEASUREMENT
/begin MEASUREMENT MAIN_MSGu8VCU_7_buf[6] "MAIN_MSGu8VCU_7_buf[6]" UBYTE Id_0x00 1 2 0 255 ECU_ADDRESS 0x7000504E /end MEASUREMENT
/begin MEASUREMENT MAIN_MSGu8VCU_7_buf[7] "MAIN_MSGu8VCU_7_buf[7]" UBYTE Id_0x00 1 2 0 255 ECU_ADDRESS 0x7000504F /end MEASUREMENT
/begin MEASUREMENT MAIN_MSGu8VCU_BMS_CloseRlyStReq "..." UBYTE I_1 1 2 0 255 ECU_ADDRESS 0x70004F2F /end MEASUREMENT
/begin MEASUREMENT MAIN_MSGu8VCU_BattState "..." UBYTE I_1 1 2 0 255 ECU_ADDRESS 0x70004F43 /end MEASUREMENT
/begin MEASUREMENT MAIN_MSGu8VCU_ChrgHVLoadPowerRaw "..." UBYTE I_1 1 2 0 255 ECU_ADDRESS 0x70004FB6 /end MEASUREMENT
/begin MEASUREMENT MAIN_MSGu8VCU_DCDCTargetVoltRaw "..." UBYTE I_1 1 2 0 255 ECU_ADDRESS 0x70004FB7 /end MEASUREMENT
/begin MEASUREMENT MAIN_MSGu8VCU_DCDCTempRaw "..." UBYTE I_1 1 2 0 255 ECU_ADDRESS 0x70004FA0 /end MEASUREMENT
/begin MEASUREMENT MAIN_MSGu8VCU_DCDCstCtrlReq "..." UBYTE I_1 1 2 0 255 ECU_ADDRESS 0x70004F3E /end MEASUREMENT
/begin MEASUREMENT MAIN_MSGu8VCU_EMWorkMod "..." UBYTE I_1 1 2 0 255 ECU_ADDRESS 0x700052DE /end MEASUREMENT
/begin MEASUREMENT MAIN_MSGu8VCU_Failure "..." UBYTE I_1 1 2 0 255 ECU_ADDRESS 0x70004EAE /end MEASUREMENT
/begin MEASUREMENT MAIN_MSGu8VCU_Faultcode "..." UBYTE I_1 1 2 0 255 ECU_ADDRESS 0x70004EAA /end MEASUREMENT
/begin MEASUREMENT MAIN_MSGu8VCU_GasPedalPositionRaw "..." UBYTE I_1 1 2 0 255 ECU_ADDRESS 0x70004FBB /end MEASUREMENT
/begin MEASUREMENT MAIN_MSGu8VCU_GearLevel "..." UBYTE I_1 1 2 0 255 ECU_ADDRESS 0x70004EA8 /end MEASUREMENT
/begin MEASUREMENT MAIN_MSGu8VCU_GearboxPositionDisplay "..." UBYTE I_1 1 2 0 255 ECU_ADDRESS 0x70004F71 /end MEASUREMENT
/begin MEASUREMENT MAIN_MSGu8VCU_InstPowerConsumRaw "..." UBYTE I_1 1 2 0 255 ECU_ADDRESS 0x70004FBA /end MEASUREMENT
/begin MEASUREMENT MAIN_MSGu8VCU_McuEnableReq "..." UBYTE I_1 1 2 0 255 ECU_ADDRESS 0x700052DD /end MEASUREMENT
/begin MEASUREMENT MAIN_MSGu8VCU_PUPDSts "..." UBYTE I_1 1 2 0 255 ECU_ADDRESS 0x70004F3D /end MEASUREMENT
/begin MEASUREMENT MAIN_MSGu8VCU_VacuumPumpSysFailure "..." UBYTE I_1 1 2 0 255 ECU_ADDRESS 0x70004F58 /end MEASUREMENT
/begin MEASUREMENT MAIN_MSGu8VCU_VechileSts "..." UBYTE I_1 1 2 0 255 ECU_ADDRESS 0x70004EB5 /end MEASUREMENT
/begin MEASUREMENT MAIN_MSGu8VCU_stVent "..." UBYTE I_1 1 2 0 255 ECU_ADDRESS 0x70004EAD /end MEASUREMENT
/begin MEASUREMENT MAIN_MSGu8Withrelaystatus "..." UBYTE I_1 1 2 0 255 ECU_ADDRESS 0x70004DD8 /end MEASUREMENT
/begin MEASUREMENT MAIN_MSGu8vcu_AliveCounter "..." UBYTE I_1 1 2 0 255 ECU_ADDRESS 0x70004EA9 /end MEASUREMENT
/begin MEASUREMENT MAIN_TCUu8CAP_TargetMotSts "..." UBYTE I_1 1 2 0 255 ECU_ADDRESS 0x700052DC /end MEASUREMENT
/begin MEASUREMENT MAIN_TotalTime "MAIN_TotalTime" ULONG I_1 1 2 0 4294967295 ECU_ADDRESS 0x700051C4 /end MEASUREMENT
/begin MEASUREMENT MAIN_VSITxsPwmUl "MAIN_VSITxsPwmUl" UWORD F_0v0061035156_p0_4 1 2 0 399.9938965 ECU_ADDRESS 0x70005230 /end MEASUREMENT
/begin MEASUREMENT MAIN_VSITxsPwmUlOn "MAIN_VSITxsPwmUlOn" UBYTE Bool_ON_OFF 1 2 0 1 BIT_MASK 0x01 ECU_ADDRESS 0x70005555 /end MEASUREMENT
/begin MEASUREMENT MAIN_VSITxsPwmUr "MAIN_VSITxsPwmUr" UWORD F_0v0061035156_p0_4 1 2 0 399.9938965 ECU_ADDRESS 0x7000522E /end MEASUREMENT
/begin MEASUREMENT MAIN_VSITxsPwmUrOn "MAIN_VSITxsPwmUrOn" UBYTE Bool_ON_OFF 1 2 0 1 BIT_MASK 0x01 ECU_ADDRESS 0x70005554 /end MEASUREMENT
/begin MEASUREMENT MAIN_VSITxsPwmVl "MAIN_VSITxsPwmVl" UWORD F_0v0061035156_p0_4 1 2 0 399.9938965 ECU_ADDRESS 0x7000522C /end MEASUREMENT
/begin MEASUREMENT MAIN_VSITxsPwmVlOn "MAIN_VSITxsPwmVlOn" UBYTE Bool_ON_OFF 1 2 0 1 BIT_MASK 0x01 ECU_ADDRESS 0x70005553 /end MEASUREMENT
/begin MEASUREMENT MAIN_VSITxsPwmVr "MAIN_VSITxsPwmVr" UWORD F_0v0061035156_p0_4 1 2 0 399.9938965 ECU_ADDRESS 0x7000522A /end MEASUREMENT
/begin MEASUREMENT MAIN_VSITxsPwmVrOn "MAIN_VSITxsPwmVrOn" UBYTE Bool_ON_OFF 1 2 0 1 BIT_MASK 0x01 ECU_ADDRESS 0x70005552 /end MEASUREMENT
/begin MEASUREMENT MAIN_VSITxsPwmWl "MAIN_VSITxsPwmWl" UWORD F_0v0061035156_p0_4 1 2 0 399.9938965 ECU_ADDRESS 0x70005228 /end MEASUREMENT
/begin MEASUREMENT MAIN_VSITxsPwmWlOn "MAIN_VSITxsPwmWlOn" UBYTE Bool_ON_OFF 1 2 0 1 BIT_MASK 0x01 ECU_ADDRESS 0x70005551 /end MEASUREMENT
/begin MEASUREMENT MAIN_VSITxsPwmWr "MAIN_VSITxsPwmWr" UWORD F_0v0061035156_p0_4 1 2 0 399.9938965 ECU_ADDRESS 0x70005226 /end MEASUREMENT
/begin MEASUREMENT MAIN_VSITxsPwmWrOn "MAIN_VSITxsPwmWrOn" UBYTE Bool_ON_OFF 1 2 0 1 BIT_MASK 0x01 ECU_ADDRESS 0x70005550 /end MEASUREMENT
/begin MEASUREMENT MAIN_as32OCTrimNvm "-" SLONG Id_0x00 1 2 -2147483648 2147483647 MATRIX_DIM 5 1 1 ECU_ADDRESS 0x700050F8 /end MEASUREMENT
/begin MEASUREMENT MAIN_as32OCTrimNvm[0] "MAIN_as32OCTrimNvm[0]" SLONG Id_0x00 1 2 -2147483648 2147483647 ECU_ADDRESS 0x700050F8 /end MEASUREMENT
/begin MEASUREMENT MAIN_as32OCTrimNvm[1] "MAIN_as32OCTrimNvm[1]" SLONG Id_0x00 1 2 -2147483648 2147483647 ECU_ADDRESS 0x700050FC /end MEASUREMENT
/begin MEASUREMENT MAIN_as32OCTrimNvm[2] "MAIN_as32OCTrimNvm[2]" SLONG Id_0x00 1 2 -2147483648 2147483647 ECU_ADDRESS 0x70005100 /end MEASUREMENT
/begin MEASUREMENT MAIN_as32OCTrimNvm[3] "MAIN_as32OCTrimNvm[3]" SLONG Id_0x00 1 2 -2147483648 2147483647 ECU_ADDRESS 0x70005104 /end MEASUREMENT
/begin MEASUREMENT MAIN_as32OCTrimNvm[4] "MAIN_as32OCTrimNvm[4]" SLONG Id_0x00 1 2 -2147483648 2147483647 ECU_ADDRESS 0x70005108 /end MEASUREMENT
/begin MEASUREMENT MAIN_au16CalibParamNvm[0] "-" UWORD F_1_p0_5 1 2 0 65535 ECU_ADDRESS 0x700055B0 /end MEASUREMENT
/begin MEASUREMENT MAIN_au16CalibParamNvm[1] "-" UWORD F_1_p0_5 1 2 0 65535 ECU_ADDRESS 0x700055B2 /end MEASUREMENT
/begin MEASUREMENT MAIN_au16CalibParamNvm[2] "-" UWORD F_1_p0_5 1 2 0 65535 ECU_ADDRESS 0x700055B4 /end MEASUREMENT
/begin MEASUREMENT MAIN_au16CalibParamNvm[3] "-" UWORD F_1_p0_5 1 2 0 65535 ECU_ADDRESS 0x700055B6 /end MEASUREMENT
/begin MEASUREMENT MAIN_au16CalibParamNvm[4] "-" UWORD F_1_p0_5 1 2 0 65535 ECU_ADDRESS 0x700055B8 /end MEASUREMENT
/begin MEASUREMENT MAIN_au16CalibParamNvm[5] "-" UWORD F_1_p0_5 1 2 0 65535 ECU_ADDRESS 0x700055BA /end MEASUREMENT
/begin MEASUREMENT MAIN_au16CalibParamNvm[6] "-" UWORD F_1_p0_5 1 2 0 65535 ECU_ADDRESS 0x700055BC /end MEASUREMENT
/begin MEASUREMENT MAIN_au16CalibParamNvm[7] "-" UWORD F_1_p0_5 1 2 0 65535 ECU_ADDRESS 0x700055BE /end MEASUREMENT
/begin MEASUREMENT MAIN_au16CalibParamNvm[8] "-" UWORD F_1_p0_5 1 2 0 65535 ECU_ADDRESS 0x700055C0 /end MEASUREMENT
/begin MEASUREMENT MAIN_au8ErrCode "-" UBYTE F_1_p0_5 1 2 0 255 MATRIX_DIM 20 1 1 ECU_ADDRESS 0x70005339 /end MEASUREMENT
/begin MEASUREMENT MAIN_au8ErrCode[0] "MAIN_au8ErrCode[0]" UBYTE F_1_p0_5 1 2 0 255 ECU_ADDRESS 0x70005339 /end MEASUREMENT
/begin MEASUREMENT MAIN_au8ErrCode[10] "MAIN_au8ErrCode[10]" UBYTE F_1_p0_5 1 2 0 255 ECU_ADDRESS 0x70005343 /end MEASUREMENT
/begin MEASUREMENT MAIN_au8ErrCode[11] "MAIN_au8ErrCode[11]" UBYTE F_1_p0_5 1 2 0 255 ECU_ADDRESS 0x70005344 /end MEASUREMENT
/begin MEASUREMENT MAIN_au8ErrCode[12] "MAIN_au8ErrCode[12]" UBYTE F_1_p0_5 1 2 0 255 ECU_ADDRESS 0x70005345 /end MEASUREMENT
/begin MEASUREMENT MAIN_au8ErrCode[13] "MAIN_au8ErrCode[13]" UBYTE F_1_p0_5 1 2 0 255 ECU_ADDRESS 0x70005346 /end MEASUREMENT
/begin MEASUREMENT MAIN_au8ErrCode[14] "MAIN_au8ErrCode[14]" UBYTE F_1_p0_5 1 2 0 255 ECU_ADDRESS 0x70005347 /end MEASUREMENT
/begin MEASUREMENT MAIN_au8ErrCode[15] "MAIN_au8ErrCode[15]" UBYTE F_1_p0_5 1 2 0 255 ECU_ADDRESS 0x70005348 /end MEASUREMENT
/begin MEASUREMENT MAIN_au8ErrCode[16] "MAIN_au8ErrCode[16]" UBYTE F_1_p0_5 1 2 0 255 ECU_ADDRESS 0x70005349 /end MEASUREMENT
/begin MEASUREMENT MAIN_au8ErrCode[17] "MAIN_au8ErrCode[17]" UBYTE F_1_p0_5 1 2 0 255 ECU_ADDRESS 0x7000534A /end MEASUREMENT
/begin MEASUREMENT MAIN_au8ErrCode[18] "MAIN_au8ErrCode[18]" UBYTE F_1_p0_5 1 2 0 255 ECU_ADDRESS 0x7000534B /end MEASUREMENT
/begin MEASUREMENT MAIN_au8ErrCode[19] "MAIN_au8ErrCode[19]" UBYTE F_1_p0_5 1 2 0 255 ECU_ADDRESS 0x7000534C /end MEASUREMENT
/begin MEASUREMENT MAIN_au8ErrCode[1] "MAIN_au8ErrCode[1]" UBYTE F_1_p0_5 1 2 0 255 ECU_ADDRESS 0x7000533A /end MEASUREMENT
/begin MEASUREMENT MAIN_au8ErrCode[2] "MAIN_au8ErrCode[2]" UBYTE F_1_p0_5 1 2 0 255 ECU_ADDRESS 0x7000533B /end MEASUREMENT
/begin MEASUREMENT MAIN_au8ErrCode[3] "MAIN_au8ErrCode[3]" UBYTE F_1_p0_5 1 2 0 255 ECU_ADDRESS 0x7000533C /end MEASUREMENT
/begin MEASUREMENT MAIN_au8ErrCode[4] "MAIN_au8ErrCode[4]" UBYTE F_1_p0_5 1 2 0 255 ECU_ADDRESS 0x7000533D /end MEASUREMENT
/begin MEASUREMENT MAIN_au8ErrCode[5] "MAIN_au8ErrCode[5]" UBYTE F_1_p0_5 1 2 0 255 ECU_ADDRESS 0x7000533E /end MEASUREMENT
/begin MEASUREMENT MAIN_au8ErrCode[6] "MAIN_au8ErrCode[6]" UBYTE F_1_p0_5 1 2 0 255 ECU_ADDRESS 0x7000533F /end MEASUREMENT
/begin MEASUREMENT MAIN_au8ErrCode[7] "MAIN_au8ErrCode[7]" UBYTE F_1_p0_5 1 2 0 255 ECU_ADDRESS 0x70005340 /end MEASUREMENT
/begin MEASUREMENT MAIN_au8ErrCode[8] "MAIN_au8ErrCode[8]" UBYTE F_1_p0_5 1 2 0 255 ECU_ADDRESS 0x70005341 /end MEASUREMENT
/begin MEASUREMENT MAIN_au8ErrCode[9] "MAIN_au8ErrCode[9]" UBYTE F_1_p0_5 1 2 0 255 ECU_ADDRESS 0x70005342 /end MEASUREMENT
/begin MEASUREMENT MAIN_bAkdAfterAscReq "..." UBYTE Bool_ON_OFF 1 2 0 1 BIT_MASK 0x01 ECU_ADDRESS 0x700055AC /end MEASUREMENT
/begin MEASUREMENT MAIN_bAntiSlopGearEna "..." UBYTE Bool_ON_OFF 1 2 0 1 BIT_MASK 0x01 ECU_ADDRESS 0x700055AB /end MEASUREMENT
/begin MEASUREMENT MAIN_bAscFlag "Flag ESM started" UBYTE Bool_ON_OFF 1 2 0 1 BIT_MASK 0x01 ECU_ADDRESS 0x700055AA /end MEASUREMENT
/begin MEASUREMENT MAIN_bBswReadySts "BSW Power on check finish flag." UBYTE Bool_ON_OFF 1 2 0 1 BIT_MASK 0x01 ECU_ADDRESS 0x700055A9 /end MEASUREMENT
/begin MEASUREMENT MAIN_bESMStarted "Flag ESM started" UBYTE Bool_ON_OFF 1 2 0 1 BIT_MASK 0x01 ECU_ADDRESS 0x700055A8 /end MEASUREMENT
/begin MEASUREMENT MAIN_bFTInitFinshFlg "FT Initilize finished flag" UBYTE Bool_ON_OFF 1 2 0 1 BIT_MASK 0x01 ECU_ADDRESS 0x700055A7 /end MEASUREMENT
/begin MEASUREMENT MAIN_bMcuMilStatus "..." UBYTE Bool_ON_OFF 1 2 0 1 BIT_MASK 0x01 ECU_ADDRESS 0x700055A6 /end MEASUREMENT
/begin MEASUREMENT MAIN_bOCStoreManualReq "..." UBYTE Bool_ON_OFF 1 2 0 1 BIT_MASK 0x01 ECU_ADDRESS 0x7000554E /end MEASUREMENT
/begin MEASUREMENT MAIN_bOcDataStoreEna "..." UBYTE Bool_ON_OFF 1 2 0 1 BIT_MASK 0x01 ECU_ADDRESS 0x700050A8 /end MEASUREMENT
/begin MEASUREMENT MAIN_bOcFailureFlg "..." UBYTE Bool_ON_OFF 1 2 0 1 BIT_MASK 0x01 ECU_ADDRESS 0x700055A5 /end MEASUREMENT
/begin MEASUREMENT MAIN_bOcFinshFlg "..." UBYTE Bool_ON_OFF 1 2 0 1 BIT_MASK 0x01 ECU_ADDRESS 0x700055A4 /end MEASUREMENT
/begin MEASUREMENT MAIN_bOcModeEna "OC mode enable flag" UBYTE Bool_ON_OFF 1 2 0 1 BIT_MASK 0x01 ECU_ADDRESS 0x700055A3 /end MEASUREMENT
/begin MEASUREMENT MAIN_bOcNotRatFlg "..." UBYTE Bool_ON_OFF 1 2 0 1 BIT_MASK 0x01 ECU_ADDRESS 0x700055A2 /end MEASUREMENT
/begin MEASUREMENT MAIN_bOcRdResultFlag "..." UBYTE Bool_ON_OFF 1 2 0 1 BIT_MASK 0x01 ECU_ADDRESS 0x700055A1 /end MEASUREMENT
/begin MEASUREMENT MAIN_bOcStartFlag "..." UBYTE Bool_ON_OFF 1 2 0 1 BIT_MASK 0x01 ECU_ADDRESS 0x700055A0 /end MEASUREMENT
/begin MEASUREMENT MAIN_bPosAccessLock "Must be Volatile variable." UBYTE Bool_ON_OFF 1 2 0 1 BIT_MASK 0x01 ECU_ADDRESS 0x7000559F /end MEASUREMENT
/begin MEASUREMENT MAIN_bProgConditionOk "..." UBYTE Bool_ON_OFF 1 2 0 1 BIT_MASK 0x01 ECU_ADDRESS 0x7000554C /end MEASUREMENT
/begin MEASUREMENT MAIN_bResExcFltDetEna "..." UBYTE Bool_ON_OFF 1 2 0 1 BIT_MASK 0x01 ECU_ADDRESS 0x7000559E /end MEASUREMENT
/begin MEASUREMENT MAIN_bSlopSlideTimoutFlg "..." UBYTE Bool_ON_OFF 1 2 0 1 BIT_MASK 0x01 ECU_ADDRESS 0x7000559D /end MEASUREMENT
/begin MEASUREMENT MAIN_bSoftOvBhvFlg "..." UBYTE Bool_ON_OFF 1 2 0 1 BIT_MASK 0x01 ECU_ADDRESS 0x7000559C /end MEASUREMENT
/begin MEASUREMENT MAIN_bSoftOvCurrPhsUFlg "..." UBYTE Bool_ON_OFF 1 2 0 1 BIT_MASK 0x01 ECU_ADDRESS 0x7000559B /end MEASUREMENT
/begin MEASUREMENT MAIN_bSoftOvCurrPhsVFlg "..." UBYTE Bool_ON_OFF 1 2 0 1 BIT_MASK 0x01 ECU_ADDRESS 0x7000559A /end MEASUREMENT
/begin MEASUREMENT MAIN_bSoftOvCurrPhsWFlg "..." UBYTE Bool_ON_OFF 1 2 0 1 BIT_MASK 0x01 ECU_ADDRESS 0x70005599 /end MEASUREMENT
/begin MEASUREMENT MAIN_bSpdReadyEst "..." UBYTE Bool_ON_OFF 1 2 0 1 BIT_MASK 0x01 ECU_ADDRESS 0x70005598 /end MEASUREMENT
/begin MEASUREMENT MAIN_bSpeedReadyFlg "..." UBYTE Bool_ON_OFF 1 2 0 1 BIT_MASK 0x01 ECU_ADDRESS 0x70005597 /end MEASUREMENT
/begin MEASUREMENT MAIN_bTeachInCompleteFlg "..." UBYTE Bool_ON_OFF 1 2 0 1 BIT_MASK 0x01 ECU_ADDRESS 0x70005596 /end MEASUREMENT
/begin MEASUREMENT MAIN_bVSIStarted "Flag VSI started" UBYTE Bool_ON_OFF 1 2 0 1 BIT_MASK 0x01 ECU_ADDRESS 0x70005595 /end MEASUREMENT
/begin MEASUREMENT MAIN_f32AntiSsEnaBrakPos "..." FLOAT32_IEEE I_8 1 2 -3.402823466E+038 3.402823466E+038 ECU_ADDRESS 0x70005548 /end MEASUREMENT
/begin MEASUREMENT MAIN_f32CpuLoadCore0 "..." FLOAT32_IEEE F_1_p0_10 1 2 -3.402823466E+038 3.402823466E+038 ECU_ADDRESS 0x70005120 /end MEASUREMENT
/begin MEASUREMENT MAIN_f32CpuLoadCore1 "..." FLOAT32_IEEE F_1_p0_10 1 2 -3.402823466E+038 3.402823466E+038 ECU_ADDRESS 0x7000511C /end MEASUREMENT
/begin MEASUREMENT MAIN_f32CpuLoadCore2 "..." FLOAT32_IEEE F_1_p0_10 1 2 -3.402823466E+038 3.402823466E+038 ECU_ADDRESS 0x70005118 /end MEASUREMENT
/begin MEASUREMENT MAIN_f32CpuLoadMaxCore0 "..." FLOAT32_IEEE F_1_p0_10 1 2 -3.402823466E+038 3.402823466E+038 ECU_ADDRESS 0x70005114 /end MEASUREMENT
/begin MEASUREMENT MAIN_f32CpuLoadMaxCore1 "..." FLOAT32_IEEE F_1_p0_10 1 2 -3.402823466E+038 3.402823466E+038 ECU_ADDRESS 0x70005110 /end MEASUREMENT
/begin MEASUREMENT MAIN_f32CpuLoadMaxCore2 "..." FLOAT32_IEEE F_1_p0_10 1 2 -3.402823466E+038 3.402823466E+038 ECU_ADDRESS 0x7000510C /end MEASUREMENT
/begin MEASUREMENT MAIN_f32ElecSpeedRds "..." FLOAT32_IEEE F_1_p0_10 1 2 -3.402823466E+038 3.402823466E+038 ECU_ADDRESS 0x70005544 /end MEASUREMENT
/begin MEASUREMENT MAIN_f32EmailElecSpeedRds "..." FLOAT32_IEEE F_1_p0_10 1 2 -3.402823466E+038 3.402823466E+038 ECU_ADDRESS 0x70005540 /end MEASUREMENT
/begin MEASUREMENT MAIN_f32EmailErrThetaRdSurPi "..." FLOAT32_IEEE F_1_p0_10 1 2 -3.402823466E+038 3.402823466E+038 ECU_ADDRESS 0x7000553C /end MEASUREMENT
/begin MEASUREMENT MAIN_f32EmailMecaSpeedRds "..." FLOAT32_IEEE F_1_p0_10 1 2 -3.402823466E+038 3.402823466E+038 ECU_ADDRESS 0x70005538 /end MEASUREMENT
/begin MEASUREMENT MAIN_f32EmailMecaSpeedRpm "..." FLOAT32_IEEE F_1_p0_10 1 2 -3.402823466E+038 3.402823466E+038 ECU_ADDRESS 0x70005534 /end MEASUREMENT
/begin MEASUREMENT MAIN_f32EmailNextThetaElecRdSurPi "..." FLOAT32_IEEE F_1_p0_10 1 2 -3.402823466E+038 3.402823466E+038 ECU_ADDRESS 0x70005530 /end MEASUREMENT
/begin MEASUREMENT MAIN_f32EmailThetaElecRdSurPi "..." FLOAT32_IEEE F_1_p0_10 1 2 -3.402823466E+038 3.402823466E+038 ECU_ADDRESS 0x7000552C /end MEASUREMENT
/begin MEASUREMENT MAIN_f32ErrThetaRdSurPi "..." FLOAT32_IEEE F_1_p0_10 1 2 -3.402823466E+038 3.402823466E+038 ECU_ADDRESS 0x70005528 /end MEASUREMENT
/begin MEASUREMENT MAIN_f32EstTempRatioScale "..." FLOAT32_IEEE F_1_p0_5 1 2 -3.402823466E+038 3.402823466E+038 ECU_ADDRESS 0x70005524 /end MEASUREMENT
/begin MEASUREMENT MAIN_f32IdDeltaAvg "..." FLOAT32_IEEE F_1_p0_5 1 2 -3.402823466E+038 3.402823466E+038 ECU_ADDRESS 0x70005520 /end MEASUREMENT
/begin MEASUREMENT MAIN_f32IdDeltaSum "..." FLOAT32_IEEE F_1_p0_5 1 2 -3.402823466E+038 3.402823466E+038 ECU_ADDRESS 0x7000551C /end MEASUREMENT
/begin MEASUREMENT MAIN_f32IdQuality "..." FLOAT32_IEEE F_1_p0_6 1 2 -3.402823466E+038 3.402823466E+038 ECU_ADDRESS 0x70005518 /end MEASUREMENT
/begin MEASUREMENT MAIN_f32IqDeltaAvg "..." FLOAT32_IEEE F_1_p0_5 1 2 -3.402823466E+038 3.402823466E+038 ECU_ADDRESS 0x70005514 /end MEASUREMENT
/begin MEASUREMENT MAIN_f32IqDeltaSum "..." FLOAT32_IEEE F_1_p0_5 1 2 -3.402823466E+038 3.402823466E+038 ECU_ADDRESS 0x70005510 /end MEASUREMENT
/begin MEASUREMENT MAIN_f32IqQuality "..." FLOAT32_IEEE F_1_p0_6 1 2 -3.402823466E+038 3.402823466E+038 ECU_ADDRESS 0x7000550C /end MEASUREMENT
/begin MEASUREMENT MAIN_f32IuFrequency "..." FLOAT32_IEEE F_1_p0_11 1 2 -3.402823466E+038 3.402823466E+038 ECU_ADDRESS 0x70005508 /end MEASUREMENT
/begin MEASUREMENT MAIN_f32IuPeriod "..." FLOAT32_IEEE F_1_p0_12 1 2 -3.402823466E+038 3.402823466E+038 ECU_ADDRESS 0x70005504 /end MEASUREMENT
/begin MEASUREMENT MAIN_f32MecaSpeedRds "..." FLOAT32_IEEE F_1_p0_10 1 2 -3.402823466E+038 3.402823466E+038 ECU_ADDRESS 0x70005500 /end MEASUREMENT
/begin MEASUREMENT MAIN_f32MecaSpeedRpm "..." FLOAT32_IEEE F_1_p0_10 1 2 -3.402823466E+038 3.402823466E+038 ECU_ADDRESS 0x700054FC /end MEASUREMENT
/begin MEASUREMENT MAIN_f32MotSpdEst "..." FLOAT32_IEEE F_1_p0_12 1 2 -3.402823466E+038 3.402823466E+038 ECU_ADDRESS 0x700054F8 /end MEASUREMENT
/begin MEASUREMENT MAIN_f32PWMDutyUPhys "..." FLOAT32_IEEE F_100_p0_13 1 2 -3.402823466E+038 3.402823466E+038 ECU_ADDRESS 0x700054F4 /end MEASUREMENT
/begin MEASUREMENT MAIN_f32PWMDutyVPhys "..." FLOAT32_IEEE F_100_p0_13 1 2 -3.402823466E+038 3.402823466E+038 ECU_ADDRESS 0x700054F0 /end MEASUREMENT
/begin MEASUREMENT MAIN_f32PWMDutyWPhys "..." FLOAT32_IEEE F_100_p0_13 1 2 -3.402823466E+038 3.402823466E+038 ECU_ADDRESS 0x700054EC /end MEASUREMENT
/begin MEASUREMENT MAIN_f32ShiftDrumInitPos "..." FLOAT32_IEEE F_100_p0_13 1 2 -3.402823466E+038 3.402823466E+038 ECU_ADDRESS 0x700054E8 /end MEASUREMENT
/begin MEASUREMENT MAIN_f32ShiftDrumTermPos "..." FLOAT32_IEEE F_100_p0_13 1 2 -3.402823466E+038 3.402823466E+038 ECU_ADDRESS 0x700054E4 /end MEASUREMENT
/begin MEASUREMENT MAIN_f32TcReadPosDuty "..." FLOAT32_IEEE F_100_p0_13 1 2 -3.402823466E+038 3.402823466E+038 ECU_ADDRESS 0x700054E0 /end MEASUREMENT
/begin MEASUREMENT MAIN_f32ThetaElecRdSurPi "..." FLOAT32_IEEE F_1_p0_10 1 2 -3.402823466E+038 3.402823466E+038 ECU_ADDRESS 0x700054DC /end MEASUREMENT
/begin MEASUREMENT MAIN_f32VsiPwmPeriod "..." FLOAT32_IEEE F_1000000_p0_15 1 2 -3.402823466E+038 3.402823466E+038 ECU_ADDRESS 0x700054D8 /end MEASUREMENT
/begin MEASUREMENT MAIN_s16BldcHallDirFdb "MAIN_s16BldcHallDirFdb" SBYTE I_1 1 2 -128 127 ECU_ADDRESS 0x7000534D /end MEASUREMENT
/begin MEASUREMENT MAIN_s32DeltTimDiff "..." SLONG F_0v01_p0_16 1 2 -21474836.48 21474836.47 ECU_ADDRESS 0x700050F4 /end MEASUREMENT
/begin MEASUREMENT MAIN_s32Email2PosTreqDiff "..." SLONG I_1 1 2 -2147483648 2147483647 ECU_ADDRESS 0x700050F0 /end MEASUREMENT
/begin MEASUREMENT MAIN_s32PosA2BDeltTimMax "..." SLONG F_0v1_p0_17 1 2 -214748364.8 214748364.7 ECU_ADDRESS 0x700050E8 /end MEASUREMENT
/begin MEASUREMENT MAIN_s32PosA2BDeltTimMin "..." SLONG F_0v1_p0_17 1 2 -214748364.8 214748364.7 ECU_ADDRESS 0x700050E4 /end MEASUREMENT
/begin MEASUREMENT MAIN_s32PosA2BDeltTime "..." SLONG F_0v1_p0_17 1 2 -214748364.8 214748364.7 ECU_ADDRESS 0x700050EC /end MEASUREMENT
/begin MEASUREMENT MAIN_u16AntiSsBrakTimCnt "..." UWORD I_1 1 2 0 65535 ECU_ADDRESS 0x7000529C /end MEASUREMENT
/begin MEASUREMENT MAIN_u16AntiSsEnaBrakCnt "..." UWORD I_1 1 2 0 65535 ECU_ADDRESS 0x7000529A /end MEASUREMENT
/begin MEASUREMENT MAIN_u16AntiSsValidCnt "..." UWORD I_1 1 2 0 65535 ECU_ADDRESS 0x70005298 /end MEASUREMENT
/begin MEASUREMENT MAIN_u16BrakRelsDelayCnt "..." UWORD I_1 1 2 0 65535 ECU_ADDRESS 0x70005296 /end MEASUREMENT
/begin MEASUREMENT MAIN_u16Cnt20 "MAIN_u16Cnt20" UWORD I_1 1 2 0 65535 ECU_ADDRESS 0x7000528A /end MEASUREMENT
/begin MEASUREMENT MAIN_u16Cnt2000 "MAIN_u16Cnt2000" UWORD I_1 1 2 0 65535 ECU_ADDRESS 0x70005288 /end MEASUREMENT
/begin MEASUREMENT MAIN_u16Cnt30 "MAIN_u16Cnt30" UWORD I_1 1 2 0 65535 ECU_ADDRESS 0x70005286 /end MEASUREMENT
/begin MEASUREMENT MAIN_u16Cnt4 "MAIN_u16Cnt4" UWORD I_1 1 2 0 65535 ECU_ADDRESS 0x70005284 /end MEASUREMENT
/begin MEASUREMENT MAIN_u16Cnt50 "MAIN_u16Cnt50" UWORD I_1 1 2 0 65535 ECU_ADDRESS 0x70005282 /end MEASUREMENT
/begin MEASUREMENT MAIN_u16Cnt500 "MAIN_u16Cnt500" UWORD I_1 1 2 0 65535 ECU_ADDRESS 0x70005280 /end MEASUREMENT
/begin MEASUREMENT MAIN_u16Core0Cnt1 "MAIN_u16Core0Cnt1" UWORD I_1 1 2 0 65535 ECU_ADDRESS 0x70005294 /end MEASUREMENT
/begin MEASUREMENT MAIN_u16Core0Cnt10 "MAIN_u16Core0Cnt10" UWORD I_1 1 2 0 65535 ECU_ADDRESS 0x7000528E /end MEASUREMENT
/begin MEASUREMENT MAIN_u16Core0Cnt100 "MAIN_u16Core0Cnt100" UWORD I_1 1 2 0 65535 ECU_ADDRESS 0x7000527C /end MEASUREMENT
/begin MEASUREMENT MAIN_u16Core0Cnt2 "MAIN_u16Core0Cnt2" UWORD I_1 1 2 0 65535 ECU_ADDRESS 0x70005292 /end MEASUREMENT
/begin MEASUREMENT MAIN_u16Core0Cnt200 "MAIN_u16Core0Cnt200" UWORD I_1 1 2 0 65535 ECU_ADDRESS 0x7000527A /end MEASUREMENT
/begin MEASUREMENT MAIN_u16Core0Cnt5 "MAIN_u16Core0Cnt5" UWORD I_1 1 2 0 65535 ECU_ADDRESS 0x70005290 /end MEASUREMENT
/begin MEASUREMENT MAIN_u16Core1Cnt1 "MAIN_u16Core1Cnt1" UWORD I_1 1 2 0 65535 ECU_ADDRESS 0x7000527E /end MEASUREMENT
/begin MEASUREMENT MAIN_u16FaultDelayCnt "MAIN_u16FaultDelayCnt" UWORD I_1 1 2 0 65535 ECU_ADDRESS 0x70005274 /end MEASUREMENT
/begin MEASUREMENT MAIN_u16FpgaFltClrCnt "MAIN_u16FpgaFltClrCnt" UWORD I_1 1 2 0 65535 ECU_ADDRESS 0x70005272 /end MEASUREMENT
/begin MEASUREMENT MAIN_u16HandBrkRelsDelay "..." UWORD I_1 1 2 0 65535 ECU_ADDRESS 0x70005270 /end MEASUREMENT
/begin MEASUREMENT MAIN_u16IdqDeltaSumCnt "MAIN_u16IdqDeltaSumCnt" UWORD I_1 1 2 0 65535 ECU_ADDRESS 0x7000526E /end MEASUREMENT
/begin MEASUREMENT MAIN_u16IuCycleCnt "..." UWORD I_1 1 2 0 65535 ECU_ADDRESS 0x7000526C /end MEASUREMENT
/begin MEASUREMENT MAIN_u16IuMiddleCnt "..." UWORD I_1 1 2 0 65535 ECU_ADDRESS 0x7000526A /end MEASUREMENT
/begin MEASUREMENT MAIN_u16IuMiddleSum "..." UWORD I_1 1 2 0 65535 ECU_ADDRESS 0x70005268 /end MEASUREMENT
/begin MEASUREMENT MAIN_u16IuNegtiveCnt "..." UWORD I_1 1 2 0 65535 ECU_ADDRESS 0x70005266 /end MEASUREMENT
/begin MEASUREMENT MAIN_u16IuNegtiveSum "..." UWORD I_1 1 2 0 65535 ECU_ADDRESS 0x70005264 /end MEASUREMENT
/begin MEASUREMENT MAIN_u16IuPositiveCnt "..." UWORD I_1 1 2 0 65535 ECU_ADDRESS 0x70005262 /end MEASUREMENT
/begin MEASUREMENT MAIN_u16IuPositiveSum "..." UWORD I_1 1 2 0 65535 ECU_ADDRESS 0x70005260 /end MEASUREMENT
/begin MEASUREMENT MAIN_u16MotorStallCnt "..." UWORD I_1 1 2 0 65535 ECU_ADDRESS 0x7000525E /end MEASUREMENT
/begin MEASUREMENT MAIN_u16OverVolHighDelay "MAIN_u16OverVolHighDelay" UWORD I_1 1 2 0 65535 ECU_ADDRESS 0x7000525C /end MEASUREMENT
/begin MEASUREMENT MAIN_u16OverVolLowDelay "MAIN_u16OverVolLowDelay" UWORD I_1 1 2 0 65535 ECU_ADDRESS 0x7000525A /end MEASUREMENT
/begin MEASUREMENT MAIN_u16OverVolMidDelay "MAIN_u16OverVolMidDelay" UWORD I_1 1 2 0 65535 ECU_ADDRESS 0x70005258 /end MEASUREMENT
/begin MEASUREMENT MAIN_u16PWMPeriodVal "MAIN_u16PWMPeriodVal" UWORD I_1 1 2 0 65535 ECU_ADDRESS 0x70000B64 /end MEASUREMENT
/begin MEASUREMENT MAIN_u16RandomNum "MAIN_u16RandomNum" UWORD I_1 1 2 0 65535 ECU_ADDRESS 0x70005224 /end MEASUREMENT
/begin MEASUREMENT MAIN_u16ResCosADVal "MAIN_u16ResCosADVal" UWORD I_1 1 2 0 65535 ECU_ADDRESS 0x70005256 /end MEASUREMENT
/begin MEASUREMENT MAIN_u16ResSinADVal "MAIN_u16ResSinADVal" UWORD I_1 1 2 0 65535 ECU_ADDRESS 0x70005254 /end MEASUREMENT
/begin MEASUREMENT MAIN_u16SlopSlideTimCnt "..." UWORD I_1 1 2 0 65535 ECU_ADDRESS 0x70005252 /end MEASUREMENT
/begin MEASUREMENT MAIN_u16SlopSpdConfirmCnt "..." UWORD I_1 1 2 0 65535 ECU_ADDRESS 0x70005250 /end MEASUREMENT
/begin MEASUREMENT MAIN_u16SpdReadyEstCnt "..." UWORD I_1 1 2 0 65535 ECU_ADDRESS 0x7000524E /end MEASUREMENT
/begin MEASUREMENT MAIN_u16T12CntVal "MAIN_u16T12CntVal" UWORD I_1 1 2 0 65535 ECU_ADDRESS 0x7000524C /end MEASUREMENT
/begin MEASUREMENT MAIN_u16TeachInWrtDelayCnt "MAIN_u16TeachInWrtDelayCnt" UWORD I_1 1 2 0 65535 ECU_ADDRESS 0x7000524A /end MEASUREMENT
/begin MEASUREMENT MAIN_u16VadcBhv "MAIN_u16VadcBhv" UWORD I_1 1 2 0 65535 ECU_ADDRESS 0x70005248 /end MEASUREMENT
/begin MEASUREMENT MAIN_u16VadcKM11FB "MAIN_u16VadcKM11FB" UWORD I_1 1 2 0 65535 ECU_ADDRESS 0x70005234 /end MEASUREMENT
/begin MEASUREMENT MAIN_u16VadcKM12FB "MAIN_u16VadcKM12FB" UWORD I_1 1 2 0 65535 ECU_ADDRESS 0x70005232 /end MEASUREMENT
/begin MEASUREMENT MAIN_u16VadcKM2FB "MAIN_u16VadcKM2FB" UWORD I_1 1 2 0 65535 ECU_ADDRESS 0x70005240 /end MEASUREMENT
/begin MEASUREMENT MAIN_u16VadcKM3FB "MAIN_u16VadcKM3FB" UWORD I_1 1 2 0 65535 ECU_ADDRESS 0x7000523E /end MEASUREMENT
/begin MEASUREMENT MAIN_u16VadcKM5FB "MAIN_u16VadcKM5FB" UWORD I_1 1 2 0 65535 ECU_ADDRESS 0x7000523C /end MEASUREMENT
/begin MEASUREMENT MAIN_u16VadcKM6FB "MAIN_u16VadcKM6FB" UWORD I_1 1 2 0 65535 ECU_ADDRESS 0x7000523A /end MEASUREMENT
/begin MEASUREMENT MAIN_u16VadcKM7FB "MAIN_u16VadcKM7FB" UWORD I_1 1 2 0 65535 ECU_ADDRESS 0x70005238 /end MEASUREMENT
/begin MEASUREMENT MAIN_u16VadcKM8FB "MAIN_u16VadcKM8FB" UWORD I_1 1 2 0 65535 ECU_ADDRESS 0x70005236 /end MEASUREMENT
/begin MEASUREMENT MAIN_u16VadcPhaseCurU "MAIN_u16VadcPhaseCurU" UWORD I_1 1 2 0 65535 ECU_ADDRESS 0x70005246 /end MEASUREMENT
/begin MEASUREMENT MAIN_u16VadcPhaseCurV "MAIN_u16VadcPhaseCurV" UWORD I_1 1 2 0 65535 ECU_ADDRESS 0x70005244 /end MEASUREMENT
/begin MEASUREMENT MAIN_u16VadcPhaseCurW "MAIN_u16VadcPhaseCurW" UWORD I_1 1 2 0 65535 ECU_ADDRESS 0x70005242 /end MEASUREMENT
/begin MEASUREMENT MAIN_u32EmailCkreq "..." ULONG I_1 1 2 0 4294967295 ECU_ADDRESS 0x70005380 /end MEASUREMENT
/begin MEASUREMENT MAIN_u32EmailPosATimeStamp "..." ULONG I_1 1 2 0 4294967295 ECU_ADDRESS 0x7000537C /end MEASUREMENT
/begin MEASUREMENT MAIN_u32IuCycleTim "..." ULONG I_1 1 2 0 4294967295 ECU_ADDRESS 0x70005378 /end MEASUREMENT
/begin MEASUREMENT MAIN_u32PosATimeStamp "..." ULONG I_1 1 2 0 4294967295 ECU_ADDRESS 0x70005374 /end MEASUREMENT
/begin MEASUREMENT MAIN_u32PosBTimeStamp "..." ULONG I_1 1 2 0 4294967295 ECU_ADDRESS 0x70005370 /end MEASUREMENT
/begin MEASUREMENT MAIN_u32PosTreatCkreq "..." ULONG I_1 1 2 0 4294967295 ECU_ADDRESS 0x7000536C /end MEASUREMENT
/begin MEASUREMENT MAIN_u32RunTime_ms "..." ULONG I_1 1 2 0 4294967295 ECU_ADDRESS 0x70005364 /end MEASUREMENT
/begin MEASUREMENT MAIN_u32RunTime_s "..." ULONG I_1 1 2 0 4294967295 ECU_ADDRESS 0x70005368 /end MEASUREMENT
/begin MEASUREMENT MAIN_u32TestVar2 "MAIN_u32TestVar2" ULONG I_1 1 2 0 4294967295 ECU_ADDRESS 0x7000535C /end MEASUREMENT
/begin MEASUREMENT MAIN_u32TestVar4 "MAIN_u32TestVar4" ULONG I_1 1 2 0 4294967295 ECU_ADDRESS 0x70005358 /end MEASUREMENT
/begin MEASUREMENT MAIN_u32WaitValueVSISafeTreatment "Additional wait value for VSISafeTreatment function (debug)" ULONG F_0v055_p0_36 1 2 0 236223201.2 ECU_ADDRESS 0x70005354 /end MEASUREMENT
/begin MEASUREMENT MAIN_u32WaitValueVSITreatment "Additional wait value for VSITreatment function (debug)" ULONG F_0v02_p0_37 1 2 0 85899345.9 ECU_ADDRESS 0x70005350 /end MEASUREMENT
/begin MEASUREMENT MAIN_u8DEV_Fault "-" UBYTE F_1_p0_5 1 2 0 255 MATRIX_DIM 16 1 1 ECU_ADDRESS 0x70005329 /end MEASUREMENT
/begin MEASUREMENT MAIN_u8DEV_Fault[0] "MAIN_u8DEV_Fault[0]" UBYTE F_1_p0_5 1 2 0 255 ECU_ADDRESS 0x70005329 /end MEASUREMENT
/begin MEASUREMENT MAIN_u8DEV_Fault[10] "MAIN_u8DEV_Fault[10]" UBYTE F_1_p0_5 1 2 0 255 ECU_ADDRESS 0x70005333 /end MEASUREMENT
/begin MEASUREMENT MAIN_u8DEV_Fault[11] "MAIN_u8DEV_Fault[11]" UBYTE F_1_p0_5 1 2 0 255 ECU_ADDRESS 0x70005334 /end MEASUREMENT
/begin MEASUREMENT MAIN_u8DEV_Fault[12] "MAIN_u8DEV_Fault[12]" UBYTE F_1_p0_5 1 2 0 255 ECU_ADDRESS 0x70005335 /end MEASUREMENT
/begin MEASUREMENT MAIN_u8DEV_Fault[13] "MAIN_u8DEV_Fault[13]" UBYTE F_1_p0_5 1 2 0 255 ECU_ADDRESS 0x70005336 /end MEASUREMENT
/begin MEASUREMENT MAIN_u8DEV_Fault[14] "MAIN_u8DEV_Fault[14]" UBYTE F_1_p0_5 1 2 0 255 ECU_ADDRESS 0x70005337 /end MEASUREMENT
/begin MEASUREMENT MAIN_u8DEV_Fault[15] "MAIN_u8DEV_Fault[15]" UBYTE F_1_p0_5 1 2 0 255 ECU_ADDRESS 0x70005338 /end MEASUREMENT
/begin MEASUREMENT MAIN_u8DEV_Fault[1] "MAIN_u8DEV_Fault[1]" UBYTE F_1_p0_5 1 2 0 255 ECU_ADDRESS 0x7000532A /end MEASUREMENT
/begin MEASUREMENT MAIN_u8DEV_Fault[2] "MAIN_u8DEV_Fault[2]" UBYTE F_1_p0_5 1 2 0 255 ECU_ADDRESS 0x7000532B /end MEASUREMENT
/begin MEASUREMENT MAIN_u8DEV_Fault[3] "MAIN_u8DEV_Fault[3]" UBYTE F_1_p0_5 1 2 0 255 ECU_ADDRESS 0x7000532C /end MEASUREMENT
/begin MEASUREMENT MAIN_u8DEV_Fault[4] "MAIN_u8DEV_Fault[4]" UBYTE F_1_p0_5 1 2 0 255 ECU_ADDRESS 0x7000532D /end MEASUREMENT
/begin MEASUREMENT MAIN_u8DEV_Fault[5] "MAIN_u8DEV_Fault[5]" UBYTE F_1_p0_5 1 2 0 255 ECU_ADDRESS 0x7000532E /end MEASUREMENT
/begin MEASUREMENT MAIN_u8DEV_Fault[6] "MAIN_u8DEV_Fault[6]" UBYTE F_1_p0_5 1 2 0 255 ECU_ADDRESS 0x7000532F /end MEASUREMENT
/begin MEASUREMENT MAIN_u8DEV_Fault[7] "MAIN_u8DEV_Fault[7]" UBYTE F_1_p0_5 1 2 0 255 ECU_ADDRESS 0x70005330 /end MEASUREMENT
/begin MEASUREMENT MAIN_u8DEV_Fault[8] "MAIN_u8DEV_Fault[8]" UBYTE F_1_p0_5 1 2 0 255 ECU_ADDRESS 0x70005331 /end MEASUREMENT
/begin MEASUREMENT MAIN_u8DEV_Fault[9] "MAIN_u8DEV_Fault[9]" UBYTE F_1_p0_5 1 2 0 255 ECU_ADDRESS 0x70005332 /end MEASUREMENT
/begin MEASUREMENT MAIN_u8ErrCodNum "MAIN_u8ErrCodNum" UBYTE I_1 1 2 0 255 ECU_ADDRESS 0x700052DB /end MEASUREMENT
/begin MEASUREMENT MAIN_u8ErrCodRdIdx "MAIN_u8ErrCodRdIdx" UBYTE I_1 1 2 0 255 ECU_ADDRESS 0x700052DA /end MEASUREMENT
/begin MEASUREMENT MAIN_u8ErrCodWrIdx "MAIN_u8ErrCodWrIdx" UBYTE I_1 1 2 0 255 ECU_ADDRESS 0x700052D9 /end MEASUREMENT
/begin MEASUREMENT MAIN_u8FaultSum "..." UBYTE I_1 1 2 0 255 ECU_ADDRESS 0x700052D8 /end MEASUREMENT
/begin MEASUREMENT MAIN_u8OcState "MAIN_u8OcState" UBYTE I_1 1 2 0 255 ECU_ADDRESS 0x700052D7 /end MEASUREMENT
/begin MEASUREMENT MAIN_u8OcStsRptDelayCnt "MAIN_u8OcStsRptDelayCnt" UBYTE I_1 1 2 0 255 ECU_ADDRESS 0x700052D6 /end MEASUREMENT
/begin MEASUREMENT MAIN_u8OverVolIndex "MAIN_u8OverVolIndex" UBYTE I_1 1 2 0 255 ECU_ADDRESS 0x700052D5 /end MEASUREMENT
/begin MEASUREMENT MAIN_u8PrevGearPos "..." UBYTE I_1 1 2 0 255 ECU_ADDRESS 0x700052D4 /end MEASUREMENT
/begin MEASUREMENT MAIN_u8TestVar1 "MAIN_u8TestVar1" UBYTE I_1 1 2 0 255 ECU_ADDRESS 0x700052D3 /end MEASUREMENT
/begin MEASUREMENT MAIN_u8TrigOcByUser "MAIN_u8TrigOcByUser" UBYTE I_1 1 2 0 255 ECU_ADDRESS 0x700052D1 /end MEASUREMENT
/begin MEASUREMENT MAIN_u8UdsSwVerSup "..." UBYTE Id_0x00 1 2 0 255 MATRIX_DIM 21 1 1 ECU_ADDRESS 0x70000B41 /end MEASUREMENT
/begin MEASUREMENT MAIN_u8UdsSwVerSup[0] "MAIN_u8UdsSwVerSup[0]" UBYTE Id_0x00 1 2 0 255 ECU_ADDRESS 0x70000B41 /end MEASUREMENT
/begin MEASUREMENT MAIN_u8UdsSwVerSup[10] "MAIN_u8UdsSwVerSup[10]" UBYTE Id_0x00 1 2 0 255 ECU_ADDRESS 0x70000B4B /end MEASUREMENT
/begin MEASUREMENT MAIN_u8UdsSwVerSup[11] "MAIN_u8UdsSwVerSup[11]" UBYTE Id_0x00 1 2 0 255 ECU_ADDRESS 0x70000B4C /end MEASUREMENT
/begin MEASUREMENT MAIN_u8UdsSwVerSup[12] "MAIN_u8UdsSwVerSup[12]" UBYTE Id_0x00 1 2 0 255 ECU_ADDRESS 0x70000B4D /end MEASUREMENT
/begin MEASUREMENT MAIN_u8UdsSwVerSup[13] "MAIN_u8UdsSwVerSup[13]" UBYTE Id_0x00 1 2 0 255 ECU_ADDRESS 0x70000B4E /end MEASUREMENT
/begin MEASUREMENT MAIN_u8UdsSwVerSup[14] "MAIN_u8UdsSwVerSup[14]" UBYTE Id_0x00 1 2 0 255 ECU_ADDRESS 0x70000B4F /end MEASUREMENT
/begin MEASUREMENT MAIN_u8UdsSwVerSup[15] "MAIN_u8UdsSwVerSup[15]" UBYTE Id_0x00 1 2 0 255 ECU_ADDRESS 0x70000B50 /end MEASUREMENT
/begin MEASUREMENT MAIN_u8UdsSwVerSup[16] "MAIN_u8UdsSwVerSup[16]" UBYTE Id_0x00 1 2 0 255 ECU_ADDRESS 0x70000B51 /end MEASUREMENT
/begin MEASUREMENT MAIN_u8UdsSwVerSup[17] "MAIN_u8UdsSwVerSup[17]" UBYTE Id_0x00 1 2 0 255 ECU_ADDRESS 0x70000B52 /end MEASUREMENT
/begin MEASUREMENT MAIN_u8UdsSwVerSup[18] "MAIN_u8UdsSwVerSup[18]" UBYTE Id_0x00 1 2 0 255 ECU_ADDRESS 0x70000B53 /end MEASUREMENT
/begin MEASUREMENT MAIN_u8UdsSwVerSup[19] "MAIN_u8UdsSwVerSup[19]" UBYTE Id_0x00 1 2 0 255 ECU_ADDRESS 0x70000B54 /end MEASUREMENT
/begin MEASUREMENT MAIN_u8UdsSwVerSup[1] "MAIN_u8UdsSwVerSup[1]" UBYTE Id_0x00 1 2 0 255 ECU_ADDRESS 0x70000B42 /end MEASUREMENT
/begin MEASUREMENT MAIN_u8UdsSwVerSup[20] "MAIN_u8UdsSwVerSup[20]" UBYTE Id_0x00 1 2 0 255 ECU_ADDRESS 0x70000B55 /end MEASUREMENT
/begin MEASUREMENT MAIN_u8UdsSwVerSup[2] "MAIN_u8UdsSwVerSup[2]" UBYTE Id_0x00 1 2 0 255 ECU_ADDRESS 0x70000B43 /end MEASUREMENT
/begin MEASUREMENT MAIN_u8UdsSwVerSup[3] "MAIN_u8UdsSwVerSup[3]" UBYTE Id_0x00 1 2 0 255 ECU_ADDRESS 0x70000B44 /end MEASUREMENT
/begin MEASUREMENT MAIN_u8UdsSwVerSup[4] "MAIN_u8UdsSwVerSup[4]" UBYTE Id_0x00 1 2 0 255 ECU_ADDRESS 0x70000B45 /end MEASUREMENT
/begin MEASUREMENT MAIN_u8UdsSwVerSup[5] "MAIN_u8UdsSwVerSup[5]" UBYTE Id_0x00 1 2 0 255 ECU_ADDRESS 0x70000B46 /end MEASUREMENT
/begin MEASUREMENT MAIN_u8UdsSwVerSup[6] "MAIN_u8UdsSwVerSup[6]" UBYTE Id_0x00 1 2 0 255 ECU_ADDRESS 0x70000B47 /end MEASUREMENT
/begin MEASUREMENT MAIN_u8UdsSwVerSup[7] "MAIN_u8UdsSwVerSup[7]" UBYTE Id_0x00 1 2 0 255 ECU_ADDRESS 0x70000B48 /end MEASUREMENT
/begin MEASUREMENT MAIN_u8UdsSwVerSup[8] "MAIN_u8UdsSwVerSup[8]" UBYTE Id_0x00 1 2 0 255 ECU_ADDRESS 0x70000B49 /end MEASUREMENT
/begin MEASUREMENT MAIN_u8UdsSwVerSup[9] "MAIN_u8UdsSwVerSup[9]" UBYTE Id_0x00 1 2 0 255 ECU_ADDRESS 0x70000B4A /end MEASUREMENT
/begin MEASUREMENT MAIN_u8UdsSwVerVeh "..." UBYTE Id_0x00 1 2 0 255 MATRIX_DIM 13 1 1 ECU_ADDRESS 0x70000B56 /end MEASUREMENT
/begin MEASUREMENT MAIN_u8UdsSwVerVeh[0] "MAIN_u8UdsSwVerVeh[0]" UBYTE Id_0x00 1 2 0 255 ECU_ADDRESS 0x70000B56 /end MEASUREMENT
/begin MEASUREMENT MAIN_u8UdsSwVerVeh[10] "MAIN_u8UdsSwVerVeh[10]" UBYTE Id_0x00 1 2 0 255 ECU_ADDRESS 0x70000B60 /end MEASUREMENT
/begin MEASUREMENT MAIN_u8UdsSwVerVeh[11] "MAIN_u8UdsSwVerVeh[11]" UBYTE Id_0x00 1 2 0 255 ECU_ADDRESS 0x70000B61 /end MEASUREMENT
/begin MEASUREMENT MAIN_u8UdsSwVerVeh[12] "MAIN_u8UdsSwVerVeh[12]" UBYTE Id_0x00 1 2 0 255 ECU_ADDRESS 0x70000B62 /end MEASUREMENT
/begin MEASUREMENT MAIN_u8UdsSwVerVeh[1] "MAIN_u8UdsSwVerVeh[1]" UBYTE Id_0x00 1 2 0 255 ECU_ADDRESS 0x70000B57 /end MEASUREMENT
/begin MEASUREMENT MAIN_u8UdsSwVerVeh[2] "MAIN_u8UdsSwVerVeh[2]" UBYTE Id_0x00 1 2 0 255 ECU_ADDRESS 0x70000B58 /end MEASUREMENT
/begin MEASUREMENT MAIN_u8UdsSwVerVeh[3] "MAIN_u8UdsSwVerVeh[3]" UBYTE Id_0x00 1 2 0 255 ECU_ADDRESS 0x70000B59 /end MEASUREMENT
/begin MEASUREMENT MAIN_u8UdsSwVerVeh[4] "MAIN_u8UdsSwVerVeh[4]" UBYTE Id_0x00 1 2 0 255 ECU_ADDRESS 0x70000B5A /end MEASUREMENT
/begin MEASUREMENT MAIN_u8UdsSwVerVeh[5] "MAIN_u8UdsSwVerVeh[5]" UBYTE Id_0x00 1 2 0 255 ECU_ADDRESS 0x70000B5B /end MEASUREMENT
/begin MEASUREMENT MAIN_u8UdsSwVerVeh[6] "MAIN_u8UdsSwVerVeh[6]" UBYTE Id_0x00 1 2 0 255 ECU_ADDRESS 0x70000B5C /end MEASUREMENT
/begin MEASUREMENT MAIN_u8UdsSwVerVeh[7] "MAIN_u8UdsSwVerVeh[7]" UBYTE Id_0x00 1 2 0 255 ECU_ADDRESS 0x70000B5D /end MEASUREMENT
/begin MEASUREMENT MAIN_u8UdsSwVerVeh[8] "MAIN_u8UdsSwVerVeh[8]" UBYTE Id_0x00 1 2 0 255 ECU_ADDRESS 0x70000B5E /end MEASUREMENT
/begin MEASUREMENT MAIN_u8UdsSwVerVeh[9] "MAIN_u8UdsSwVerVeh[9]" UBYTE Id_0x00 1 2 0 255 ECU_ADDRESS 0x70000B5F /end MEASUREMENT
/begin MEASUREMENT Os_Task_BackGround_Counter "..." ULONG I_1 1 2 0 4294967295 ECU_ADDRESS 0x7002B2BC /end MEASUREMENT
/begin MEASUREMENT Os_Task_Idle_Counter "..." ULONG I_1 1 2 0 4294967295 ECU_ADDRESS 0x70022580 /end MEASUREMENT
/begin MEASUREMENT Rte_ModeCurrent_0 "..." UBYTE I_1 1 2 0 255 ECU_ADDRESS 0x70000AA3 /end MEASUREMENT
/begin MEASUREMENT Rte_ModeCurrent_4 "..." UBYTE I_1 1 2 0 255 ECU_ADDRESS 0x70004252 /end MEASUREMENT
/begin COMPU_METHOD I_1 "" RAT_FUNC "%9.2" "-" COEFFS 0 1 0 0 0 1 /end COMPU_METHOD
/begin COMPU_METHOD I_3 "" RAT_FUNC "%9.2" "V" COEFFS 0 1 0 0 0 1 /end COMPU_METHOD
/begin COMPU_METHOD F_0v0061035156_p0_4 "" RAT_FUNC "%9.3" "%" COEFFS 0 1 0 0 0 0.00610352 /end COMPU_METHOD
/begin COMPU_METHOD F_1_p0_5 "" RAT_FUNC "%9.2" "-" COEFFS 0 1 0 0 0 1 /end COMPU_METHOD
/begin COMPU_METHOD F_1_p0_6 "" RAT_FUNC "%9.2" "%" COEFFS 0 1 0 0 0 1 /end COMPU_METHOD
/begin COMPU_METHOD F_1_p0_7 "" RAT_FUNC "%9.2" "rpm" COEFFS 0 1 0 0 0 1 /end COMPU_METHOD
/begin COMPU_METHOD I_8 "" RAT_FUNC "%9.2" "%" COEFFS 0 1 0 0 0 1 /end COMPU_METHOD
/begin COMPU_METHOD F_1_p0_9 "" RAT_FUNC "%9.2" "Nm" COEFFS 0 1 0 0 0 1 /end COMPU_METHOD
/begin COMPU_METHOD F_1_p0_10 "" RAT_FUNC "%9.2" "RPM" COEFFS 0 1 0 0 0 1 /end COMPU_METHOD
/begin COMPU_METHOD F_1_p0_11 "" RAT_FUNC "%9.2" "Hz" COEFFS 0 1 0 0 0 1 /end COMPU_METHOD
/begin COMPU_METHOD F_1_p0_12 "" RAT_FUNC "%9.2" "s" COEFFS 0 1 0 0 0 1 /end COMPU_METHOD
/begin COMPU_METHOD F_100_p0_13 "" RAT_FUNC "%9.2" "%" COEFFS 0 1 0 0 0 100 /end COMPU_METHOD
/begin COMPU_METHOD F_1_p0_14 "" RAT_FUNC "%9.2" "A" COEFFS 0 1 0 0 0 1 /end COMPU_METHOD
/begin COMPU_METHOD F_1000000_p0_15 "" RAT_FUNC "%9.2" "us" COEFFS 0 1 0 0 0 1e+006 /end COMPU_METHOD
/begin COMPU_METHOD F_0v01_p0_16 "" RAT_FUNC "%9.2" "ï¿½s" COEFFS 0 1 0 0 0 0.01 /end COMPU_METHOD
/begin COMPU_METHOD F_0v1_p0_17 "" RAT_FUNC "%9.2" "ï¿½s" COEFFS 0 1 0 0 0 0.1 /end COMPU_METHOD
/begin COMPU_METHOD F_1_p0_18 "" RAT_FUNC "%9.2" "ms" COEFFS 0 1 0 0 0 1 /end COMPU_METHOD
/begin COMPU_METHOD F_0v04_p1_19 "" RAT_FUNC "%9.2" "us" COEFFS 0 1 -1 0 0 0.04 /end COMPU_METHOD
/begin COMPU_METHOD F_0v04_p1_20 "" RAT_FUNC "%9.2" "-" COEFFS 0 1 -1 0 0 0.04 /end COMPU_METHOD
/begin COMPU_METHOD F_0v01_p0_24 "" RAT_FUNC "%9.2" "-" COEFFS 0 1 0 0 0 0.01 /end COMPU_METHOD
/begin COMPU_METHOD I_35 "" RAT_FUNC "%9.2" "Kmh" COEFFS 0 1 0 0 0 1 /end COMPU_METHOD
/begin COMPU_METHOD F_0v055_p0_36 "" RAT_FUNC "%9.2" "ï¿½s" COEFFS 0 1 0 0 0 0.055 /end COMPU_METHOD
/begin COMPU_METHOD F_0v02_p0_37 "" RAT_FUNC "%9.2" "ï¿½s" COEFFS 0 1 0 0 0 0.02 /end COMPU_METHOD
/begin COMPU_METHOD F_0v1_p0_38 "" RAT_FUNC "%9.2" "µs" COEFFS 0 1 0 0 0 0.1 /end COMPU_METHOD
/begin COMPU_METHOD Id_0x00 "" RAT_FUNC "%9.2" "." COEFFS 0 1 0 0 0 1 /end COMPU_METHOD
/begin COMPU_METHOD Bool_ON_OFF "" TAB_VERB "%8.4" "." COMPU_TAB_REF Bool_ON_OFF_table /end COMPU_METHOD
/begin COMPU_VTAB Bool_ON_OFF_table "" TAB_VERB 2 0 "OFF" 1 "ON" /end COMPU_VTAB
/begin FUNCTION MAIN ""
 /begin DEF_CHARACTERISTIC AMAIN_bMSGRxToutBenchOnC AMAIN_f32AccPosClrSSTimC AMAIN_f32AntiSlopExitSpdC AMAIN_f32AntiSsGapDrtGainC AMAIN_f32AntiSsValidTrqC AMAIN_f32BldcStuckDutyC AMAIN_f32BrakDeratGainC AMAIN_f32BrakPedalPosLowC AMAIN_f32BrakPedPosHighC AMAIN_f32OcAutophsGainC AMAIN_f32OcAutophsOffstC AMAIN_f32PowerdownVoltC AMAIN_f32PwmFreqHighThrdC AMAIN_f32PwmMaxDutyPhysC AMAIN_f32PwmMinDutyPhysC AMAIN_f32PwmRatioReduceC AMAIN_f32SlopOrRoadSpdDiffC AMAIN_f32UvwOvCurrThdC AMAIN_f32VsiPwmPeriodC AMAIN_HARDBenchOnC AMAIN_ku16PwmPerdInitValC AMAIN_ku16SpdReadyEstConfirmC AMAIN_MSGRxBenchOnC AMAIN_MSGTxBenchOnC AMAIN_MSGu8PwModFiltCntC AMAIN_s32CurHardDelayC AMAIN_s32ResHardDelayC AMAIN_s32SampleDelayC AMAIN_TSTBenchOnC AMAIN_u16AntiSsChkTimC AMAIN_u16AntiSsEnaBrakTimC AMAIN_u16AntiSsGapTimC AMAIN_u16BrakRelsDelayC AMAIN_u16FpgaFltClrTimoutC AMAIN_u16IdqDeltaCntMaxC AMAIN_u16PwmRatioPerd0C AMAIN_u16PwmRatioPerd1C AMAIN_u16PwmRatioPerd2C AMAIN_u16PwmRatioPerd3C AMAIN_u16SlopSlideTim1C AMAIN_u16SlopSlideTim2C AMAIN_u16SlopSlideTimoutC AMAIN_u16SlopSpdConfirmC AMAIN_u32VSICntCkreqESMStartedC AMAIN_u32VSICntCkreqVSIStartedC AMAIN_VSIBenchOnWriteDataC AMAIN_VSIBenchOnWriteEmergSwC BSW_ku16CCPReinitTriggerC BSW_ku16MotorVariantC MAIN_bMSGRxToutBenchOnC MAIN_f32AccPosClrSSTimC MAIN_f32AntiSlopExitSpdC MAIN_f32AntiSsGapDrtGainC MAIN_f32AntiSsValidTrqC MAIN_f32BrakDeratGainC MAIN_f32BrakPedalPosLowC MAIN_f32BrakPedPosHighC MAIN_f32OcAutophsGainC MAIN_f32OcAutophsOffstC MAIN_f32PowerdownVoltC MAIN_f32PwmFreqHighThrdC MAIN_f32PwmMaxDutyPhysC MAIN_f32PwmMinDutyPhysC MAIN_f32PwmRatioReduceC MAIN_f32RandomFrecMecaSpdMaxC MAIN_f32RandomFrecMecaSpdMinC MAIN_f32SlopOrRoadSpdDiffC MAIN_f32UvwOvCurrThdC MAIN_f32VsiPwmPeriodC MAIN_HARDBenchOnC MAIN_ku16PwmPerdInitValC MAIN_ku16SpdReadyEstConfirmC MAIN_MSGbBenchTestOnC MAIN_MSGbDbgFrameOnC MAIN_MSGRxBenchOnC MAIN_MSGTxBenchOnC MAIN_MSGu8PwModFiltCntC MAIN_s32CurHardDelayC MAIN_s32ResHardDelayC MAIN_s32SampleDelayC MAIN_SampleSequenceEnC MAIN_TSTBenchOnC MAIN_u16AntiSsChkTimC MAIN_u16AntiSsEnaBrakTimC MAIN_u16AntiSsGapTimC MAIN_u16BrakRelsDelayC MAIN_u16FpgaFltClrTimoutC MAIN_u16IdqDeltaCntMaxC MAIN_u16OverBhvThdC MAIN_u16PwmRatioPerd0C MAIN_u16PwmRatioPerd1C MAIN_u16PwmRatioPerd2C MAIN_u16PwmRatioPerd3C MAIN_u16RandomFrecMaxC MAIN_u16SlopSlideTim1C MAIN_u16SlopSlideTim2C MAIN_u16SlopSlideTimoutC MAIN_u16SlopSpdConfirmC MAIN_u32VSICntCkreqESMStartedC MAIN_u32VSICntCkreqVSIStartedC MAIN_VSIBenchOnWriteDataC MAIN_VSIBenchOnWriteEmergSwC MosSWOverCurrentTestOnC /end DEF_CHARACTERISTIC
 /begin OUT_MEASUREMENT ADCTotalTime AMAIN_as32OCTrimNvm AMAIN_as32OCTrimNvm[0] AMAIN_as32OCTrimNvm[1] AMAIN_as32OCTrimNvm[2] AMAIN_as32OCTrimNvm[3] AMAIN_as32OCTrimNvm[4] AMAIN_au16CalibParamNvm[0] AMAIN_au16CalibParamNvm[1] AMAIN_au16CalibParamNvm[2] AMAIN_au16CalibParamNvm[3] AMAIN_au16CalibParamNvm[4] AMAIN_au16CalibParamNvm[5] AMAIN_au16CalibParamNvm[6] AMAIN_au16CalibParamNvm[7] AMAIN_au16CalibParamNvm[8] AMAIN_au8ErrCode AMAIN_au8ErrCode[0] AMAIN_au8ErrCode[10] AMAIN_au8ErrCode[11] AMAIN_au8ErrCode[12] AMAIN_au8ErrCode[13] AMAIN_au8ErrCode[14] AMAIN_au8ErrCode[15] AMAIN_au8ErrCode[16] AMAIN_au8ErrCode[17] AMAIN_au8ErrCode[18] AMAIN_au8ErrCode[19] AMAIN_au8ErrCode[1] AMAIN_au8ErrCode[2] AMAIN_au8ErrCode[3] AMAIN_au8ErrCode[4] AMAIN_au8ErrCode[5] AMAIN_au8ErrCode[6] AMAIN_au8ErrCode[7] AMAIN_au8ErrCode[8] AMAIN_au8ErrCode[9] AMAIN_bAntiSlopGearEna AMAIN_bAscFlag AMAIN_bBswReadySts AMAIN_bESMStarted AMAIN_bFTInitFinshFlg AMAIN_bOcDataStoreEna AMAIN_bOcFailureFlg AMAIN_bOcFinshFlg AMAIN_bOcModeEna AMAIN_bOcNotRatFlg AMAIN_bOcRdResultFlag AMAIN_bOcStartFlag AMAIN_bOCStoreManualReq AMAIN_bPosAccessLock AMAIN_bProgConditionOk AMAIN_bResExcFltDetEna AMAIN_bSlopSlideTimoutFlg AMAIN_bSoftOvBhvFlg AMAIN_bSoftOvCurrPhsUFlg AMAIN_bSoftOvCurrPhsVFlg AMAIN_bSoftOvCurrPhsWFlg AMAIN_bSpdReadyEst AMAIN_bSpeedReadyFlg AMAIN_bTeachInCompleteFlg AMAIN_bVSIStarted AMAIN_ESMGo2StartupIEvent AMAIN_f32AntiSsEnaBrakPos AMAIN_f32ElecSpeedRds AMAIN_f32EmailElecSpeedRds AMAIN_f32EmailErrThetaRdSurPi AMAIN_f32EmailMecaSpeedRds AMAIN_f32EmailMecaSpeedRpm AMAIN_f32EmailNextThetaElecRdSurPi AMAIN_f32EmailThetaElecRdSurPi AMAIN_f32ErrThetaRdSurPi AMAIN_f32EstTempRatioScale AMAIN_f32IdDeltaAvg AMAIN_f32IdDeltaSum AMAIN_f32IdQuality AMAIN_f32IqDeltaAvg AMAIN_f32IqDeltaSum AMAIN_f32IqQuality AMAIN_f32IuFrequency AMAIN_f32IuPeriod AMAIN_f32MecaSpeedRds AMAIN_f32MecaSpeedRpm AMAIN_f32MotSpdEst AMAIN_f32PWMDutyUPhys AMAIN_f32PWMDutyVPhys AMAIN_f32PWMDutyWPhys AMAIN_f32ThetaElecRdSurPi AMAIN_f32VsiPwmPeriod AMAIN_MSGf32MCU_LvVoltPhys AMAIN_MSGu8BMS_MainNegConnSts AMAIN_MSGu8BMS_MainPosConnSts AMAIN_MSGu8DCU_OfsAlCalSts AMAIN_MSGu8DEV_Fault0 AMAIN_MSGu8DEV_Fault1 AMAIN_MSGu8DEV_Fault10 AMAIN_MSGu8DEV_Fault11 AMAIN_MSGu8DEV_Fault12 AMAIN_MSGu8DEV_Fault13 AMAIN_MSGu8DEV_Fault14 AMAIN_MSGu8DEV_Fault15 AMAIN_MSGu8DEV_Fault2 AMAIN_MSGu8DEV_Fault3 AMAIN_MSGu8DEV_Fault4 AMAIN_MSGu8DEV_Fault5 AMAIN_MSGu8DEV_Fault6 AMAIN_MSGu8DEV_Fault7 AMAIN_MSGu8DEV_Fault8 AMAIN_MSGu8DEV_Fault9 AMAIN_MSGu8MCU_McuEnableSts AMAIN_MSGu8McuHVLoopFlt AMAIN_MSGu8McuHwCapOVFlt AMAIN_MSGu8McuIgbtFlt AMAIN_MSGu8McuInvtTempSensErr AMAIN_MSGu8McuLVVoltFlt AMAIN_MSGu8McuMemoryFlt AMAIN_MSGu8McuMotLockRotErr AMAIN_MSGu8McuMotSN AMAIN_MSGu8McuMotSpdHighAlarm AMAIN_MSGu8McuMotSubFltLevel AMAIN_MSGu8McuMotSysOVCAlarm AMAIN_MSGu8McuMotTempHighAlarm AMAIN_MSGu8McuMotTempSensErr AMAIN_MSGu8McuResolverFlt AMAIN_MSGu8McuSoftCapOVFlt AMAIN_MSGu8McuSoftMajorVer AMAIN_MSGu8McuSoftMinorVer AMAIN_MSGu8McuTempHighAlarm AMAIN_MSGu8McuUCurSensFlt AMAIN_MSGu8McuVCurSensFlt AMAIN_MSGu8McuWCurSensFlt AMAIN_MSGu8VCU_AccPedPosRaw AMAIN_MSGu8VCU_EMWorkMod AMAIN_MSGu8VCU_ePTReady AMAIN_MSGu8VCU_HandBrakSts AMAIN_MSGu8VCU_McuEnableReq AMAIN_s32DeltTimDiff AMAIN_s32Email2PosTreqDiff AMAIN_s32PosA2BDeltTimMax AMAIN_s32PosA2BDeltTimMin AMAIN_TotalTime AMAIN_u16AntiSsBrakTimCnt AMAIN_u16AntiSsEnaBrakCnt AMAIN_u16AntiSsValidCnt AMAIN_u16BrakRelsDelayCnt AMAIN_u16Cnt20 AMAIN_u16Cnt2000 AMAIN_u16Cnt30 AMAIN_u16Cnt4 AMAIN_u16Cnt50 AMAIN_u16Cnt500 AMAIN_u16Core1Cnt1 AMAIN_u16Core1Cnt100 AMAIN_u16Core1Cnt200 AMAIN_u16Core2Cnt1 AMAIN_u16Core2Cnt10 AMAIN_u16Core2Cnt2 AMAIN_u16Core2Cnt5 AMAIN_u16FaultDelayCnt AMAIN_u16FpgaFltClrCnt AMAIN_u16HandBrkRelsDelay AMAIN_u16IdqDeltaSumCnt AMAIN_u16IuCycleCnt AMAIN_u16IuMiddleCnt AMAIN_u16IuMiddleSum AMAIN_u16IuNegtiveCnt AMAIN_u16IuNegtiveSum AMAIN_u16IuPositiveCnt AMAIN_u16IuPositiveSum AMAIN_u16MotorStallCnt AMAIN_u16OverVolHighDelay AMAIN_u16OverVolLowDelay AMAIN_u16OverVolMidDelay AMAIN_u16PWMPeriodVal AMAIN_u16ResCosADVal AMAIN_u16ResSinADVal AMAIN_u16SlopSlideTimCnt AMAIN_u16SlopSpdConfirmCnt AMAIN_u16SpdReadyEstCnt AMAIN_u16T12CntVal AMAIN_u16TeachInWrtDelayCnt AMAIN_u16VadcPhaseCurU AMAIN_u16VadcPhaseCurV AMAIN_u16VadcPhaseCurW AMAIN_u32EmailCkreq AMAIN_u32EmailPosATimeStamp AMAIN_u32IuCycleTim AMAIN_u32PosATimeStamp AMAIN_u32PosBTimeStamp AMAIN_u32PosTreatCkreq AMAIN_u32TestVar2 AMAIN_u8DEV_Fault AMAIN_u8DEV_Fault[0] AMAIN_u8DEV_Fault[10] AMAIN_u8DEV_Fault[11] AMAIN_u8DEV_Fault[12] AMAIN_u8DEV_Fault[13] AMAIN_u8DEV_Fault[14] AMAIN_u8DEV_Fault[15] AMAIN_u8DEV_Fault[1] AMAIN_u8DEV_Fault[2] AMAIN_u8DEV_Fault[3] AMAIN_u8DEV_Fault[4] AMAIN_u8DEV_Fault[5] AMAIN_u8DEV_Fault[6] AMAIN_u8DEV_Fault[7] AMAIN_u8DEV_Fault[8] AMAIN_u8DEV_Fault[9] AMAIN_u8ErrCodNum AMAIN_u8ErrCodRdIdx AMAIN_u8ErrCodWrIdx AMAIN_u8FaultSum AMAIN_u8OcState AMAIN_u8OcStsRptDelayCnt AMAIN_u8OverVolIndex AMAIN_u8PrevGearPos AMAIN_u8TcFaultCodeL3 AMAIN_u8TcFaultCodeL5 AMAIN_u8TestVar1 AMAIN_u8TrigOcByUser AMAIN_VSITxsPwmUl AMAIN_VSITxsPwmUlOn AMAIN_VSITxsPwmUr AMAIN_VSITxsPwmUrOn AMAIN_VSITxsPwmVl AMAIN_VSITxsPwmVlOn AMAIN_VSITxsPwmVr AMAIN_VSITxsPwmVrOn AMAIN_VSITxsPwmWl AMAIN_VSITxsPwmWlOn AMAIN_VSITxsPwmWr AMAIN_VSITxsPwmWrOn ASWNM_bFullComSts ASWNM_u8CurrentState ASWNM_u8CurrentState[0] ASWNM_u8CurrentState[10] ASWNM_u8CurrentState[11] ASWNM_u8CurrentState[12] ASWNM_u8CurrentState[13] ASWNM_u8CurrentState[14] ASWNM_u8CurrentState[15] ASWNM_u8CurrentState[16] ASWNM_u8CurrentState[17] ASWNM_u8CurrentState[18] ASWNM_u8CurrentState[19] ASWNM_u8CurrentState[1] ASWNM_u8CurrentState[20] ASWNM_u8CurrentState[2] ASWNM_u8CurrentState[3] ASWNM_u8CurrentState[4] ASWNM_u8CurrentState[5] ASWNM_u8CurrentState[6] ASWNM_u8CurrentState[7] ASWNM_u8CurrentState[8] ASWNM_u8CurrentState[9] Calibration_debut Core0_f32Asw100msLoad Core0_f32Asw10msLoad Core0_f32Bsw100msLoad Core0_f32Bsw10msLoad Core0_f32Bsw1msLoad Core0_f32Bsw50msLoad Core0_f32ModReqLoad Core0_f32VsiTreatmentLoad Core1_f32Asw10msLoad Core1_f32Asw1msLoad Core1_f32Bsw10msLoad Core1_f32PosTreatmentLoad Core2_f32Asw10msLoad Core2_f32Asw1msLoad Core2_f32Bsw10msLoad CPU0_MaximumUtilization CPU0_PercentUtilization CPU1_MaximumUtilization CPU1_PercentUtilization CPU2_MaximumUtilization CPU2_PercentUtilization HARD_bDioWriteTestEna MAIN_as32OCTrimNvm MAIN_as32OCTrimNvm[0] MAIN_as32OCTrimNvm[1] MAIN_as32OCTrimNvm[2] MAIN_as32OCTrimNvm[3] MAIN_as32OCTrimNvm[4] MAIN_au16CalibParamNvm[0] MAIN_au16CalibParamNvm[1] MAIN_au16CalibParamNvm[2] MAIN_au16CalibParamNvm[3] MAIN_au16CalibParamNvm[4] MAIN_au16CalibParamNvm[5] MAIN_au16CalibParamNvm[6] MAIN_au16CalibParamNvm[7] MAIN_au16CalibParamNvm[8] MAIN_au8ErrCode MAIN_au8ErrCode[0] MAIN_au8ErrCode[10] MAIN_au8ErrCode[11] MAIN_au8ErrCode[12] MAIN_au8ErrCode[13] MAIN_au8ErrCode[14] MAIN_au8ErrCode[15] MAIN_au8ErrCode[16] MAIN_au8ErrCode[17] MAIN_au8ErrCode[18] MAIN_au8ErrCode[19] MAIN_au8ErrCode[1] MAIN_au8ErrCode[2] MAIN_au8ErrCode[3] MAIN_au8ErrCode[4] MAIN_au8ErrCode[5] MAIN_au8ErrCode[6] MAIN_au8ErrCode[7] MAIN_au8ErrCode[8] MAIN_au8ErrCode[9] MAIN_bAkdAfterAscReq MAIN_bAntiSlopGearEna MAIN_bAscFlag MAIN_bBswReadySts MAIN_bESMStarted MAIN_bFTInitFinshFlg MAIN_bMcuMilStatus MAIN_bOcDataStoreEna MAIN_bOcFailureFlg MAIN_bOcFinshFlg MAIN_bOcModeEna MAIN_bOcNotRatFlg MAIN_bOcRdResultFlag MAIN_bOcStartFlag MAIN_bOCStoreManualReq MAIN_bPosAccessLock MAIN_bProgConditionOk MAIN_bResExcFltDetEna MAIN_bSlopSlideTimoutFlg MAIN_bSoftOvBhvFlg MAIN_bSoftOvCurrPhsUFlg MAIN_bSoftOvCurrPhsVFlg MAIN_bSoftOvCurrPhsWFlg MAIN_bSpdReadyEst MAIN_bSpeedReadyFlg MAIN_bTeachInCompleteFlg MAIN_bVSIStarted MAIN_ESMGo2StartupIEvent MAIN_f32AntiSsEnaBrakPos MAIN_f32CpuLoadCore0 MAIN_f32CpuLoadCore1 MAIN_f32CpuLoadCore2 MAIN_f32CpuLoadMaxCore0 MAIN_f32CpuLoadMaxCore1 MAIN_f32CpuLoadMaxCore2 MAIN_f32ElecSpeedRds MAIN_f32EmailElecSpeedRds MAIN_f32EmailErrThetaRdSurPi MAIN_f32EmailMecaSpeedRds MAIN_f32EmailMecaSpeedRpm MAIN_f32EmailNextThetaElecRdSurPi MAIN_f32EmailThetaElecRdSurPi MAIN_f32ErrThetaRdSurPi MAIN_f32EstTempRatioScale MAIN_f32IdDeltaAvg MAIN_f32IdDeltaSum MAIN_f32IdQuality MAIN_f32IqDeltaAvg MAIN_f32IqDeltaSum MAIN_f32IqQuality MAIN_f32IuFrequency MAIN_f32IuPeriod MAIN_f32MecaSpeedRds MAIN_f32MecaSpeedRpm MAIN_f32MotSpdEst MAIN_f32PWMDutyUPhys MAIN_f32PWMDutyVPhys MAIN_f32PWMDutyWPhys MAIN_f32ShiftDrumInitPos MAIN_f32ShiftDrumTermPos MAIN_f32TcReadPosDuty MAIN_f32ThetaElecRdSurPi MAIN_f32VsiPwmPeriod MAIN_MSGbACP_APTCTempSts MAIN_MSGbACP_EACEnaCmd MAIN_MSGbACP_EvaporatorTempSts MAIN_MSGbAirPumpRelayEnableSignal MAIN_MSGbBMS_BattCellEqualizationSts MAIN_MSGbBMS_BattConstantSts MAIN_MSGbBMS_bKeepWarmSet MAIN_MSGbBMS_Powerdown MAIN_MSGbBMS_PTCSts MAIN_MSGbBMS_QuickchargeStsRequest MAIN_MSGbBMS_RequestQuickcharge MAIN_MSGbElevation_Valid MAIN_MSGbFMCU1_ActTrqValid MAIN_MSGbFMCU2_DischrgAllowed MAIN_MSGbMCU_ActiveAntiShake MAIN_MSGbMCU_alarmHighSpeedDir MAIN_MSGbMCU_alarmHighSpeedStop MAIN_MSGbMCU_alarmHighTorStop MAIN_MSGbMCU_alarmOperOrder MAIN_MSGbMCU_CoderFault MAIN_MSGbMCU_CoverProtectionErr MAIN_MSGbMCU_DischrgFault MAIN_MSGbMCU_EcuEepromFault MAIN_MSGbMCU_errorCanBRcv MAIN_MSGbMCU_EstimatedJunTemp MAIN_MSGbMCU_HSBiasAlarmFault MAIN_MSGbMCU_HWOverCrntFault MAIN_MSGbMCU_HWOverVoltFault MAIN_MSGbMCU_HWUnderVoltFault MAIN_MSGbMCU_IGBTFault MAIN_MSGbMCU_IGBTready MAIN_MSGbMCU_InverterOverTemp MAIN_MSGbMCU_InvOvertempHigh MAIN_MSGbMCU_InvOvertempLow MAIN_MSGbMCU_Level1EstimTorqReve MAIN_MSGbMCU_Level1ExcEstimTorqDev MAIN_MSGbMCU_Level2EstimTorqReve MAIN_MSGbMCU_Level2ExcEstimTorq MAIN_MSGbMCU_LosePhaseFault MAIN_MSGbMCU_MCU_Bus_Fault MAIN_MSGbMCU_ModeError MAIN_MSGbMCU_MOTLOCK_OL MAIN_MSGbMCU_MotorOverLoadDerat MAIN_MSGbMCU_MotorOverTempA MAIN_MSGbMCU_MotorTempBreakFault MAIN_MSGbMCU_OverLoadFault MAIN_MSGbMCU_OverSpeedHighFault MAIN_MSGbMCU_OverSpeedLowFault MAIN_MSGbMCU_PassDischgTimeFault MAIN_MSGbMCU_PhaseOverVoltFa MAIN_MSGbMCU_PhaseOverVoltFau MAIN_MSGbMCU_ShutdownAllowed MAIN_MSGbMCU_SWOverCrntFault MAIN_MSGbMCU_UnderVoltHighFault MAIN_MSGbMCU_UnderVoltLowFault MAIN_MSGbMCU_VoltBattOverVolta MAIN_MSGbPEPS_ACCRelaySts MAIN_MSGbPEPS_BrakeSts MAIN_MSGbPEPS_IGN1RelaySts MAIN_MSGbPEPS_IGN1RelayValidity MAIN_MSGbPEPS_IGN2RelaySts MAIN_MSGbPEPS_SW1 MAIN_MSGbPEPS_SW2 MAIN_MSGbPower_ON_Permit MAIN_MSGbPTCPowerLimt MAIN_MSGbPumpupthesignal MAIN_MSGbRemote_LowBeamCon_Req MAIN_MSGbRemote_SmaChrgReq MAIN_MSGbRemoveTheFortifiedState MAIN_MSGbRMCU4_MilReq MAIN_MSGbRMCU4_MoterFault MAIN_MSGbSmartSystemWarning1_0 MAIN_MSGbSmartSystemWarning4_3 MAIN_MSGbSmartsystemwarning5_2 MAIN_MSGbTBOX_4GSts MAIN_MSGbTBOX_GPSSts MAIN_MSGbTBOX_IGNSts MAIN_MSGbTBOX_PowerSts MAIN_MSGbTBOX_RemoteACReq MAIN_MSGbTBOX_RemotePowerOnOffReq MAIN_MSGbTBOX_RemoteWU MAIN_MSGbTBOX_StopChrgReq MAIN_MSGbTBOX_TimeValidity MAIN_MSGbTMS_APTCTempSts MAIN_MSGbTMS_EACEnaCmd MAIN_MSGbTMS_EvaporatorTempSts MAIN_MSGbTMS_WPTCEnaCmd MAIN_MSGbVCU_12VChrgFaultLightSts MAIN_MSGbVCU_bGrLevErr MAIN_MSGbVCU_BMS_EmergencyCmd MAIN_MSGbVCU_BrakeSts MAIN_MSGbVCU_ChargeAllow MAIN_MSGbVCU_CrashOutputSts MAIN_MSGbVCU_DCDCStatus MAIN_MSGbVCU_DrumTest MAIN_MSGbVCU_ECOSts MAIN_MSGbVCU_FmcuAkdReq MAIN_MSGbVCU_HvEmgyStatus MAIN_MSGbVCU_HVIL_3 MAIN_MSGbVCU_InterlockSts MAIN_MSGbVCU_MaintainLightSts MAIN_MSGbVCU_MCEnable MAIN_MSGbVCU_MCUActDischarCmd MAIN_MSGbVCU_MCUPowerOff MAIN_MSGbVCU_MCUSkid MAIN_MSGbVCU_MotorFaultLightSts MAIN_MSGbVCU_MotorOverTempLightSts MAIN_MSGbVCU_PowerBattFaultsLightSts MAIN_MSGbVCU_READYLightSts MAIN_MSGbVCU_RemoteEAC_COMFault MAIN_MSGbVCU_RemoteEAC_SystemFault MAIN_MSGbVcu_Shift_allow MAIN_MSGbVCU_SOCWarnLightSts MAIN_MSGbVCU_stPompe MAIN_MSGbVCU_stPTC MAIN_MSGbVCU_StSmartCharge MAIN_MSGbVCU_SystemFaultsLightSts MAIN_MSGbVCU_SystemWarnLightSts MAIN_MSGbWithrelayrequest MAIN_MSGf32ACP_APTCPowerAllowed MAIN_MSGf32ACP_APTCTemp MAIN_MSGf32ACP_EACPowerAllowed MAIN_MSGf32ACP_EACSpdReq MAIN_MSGf32ACP_EvaporatorTemp MAIN_MSGf32ACP_TargetEvapTempSts MAIN_MSGf32ACPowerLimt MAIN_MSGf32BMS_RequestOutputCrnt MAIN_MSGf32BMS_RequestOutputVolt MAIN_MSGf32EAC_Input_Current MAIN_MSGf32EAC_Input_Voltage MAIN_MSGf32EAC_inverter_Temperature MAIN_MSGf32EAC_Motor_Spd MAIN_MSGf32EAC_Motor_Temperature MAIN_MSGf32EAC_Output_Current MAIN_MSGf32EAC_Output_Voltage MAIN_MSGf32Elevation MAIN_MSGf32LowerTemperatureWarningLimit MAIN_MSGf32MCU_AC_Valid MAIN_MSGf32MCU_ControllerTemp MAIN_MSGf32MCU_ControllerTorque MAIN_MSGf32MCU_ContrTemp_NTC MAIN_MSGf32MCU_DC_link_Crnt MAIN_MSGf32MCU_DC_link_Volt MAIN_MSGf32MCU_LvVoltPhys MAIN_MSGf32MCU_MaxAvailPower MAIN_MSGf32MCU_MaxTorque MAIN_MSGf32MCU_MotorMaxSpeed MAIN_MSGf32MCU_MotorSpeed MAIN_MSGf32MCU_MotorTemp MAIN_MSGf32MCU_VechileSpeed MAIN_MSGf32Motor_Percent_torque MAIN_MSGf32SettingTemperature MAIN_MSGf32TBOX_TempSet MAIN_MSGf32TMS_APTCPowerAllowed MAIN_MSGf32TMS_APTCTemp MAIN_MSGf32TMS_EACPowerAllowed MAIN_MSGf32TMS_EACSpdReq MAIN_MSGf32TMS_EvaporatorTemp MAIN_MSGf32TMS_TargetEvaporatorTemp MAIN_MSGf32TMS_WPTCPowerAllowed MAIN_MSGf32Upper_Limit_Torque MAIN_MSGf32UpperTemperatureWarningLimit MAIN_MSGf32VCU7_12VBatVoltPhys MAIN_MSGf32VCU_AccPedPosPhys MAIN_MSGf32VCU_AvailResidPower MAIN_MSGf32VCU_BrakPedPosPhys MAIN_MSGf32VCU_ChrgHVLoadPower MAIN_MSGf32VCU_DCDCTargetVolt MAIN_MSGf32VCU_DCDCTemp MAIN_MSGf32VCU_GasPedalPosition MAIN_MSGf32VCU_InstantPower MAIN_MSGf32VCU_InstPowerConsum MAIN_MSGf32VCU_MotorMaxPower MAIN_MSGf32VCU_ResidualOdometer MAIN_MSGf32VCU_TorqueCommand MAIN_MSGf32VCU_VehicleSpeedVSOSig MAIN_MSGu16BMS_ChargeTime MAIN_MSGu16BMS_RequestOutputCrntRaw MAIN_MSGu16BMS_RequestOutputVoltRaw MAIN_MSGu16EAC_Input_CurrentRaw MAIN_MSGu16EAC_Input_VoltageRaw MAIN_MSGu16EAC_Motor_SpdRaw MAIN_MSGu16EAC_Output_CurrentRaw MAIN_MSGu16EAC_Output_VoltageRaw MAIN_MSGu16ElevationRaw MAIN_MSGu16EMS_EngActualFlwTorqueRaw MAIN_MSGu16MCU_AC_ValidRaw MAIN_MSGu16MCU_ControllerTorqueRaw MAIN_MSGu16MCU_DC_link_CrntRaw MAIN_MSGu16MCU_DC_link_VoltRaw MAIN_MSGu16MCU_MaxAvailPowerRaw MAIN_MSGu16MCU_MaxTorqueRaw MAIN_MSGu16MCU_MotorMaxSpeedRaw MAIN_MSGu16MCU_MotorSpeedRaw MAIN_MSGu16MCU_VechileSpeedRaw MAIN_MSGu16Upper_Limit_TorqueRaw MAIN_MSGu16VCU_AvailResidPowerRaw MAIN_MSGu16VCU_InstantPowerRaw MAIN_MSGu16VCU_MotorMaxPowerRaw MAIN_MSGu16VCU_ResidualOdometerRaw MAIN_MSGu16VCU_TorqueCommandRaw MAIN_MSGu16VCU_VehicleSpeedVSOSigRaw MAIN_MSGu8ACP_2_buf MAIN_MSGu8ACP_2_buf[0] MAIN_MSGu8ACP_2_buf[1] MAIN_MSGu8ACP_2_buf[2] MAIN_MSGu8ACP_2_buf[3] MAIN_MSGu8ACP_2_buf[4] MAIN_MSGu8ACP_2_buf[5] MAIN_MSGu8ACP_2_buf[6] MAIN_MSGu8ACP_2_buf[7] MAIN_MSGu8ACP_APTCPowerAllowedRaw MAIN_MSGu8ACP_APTCTempRaw MAIN_MSGu8ACP_EACPowerAllowedRaw MAIN_MSGu8ACP_EACSpdReqRaw MAIN_MSGu8ACP_EvaporatorTempRaw MAIN_MSGu8ACP_MsgAliveCounter MAIN_MSGu8ACP_TargetEvapTempStsRaw MAIN_MSGu8ACPowerLimtRaw MAIN_MSGu8BMS_6_buf MAIN_MSGu8BMS_6_buf[0] MAIN_MSGu8BMS_6_buf[1] MAIN_MSGu8BMS_6_buf[2] MAIN_MSGu8BMS_6_buf[3] MAIN_MSGu8BMS_6_buf[4] MAIN_MSGu8BMS_6_buf[5] MAIN_MSGu8BMS_6_buf[6] MAIN_MSGu8BMS_6_buf[7] MAIN_MSGu8BMS_8_buf MAIN_MSGu8BMS_8_buf[0] MAIN_MSGu8BMS_8_buf[1] MAIN_MSGu8BMS_8_buf[2] MAIN_MSGu8BMS_8_buf[3] MAIN_MSGu8BMS_8_buf[4] MAIN_MSGu8BMS_8_buf[5] MAIN_MSGu8BMS_8_buf[6] MAIN_MSGu8BMS_8_buf[7] MAIN_MSGu8BMS_BattReady MAIN_MSGu8BMS_BattVTMSReq MAIN_MSGu8BMS_BMSSts MAIN_MSGu8BMS_ChrgActiveFaultGrade MAIN_MSGu8BMS_DischrgActiveFaultGrade MAIN_MSGu8BMS_NegBattContSts MAIN_MSGu8BMS_PosBattContSts MAIN_MSGu8BMS_PrechargeContSts MAIN_MSGu8BMS_PrechargeSts MAIN_MSGu8BMS_QuickChargeGunSts MAIN_MSGu8BMS_QUICKChargeSts MAIN_MSGu8BMS_RequestOutputMode MAIN_MSGu8BMS_RunMode_TBOX MAIN_MSGu8BMS_TotalFautlCount_N1 MAIN_MSGu8BMS_VehicleChrgMode MAIN_MSGu8BMS_workingMode MAIN_MSGu8ColdMachineWorkMode MAIN_MSGu8Control_Mode_sts MAIN_MSGu8DCAC_1_buf MAIN_MSGu8DCAC_1_buf[0] MAIN_MSGu8DCAC_1_buf[1] MAIN_MSGu8DCAC_1_buf[2] MAIN_MSGu8DCAC_1_buf[3] MAIN_MSGu8DCAC_1_buf[4] MAIN_MSGu8DCAC_1_buf[5] MAIN_MSGu8DCAC_1_buf[6] MAIN_MSGu8DCAC_1_buf[7] MAIN_MSGu8DCAC_2_buf MAIN_MSGu8DCAC_2_buf[0] MAIN_MSGu8DCAC_2_buf[1] MAIN_MSGu8DCAC_2_buf[2] MAIN_MSGu8DCAC_2_buf[3] MAIN_MSGu8DCAC_2_buf[4] MAIN_MSGu8DCAC_2_buf[5] MAIN_MSGu8DCAC_2_buf[6] MAIN_MSGu8DCAC_2_buf[7] MAIN_MSGu8DCU_FltLev MAIN_MSGu8DCU_OfsAlCalSts MAIN_MSGu8DEV_Fault0 MAIN_MSGu8DEV_Fault1 MAIN_MSGu8DEV_Fault10 MAIN_MSGu8DEV_Fault11 MAIN_MSGu8DEV_Fault12 MAIN_MSGu8DEV_Fault13 MAIN_MSGu8DEV_Fault14 MAIN_MSGu8DEV_Fault15 MAIN_MSGu8DEV_Fault2 MAIN_MSGu8DEV_Fault3 MAIN_MSGu8DEV_Fault4 MAIN_MSGu8DEV_Fault5 MAIN_MSGu8DEV_Fault6 MAIN_MSGu8DEV_Fault7 MAIN_MSGu8DEV_Fault8 MAIN_MSGu8DEV_Fault9 MAIN_MSGu8DVD_SET_HORNcmd MAIN_MSGu8EAC_Err_Code MAIN_MSGu8EAC_Err_Level MAIN_MSGu8EAC_Fault_Status MAIN_MSGu8EAC_inverter_TemperatureRaw MAIN_MSGu8EAC_Life MAIN_MSGu8EAC_Motor_TemperatureRaw MAIN_MSGu8EAC_Work_Status MAIN_MSGu8EACPowerStatus MAIN_MSGu8Financial_services_reminder MAIN_MSGu8GearRequest MAIN_MSGu8HumidityWarningLowerLimit MAIN_MSGu8HumidityWarningUpperLimit MAIN_MSGu8InformationSource MAIN_MSGu8LowerTemperatureWarningLimitRaw MAIN_MSGu8MCU_1_buf MAIN_MSGu8MCU_1_buf[0] MAIN_MSGu8MCU_1_buf[1] MAIN_MSGu8MCU_1_buf[2] MAIN_MSGu8MCU_1_buf[3] MAIN_MSGu8MCU_1_buf[4] MAIN_MSGu8MCU_1_buf[5] MAIN_MSGu8MCU_1_buf[6] MAIN_MSGu8MCU_1_buf[7] MAIN_MSGu8MCU_2_buf MAIN_MSGu8MCU_2_buf[0] MAIN_MSGu8MCU_2_buf[1] MAIN_MSGu8MCU_2_buf[2] MAIN_MSGu8MCU_2_buf[3] MAIN_MSGu8MCU_2_buf[4] MAIN_MSGu8MCU_2_buf[5] MAIN_MSGu8MCU_2_buf[6] MAIN_MSGu8MCU_2_buf[7] MAIN_MSGu8MCU_3_buf MAIN_MSGu8MCU_3_buf[0] MAIN_MSGu8MCU_3_buf[1] MAIN_MSGu8MCU_3_buf[2] MAIN_MSGu8MCU_3_buf[3] MAIN_MSGu8MCU_3_buf[4] MAIN_MSGu8MCU_3_buf[5] MAIN_MSGu8MCU_3_buf[6] MAIN_MSGu8MCU_3_buf[7] MAIN_MSGu8MCU_4_buf MAIN_MSGu8MCU_4_buf[0] MAIN_MSGu8MCU_4_buf[1] MAIN_MSGu8MCU_4_buf[2] MAIN_MSGu8MCU_4_buf[3] MAIN_MSGu8MCU_4_buf[4] MAIN_MSGu8MCU_4_buf[5] MAIN_MSGu8MCU_4_buf[6] MAIN_MSGu8MCU_4_buf[7] MAIN_MSGu8MCU_ControllerTempRaw MAIN_MSGu8MCU_ContrTemp_NTCRaw MAIN_MSGu8MCU_FaultGrade MAIN_MSGu8MCU_InvOverTemp MAIN_MSGu8MCU_MCUMode MAIN_MSGu8MCU_Motor_FAULTNum MAIN_MSGu8MCU_Motor_Sts MAIN_MSGu8MCU_MotorOverTemp MAIN_MSGu8MCU_MotorTempRaw MAIN_MSGu8MCU_SelfCheck MAIN_MSGu8McuDTC MAIN_MSGu8MCUF_Cali1 MAIN_MSGu8MCUF_Cali1[0] MAIN_MSGu8MCUF_Cali1[1] MAIN_MSGu8MCUF_Cali1[2] MAIN_MSGu8MCUF_Cali1[3] MAIN_MSGu8MCUF_Cali1[4] MAIN_MSGu8MCUF_Cali1[5] MAIN_MSGu8MCUF_Cali1[6] MAIN_MSGu8MCUF_Cali1[7] MAIN_MSGu8MCUF_Cali2 MAIN_MSGu8MCUF_Cali2[0] MAIN_MSGu8MCUF_Cali2[1] MAIN_MSGu8MCUF_Cali2[2] MAIN_MSGu8MCUF_Cali2[3] MAIN_MSGu8MCUF_Cali2[4] MAIN_MSGu8MCUF_Cali2[5] MAIN_MSGu8MCUF_Cali2[6] MAIN_MSGu8MCUF_Cali2[7] MAIN_MSGu8MCUF_Cali3 MAIN_MSGu8MCUF_Cali3[0] MAIN_MSGu8MCUF_Cali3[1] MAIN_MSGu8MCUF_Cali3[2] MAIN_MSGu8MCUF_Cali3[3] MAIN_MSGu8MCUF_Cali3[4] MAIN_MSGu8MCUF_Cali3[5] MAIN_MSGu8MCUF_Cali3[6] MAIN_MSGu8MCUF_Cali3[7] MAIN_MSGu8MCUF_Cali4 MAIN_MSGu8MCUF_Cali4[0] MAIN_MSGu8MCUF_Cali4[1] MAIN_MSGu8MCUF_Cali4[2] MAIN_MSGu8MCUF_Cali4[3] MAIN_MSGu8MCUF_Cali4[4] MAIN_MSGu8MCUF_Cali4[5] MAIN_MSGu8MCUF_Cali4[6] MAIN_MSGu8MCUF_Cali4[7] MAIN_MSGu8McuMotSubFltLevel MAIN_MSGu8MCUR_Cali MAIN_MSGu8MCUR_Cali[0] MAIN_MSGu8MCUR_Cali[1] MAIN_MSGu8MCUR_Cali[2] MAIN_MSGu8MCUR_Cali[3] MAIN_MSGu8MCUR_Cali[4] MAIN_MSGu8MCUR_Cali[5] MAIN_MSGu8MCUR_Cali[6] MAIN_MSGu8MCUR_Cali[7] MAIN_MSGu8Motor_Percent_torqueRaw MAIN_MSGu8OrderInformation MAIN_MSGu8PDU_1_buf MAIN_MSGu8PDU_1_buf[0] MAIN_MSGu8PDU_1_buf[1] MAIN_MSGu8PDU_1_buf[2] MAIN_MSGu8PDU_1_buf[3] MAIN_MSGu8PDU_1_buf[4] MAIN_MSGu8PDU_1_buf[5] MAIN_MSGu8PDU_1_buf[6] MAIN_MSGu8PDU_1_buf[7] MAIN_MSGu8PDU_FaultCode MAIN_MSGu8PDU_FaultGrade MAIN_MSGu8PDU_InterlockSts MAIN_MSGu8PEPS_1_buf MAIN_MSGu8PEPS_1_buf[0] MAIN_MSGu8PEPS_1_buf[1] MAIN_MSGu8PEPS_1_buf[2] MAIN_MSGu8PEPS_1_buf[3] MAIN_MSGu8PEPS_1_buf[4] MAIN_MSGu8PEPS_1_buf[5] MAIN_MSGu8PEPS_1_buf[6] MAIN_MSGu8PEPS_1_buf[7] MAIN_MSGu8PEPS_Learning_Status MAIN_MSGu8PEPS_Message_CheckSum MAIN_MSGu8PEPS_Message_Counter MAIN_MSGu8PEPS_PowerMode MAIN_MSGu8PEPS_PowerModeValidity MAIN_MSGu8Pre_chargedrelaystatus MAIN_MSGu8PTCrelay1status MAIN_MSGu8PTCrelay2status MAIN_MSGu8Pumprelaystatus MAIN_MSGu8PwModOffCnt MAIN_MSGu8PwModOnCnt MAIN_MSGu8QUICKChargeSts MAIN_MSGu8Remote_BattConstantStsReq MAIN_MSGu8Remote_KeepWarmReq MAIN_MSGu8RemoteCoolingRequest MAIN_MSGu8SettingTemperatureRaw MAIN_MSGu8TBOX_1_buf MAIN_MSGu8TBOX_1_buf[0] MAIN_MSGu8TBOX_1_buf[1] MAIN_MSGu8TBOX_1_buf[2] MAIN_MSGu8TBOX_1_buf[3] MAIN_MSGu8TBOX_1_buf[4] MAIN_MSGu8TBOX_1_buf[5] MAIN_MSGu8TBOX_1_buf[6] MAIN_MSGu8TBOX_1_buf[7] MAIN_MSGu8TBOX_2_buf MAIN_MSGu8TBOX_2_buf[0] MAIN_MSGu8TBOX_2_buf[1] MAIN_MSGu8TBOX_2_buf[2] MAIN_MSGu8TBOX_2_buf[3] MAIN_MSGu8TBOX_2_buf[4] MAIN_MSGu8TBOX_2_buf[5] MAIN_MSGu8TBOX_2_buf[6] MAIN_MSGu8TBOX_2_buf[7] MAIN_MSGu8TBOX_4_buf MAIN_MSGu8TBOX_4_buf[0] MAIN_MSGu8TBOX_4_buf[1] MAIN_MSGu8TBOX_4_buf[2] MAIN_MSGu8TBOX_4_buf[3] MAIN_MSGu8TBOX_4_buf[4] MAIN_MSGu8TBOX_4_buf[5] MAIN_MSGu8TBOX_4_buf[6] MAIN_MSGu8TBOX_4_buf[7] MAIN_MSGu8TBOX_AliveCounter MAIN_MSGu8TBOX_Checksum MAIN_MSGu8TBOX_DiagSts MAIN_MSGu8TBOX_Message_Days MAIN_MSGu8TBOX_Message_Hours MAIN_MSGu8TBOX_Message_Minutes MAIN_MSGu8TBOX_Message_Months MAIN_MSGu8TBOX_Message_Seconds MAIN_MSGu8TBOX_Message_Years1 MAIN_MSGu8TBOX_Message_Years2 MAIN_MSGu8TBOX_OTA_Sts MAIN_MSGu8TBOX_Rem12VchargReqSts MAIN_MSGu8TBOX_RemoteControlLock MAIN_MSGu8TBOX_SpeedLimit MAIN_MSGu8TBOX_SpeedLimitSource MAIN_MSGu8TBOX_TempSetRaw MAIN_MSGu8TMS_4_buf MAIN_MSGu8TMS_4_buf[0] MAIN_MSGu8TMS_4_buf[1] MAIN_MSGu8TMS_4_buf[2] MAIN_MSGu8TMS_4_buf[3] MAIN_MSGu8TMS_4_buf[4] MAIN_MSGu8TMS_4_buf[5] MAIN_MSGu8TMS_4_buf[6] MAIN_MSGu8TMS_4_buf[7] MAIN_MSGu8TMS_APTCPowerAllowedRaw MAIN_MSGu8TMS_APTCTempRaw MAIN_MSGu8TMS_EACPowerAllowedRaw MAIN_MSGu8TMS_EACSpdReqRaw MAIN_MSGu8TMS_EvaporatorTempRaw MAIN_MSGu8TMS_MsgAliveCounter MAIN_MSGu8TMS_TargetEvaporatorTempRaw MAIN_MSGu8TMS_WPTCPowerAllowedRaw MAIN_MSGu8Unused MAIN_MSGu8Unused1 MAIN_MSGu8UpperTemperatureWarningLimitRaw MAIN_MSGu8VCU_1_buf MAIN_MSGu8VCU_1_buf[0] MAIN_MSGu8VCU_1_buf[1] MAIN_MSGu8VCU_1_buf[2] MAIN_MSGu8VCU_1_buf[3] MAIN_MSGu8VCU_1_buf[4] MAIN_MSGu8VCU_1_buf[5] MAIN_MSGu8VCU_1_buf[6] MAIN_MSGu8VCU_1_buf[7] MAIN_MSGu8VCU_2_buf MAIN_MSGu8VCU_2_buf[0] MAIN_MSGu8VCU_2_buf[1] MAIN_MSGu8VCU_2_buf[2] MAIN_MSGu8VCU_2_buf[3] MAIN_MSGu8VCU_2_buf[4] MAIN_MSGu8VCU_2_buf[5] MAIN_MSGu8VCU_2_buf[6] MAIN_MSGu8VCU_2_buf[7] MAIN_MSGu8VCU_3_buf MAIN_MSGu8VCU_3_buf[0] MAIN_MSGu8VCU_3_buf[1] MAIN_MSGu8VCU_3_buf[2] MAIN_MSGu8VCU_3_buf[3] MAIN_MSGu8VCU_3_buf[4] MAIN_MSGu8VCU_3_buf[5] MAIN_MSGu8VCU_3_buf[6] MAIN_MSGu8VCU_3_buf[7] MAIN_MSGu8VCU_5_buf MAIN_MSGu8VCU_5_buf[0] MAIN_MSGu8VCU_5_buf[1] MAIN_MSGu8VCU_5_buf[2] MAIN_MSGu8VCU_5_buf[3] MAIN_MSGu8VCU_5_buf[4] MAIN_MSGu8VCU_5_buf[5] MAIN_MSGu8VCU_5_buf[6] MAIN_MSGu8VCU_5_buf[7] MAIN_MSGu8VCU_7_buf MAIN_MSGu8VCU_7_buf[0] MAIN_MSGu8VCU_7_buf[1] MAIN_MSGu8VCU_7_buf[2] MAIN_MSGu8VCU_7_buf[3] MAIN_MSGu8VCU_7_buf[4] MAIN_MSGu8VCU_7_buf[5] MAIN_MSGu8VCU_7_buf[6] MAIN_MSGu8VCU_7_buf[7] MAIN_MSGu8vcu_AliveCounter MAIN_MSGu8VCU_BattState MAIN_MSGu8VCU_BMS_CloseRlyStReq MAIN_MSGu8VCU_ChrgHVLoadPowerRaw MAIN_MSGu8VCU_DCDCstCtrlReq MAIN_MSGu8VCU_DCDCTargetVoltRaw MAIN_MSGu8VCU_DCDCTempRaw MAIN_MSGu8VCU_EMWorkMod MAIN_MSGu8VCU_Failure MAIN_MSGu8VCU_Faultcode MAIN_MSGu8VCU_GasPedalPositionRaw MAIN_MSGu8VCU_GearboxPositionDisplay MAIN_MSGu8VCU_GearLevel MAIN_MSGu8VCU_InstPowerConsumRaw MAIN_MSGu8VCU_McuEnableReq MAIN_MSGu8VCU_PUPDSts MAIN_MSGu8VCU_stVent MAIN_MSGu8VCU_VacuumPumpSysFailure MAIN_MSGu8VCU_VechileSts MAIN_MSGu8Withrelaystatus MAIN_s16BldcHallDirFdb MAIN_s32DeltTimDiff MAIN_s32Email2PosTreqDiff MAIN_s32PosA2BDeltTime MAIN_s32PosA2BDeltTimMax MAIN_s32PosA2BDeltTimMin MAIN_TCUu8CAP_TargetMotSts MAIN_TotalTime MAIN_u16AntiSsBrakTimCnt MAIN_u16AntiSsEnaBrakCnt MAIN_u16AntiSsValidCnt MAIN_u16BrakRelsDelayCnt MAIN_u16Cnt20 MAIN_u16Cnt2000 MAIN_u16Cnt30 MAIN_u16Cnt4 MAIN_u16Cnt50 MAIN_u16Cnt500 MAIN_u16Core0Cnt1 MAIN_u16Core0Cnt10 MAIN_u16Core0Cnt100 MAIN_u16Core0Cnt2 MAIN_u16Core0Cnt200 MAIN_u16Core0Cnt5 MAIN_u16Core1Cnt1 MAIN_u16FaultDelayCnt MAIN_u16FpgaFltClrCnt MAIN_u16HandBrkRelsDelay MAIN_u16IdqDeltaSumCnt MAIN_u16IuCycleCnt MAIN_u16IuMiddleCnt MAIN_u16IuMiddleSum MAIN_u16IuNegtiveCnt MAIN_u16IuNegtiveSum MAIN_u16IuPositiveCnt MAIN_u16IuPositiveSum MAIN_u16MotorStallCnt MAIN_u16OverVolHighDelay MAIN_u16OverVolLowDelay MAIN_u16OverVolMidDelay MAIN_u16PWMPeriodVal MAIN_u16RandomNum MAIN_u16ResCosADVal MAIN_u16ResSinADVal MAIN_u16SlopSlideTimCnt MAIN_u16SlopSpdConfirmCnt MAIN_u16SpdReadyEstCnt MAIN_u16T12CntVal MAIN_u16TeachInWrtDelayCnt MAIN_u16VadcBhv MAIN_u16VadcKM11FB MAIN_u16VadcKM12FB MAIN_u16VadcKM2FB MAIN_u16VadcKM3FB MAIN_u16VadcKM5FB MAIN_u16VadcKM6FB MAIN_u16VadcKM7FB MAIN_u16VadcKM8FB MAIN_u16VadcPhaseCurU MAIN_u16VadcPhaseCurV MAIN_u16VadcPhaseCurW MAIN_u32EmailCkreq MAIN_u32EmailPosATimeStamp MAIN_u32IuCycleTim MAIN_u32PosATimeStamp MAIN_u32PosBTimeStamp MAIN_u32PosTreatCkreq MAIN_u32RunTime_ms MAIN_u32RunTime_s MAIN_u32TestVar2 MAIN_u32TestVar4 MAIN_u32WaitValueVSISafeTreatment MAIN_u32WaitValueVSITreatment MAIN_u8DEV_Fault MAIN_u8DEV_Fault[0] MAIN_u8DEV_Fault[10] MAIN_u8DEV_Fault[11] MAIN_u8DEV_Fault[12] MAIN_u8DEV_Fault[13] MAIN_u8DEV_Fault[14] MAIN_u8DEV_Fault[15] MAIN_u8DEV_Fault[1] MAIN_u8DEV_Fault[2] MAIN_u8DEV_Fault[3] MAIN_u8DEV_Fault[4] MAIN_u8DEV_Fault[5] MAIN_u8DEV_Fault[6] MAIN_u8DEV_Fault[7] MAIN_u8DEV_Fault[8] MAIN_u8DEV_Fault[9] MAIN_u8ErrCodNum MAIN_u8ErrCodRdIdx MAIN_u8ErrCodWrIdx MAIN_u8FaultSum MAIN_u8OcState MAIN_u8OcStsRptDelayCnt MAIN_u8OverVolIndex MAIN_u8PrevGearPos MAIN_u8TestVar1 MAIN_u8TrigOcByUser MAIN_u8UdsSwVerSup MAIN_u8UdsSwVerSup[0] MAIN_u8UdsSwVerSup[10] MAIN_u8UdsSwVerSup[11] MAIN_u8UdsSwVerSup[12] MAIN_u8UdsSwVerSup[13] MAIN_u8UdsSwVerSup[14] MAIN_u8UdsSwVerSup[15] MAIN_u8UdsSwVerSup[16] MAIN_u8UdsSwVerSup[17] MAIN_u8UdsSwVerSup[18] MAIN_u8UdsSwVerSup[19] MAIN_u8UdsSwVerSup[1] MAIN_u8UdsSwVerSup[20] MAIN_u8UdsSwVerSup[2] MAIN_u8UdsSwVerSup[3] MAIN_u8UdsSwVerSup[4] MAIN_u8UdsSwVerSup[5] MAIN_u8UdsSwVerSup[6] MAIN_u8UdsSwVerSup[7] MAIN_u8UdsSwVerSup[8] MAIN_u8UdsSwVerSup[9] MAIN_u8UdsSwVerVeh MAIN_u8UdsSwVerVeh[0] MAIN_u8UdsSwVerVeh[10] MAIN_u8UdsSwVerVeh[11] MAIN_u8UdsSwVerVeh[12] MAIN_u8UdsSwVerVeh[1] MAIN_u8UdsSwVerVeh[2] MAIN_u8UdsSwVerVeh[3] MAIN_u8UdsSwVerVeh[4] MAIN_u8UdsSwVerVeh[5] MAIN_u8UdsSwVerVeh[6] MAIN_u8UdsSwVerVeh[7] MAIN_u8UdsSwVerVeh[8] MAIN_u8UdsSwVerVeh[9] MAIN_VSITxsPwmUl MAIN_VSITxsPwmUlOn MAIN_VSITxsPwmUr MAIN_VSITxsPwmUrOn MAIN_VSITxsPwmVl MAIN_VSITxsPwmVlOn MAIN_VSITxsPwmVr MAIN_VSITxsPwmVrOn MAIN_VSITxsPwmWl MAIN_VSITxsPwmWlOn MAIN_VSITxsPwmWr MAIN_VSITxsPwmWrOn Os_Task_BackGround_Counter Os_Task_Idle_Counter /end OUT_MEASUREMENT
/end FUNCTION
/begin FUNCTION RES ""
 /begin DEF_CHARACTERISTIC RES_bGenerateSyncPosC RES_u16ExcitDelayC RES_u16SyncDelay2C RES_u16SyncDelayC RES_u16VSICkreqPeriodDefC RES_u8ExcitDutyPercentC RES_u8SyncDutyPercentC /end DEF_CHARACTERISTIC
/end FUNCTION
/begin FUNCTION RTE ""
 /begin OUT_MEASUREMENT Core0_Asw100msStartTime Core0_Asw100msStopTime Core0_Asw100msTotalTime Core0_Asw10msStartTime Core0_Asw10msStopTime Core0_Asw10msTotalTime Core0_Bsw100msStartTime Core0_Bsw100msStopTime Core0_Bsw100msTotalTime Core0_Bsw10msStartTime Core0_Bsw10msStopTime Core0_Bsw10msTotalTime Core0_Bsw1msStartTime Core0_Bsw1msStopTime Core0_Bsw1msTotalTime Core0_Bsw50msStartTime Core0_Bsw50msStopTime Core0_Bsw50msTotalTime Core1_Asw10msStartTime Core1_Asw10msStopTime Core1_Asw10msTotalTime Core1_Asw1msStartTime Core1_Asw1msStopTime Core1_Asw1msTotalTime Core1_Bsw10msStartTime Core1_Bsw10msStopTime Core1_Bsw10msTotalTime Core2_Asw10msStartTime Core2_Asw10msStopTime Core2_Asw10msTotalTime Core2_Asw1msStartTime Core2_Asw1msStopTime Core2_Asw1msTotalTime Core2_Bsw10msStartTime Core2_Bsw10msStopTime Core2_Bsw10msTotalTime Rte_ModeCurrent_0 Rte_ModeCurrent_4 /end OUT_MEASUREMENT
/end FUNCTION
/end MODULE
/end PROJECT
