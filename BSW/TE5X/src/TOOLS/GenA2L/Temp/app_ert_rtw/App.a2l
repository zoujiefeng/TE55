/******************************************************************************
* ASAP2 file: CAND.a2l
* Code generation for model "CAND.mdl".
* Model version : 1.17
* Simulink Coder version : 8.1 (R2011b) 08-Jul-2011
* C source code generated on : Thu Mar 02 11:07:16 2023
* Target selection: autosar_servicePort.tlc
* Embedded hardware selection: Freescale->32-bit PowerPC
* Code generation objectives: Unspecified
* Validation result: Not run
* (add additional file header information here)
******************************************************************************/
/* Version 1.31 */
ASAP2_VERSION 1 31
/begin PROJECT ProjectName "Project Comment Goes Here"
/begin HEADER "Header Comments go here" /end HEADER
/begin MODULE ModuleName "Module Comment Goes Here"
/begin MOD_PAR "MOD PAR Comment Goes Here" /end MOD_PAR
/begin MOD_COMMON "Mod Common Comment Here" BYTE_ORDER MSB_FIRST /end MOD_COMMON
/begin RECORD_LAYOUT Scalar_BYTE FNC_VALUES 1 SBYTE COLUMN_DIR DIRECT /end RECORD_LAYOUT
/begin RECORD_LAYOUT Scalar_LONG FNC_VALUES 1 SLONG COLUMN_DIR DIRECT /end RECORD_LAYOUT
/begin RECORD_LAYOUT Scalar_FLOAT64_IEEE FNC_VALUES 1 FLOAT64_IEEE COLUMN_DIR DIRECT /end RECORD_LAYOUT
/* EOF PORS.a2l */
/begin RECORD_LAYOUT DATA_RECORD_UBYTE FNC_VALUES 1 UBYTE ROW_DIR DIRECT /end RECORD_LAYOUT
/begin RECORD_LAYOUT DATA_RECORD_UWORD FNC_VALUES 1 UWORD ROW_DIR DIRECT /end RECORD_LAYOUT
/begin RECORD_LAYOUT DATA_RECORD_ULONG FNC_VALUES 1 ULONG ROW_DIR DIRECT /end RECORD_LAYOUT
/begin RECORD_LAYOUT DATA_RECORD_FLOAT32_IEEE FNC_VALUES 1 FLOAT32_IEEE ROW_DIR DIRECT /end RECORD_LAYOUT
/begin CHARACTERISTIC BLDC_bHallInvalidFltTestOnC "..." VALUE 0x80060005 DATA_RECORD_UBYTE 1 Bool_ON_OFF 0 1 BIT_MASK 0x01 /end CHARACTERISTIC
/begin CHARACTERISTIC BLDC_bHallUndefFltTestOnC "..." VALUE 0x80060004 DATA_RECORD_UBYTE 1 Bool_ON_OFF 0 1 BIT_MASK 0x01 /end CHARACTERISTIC
/begin CHARACTERISTIC BLDC_bHwPinAscEnaC "..." VALUE 0x80060007 DATA_RECORD_UBYTE 1 Bool_ON_OFF 0 1 BIT_MASK 0x01 /end CHARACTERISTIC
/begin CHARACTERISTIC BLDC_bOilPressShortGndFltTestOnC "..." VALUE 0x80060001 DATA_RECORD_UBYTE 1 Bool_ON_OFF 0 1 BIT_MASK 0x01 /end CHARACTERISTIC
/begin CHARACTERISTIC BLDC_bOilPressShortVccFltTestOnC "..." VALUE 0x80060000 DATA_RECORD_UBYTE 1 Bool_ON_OFF 0 1 BIT_MASK 0x01 /end CHARACTERISTIC
/begin CHARACTERISTIC BLDC_bP5vAD2SOverVolFltTestOnC "..." VALUE 0x80060003 DATA_RECORD_UBYTE 1 Bool_ON_OFF 0 1 BIT_MASK 0x01 /end CHARACTERISTIC
/begin CHARACTERISTIC BLDC_bP5vAD2SUnderVolFltTestOnC "..." VALUE 0x80060002 DATA_RECORD_UBYTE 1 Bool_ON_OFF 0 1 BIT_MASK 0x01 /end CHARACTERISTIC
/begin CHARACTERISTIC BLDC_bTestPinEnaC "..." VALUE 0x80060006 DATA_RECORD_UBYTE 1 Bool_ON_OFF 0 1 BIT_MASK 0x01 /end CHARACTERISTIC
/begin CHARACTERISTIC BLDC_kf32LVThdHighC "..." VALUE 0x80064D30 DATA_RECORD_FLOAT32_IEEE 3.402823466E+038 F_1_p0_4 -3.402823466E+038 3.402823466E+038 /end CHARACTERISTIC
/begin CHARACTERISTIC BLDC_kf32LVThdLowC "..." VALUE 0x80064D2C DATA_RECORD_FLOAT32_IEEE 3.402823466E+038 F_1_p0_4 -3.402823466E+038 3.402823466E+038 /end CHARACTERISTIC
/begin CHARACTERISTIC BLDC_kf32MidPotMaxMonitorDutyC "Spare" VALUE 0x80064D38 DATA_RECORD_FLOAT32_IEEE 3.402823466E+038 F_1_p0_4 -3.402823466E+038 3.402823466E+038 /end CHARACTERISTIC
/begin CHARACTERISTIC BLDC_kf32MidPotMinMonitorDutyC "Spare" VALUE 0x80064D34 DATA_RECORD_FLOAT32_IEEE 3.402823466E+038 F_1_p0_4 -3.402823466E+038 3.402823466E+038 /end CHARACTERISTIC
/begin CHARACTERISTIC BLDC_kf32MidPotShrtGndDutyC "Spare" VALUE 0x80064D58 DATA_RECORD_FLOAT32_IEEE 3.402823466E+038 F_100_p0_5 -3.402823466E+038 3.402823466E+038 /end CHARACTERISTIC
/begin CHARACTERISTIC BLDC_kf32MidPotShrtVccDutyC "Spare" VALUE 0x80064D54 DATA_RECORD_FLOAT32_IEEE 3.402823466E+038 F_100_p0_5 -3.402823466E+038 3.402823466E+038 /end CHARACTERISTIC
/begin CHARACTERISTIC BLDC_kf32MidPotTgtHighC "Spare" VALUE 0x80064D50 DATA_RECORD_FLOAT32_IEEE 3.402823466E+038 F_100_p0_5 -3.402823466E+038 3.402823466E+038 /end CHARACTERISTIC
/begin CHARACTERISTIC BLDC_kf32MidPotTgtLowC "Spare" VALUE 0x80064D4C DATA_RECORD_FLOAT32_IEEE 3.402823466E+038 F_100_p0_5 -3.402823466E+038 3.402823466E+038 /end CHARACTERISTIC
/begin CHARACTERISTIC BLDC_kf32MotorSpeedC "..." VALUE 0x80064D48 DATA_RECORD_FLOAT32_IEEE 3.402823466E+038 F_1_p0_4 -3.402823466E+038 3.402823466E+038 /end CHARACTERISTIC
/begin CHARACTERISTIC BLDC_kf32P5vAD2SOverVolC "Spare" VALUE 0x80064D44 DATA_RECORD_FLOAT32_IEEE 3.402823466E+038 F_1_p0_4 -3.402823466E+038 3.402823466E+038 /end CHARACTERISTIC
/begin CHARACTERISTIC BLDC_kf32P5vAD2SUnderVolC "Spare" VALUE 0x80064D40 DATA_RECORD_FLOAT32_IEEE 3.402823466E+038 F_1_p0_4 -3.402823466E+038 3.402823466E+038 /end CHARACTERISTIC
/begin CHARACTERISTIC BLDC_kf32TgtDutyDeltMaxC "Spare" VALUE 0x80064D3C DATA_RECORD_FLOAT32_IEEE 3.402823466E+038 F_1_p0_4 -3.402823466E+038 3.402823466E+038 /end CHARACTERISTIC
/begin CHARACTERISTIC BLDC_ku16MidPotFltConfirmC "BLDC_ku16MidPotFltConfirmC" VALUE 0x8006006E DATA_RECORD_UWORD 65535 I_1 0 65535 /end CHARACTERISTIC
/begin CHARACTERISTIC BLDC_ku16MidPotFltIncStepC "BLDC_ku16MidPotFltIncStepC" VALUE 0x8006006C DATA_RECORD_UWORD 65535 I_1 0 65535 /end CHARACTERISTIC
/begin CHARACTERISTIC BLDC_ku16MidPotRcvTimC "Spare" VALUE 0x80060070 DATA_RECORD_UWORD 655350 F_10_p0_6 0 655350 /end CHARACTERISTIC
/begin CHARACTERISTIC BLDC_ku16RvsDutyDelayC "Spare" VALUE 0x80060072 DATA_RECORD_UWORD 3276.75 F_0v05_p0_7 0 3276.75 /end CHARACTERISTIC
/begin CHARACTERISTIC BLDC_ku16TgtDutyRisingTimC "BLDC_ku16TgtDutyRisingTimC" VALUE 0x80060074 DATA_RECORD_UWORD 65535 I_1 0 65535 /end CHARACTERISTIC
/begin CHARACTERISTIC BSW_bGCUTOutTestOnC "..." VALUE 0x80060008 DATA_RECORD_UBYTE 1 Bool_ON_OFF 0 1 BIT_MASK 0x01 /end CHARACTERISTIC
/begin CHARACTERISTIC BSW_bIntLockDetEnaC "..." VALUE 0x8006000B DATA_RECORD_UBYTE 1 Bool_ON_OFF 0 1 BIT_MASK 0x01 /end CHARACTERISTIC
/begin CHARACTERISTIC BSW_bOBDEnaC "..." VALUE 0x8006000A DATA_RECORD_UBYTE 1 Bool_ON_OFF 0 1 BIT_MASK 0x01 /end CHARACTERISTIC
/begin CHARACTERISTIC BSW_bSPYBenchOnC "SPY activation" VALUE 0x80060009 DATA_RECORD_UBYTE 1 Bool_ON_OFF 0 1 BIT_MASK 0x01 /end CHARACTERISTIC
/begin CHARACTERISTIC BSW_ku16VSIRdyChkTimoutC "BSW_ku16VSIRdyChkTimoutC" VALUE 0x8006007C DATA_RECORD_UWORD 65535 I_1 0 65535 /end CHARACTERISTIC
/begin CHARACTERISTIC CCU6_bAlimFreqChgEnaC "..." VALUE 0x80060023 DATA_RECORD_UBYTE 1 Bool_ON_OFF 0 1 BIT_MASK 0x01 /end CHARACTERISTIC
/begin CHARACTERISTIC CCU6_bDualSmpEnaC "..." VALUE 0x80060022 DATA_RECORD_UBYTE 1 Bool_ON_OFF 0 1 BIT_MASK 0x01 /end CHARACTERISTIC
/begin CHARACTERISTIC CCU6_bHwOvcFltDetEnaC "..." VALUE 0x80060021 DATA_RECORD_UBYTE 1 Bool_ON_OFF 0 1 BIT_MASK 0x01 /end CHARACTERISTIC
/begin CHARACTERISTIC CCU6_bHwPinAscEnaC "..." VALUE 0x80060020 DATA_RECORD_UBYTE 1 Bool_ON_OFF 0 1 BIT_MASK 0x01 /end CHARACTERISTIC
/begin CHARACTERISTIC CCU6_f32DrvClkDutyThdHighC "..." VALUE 0x8006001C DATA_RECORD_FLOAT32_IEEE 3.402823466E+038 F_1_p0_4 -3.402823466E+038 3.402823466E+038 /end CHARACTERISTIC
/begin CHARACTERISTIC CCU6_f32DrvClkDutyThdLowC "..." VALUE 0x80060018 DATA_RECORD_FLOAT32_IEEE 3.402823466E+038 F_1_p0_4 -3.402823466E+038 3.402823466E+038 /end CHARACTERISTIC
/begin CHARACTERISTIC CCU6_kbDrvBdClkEnaC "..." VALUE 0x8006000C DATA_RECORD_UBYTE 1 Bool_ON_OFF 0 1 BIT_MASK 0x01 /end CHARACTERISTIC
/begin CHARACTERISTIC CCU6_kf32MidPointDutyHC "..." VALUE 0x80060014 DATA_RECORD_FLOAT32_IEEE 3.402823466E+038 F_1_p0_4 -3.402823466E+038 3.402823466E+038 /end CHARACTERISTIC
/begin CHARACTERISTIC CCU6_kf32MidPointDutyLC "..." VALUE 0x80060010 DATA_RECORD_FLOAT32_IEEE 3.402823466E+038 F_1_p0_4 -3.402823466E+038 3.402823466E+038 /end CHARACTERISTIC
/begin CHARACTERISTIC CCU6_ku16AlimDutyCycRawC "..." VALUE 0x80060084 DATA_RECORD_UWORD 65535 F_1_p0_4 0 65535 /end CHARACTERISTIC
/begin CHARACTERISTIC CCU6_ku32AlimFreqRawC "..." VALUE 0x80060B98 DATA_RECORD_ULONG 4294967295 F_1_p0_4 0 4294967295 /end CHARACTERISTIC
/begin CHARACTERISTIC CCU6_ku8AscRecoverCntMaxC "..." VALUE 0x8006000F DATA_RECORD_UBYTE 255 F_1_p0_4 0 255 /end CHARACTERISTIC
/begin CHARACTERISTIC CCU6_ku8PwmMidPointFaultC "..." VALUE 0x8006000E DATA_RECORD_UBYTE 255 F_1_p0_4 0 255 /end CHARACTERISTIC
/begin CHARACTERISTIC CalUsr_ku32CalibUpdEnaMskA "..." VALUE 0x80064D60 DATA_RECORD_ULONG 4294967295 I_1 0 4294967295 /end CHARACTERISTIC
/begin CHARACTERISTIC CalUsr_ku32CalibUpdEnaMskB "..." VALUE 0x80064D5C DATA_RECORD_ULONG 4294967295 I_1 0 4294967295 /end CHARACTERISTIC
/begin CHARACTERISTIC ESM_u16PowerLatchTempoC "ESM_u16PowerLatchTempoC" VALUE 0x80099D42 DATA_RECORD_UWORD 327675 F_5_p0_28 0 327675 /end CHARACTERISTIC
/begin CHARACTERISTIC ESM_u8RestartDelayCntC "ESM_u8RestartDelayCntC" VALUE 0x80099D40 DATA_RECORD_UBYTE 1275 F_5_p0_28 0 1275 /end CHARACTERISTIC
/begin CHARACTERISTIC FAIL_bCanErrCheckonC "Check Can Error" VALUE 0x80099D44 DATA_RECORD_UBYTE 1 Bool_ON_OFF 0 1 BIT_MASK 0x01 /end CHARACTERISTIC
/begin CHARACTERISTIC FaultEraseRequestC "FaultEraseRequestC" VALUE 0x80060086 DATA_RECORD_UWORD 65535 I_1 0 65535 /end CHARACTERISTIC
/begin CHARACTERISTIC RTE_bGCUTOutTestOnC "..." VALUE 0x80060ABC DATA_RECORD_UBYTE 1 Bool_ON_OFF 0 1 BIT_MASK 0x01 /end CHARACTERISTIC
/begin MEASUREMENT ASWNM_bBusSleep "Shutdown request" UBYTE Bool_ON_OFF 1 2 0 1 BIT_MASK 0x01 ECU_ADDRESS 0x70002880 /end MEASUREMENT
/begin MEASUREMENT ASWNM_bStayAwake "Shutdown request" UBYTE Bool_ON_OFF 1 2 0 1 BIT_MASK 0x01 ECU_ADDRESS 0x7000287C /end MEASUREMENT
/begin MEASUREMENT ASWNM_u16AfterRunDelayTimes "ASWNM_u16AfterRunDelayTimes" UWORD I_1 1 2 0 65535 ECU_ADDRESS 0x7000287A /end MEASUREMENT
/begin MEASUREMENT ASWNM_u16Kl15Sts "ASWNM_u16Kl15Sts" UWORD I_1 1 2 0 65535 ECU_ADDRESS 0x7000287E /end MEASUREMENT
/begin MEASUREMENT BLDC_bClrTrapReq "..." UBYTE Bool_ON_OFF 1 2 0 1 BIT_MASK 0x01 ECU_ADDRESS 0x700069F4 /end MEASUREMENT
/begin MEASUREMENT BLDC_bEnterSleepMod "..." UBYTE Bool_ON_OFF 1 2 0 1 BIT_MASK 0x01 ECU_ADDRESS 0x700069F3 /end MEASUREMENT
/begin MEASUREMENT BLDC_bHallInvalidFlt "..." UBYTE Bool_ON_OFF 1 2 0 1 BIT_MASK 0x01 ECU_ADDRESS 0x700069F2 /end MEASUREMENT
/begin MEASUREMENT BLDC_bHallUndefFlt "..." UBYTE Bool_ON_OFF 1 2 0 1 BIT_MASK 0x01 ECU_ADDRESS 0x700069F1 /end MEASUREMENT
/begin MEASUREMENT BLDC_bHwFaultDcOvVolt "..." UBYTE Bool_ON_OFF 1 2 0 1 BIT_MASK 0x01 ECU_ADDRESS 0x700069F0 /end MEASUREMENT
/begin MEASUREMENT BLDC_bHwFaultIgbtH "..." UBYTE Bool_ON_OFF 1 2 0 1 BIT_MASK 0x01 ECU_ADDRESS 0x700069EF /end MEASUREMENT
/begin MEASUREMENT BLDC_bHwFaultIgbtL "..." UBYTE Bool_ON_OFF 1 2 0 1 BIT_MASK 0x01 ECU_ADDRESS 0x700069EE /end MEASUREMENT
/begin MEASUREMENT BLDC_bHwFaultOvcU "..." UBYTE Bool_ON_OFF 1 2 0 1 BIT_MASK 0x01 ECU_ADDRESS 0x700069ED /end MEASUREMENT
/begin MEASUREMENT BLDC_bHwFaultOvcV "..." UBYTE Bool_ON_OFF 1 2 0 1 BIT_MASK 0x01 ECU_ADDRESS 0x700069EC /end MEASUREMENT
/begin MEASUREMENT BLDC_bHwFaultOvcW "..." UBYTE Bool_ON_OFF 1 2 0 1 BIT_MASK 0x01 ECU_ADDRESS 0x700069EB /end MEASUREMENT
/begin MEASUREMENT BLDC_bIsBldcStart "..." UBYTE Bool_ON_OFF 1 2 0 1 BIT_MASK 0x01 ECU_ADDRESS 0x700069EA /end MEASUREMENT
/begin MEASUREMENT BLDC_bMotorSpdRdy "..." UBYTE Bool_ON_OFF 1 2 0 1 BIT_MASK 0x01 ECU_ADDRESS 0x700069E9 /end MEASUREMENT
/begin MEASUREMENT BLDC_bOilPressShortGndFlt "..." UBYTE Bool_ON_OFF 1 2 0 1 BIT_MASK 0x01 ECU_ADDRESS 0x700069E8 /end MEASUREMENT
/begin MEASUREMENT BLDC_bOilPressShortVccFlt "..." UBYTE Bool_ON_OFF 1 2 0 1 BIT_MASK 0x01 ECU_ADDRESS 0x700069E7 /end MEASUREMENT
/begin MEASUREMENT BLDC_bP5vAD2SOverVolFlt "..." UBYTE Bool_ON_OFF 1 2 0 1 BIT_MASK 0x01 ECU_ADDRESS 0x700069E6 /end MEASUREMENT
/begin MEASUREMENT BLDC_bP5vAD2SUnderVolFlt "..." UBYTE Bool_ON_OFF 1 2 0 1 BIT_MASK 0x01 ECU_ADDRESS 0x700069E5 /end MEASUREMENT
/begin MEASUREMENT BLDC_bTrapTrigger "..." UBYTE Bool_ON_OFF 1 2 0 1 BIT_MASK 0x01 ECU_ADDRESS 0x700069E4 /end MEASUREMENT
/begin MEASUREMENT BLDC_bUShortGnd "..." UBYTE Bool_ON_OFF 1 2 0 1 BIT_MASK 0x01 ECU_ADDRESS 0x700069E3 /end MEASUREMENT
/begin MEASUREMENT BLDC_bUShortVs "..." UBYTE Bool_ON_OFF 1 2 0 1 BIT_MASK 0x01 ECU_ADDRESS 0x700069E2 /end MEASUREMENT
/begin MEASUREMENT BLDC_bUvwShortGnd "..." UBYTE Bool_ON_OFF 1 2 0 1 BIT_MASK 0x01 ECU_ADDRESS 0x700069E1 /end MEASUREMENT
/begin MEASUREMENT BLDC_bUvwShortVs "..." UBYTE Bool_ON_OFF 1 2 0 1 BIT_MASK 0x01 ECU_ADDRESS 0x700069E0 /end MEASUREMENT
/begin MEASUREMENT BLDC_bVShortGnd "..." UBYTE Bool_ON_OFF 1 2 0 1 BIT_MASK 0x01 ECU_ADDRESS 0x700069DF /end MEASUREMENT
/begin MEASUREMENT BLDC_bVShortVs "..." UBYTE Bool_ON_OFF 1 2 0 1 BIT_MASK 0x01 ECU_ADDRESS 0x700069DE /end MEASUREMENT
/begin MEASUREMENT BLDC_bWShortGnd "..." UBYTE Bool_ON_OFF 1 2 0 1 BIT_MASK 0x01 ECU_ADDRESS 0x700069DD /end MEASUREMENT
/begin MEASUREMENT BLDC_bWShortVs "..." UBYTE Bool_ON_OFF 1 2 0 1 BIT_MASK 0x01 ECU_ADDRESS 0x700069DC /end MEASUREMENT
/begin MEASUREMENT BLDC_f32BatteryVoltage "BLDC_f32BatteryVoltage" FLOAT32_IEEE I_3 1 2 -3.402823466E+038 3.402823466E+038 ECU_ADDRESS 0x7000693C /end MEASUREMENT
/begin MEASUREMENT BLDC_f32BkpVoltage "BLDC_f32BkpVoltage" FLOAT32_IEEE I_3 1 2 -3.402823466E+038 3.402823466E+038 ECU_ADDRESS 0x70006938 /end MEASUREMENT
/begin MEASUREMENT BLDC_f32BldcPosDuty "..." FLOAT32_IEEE I_1 1 2 -3.402823466E+038 3.402823466E+038 ECU_ADDRESS 0x700069D8 /end MEASUREMENT
/begin MEASUREMENT BLDC_f32MotorSpeed "BLDC_f32MotorSpeed" FLOAT32_IEEE I_3 1 2 -3.402823466E+038 3.402823466E+038 ECU_ADDRESS 0x700069D4 /end MEASUREMENT
/begin MEASUREMENT BLDC_f32P5vAD2SPhys "..." FLOAT32_IEEE I_1 1 2 -3.402823466E+038 3.402823466E+038 ECU_ADDRESS 0x700069D0 /end MEASUREMENT
/begin MEASUREMENT BLDC_f32Pfb1DutyPhys "BLDC_f32Pfb1DutyPhys" FLOAT32_IEEE I_1 1 2 -3.402823466E+038 3.402823466E+038 MATRIX_DIM 8 1 1 ECU_ADDRESS 0x700069B0 /end MEASUREMENT
/begin MEASUREMENT BLDC_f32Pfb1DutyPhysSum "..." FLOAT32_IEEE I_1 1 2 -3.402823466E+038 3.402823466E+038 ECU_ADDRESS 0x70006948 /end MEASUREMENT
/begin MEASUREMENT BLDC_f32Pfb1DutyPhys[0] "BLDC_f32Pfb1DutyPhys[0]" FLOAT32_IEEE I_1 1 2 -3.402823466E+038 3.402823466E+038 ECU_ADDRESS 0x700069B0 /end MEASUREMENT
/begin MEASUREMENT BLDC_f32Pfb1DutyPhys[1] "BLDC_f32Pfb1DutyPhys[1]" FLOAT32_IEEE I_1 1 2 -3.402823466E+038 3.402823466E+038 ECU_ADDRESS 0x700069B4 /end MEASUREMENT
/begin MEASUREMENT BLDC_f32Pfb1DutyPhys[2] "BLDC_f32Pfb1DutyPhys[2]" FLOAT32_IEEE I_1 1 2 -3.402823466E+038 3.402823466E+038 ECU_ADDRESS 0x700069B8 /end MEASUREMENT
/begin MEASUREMENT BLDC_f32Pfb1DutyPhys[3] "BLDC_f32Pfb1DutyPhys[3]" FLOAT32_IEEE I_1 1 2 -3.402823466E+038 3.402823466E+038 ECU_ADDRESS 0x700069BC /end MEASUREMENT
/begin MEASUREMENT BLDC_f32Pfb1DutyPhys[4] "BLDC_f32Pfb1DutyPhys[4]" FLOAT32_IEEE I_1 1 2 -3.402823466E+038 3.402823466E+038 ECU_ADDRESS 0x700069C0 /end MEASUREMENT
/begin MEASUREMENT BLDC_f32Pfb1DutyPhys[5] "BLDC_f32Pfb1DutyPhys[5]" FLOAT32_IEEE I_1 1 2 -3.402823466E+038 3.402823466E+038 ECU_ADDRESS 0x700069C4 /end MEASUREMENT
/begin MEASUREMENT BLDC_f32Pfb1DutyPhys[6] "BLDC_f32Pfb1DutyPhys[6]" FLOAT32_IEEE I_1 1 2 -3.402823466E+038 3.402823466E+038 ECU_ADDRESS 0x700069C8 /end MEASUREMENT
/begin MEASUREMENT BLDC_f32Pfb1DutyPhys[7] "BLDC_f32Pfb1DutyPhys[7]" FLOAT32_IEEE I_1 1 2 -3.402823466E+038 3.402823466E+038 ECU_ADDRESS 0x700069CC /end MEASUREMENT
/begin MEASUREMENT BLDC_f32Pfb2DutyPhys "BLDC_f32Pfb2DutyPhys" FLOAT32_IEEE I_1 1 2 -3.402823466E+038 3.402823466E+038 MATRIX_DIM 8 1 1 ECU_ADDRESS 0x70006990 /end MEASUREMENT
/begin MEASUREMENT BLDC_f32Pfb2DutyPhysSum "..." FLOAT32_IEEE I_1 1 2 -3.402823466E+038 3.402823466E+038 ECU_ADDRESS 0x70006944 /end MEASUREMENT
/begin MEASUREMENT BLDC_f32Pfb2DutyPhys[0] "BLDC_f32Pfb2DutyPhys[0]" FLOAT32_IEEE I_1 1 2 -3.402823466E+038 3.402823466E+038 ECU_ADDRESS 0x70006990 /end MEASUREMENT
/begin MEASUREMENT BLDC_f32Pfb2DutyPhys[1] "BLDC_f32Pfb2DutyPhys[1]" FLOAT32_IEEE I_1 1 2 -3.402823466E+038 3.402823466E+038 ECU_ADDRESS 0x70006994 /end MEASUREMENT
/begin MEASUREMENT BLDC_f32Pfb2DutyPhys[2] "BLDC_f32Pfb2DutyPhys[2]" FLOAT32_IEEE I_1 1 2 -3.402823466E+038 3.402823466E+038 ECU_ADDRESS 0x70006998 /end MEASUREMENT
/begin MEASUREMENT BLDC_f32Pfb2DutyPhys[3] "BLDC_f32Pfb2DutyPhys[3]" FLOAT32_IEEE I_1 1 2 -3.402823466E+038 3.402823466E+038 ECU_ADDRESS 0x7000699C /end MEASUREMENT
/begin MEASUREMENT BLDC_f32Pfb2DutyPhys[4] "BLDC_f32Pfb2DutyPhys[4]" FLOAT32_IEEE I_1 1 2 -3.402823466E+038 3.402823466E+038 ECU_ADDRESS 0x700069A0 /end MEASUREMENT
/begin MEASUREMENT BLDC_f32Pfb2DutyPhys[5] "BLDC_f32Pfb2DutyPhys[5]" FLOAT32_IEEE I_1 1 2 -3.402823466E+038 3.402823466E+038 ECU_ADDRESS 0x700069A4 /end MEASUREMENT
/begin MEASUREMENT BLDC_f32Pfb2DutyPhys[6] "BLDC_f32Pfb2DutyPhys[6]" FLOAT32_IEEE I_1 1 2 -3.402823466E+038 3.402823466E+038 ECU_ADDRESS 0x700069A8 /end MEASUREMENT
/begin MEASUREMENT BLDC_f32Pfb2DutyPhys[7] "BLDC_f32Pfb2DutyPhys[7]" FLOAT32_IEEE I_1 1 2 -3.402823466E+038 3.402823466E+038 ECU_ADDRESS 0x700069AC /end MEASUREMENT
/begin MEASUREMENT BLDC_f32Pfb3DutyPhys "BLDC_f32Pfb3DutyPhys" FLOAT32_IEEE I_1 1 2 -3.402823466E+038 3.402823466E+038 MATRIX_DIM 8 1 1 ECU_ADDRESS 0x70006970 /end MEASUREMENT
/begin MEASUREMENT BLDC_f32Pfb3DutyPhysSum "..." FLOAT32_IEEE I_1 1 2 -3.402823466E+038 3.402823466E+038 ECU_ADDRESS 0x70006940 /end MEASUREMENT
/begin MEASUREMENT BLDC_f32Pfb3DutyPhys[0] "BLDC_f32Pfb3DutyPhys[0]" FLOAT32_IEEE I_1 1 2 -3.402823466E+038 3.402823466E+038 ECU_ADDRESS 0x70006970 /end MEASUREMENT
/begin MEASUREMENT BLDC_f32Pfb3DutyPhys[1] "BLDC_f32Pfb3DutyPhys[1]" FLOAT32_IEEE I_1 1 2 -3.402823466E+038 3.402823466E+038 ECU_ADDRESS 0x70006974 /end MEASUREMENT
/begin MEASUREMENT BLDC_f32Pfb3DutyPhys[2] "BLDC_f32Pfb3DutyPhys[2]" FLOAT32_IEEE I_1 1 2 -3.402823466E+038 3.402823466E+038 ECU_ADDRESS 0x70006978 /end MEASUREMENT
/begin MEASUREMENT BLDC_f32Pfb3DutyPhys[3] "BLDC_f32Pfb3DutyPhys[3]" FLOAT32_IEEE I_1 1 2 -3.402823466E+038 3.402823466E+038 ECU_ADDRESS 0x7000697C /end MEASUREMENT
/begin MEASUREMENT BLDC_f32Pfb3DutyPhys[4] "BLDC_f32Pfb3DutyPhys[4]" FLOAT32_IEEE I_1 1 2 -3.402823466E+038 3.402823466E+038 ECU_ADDRESS 0x70006980 /end MEASUREMENT
/begin MEASUREMENT BLDC_f32Pfb3DutyPhys[5] "BLDC_f32Pfb3DutyPhys[5]" FLOAT32_IEEE I_1 1 2 -3.402823466E+038 3.402823466E+038 ECU_ADDRESS 0x70006984 /end MEASUREMENT
/begin MEASUREMENT BLDC_f32Pfb3DutyPhys[6] "BLDC_f32Pfb3DutyPhys[6]" FLOAT32_IEEE I_1 1 2 -3.402823466E+038 3.402823466E+038 ECU_ADDRESS 0x70006988 /end MEASUREMENT
/begin MEASUREMENT BLDC_f32Pfb3DutyPhys[7] "BLDC_f32Pfb3DutyPhys[7]" FLOAT32_IEEE I_1 1 2 -3.402823466E+038 3.402823466E+038 ECU_ADDRESS 0x7000698C /end MEASUREMENT
/begin MEASUREMENT BLDC_f32PrevTgtDuty "..." FLOAT32_IEEE I_1 1 2 -3.402823466E+038 3.402823466E+038 ECU_ADDRESS 0x700068F4 /end MEASUREMENT
/begin MEASUREMENT BLDC_f32TgtDutyDeltVal "..." FLOAT32_IEEE I_1 1 2 -3.402823466E+038 3.402823466E+038 ECU_ADDRESS 0x700068F0 /end MEASUREMENT
/begin MEASUREMENT BLDC_f32TgtDutyPhys "BLDC_f32TgtDutyPhys" FLOAT32_IEEE I_1 1 2 -3.402823466E+038 3.402823466E+038 MATRIX_DIM 8 1 1 ECU_ADDRESS 0x70006950 /end MEASUREMENT
/begin MEASUREMENT BLDC_f32TgtDutyPhysSum "..." FLOAT32_IEEE I_1 1 2 -3.402823466E+038 3.402823466E+038 ECU_ADDRESS 0x7000694C /end MEASUREMENT
/begin MEASUREMENT BLDC_f32TgtDutyPhys[0] "BLDC_f32TgtDutyPhys[0]" FLOAT32_IEEE I_1 1 2 -3.402823466E+038 3.402823466E+038 ECU_ADDRESS 0x70006950 /end MEASUREMENT
/begin MEASUREMENT BLDC_f32TgtDutyPhys[1] "BLDC_f32TgtDutyPhys[1]" FLOAT32_IEEE I_1 1 2 -3.402823466E+038 3.402823466E+038 ECU_ADDRESS 0x70006954 /end MEASUREMENT
/begin MEASUREMENT BLDC_f32TgtDutyPhys[2] "BLDC_f32TgtDutyPhys[2]" FLOAT32_IEEE I_1 1 2 -3.402823466E+038 3.402823466E+038 ECU_ADDRESS 0x70006958 /end MEASUREMENT
/begin MEASUREMENT BLDC_f32TgtDutyPhys[3] "BLDC_f32TgtDutyPhys[3]" FLOAT32_IEEE I_1 1 2 -3.402823466E+038 3.402823466E+038 ECU_ADDRESS 0x7000695C /end MEASUREMENT
/begin MEASUREMENT BLDC_f32TgtDutyPhys[4] "BLDC_f32TgtDutyPhys[4]" FLOAT32_IEEE I_1 1 2 -3.402823466E+038 3.402823466E+038 ECU_ADDRESS 0x70006960 /end MEASUREMENT
/begin MEASUREMENT BLDC_f32TgtDutyPhys[5] "BLDC_f32TgtDutyPhys[5]" FLOAT32_IEEE I_1 1 2 -3.402823466E+038 3.402823466E+038 ECU_ADDRESS 0x70006964 /end MEASUREMENT
/begin MEASUREMENT BLDC_f32TgtDutyPhys[6] "BLDC_f32TgtDutyPhys[6]" FLOAT32_IEEE I_1 1 2 -3.402823466E+038 3.402823466E+038 ECU_ADDRESS 0x70006968 /end MEASUREMENT
/begin MEASUREMENT BLDC_f32TgtDutyPhys[7] "BLDC_f32TgtDutyPhys[7]" FLOAT32_IEEE I_1 1 2 -3.402823466E+038 3.402823466E+038 ECU_ADDRESS 0x7000696C /end MEASUREMENT
/begin MEASUREMENT BLDC_u16DutyDelayCnt "..." UWORD I_1 1 2 0 65535 ECU_ADDRESS 0x70006912 /end MEASUREMENT
/begin MEASUREMENT BLDC_u16McuAscSttDelay "..." UWORD I_1 1 2 0 65535 ECU_ADDRESS 0x70006910 /end MEASUREMENT
/begin MEASUREMENT BLDC_u16OilPressureRaw "..." UWORD I_1 1 2 0 65535 ECU_ADDRESS 0x7000690E /end MEASUREMENT
/begin MEASUREMENT BLDC_u16P5vAD2SRaw "..." UWORD I_1 1 2 0 65535 ECU_ADDRESS 0x7000690C /end MEASUREMENT
/begin MEASUREMENT BLDC_u16PowerOnDelay "..." UWORD I_1 1 2 0 65535 ECU_ADDRESS 0x7000690A /end MEASUREMENT
/begin MEASUREMENT BLDC_u16PwmMaxDutyCyc "..." UWORD I_1 1 2 0 65535 ECU_ADDRESS 0x70006908 /end MEASUREMENT
/begin MEASUREMENT BLDC_u16PwmMinDutyCyc "..." UWORD I_1 1 2 0 65535 ECU_ADDRESS 0x70006906 /end MEASUREMENT
/begin MEASUREMENT BLDC_u16ShortConfirmCnt "..." UWORD I_1 1 2 0 65535 ECU_ADDRESS 0x700068FC /end MEASUREMENT
/begin MEASUREMENT BLDC_u16ShortRecoveryCnt "BLDC_u16ShortRecoveryCnt" UWORD I_1 1 2 0 65535 ECU_ADDRESS 0x70006904 /end MEASUREMENT
/begin MEASUREMENT BLDC_u16T12PeriodVal "..." UWORD I_1 1 2 0 65535 ECU_ADDRESS 0x70006902 /end MEASUREMENT
/begin MEASUREMENT BLDC_u16T13CmpVal "." UWORD F_1_p0_4 1 2 0 65535 ECU_ADDRESS 0x70006900 /end MEASUREMENT
/begin MEASUREMENT BLDC_u16T13PeriodVal "..." UWORD I_1 1 2 0 65535 ECU_ADDRESS 0x700068FE /end MEASUREMENT
/begin MEASUREMENT BLDC_u16TgtDutyRisingDelay "..." UWORD I_1 1 2 0 65535 ECU_ADDRESS 0x70006914 /end MEASUREMENT
/begin MEASUREMENT BLDC_u32MotPosSigDuty "..." ULONG I_1 1 2 0 4294967295 ECU_ADDRESS 0x70006934 /end MEASUREMENT
/begin MEASUREMENT BLDC_u32MotPosSigPerd "..." ULONG I_1 1 2 0 4294967295 ECU_ADDRESS 0x70006930 /end MEASUREMENT
/begin MEASUREMENT BLDC_u32T12IsrCounter "..." ULONG I_1 1 2 0 4294967295 ECU_ADDRESS 0x7000692C /end MEASUREMENT
/begin MEASUREMENT BLDC_u32TrapCreq "..." ULONG I_1 1 2 0 4294967295 ECU_ADDRESS 0x70006928 /end MEASUREMENT
/begin MEASUREMENT BLDC_u8ConfirmDirSts "..." UBYTE I_1 1 2 0 255 ECU_ADDRESS 0x70006924 /end MEASUREMENT
/begin MEASUREMENT BLDC_u8CurDirSts "..." UBYTE I_1 1 2 0 255 ECU_ADDRESS 0x70006923 /end MEASUREMENT
/begin MEASUREMENT BLDC_u8CurHallStt "..." UBYTE I_1 1 2 0 255 ECU_ADDRESS 0x70006922 /end MEASUREMENT
/begin MEASUREMENT BLDC_u8DiagHallStt "..." UBYTE I_1 1 2 0 255 ECU_ADDRESS 0x70006921 /end MEASUREMENT
/begin MEASUREMENT BLDC_u8DiagHallSttPre "..." UBYTE I_1 1 2 0 255 ECU_ADDRESS 0x70006920 /end MEASUREMENT
/begin MEASUREMENT BLDC_u8DutyModeStt "..." UBYTE I_1 1 2 0 255 ECU_ADDRESS 0x7000691F /end MEASUREMENT
/begin MEASUREMENT BLDC_u8HallStt "..." UBYTE I_1 1 2 0 255 ECU_ADDRESS 0x7000691E /end MEASUREMENT
/begin MEASUREMENT BLDC_u8McuAscSttStep "BLDC State" UBYTE I_1 1 2 0 255 ECU_ADDRESS 0x7000691D /end MEASUREMENT
/begin MEASUREMENT BLDC_u8PfbDutyCnt "BLDC_u8PfbDutyCnt" UBYTE I_1 1 2 0 255 ECU_ADDRESS 0x7000691C /end MEASUREMENT
/begin MEASUREMENT BLDC_u8PrevDirSts "..." UBYTE I_1 1 2 0 255 ECU_ADDRESS 0x7000691B /end MEASUREMENT
/begin MEASUREMENT BLDC_u8PwmState "BLDC State" UBYTE I_1 1 2 0 255 ECU_ADDRESS 0x7000691A /end MEASUREMENT
/begin MEASUREMENT BLDC_u8WrCurHallStt "..." UBYTE I_1 1 2 0 255 ECU_ADDRESS 0x70006919 /end MEASUREMENT
/begin MEASUREMENT BLDC_u8WrExpHallStt "..." UBYTE I_1 1 2 0 255 ECU_ADDRESS 0x70006918 /end MEASUREMENT
/begin MEASUREMENT BLDC_u8WrExpOutput "..." UBYTE I_1 1 2 0 255 ECU_ADDRESS 0x70006917 /end MEASUREMENT
/begin MEASUREMENT BLDC_u8WrExpOutputLast "BLDC_u8WrExpOutputLast" UBYTE I_1 1 2 0 255 ECU_ADDRESS 0x70006916 /end MEASUREMENT
/begin MEASUREMENT BSW_bAppMsgTxEna "Flag to enable App message transmission" UBYTE Bool_ON_OFF 1 2 0 1 BIT_MASK 0x01 ECU_ADDRESS 0x70006BF0 /end MEASUREMENT
/begin MEASUREMENT BSW_bCAN0BusOff "BSW_bCAN0BusOff" UBYTE Bool_ON_OFF 1 2 0 1 BIT_MASK 0x01 ECU_ADDRESS 0x70006BEF /end MEASUREMENT
/begin MEASUREMENT BSW_bCAN1BusOff "BSW_bCAN1BusOff" UBYTE Bool_ON_OFF 1 2 0 1 BIT_MASK 0x01 ECU_ADDRESS 0x70006BEE /end MEASUREMENT
/begin MEASUREMENT BSW_bCbkRxTOutFlag_SGBCM_pepsReq "..." UBYTE Bool_ON_OFF 1 2 0 1 BIT_MASK 0x01 ECU_ADDRESS 0x70006BEB /end MEASUREMENT
/begin MEASUREMENT BSW_bCbkRxTOutFlag_SGEMS1Req "..." UBYTE Bool_ON_OFF 1 2 0 1 BIT_MASK 0x01 ECU_ADDRESS 0x70006BEA /end MEASUREMENT
/begin MEASUREMENT BSW_bCbkRxTOutFlag_SGEMS3Req "..." UBYTE Bool_ON_OFF 1 2 0 1 BIT_MASK 0x01 ECU_ADDRESS 0x70006BE9 /end MEASUREMENT
/begin MEASUREMENT BSW_bCbkRxTOutFlag_SGEMS5Req "..." UBYTE Bool_ON_OFF 1 2 0 1 BIT_MASK 0x01 ECU_ADDRESS 0x70006BE8 /end MEASUREMENT
/begin MEASUREMENT BSW_bCbkRxTOutFlag_SGEMS8Req "..." UBYTE Bool_ON_OFF 1 2 0 1 BIT_MASK 0x01 ECU_ADDRESS 0x70006BE7 /end MEASUREMENT
/begin MEASUREMENT BSW_bCbkRxTOutFlag_SGG2m1Req "..." UBYTE Bool_ON_OFF 1 2 0 1 BIT_MASK 0x01 ECU_ADDRESS 0x70006BE6 /end MEASUREMENT
/begin MEASUREMENT BSW_bCbkRxTOutFlag_SGG2m2Req "..." UBYTE Bool_ON_OFF 1 2 0 1 BIT_MASK 0x01 ECU_ADDRESS 0x70006BE5 /end MEASUREMENT
/begin MEASUREMENT BSW_bCbkRxTOutFlag_SGG2m3Req "..." UBYTE Bool_ON_OFF 1 2 0 1 BIT_MASK 0x01 ECU_ADDRESS 0x70006BE4 /end MEASUREMENT
/begin MEASUREMENT BSW_bCbkRxTOutFlag_SGGCU2Req "..." UBYTE Bool_ON_OFF 1 2 0 1 BIT_MASK 0x01 ECU_ADDRESS 0x70006BE3 /end MEASUREMENT
/begin MEASUREMENT BSW_bCbkRxTOutFlag_SGGCU4Req "..." UBYTE Bool_ON_OFF 1 2 0 1 BIT_MASK 0x01 ECU_ADDRESS 0x70006BE2 /end MEASUREMENT
/begin MEASUREMENT BSW_bCbkRxTOutFlag_SGIPB4Req "..." UBYTE Bool_ON_OFF 1 2 0 1 BIT_MASK 0x01 ECU_ADDRESS 0x70006BE1 /end MEASUREMENT
/begin MEASUREMENT BSW_bCbkRxTOutFlag_SGIPB5Req "..." UBYTE Bool_ON_OFF 1 2 0 1 BIT_MASK 0x01 ECU_ADDRESS 0x70006BE0 /end MEASUREMENT
/begin MEASUREMENT BSW_bCbkRxTOutFlag_SGIPB7Req "..." UBYTE Bool_ON_OFF 1 2 0 1 BIT_MASK 0x01 ECU_ADDRESS 0x70006BDF /end MEASUREMENT
/begin MEASUREMENT BSW_bCbkRxTOutFlag_SGIVI_timeAndGPSReq "..." UBYTE Bool_ON_OFF 1 2 0 1 BIT_MASK 0x01 ECU_ADDRESS 0x70006BDE /end MEASUREMENT
/begin MEASUREMENT BSW_bCbkRxTOutFlag_SGPDCM10Req "..." UBYTE Bool_ON_OFF 1 2 0 1 BIT_MASK 0x01 ECU_ADDRESS 0x70006BD7 /end MEASUREMENT
/begin MEASUREMENT BSW_bCbkRxTOutFlag_SGPDCM1Req "..." UBYTE Bool_ON_OFF 1 2 0 1 BIT_MASK 0x01 ECU_ADDRESS 0x70006BD6 /end MEASUREMENT
/begin MEASUREMENT BSW_bCbkRxTOutFlag_SGPDCM21Req "..." UBYTE Bool_ON_OFF 1 2 0 1 BIT_MASK 0x01 ECU_ADDRESS 0x70006BD5 /end MEASUREMENT
/begin MEASUREMENT BSW_bCbkRxTOutFlag_SGPDCM22Req "..." UBYTE Bool_ON_OFF 1 2 0 1 BIT_MASK 0x01 ECU_ADDRESS 0x70006BD4 /end MEASUREMENT
/begin MEASUREMENT BSW_bCbkRxTOutFlag_SGPDCM24Req "..." UBYTE Bool_ON_OFF 1 2 0 1 BIT_MASK 0x01 ECU_ADDRESS 0x70006BD3 /end MEASUREMENT
/begin MEASUREMENT BSW_bCbkRxTOutFlag_SGPDCM30Req "..." UBYTE Bool_ON_OFF 1 2 0 1 BIT_MASK 0x01 ECU_ADDRESS 0x70006BD2 /end MEASUREMENT
/begin MEASUREMENT BSW_bCbkRxTOutFlag_SGPDCM38Req "..." UBYTE Bool_ON_OFF 1 2 0 1 BIT_MASK 0x01 ECU_ADDRESS 0x70006BD1 /end MEASUREMENT
/begin MEASUREMENT BSW_bCbkRxTOutFlag_SGPDCM5Req "..." UBYTE Bool_ON_OFF 1 2 0 1 BIT_MASK 0x01 ECU_ADDRESS 0x70006BD0 /end MEASUREMENT
/begin MEASUREMENT BSW_bCbkRxTOutFlag_SGPDCM_ACU_EPSReq "..." UBYTE Bool_ON_OFF 1 2 0 1 BIT_MASK 0x01 ECU_ADDRESS 0x70006BDD /end MEASUREMENT
/begin MEASUREMENT BSW_bCbkRxTOutFlag_SGPDCM_Body_ICReq "..." UBYTE Bool_ON_OFF 1 2 0 1 BIT_MASK 0x01 ECU_ADDRESS 0x70006BDC /end MEASUREMENT
/begin MEASUREMENT BSW_bCbkRxTOutFlag_SGPDCM_GCUReq "..." UBYTE Bool_ON_OFF 1 2 0 1 BIT_MASK 0x01 ECU_ADDRESS 0x70006BDB /end MEASUREMENT
/begin MEASUREMENT BSW_bCbkRxTOutFlag_SGPDCM_IC_ACUReq "..." UBYTE Bool_ON_OFF 1 2 0 1 BIT_MASK 0x01 ECU_ADDRESS 0x70006BDA /end MEASUREMENT
/begin MEASUREMENT BSW_bCbkRxTOutFlag_SGPDCM_OBDReq "..." UBYTE Bool_ON_OFF 1 2 0 1 BIT_MASK 0x01 ECU_ADDRESS 0x70006BD9 /end MEASUREMENT
/begin MEASUREMENT BSW_bCbkRxTOutFlag_SGPDCM_SelfHeatReq "..." UBYTE Bool_ON_OFF 1 2 0 1 BIT_MASK 0x01 ECU_ADDRESS 0x70006BD8 /end MEASUREMENT
/begin MEASUREMENT BSW_bCbkRxTOutFlag_SGTBOX_VehicleModeReq "..." UBYTE Bool_ON_OFF 1 2 0 1 BIT_MASK 0x01 ECU_ADDRESS 0x70006BCE /end MEASUREMENT
/begin MEASUREMENT BSW_bCbkRxTOutFlag_SGTBOX_engineOFFReq "..." UBYTE Bool_ON_OFF 1 2 0 1 BIT_MASK 0x01 ECU_ADDRESS 0x70006BCF /end MEASUREMENT
/begin MEASUREMENT BSW_bCsumErrFlag_SGEms1Req "..." UBYTE Bool_ON_OFF 1 2 0 1 BIT_MASK 0x01 ECU_ADDRESS 0x70006BC1 /end MEASUREMENT
/begin MEASUREMENT BSW_bCsumErrFlag_SGEms3Req "..." UBYTE Bool_ON_OFF 1 2 0 1 BIT_MASK 0x01 ECU_ADDRESS 0x70006BBF /end MEASUREMENT
/begin MEASUREMENT BSW_bCsumErrFlag_SGEms8Req "..." UBYTE Bool_ON_OFF 1 2 0 1 BIT_MASK 0x01 ECU_ADDRESS 0x70006BBD /end MEASUREMENT
/begin MEASUREMENT BSW_bCsumErrFlag_SGIpb4Req "..." UBYTE Bool_ON_OFF 1 2 0 1 BIT_MASK 0x01 ECU_ADDRESS 0x70006BBB /end MEASUREMENT
/begin MEASUREMENT BSW_bCsumErrFlag_SGIpb5Req "..." UBYTE Bool_ON_OFF 1 2 0 1 BIT_MASK 0x01 ECU_ADDRESS 0x70006BB9 /end MEASUREMENT
/begin MEASUREMENT BSW_bCsumErrFlag_SGIpb7Req "..." UBYTE Bool_ON_OFF 1 2 0 1 BIT_MASK 0x01 ECU_ADDRESS 0x70006BB7 /end MEASUREMENT
/begin MEASUREMENT BSW_bCsumErrFlag_SGPdcm10Req "..." UBYTE Bool_ON_OFF 1 2 0 1 BIT_MASK 0x01 ECU_ADDRESS 0x70006BB5 /end MEASUREMENT
/begin MEASUREMENT BSW_bCsumErrFlag_SGPdcm21Req "..." UBYTE Bool_ON_OFF 1 2 0 1 BIT_MASK 0x01 ECU_ADDRESS 0x70006BB3 /end MEASUREMENT
/begin MEASUREMENT BSW_bCsumErrFlag_SGPdcm22Req "..." UBYTE Bool_ON_OFF 1 2 0 1 BIT_MASK 0x01 ECU_ADDRESS 0x70006BB1 /end MEASUREMENT
/begin MEASUREMENT BSW_bCsumErrFlag_SGPdcm24Req "..." UBYTE Bool_ON_OFF 1 2 0 1 BIT_MASK 0x01 ECU_ADDRESS 0x70006BAF /end MEASUREMENT
/begin MEASUREMENT BSW_bCsumErrFlag_SGPdcm30Req "..." UBYTE Bool_ON_OFF 1 2 0 1 BIT_MASK 0x01 ECU_ADDRESS 0x70006BAD /end MEASUREMENT
/begin MEASUREMENT BSW_bCsumErrFlag_SGPdcmGcuReq "..." UBYTE Bool_ON_OFF 1 2 0 1 BIT_MASK 0x01 ECU_ADDRESS 0x70006BAB /end MEASUREMENT
/begin MEASUREMENT BSW_bCsumErrFlag_SGTbox_vehiclemodeReq "..." UBYTE Bool_ON_OFF 1 2 0 1 BIT_MASK 0x01 ECU_ADDRESS 0x70006BA9 /end MEASUREMENT
/begin MEASUREMENT BSW_bEnableCalcWriteNvMMaxTime "Enable Calc Write NvM Max Time" UBYTE Bool_ON_OFF 1 2 0 1 BIT_MASK 0x01 ECU_ADDRESS 0x70006BCD /end MEASUREMENT
/begin MEASUREMENT BSW_bIntLockDetEna "..." UBYTE Bool_ON_OFF 1 2 0 1 BIT_MASK 0x01 ECU_ADDRESS 0x70006BCC /end MEASUREMENT
/begin MEASUREMENT BSW_bIntLockOccurFlg "..." UBYTE Bool_ON_OFF 1 2 0 1 BIT_MASK 0x01 ECU_ADDRESS 0x70006BCB /end MEASUREMENT
/begin MEASUREMENT BSW_bMKeyOnStatus "..." UBYTE Bool_ON_OFF 1 2 0 1 BIT_MASK 0x01 ECU_ADDRESS 0x70006BCA /end MEASUREMENT
/begin MEASUREMENT BSW_bMSGTrigTxFlag_Mcu7Req "..." UBYTE Bool_ON_OFF 1 2 0 1 BIT_MASK 0x01 ECU_ADDRESS 0x70006BC9 /end MEASUREMENT
/begin MEASUREMENT BSW_bNvmWrTrig "..." UBYTE Bool_ON_OFF 1 2 0 1 BIT_MASK 0x01 ECU_ADDRESS 0x70006BC8 /end MEASUREMENT
/begin MEASUREMENT BSW_bOCDataNotRation "..." UBYTE Bool_ON_OFF 1 2 0 1 BIT_MASK 0x01 ECU_ADDRESS 0x70006BC7 /end MEASUREMENT
/begin MEASUREMENT BSW_bRcErrFlag_SGEms1Req "..." UBYTE Bool_ON_OFF 1 2 0 1 BIT_MASK 0x01 ECU_ADDRESS 0x70006BC0 /end MEASUREMENT
/begin MEASUREMENT BSW_bRcErrFlag_SGEms3Req "..." UBYTE Bool_ON_OFF 1 2 0 1 BIT_MASK 0x01 ECU_ADDRESS 0x70006BBE /end MEASUREMENT
/begin MEASUREMENT BSW_bRcErrFlag_SGEms8Req "..." UBYTE Bool_ON_OFF 1 2 0 1 BIT_MASK 0x01 ECU_ADDRESS 0x70006BBC /end MEASUREMENT
/begin MEASUREMENT BSW_bRcErrFlag_SGIpb4Req "..." UBYTE Bool_ON_OFF 1 2 0 1 BIT_MASK 0x01 ECU_ADDRESS 0x70006BBA /end MEASUREMENT
/begin MEASUREMENT BSW_bRcErrFlag_SGIpb5Req "..." UBYTE Bool_ON_OFF 1 2 0 1 BIT_MASK 0x01 ECU_ADDRESS 0x70006BB8 /end MEASUREMENT
/begin MEASUREMENT BSW_bRcErrFlag_SGIpb7Req "..." UBYTE Bool_ON_OFF 1 2 0 1 BIT_MASK 0x01 ECU_ADDRESS 0x70006BB6 /end MEASUREMENT
/begin MEASUREMENT BSW_bRcErrFlag_SGPdcm10Req "..." UBYTE Bool_ON_OFF 1 2 0 1 BIT_MASK 0x01 ECU_ADDRESS 0x70006BB4 /end MEASUREMENT
/begin MEASUREMENT BSW_bRcErrFlag_SGPdcm21Req "..." UBYTE Bool_ON_OFF 1 2 0 1 BIT_MASK 0x01 ECU_ADDRESS 0x70006BB2 /end MEASUREMENT
/begin MEASUREMENT BSW_bRcErrFlag_SGPdcm22Req "..." UBYTE Bool_ON_OFF 1 2 0 1 BIT_MASK 0x01 ECU_ADDRESS 0x70006BB0 /end MEASUREMENT
/begin MEASUREMENT BSW_bRcErrFlag_SGPdcm24Req "..." UBYTE Bool_ON_OFF 1 2 0 1 BIT_MASK 0x01 ECU_ADDRESS 0x70006BAE /end MEASUREMENT
/begin MEASUREMENT BSW_bRcErrFlag_SGPdcm30Req "..." UBYTE Bool_ON_OFF 1 2 0 1 BIT_MASK 0x01 ECU_ADDRESS 0x70006BAC /end MEASUREMENT
/begin MEASUREMENT BSW_bRcErrFlag_SGPdcmGcuReq "..." UBYTE Bool_ON_OFF 1 2 0 1 BIT_MASK 0x01 ECU_ADDRESS 0x70006BAA /end MEASUREMENT
/begin MEASUREMENT BSW_bRcErrFlag_SGTbox_vehiclemodeReq "..." UBYTE Bool_ON_OFF 1 2 0 1 BIT_MASK 0x01 ECU_ADDRESS 0x70006BA8 /end MEASUREMENT
/begin MEASUREMENT BSW_bStackOverflowWarning "Stack overflow warning" UBYTE Bool_ON_OFF 1 2 0 1 BIT_MASK 0x01 ECU_ADDRESS 0x70006BC4 /end MEASUREMENT
/begin MEASUREMENT BSW_bUdsFunctionReqFlg "..." UBYTE Bool_ON_OFF 1 2 0 1 BIT_MASK 0x01 ECU_ADDRESS 0x70006BC3 /end MEASUREMENT
/begin MEASUREMENT BSW_bVsiReadySts "...." UBYTE Bool_ON_OFF 1 2 0 1 BIT_MASK 0x01 ECU_ADDRESS 0x70006BC2 /end MEASUREMENT
/begin MEASUREMENT BSW_u16CurWriteNvMTime "Current Write NvM Time" UWORD F_0v001_p0_9 1 2 0 65.535 ECU_ADDRESS 0x70006AB0 /end MEASUREMENT
/begin MEASUREMENT BSW_u16IntLockDelayTim "..." UWORD I_1 1 2 0 65535 ECU_ADDRESS 0x70006AAE /end MEASUREMENT
/begin MEASUREMENT BSW_u16NvMWriteCmd "BSW_u16NvMWriteCmd" UWORD I_1 1 2 0 65535 ECU_ADDRESS 0x70006AAA /end MEASUREMENT
/begin MEASUREMENT BSW_u16NvmStoreDelay "...." UWORD I_1 1 2 0 65535 ECU_ADDRESS 0x70006AAC /end MEASUREMENT
/begin MEASUREMENT BSW_u16RawVolMonCurOcpH "BSW_u16RawVolMonCurOcpH" UWORD F_0v0012210012_p0_10 1 2 0 80.01831502 ECU_ADDRESS 0x70006AA8 /end MEASUREMENT
/begin MEASUREMENT BSW_u16RawVolMonCurOcpL "BSW_u16RawVolMonCurOcpL" UWORD F_0v0012210012_p0_10 1 2 0 80.01831502 ECU_ADDRESS 0x70006AA6 /end MEASUREMENT
/begin MEASUREMENT BSW_u16RawVolMonDcOvpSele "BSW_u16RawVolMonDcOvpSele" UWORD F_0v0012210012_p0_10 1 2 0 80.01831502 ECU_ADDRESS 0x70006AA4 /end MEASUREMENT
/begin MEASUREMENT BSW_u16RawVolP16VMulti "BSW_u16RawVolP16VMulti" UWORD F_0v0012210012_p0_10 1 2 0 80.01831502 ECU_ADDRESS 0x70006AA2 /end MEASUREMENT
/begin MEASUREMENT BSW_u16RawVolP5VHS "BSW_u16RawVolP5VHS" UWORD F_0v0012210012_p0_10 1 2 0 80.01831502 ECU_ADDRESS 0x70006AA0 /end MEASUREMENT
/begin MEASUREMENT BSW_u16RawVolP5VHsREF "BSW_u16RawVolP5VHsREF" UWORD F_0v0012210012_p0_10 1 2 0 80.01831502 ECU_ADDRESS 0x70006A9E /end MEASUREMENT
/begin MEASUREMENT BSW_u16RawVolP5VLS "BSW_u16RawVolP5VLS" UWORD F_0v0012210012_p0_10 1 2 0 80.01831502 ECU_ADDRESS 0x70006A9C /end MEASUREMENT
/begin MEASUREMENT BSW_u16RawVolP5VLsREF "BSW_u16RawVolP5VLsREF" UWORD F_0v0012210012_p0_10 1 2 0 80.01831502 ECU_ADDRESS 0x70006A9A /end MEASUREMENT
/begin MEASUREMENT BSW_u16RawVolP5VREF "BSW_u16RawVolP5VREF" UWORD F_0v0012210012_p0_10 1 2 0 80.01831502 ECU_ADDRESS 0x70006A98 /end MEASUREMENT
/begin MEASUREMENT BSW_u16RawVolt15VRdc "BSW_u16RawVolt15VRdc" UWORD F_0v0012210012_p0_10 1 2 0 80.01831502 ECU_ADDRESS 0x70006A96 /end MEASUREMENT
/begin MEASUREMENT BSW_u16RawVoltDclinkFIL "BSW_u16RawVoltDclinkFIL" UWORD F_0v0012210012_p0_10 1 2 0 80.01831502 ECU_ADDRESS 0x70006A94 /end MEASUREMENT
/begin MEASUREMENT BSW_u16SelfChkDelay "...." UWORD I_1 1 2 0 65535 ECU_ADDRESS 0x70006A92 /end MEASUREMENT
/begin MEASUREMENT BSW_u16Var1 "BSW_u16Var1" UWORD I_1 1 2 0 65535 ECU_ADDRESS 0x70006A90 /end MEASUREMENT
/begin MEASUREMENT BSW_u16VsiReadyDelay "...." UWORD I_1 1 2 0 65535 ECU_ADDRESS 0x70006A8E /end MEASUREMENT
/begin MEASUREMENT BSW_u16WriteNvMMaxTime "Write NvM Max Time" UWORD F_0v001_p0_9 1 2 0 65.535 ECU_ADDRESS 0x70006A8C /end MEASUREMENT
/begin MEASUREMENT BSW_u32CbkRxAckCntSGPepsMsgSts "..." ULONG I_1 1 2 0 4294967295 ECU_ADDRESS 0x70006B84 /end MEASUREMENT
/begin MEASUREMENT BSW_u32FeeNextFreePageAddr "Fee Next Free Page Addr" ULONG I_1 1 2 0 4294967295 ECU_ADDRESS 0x70006B4C /end MEASUREMENT
/begin MEASUREMENT BSW_u32RcvUdsCanId "..." ULONG I_1 1 2 0 4294967295 ECU_ADDRESS 0x70006B48 /end MEASUREMENT
/begin MEASUREMENT BSW_u32StackUsed "Stack used (bytes)" ULONG F_4_p0_11 1 2 0 1.717986918E+010 ECU_ADDRESS 0x70006B44 /end MEASUREMENT
/begin MEASUREMENT BSW_u32VSICounterCkreq "..." ULONG I_1 1 2 0 4294967295 ECU_ADDRESS 0x70006B40 /end MEASUREMENT
/begin MEASUREMENT BSW_u32VSICounterSafeCkreq "..." ULONG I_1 1 2 0 4294967295 ECU_ADDRESS 0x70006B3C /end MEASUREMENT
/begin MEASUREMENT BSW_u32VSICounterTimeoutCs "..." ULONG I_1 1 2 0 4294967295 ECU_ADDRESS 0x70006B38 /end MEASUREMENT
/begin MEASUREMENT BSW_u32VSICounterTimeoutFrame "..." ULONG I_1 1 2 0 4294967295 ECU_ADDRESS 0x70006B34 /end MEASUREMENT
/begin MEASUREMENT BSW_u32VSICounterTimeoutSafeTCalc "..." ULONG I_1 1 2 0 4294967295 ECU_ADDRESS 0x70006B30 /end MEASUREMENT
/begin MEASUREMENT BSW_u32VSICounterTimeoutSyncPos "..." ULONG I_1 1 2 0 4294967295 ECU_ADDRESS 0x70006B2C /end MEASUREMENT
/begin MEASUREMENT BSW_u32VSICounterTimeoutTCalc "..." ULONG I_1 1 2 0 4294967295 ECU_ADDRESS 0x70006B28 /end MEASUREMENT
/begin MEASUREMENT BSW_u32VSISafeTimeDuration "..." ULONG F_0v01_p0_12 1 2 0 42949672.95 ECU_ADDRESS 0x70006B24 /end MEASUREMENT
/begin MEASUREMENT BSW_u32VSISafeTimeDurationMax "..." ULONG F_0v01_p0_12 1 2 0 42949672.95 ECU_ADDRESS 0x70006B20 /end MEASUREMENT
/begin MEASUREMENT BSW_u32VSISafeTimeDurationMin "..." ULONG F_0v01_p0_12 1 2 0 42949672.95 ECU_ADDRESS 0x70006B1C /end MEASUREMENT
/begin MEASUREMENT BSW_u32VSITimeDuration "..." ULONG F_0v01_p0_12 1 2 0 42949672.95 ECU_ADDRESS 0x70006B18 /end MEASUREMENT
/begin MEASUREMENT BSW_u32VSITimeDurationMax "..." ULONG F_0v01_p0_12 1 2 0 42949672.95 ECU_ADDRESS 0x70006B14 /end MEASUREMENT
/begin MEASUREMENT BSW_u32VSITimeDurationMin "..." ULONG F_0v01_p0_12 1 2 0 42949672.95 ECU_ADDRESS 0x70006B10 /end MEASUREMENT
/begin MEASUREMENT BSW_u8CAN0BusOffCounter "..." ULONG I_1 1 2 0 4294967295 ECU_ADDRESS 0x70006B0C /end MEASUREMENT
/begin MEASUREMENT BSW_u8CAN1BusOffCounter "..." ULONG I_1 1 2 0 4294967295 ECU_ADDRESS 0x70006B08 /end MEASUREMENT
/begin MEASUREMENT BSW_u8Ems1CsumErrCnt "..." UBYTE I_1 1 2 0 255 ECU_ADDRESS 0x70006AF2 /end MEASUREMENT
/begin MEASUREMENT BSW_u8Ems1RcErrCnt "..." UBYTE I_1 1 2 0 255 ECU_ADDRESS 0x70006AEF /end MEASUREMENT
/begin MEASUREMENT BSW_u8Ems1RcLast "..." UBYTE I_1 1 2 0 255 ECU_ADDRESS 0x70006AF0 /end MEASUREMENT
/begin MEASUREMENT BSW_u8Ems1RcNow "..." UBYTE I_1 1 2 0 255 ECU_ADDRESS 0x70006AF1 /end MEASUREMENT
/begin MEASUREMENT BSW_u8Ems3CsumErrCnt "..." UBYTE I_1 1 2 0 255 ECU_ADDRESS 0x70006AED /end MEASUREMENT
/begin MEASUREMENT BSW_u8Ems3RcErrCnt "..." UBYTE I_1 1 2 0 255 ECU_ADDRESS 0x70006AEA /end MEASUREMENT
/begin MEASUREMENT BSW_u8Ems3RcLast "..." UBYTE I_1 1 2 0 255 ECU_ADDRESS 0x70006AEB /end MEASUREMENT
/begin MEASUREMENT BSW_u8Ems3RcNow "..." UBYTE I_1 1 2 0 255 ECU_ADDRESS 0x70006AEC /end MEASUREMENT
/begin MEASUREMENT BSW_u8Ems8CsumErrCnt "..." UBYTE I_1 1 2 0 255 ECU_ADDRESS 0x70006AE8 /end MEASUREMENT
/begin MEASUREMENT BSW_u8Ems8RcErrCnt "..." UBYTE I_1 1 2 0 255 ECU_ADDRESS 0x70006AE5 /end MEASUREMENT
/begin MEASUREMENT BSW_u8Ems8RcLast "..." UBYTE I_1 1 2 0 255 ECU_ADDRESS 0x70006AE6 /end MEASUREMENT
/begin MEASUREMENT BSW_u8Ems8RcNow "..." UBYTE I_1 1 2 0 255 ECU_ADDRESS 0x70006AE7 /end MEASUREMENT
/begin MEASUREMENT BSW_u8FeeCurSector "Fee Current Sector" UBYTE I_1 1 2 0 255 ECU_ADDRESS 0x70006B03 /end MEASUREMENT
/begin MEASUREMENT BSW_u8FeeSectorChangeCnt "Fee Sector change count" UBYTE I_1 1 2 0 255 ECU_ADDRESS 0x70006B02 /end MEASUREMENT
/begin MEASUREMENT BSW_u8IntLockErrCnt "..." UBYTE I_1 1 2 0 255 ECU_ADDRESS 0x70006B01 /end MEASUREMENT
/begin MEASUREMENT BSW_u8Ipb4CsumErrCnt "..." UBYTE I_1 1 2 0 255 ECU_ADDRESS 0x70006AE3 /end MEASUREMENT
/begin MEASUREMENT BSW_u8Ipb4RcErrCnt "..." UBYTE I_1 1 2 0 255 ECU_ADDRESS 0x70006AE0 /end MEASUREMENT
/begin MEASUREMENT BSW_u8Ipb4RcLast "..." UBYTE I_1 1 2 0 255 ECU_ADDRESS 0x70006AE1 /end MEASUREMENT
/begin MEASUREMENT BSW_u8Ipb4RcNow "..." UBYTE I_1 1 2 0 255 ECU_ADDRESS 0x70006AE2 /end MEASUREMENT
/begin MEASUREMENT BSW_u8Ipb5CsumErrCnt "..." UBYTE I_1 1 2 0 255 ECU_ADDRESS 0x70006ADE /end MEASUREMENT
/begin MEASUREMENT BSW_u8Ipb5RcErrCnt "..." UBYTE I_1 1 2 0 255 ECU_ADDRESS 0x70006ADB /end MEASUREMENT
/begin MEASUREMENT BSW_u8Ipb5RcLast "..." UBYTE I_1 1 2 0 255 ECU_ADDRESS 0x70006ADC /end MEASUREMENT
/begin MEASUREMENT BSW_u8Ipb5RcNow "..." UBYTE I_1 1 2 0 255 ECU_ADDRESS 0x70006ADD /end MEASUREMENT
/begin MEASUREMENT BSW_u8Ipb7CsumErrCnt "..." UBYTE I_1 1 2 0 255 ECU_ADDRESS 0x70006AD9 /end MEASUREMENT
/begin MEASUREMENT BSW_u8Ipb7RcErrCnt "..." UBYTE I_1 1 2 0 255 ECU_ADDRESS 0x70006AD6 /end MEASUREMENT
/begin MEASUREMENT BSW_u8Ipb7RcLast "..." UBYTE I_1 1 2 0 255 ECU_ADDRESS 0x70006AD7 /end MEASUREMENT
/begin MEASUREMENT BSW_u8Ipb7RcNow "..." UBYTE I_1 1 2 0 255 ECU_ADDRESS 0x70006AD8 /end MEASUREMENT
/begin MEASUREMENT BSW_u8McuMotTrqRollCnt "..." UBYTE I_1 1 2 0 255 ECU_ADDRESS 0x70006B00 /end MEASUREMENT
/begin MEASUREMENT BSW_u8McuStsRollCnt "..." UBYTE I_1 1 2 0 255 ECU_ADDRESS 0x70006AFF /end MEASUREMENT
/begin MEASUREMENT BSW_u8NvMReturnResult "NvM Return Result" UBYTE I_1 1 2 0 255 ECU_ADDRESS 0x70006AFD /end MEASUREMENT
/begin MEASUREMENT BSW_u8NvmMngStt "..." UBYTE I_1 1 2 0 255 ECU_ADDRESS 0x70006AFE /end MEASUREMENT
/begin MEASUREMENT BSW_u8Pdcm10CsumErrCnt "..." UBYTE I_1 1 2 0 255 ECU_ADDRESS 0x70006AD4 /end MEASUREMENT
/begin MEASUREMENT BSW_u8Pdcm10RcErrCnt "..." UBYTE I_1 1 2 0 255 ECU_ADDRESS 0x70006AD1 /end MEASUREMENT
/begin MEASUREMENT BSW_u8Pdcm10RcLast "..." UBYTE I_1 1 2 0 255 ECU_ADDRESS 0x70006AD2 /end MEASUREMENT
/begin MEASUREMENT BSW_u8Pdcm10RcNow "..." UBYTE I_1 1 2 0 255 ECU_ADDRESS 0x70006AD3 /end MEASUREMENT
/begin MEASUREMENT BSW_u8Pdcm21CsumErrCnt "..." UBYTE I_1 1 2 0 255 ECU_ADDRESS 0x70006ACF /end MEASUREMENT
/begin MEASUREMENT BSW_u8Pdcm21RcErrCnt "..." UBYTE I_1 1 2 0 255 ECU_ADDRESS 0x70006ACC /end MEASUREMENT
/begin MEASUREMENT BSW_u8Pdcm21RcLast "..." UBYTE I_1 1 2 0 255 ECU_ADDRESS 0x70006ACD /end MEASUREMENT
/begin MEASUREMENT BSW_u8Pdcm21RcNow "..." UBYTE I_1 1 2 0 255 ECU_ADDRESS 0x70006ACE /end MEASUREMENT
/begin MEASUREMENT BSW_u8Pdcm22CsumErrCnt "..." UBYTE I_1 1 2 0 255 ECU_ADDRESS 0x70006ACA /end MEASUREMENT
/begin MEASUREMENT BSW_u8Pdcm22RcErrCnt "..." UBYTE I_1 1 2 0 255 ECU_ADDRESS 0x70006AC7 /end MEASUREMENT
/begin MEASUREMENT BSW_u8Pdcm22RcLast "..." UBYTE I_1 1 2 0 255 ECU_ADDRESS 0x70006AC8 /end MEASUREMENT
/begin MEASUREMENT BSW_u8Pdcm22RcNow "..." UBYTE I_1 1 2 0 255 ECU_ADDRESS 0x70006AC9 /end MEASUREMENT
/begin MEASUREMENT BSW_u8Pdcm24CsumErrCnt "..." UBYTE I_1 1 2 0 255 ECU_ADDRESS 0x70006AC5 /end MEASUREMENT
/begin MEASUREMENT BSW_u8Pdcm24RcErrCnt "..." UBYTE I_1 1 2 0 255 ECU_ADDRESS 0x70006AC2 /end MEASUREMENT
/begin MEASUREMENT BSW_u8Pdcm24RcLast "..." UBYTE I_1 1 2 0 255 ECU_ADDRESS 0x70006AC3 /end MEASUREMENT
/begin MEASUREMENT BSW_u8Pdcm24RcNow "..." UBYTE I_1 1 2 0 255 ECU_ADDRESS 0x70006AC4 /end MEASUREMENT
/begin MEASUREMENT BSW_u8Pdcm30CsumErrCnt "..." UBYTE I_1 1 2 0 255 ECU_ADDRESS 0x70006AC0 /end MEASUREMENT
/begin MEASUREMENT BSW_u8Pdcm30RcErrCnt "..." UBYTE I_1 1 2 0 255 ECU_ADDRESS 0x70006ABD /end MEASUREMENT
/begin MEASUREMENT BSW_u8Pdcm30RcLast "..." UBYTE I_1 1 2 0 255 ECU_ADDRESS 0x70006ABE /end MEASUREMENT
/begin MEASUREMENT BSW_u8Pdcm30RcNow "..." UBYTE I_1 1 2 0 255 ECU_ADDRESS 0x70006ABF /end MEASUREMENT
/begin MEASUREMENT BSW_u8PdcmGcuCsumErrCnt "..." UBYTE I_1 1 2 0 255 ECU_ADDRESS 0x70006ABB /end MEASUREMENT
/begin MEASUREMENT BSW_u8PdcmGcuRcErrCnt "..." UBYTE I_1 1 2 0 255 ECU_ADDRESS 0x70006AB8 /end MEASUREMENT
/begin MEASUREMENT BSW_u8PdcmGcuRcLast "..." UBYTE I_1 1 2 0 255 ECU_ADDRESS 0x70006AB9 /end MEASUREMENT
/begin MEASUREMENT BSW_u8PdcmGcuRcNow "..." UBYTE I_1 1 2 0 255 ECU_ADDRESS 0x70006ABA /end MEASUREMENT
/begin MEASUREMENT BSW_u8SelfChkErr "..." UBYTE I_1 1 2 0 255 ECU_ADDRESS 0x70006AF9 /end MEASUREMENT
/begin MEASUREMENT BSW_u8Tbox_vehiclemodeCsumErrCnt "..." UBYTE I_1 1 2 0 255 ECU_ADDRESS 0x70006AB6 /end MEASUREMENT
/begin MEASUREMENT BSW_u8Tbox_vehiclemodeRcErrCnt "..." UBYTE I_1 1 2 0 255 ECU_ADDRESS 0x70006AB3 /end MEASUREMENT
/begin MEASUREMENT BSW_u8Tbox_vehiclemodeRcLast "..." UBYTE I_1 1 2 0 255 ECU_ADDRESS 0x70006AB4 /end MEASUREMENT
/begin MEASUREMENT BSW_u8Tbox_vehiclemodeRcNow "..." UBYTE I_1 1 2 0 255 ECU_ADDRESS 0x70006AB5 /end MEASUREMENT
/begin MEASUREMENT CCU6_au32PWMOnTime "." ULONG F_1_p0_4 1 2 0 4294967295 MATRIX_DIM 3 1 1 ECU_ADDRESS 0x70006E10 /end MEASUREMENT
/begin MEASUREMENT CCU6_au32PWMOnTime[0] "CCU6_au32PWMOnTime[0]" ULONG F_1_p0_4 1 2 0 4294967295 ECU_ADDRESS 0x70006E10 /end MEASUREMENT
/begin MEASUREMENT CCU6_au32PWMOnTime[1] "CCU6_au32PWMOnTime[1]" ULONG F_1_p0_4 1 2 0 4294967295 ECU_ADDRESS 0x70006E14 /end MEASUREMENT
/begin MEASUREMENT CCU6_au32PWMOnTime[2] "CCU6_au32PWMOnTime[2]" ULONG F_1_p0_4 1 2 0 4294967295 ECU_ADDRESS 0x70006E18 /end MEASUREMENT
/begin MEASUREMENT CCU6_bAkdAfterAscReq "..." UBYTE Bool_ON_OFF 1 2 0 1 BIT_MASK 0x01 ECU_ADDRESS 0x70006E4A /end MEASUREMENT
/begin MEASUREMENT CCU6_bClrTrapReq "..." UBYTE Bool_ON_OFF 1 2 0 1 BIT_MASK 0x01 ECU_ADDRESS 0x70006E49 /end MEASUREMENT
/begin MEASUREMENT CCU6_bHwFaultDcOvVolt "..." UBYTE Bool_ON_OFF 1 2 0 1 BIT_MASK 0x01 ECU_ADDRESS 0x70006E48 /end MEASUREMENT
/begin MEASUREMENT CCU6_bHwFaultIgbtH "..." UBYTE Bool_ON_OFF 1 2 0 1 BIT_MASK 0x01 ECU_ADDRESS 0x70006E47 /end MEASUREMENT
/begin MEASUREMENT CCU6_bHwFaultIgbtL "..." UBYTE Bool_ON_OFF 1 2 0 1 BIT_MASK 0x01 ECU_ADDRESS 0x70006E46 /end MEASUREMENT
/begin MEASUREMENT CCU6_bHwFaultOvcU "..." UBYTE Bool_ON_OFF 1 2 0 1 BIT_MASK 0x01 ECU_ADDRESS 0x70006E45 /end MEASUREMENT
/begin MEASUREMENT CCU6_bHwFaultOvcV "..." UBYTE Bool_ON_OFF 1 2 0 1 BIT_MASK 0x01 ECU_ADDRESS 0x70006E44 /end MEASUREMENT
/begin MEASUREMENT CCU6_bHwFaultOvcW "..." UBYTE Bool_ON_OFF 1 2 0 1 BIT_MASK 0x01 ECU_ADDRESS 0x70006E43 /end MEASUREMENT
/begin MEASUREMENT CCU6_bIgbtHighSideShort "..." UBYTE Bool_ON_OFF 1 2 0 1 BIT_MASK 0x01 ECU_ADDRESS 0x70006E42 /end MEASUREMENT
/begin MEASUREMENT CCU6_bIgbtLowSideShort "..." UBYTE Bool_ON_OFF 1 2 0 1 BIT_MASK 0x01 ECU_ADDRESS 0x70006E41 /end MEASUREMENT
/begin MEASUREMENT CCU6_bIsCCU6Start "..." UBYTE Bool_ON_OFF 1 2 0 1 BIT_MASK 0x01 ECU_ADDRESS 0x70006E40 /end MEASUREMENT
/begin MEASUREMENT CCU6_bIuvwCompReq "..." UBYTE Bool_ON_OFF 1 2 0 1 BIT_MASK 0x01 ECU_ADDRESS 0x70006E3F /end MEASUREMENT
/begin MEASUREMENT CCU6_bMotorSpdRdy "..." UBYTE Bool_ON_OFF 1 2 0 1 BIT_MASK 0x01 ECU_ADDRESS 0x70006E3E /end MEASUREMENT
/begin MEASUREMENT CCU6_bP5VDiagReinitCmd "..." UBYTE Bool_ON_OFF 1 2 0 1 BIT_MASK 0x01 ECU_ADDRESS 0x70006E3D /end MEASUREMENT
/begin MEASUREMENT CCU6_bP5VHSFltFlg "..." UBYTE Bool_ON_OFF 1 2 0 1 BIT_MASK 0x01 ECU_ADDRESS 0x70006E3C /end MEASUREMENT
/begin MEASUREMENT CCU6_bP5VLSFltFlg "..." UBYTE Bool_ON_OFF 1 2 0 1 BIT_MASK 0x01 ECU_ADDRESS 0x70006E3B /end MEASUREMENT
/begin MEASUREMENT CCU6_bPwmMidPointU "..." UBYTE Bool_ON_OFF 1 2 0 1 BIT_MASK 0x01 ECU_ADDRESS 0x70006E3A /end MEASUREMENT
/begin MEASUREMENT CCU6_bPwmMidPointV "..." UBYTE Bool_ON_OFF 1 2 0 1 BIT_MASK 0x01 ECU_ADDRESS 0x70006E39 /end MEASUREMENT
/begin MEASUREMENT CCU6_bPwmMidPointW "..." UBYTE Bool_ON_OFF 1 2 0 1 BIT_MASK 0x01 ECU_ADDRESS 0x70006E38 /end MEASUREMENT
/begin MEASUREMENT CCU6_bPwmOnGoingFlg "..." UBYTE Bool_ON_OFF 1 2 0 1 BIT_MASK 0x01 ECU_ADDRESS 0x70006E37 /end MEASUREMENT
/begin MEASUREMENT CCU6_bT12ZeroMatchFlg "..." UBYTE Bool_ON_OFF 1 2 0 1 BIT_MASK 0x01 ECU_ADDRESS 0x70006E36 /end MEASUREMENT
/begin MEASUREMENT CCU6_bTrapTrigger "..." UBYTE Bool_ON_OFF 1 2 0 1 BIT_MASK 0x01 ECU_ADDRESS 0x70006E35 /end MEASUREMENT
/begin MEASUREMENT CCU6_f32DrvClkHsDuty "..." FLOAT32_IEEE I_1 1 2 -3.402823466E+038 3.402823466E+038 ECU_ADDRESS 0x70006E30 /end MEASUREMENT
/begin MEASUREMENT CCU6_f32DrvClkLsDuty "..." FLOAT32_IEEE I_1 1 2 -3.402823466E+038 3.402823466E+038 ECU_ADDRESS 0x70006E2C /end MEASUREMENT
/begin MEASUREMENT CCU6_f32HighVolPhys "..." FLOAT32_IEEE I_1 1 2 -3.402823466E+038 3.402823466E+038 ECU_ADDRESS 0x70006E28 /end MEASUREMENT
/begin MEASUREMENT CCU6_f32PwmDutyPhysUZ "..." FLOAT32_IEEE I_1 1 2 -3.402823466E+038 3.402823466E+038 ECU_ADDRESS 0x70006E24 /end MEASUREMENT
/begin MEASUREMENT CCU6_f32PwmDutyPhysVZ "..." FLOAT32_IEEE I_1 1 2 -3.402823466E+038 3.402823466E+038 ECU_ADDRESS 0x70006E20 /end MEASUREMENT
/begin MEASUREMENT CCU6_f32PwmDutyPhysWZ "..." FLOAT32_IEEE I_1 1 2 -3.402823466E+038 3.402823466E+038 ECU_ADDRESS 0x70006E1C /end MEASUREMENT
/begin MEASUREMENT CCU6_u16AlimPowerOnDelay "..." UWORD I_1 1 2 0 65535 ECU_ADDRESS 0x70006DEE /end MEASUREMENT
/begin MEASUREMENT CCU6_u16CCU6T13CmpVal "PWM duty of CCU6" UWORD I_1 1 2 0 65535 ECU_ADDRESS 0x7000145A /end MEASUREMENT
/begin MEASUREMENT CCU6_u16HighVolAdc "..." UWORD I_1 1 2 0 65535 ECU_ADDRESS 0x70006DEA /end MEASUREMENT
/begin MEASUREMENT CCU6_u16McuAscSttDelay "..." UWORD I_1 1 2 0 65535 ECU_ADDRESS 0x70006DE8 /end MEASUREMENT
/begin MEASUREMENT CCU6_u16P5VHSAdc "..." UWORD I_15 1 2 0 65535 ECU_ADDRESS 0x70006DE6 /end MEASUREMENT
/begin MEASUREMENT CCU6_u16PowerOnDelay "..." UWORD I_1 1 2 0 65535 ECU_ADDRESS 0x70006DE4 /end MEASUREMENT
/begin MEASUREMENT CCU6_u16PwmMaxDutyCyc "..." UWORD I_1 1 2 0 65535 ECU_ADDRESS 0x70006DE2 /end MEASUREMENT
/begin MEASUREMENT CCU6_u16PwmMidPointErrCnt "..." UWORD I_1 1 2 0 65535 ECU_ADDRESS 0x70006DE0 /end MEASUREMENT
/begin MEASUREMENT CCU6_u16PwmMinDutyCyc "..." UWORD I_1 1 2 0 65535 ECU_ADDRESS 0x70006DDE /end MEASUREMENT
/begin MEASUREMENT CCU6_u16PwmModReq "..." UWORD I_1 1 2 0 65535 ECU_ADDRESS 0x70006DDC /end MEASUREMENT
/begin MEASUREMENT CCU6_u16T12CntVal "..." UWORD I_1 1 2 0 65535 ECU_ADDRESS 0x70006DDA /end MEASUREMENT
/begin MEASUREMENT CCU6_u16T12PeriodVal "..." UWORD I_1 1 2 0 65535 ECU_ADDRESS 0x70001458 /end MEASUREMENT
/begin MEASUREMENT CCU6_u16T13PeriodVal "..." UWORD I_1 1 2 0 65535 ECU_ADDRESS 0x70006DD8 /end MEASUREMENT
/begin MEASUREMENT CCU6_u32DrvClkHsDutyRaw "..." ULONG I_1 1 2 0 4294967295 ECU_ADDRESS 0x70006E0C /end MEASUREMENT
/begin MEASUREMENT CCU6_u32DrvClkHsPerdRaw "..." ULONG I_1 1 2 0 4294967295 ECU_ADDRESS 0x70006E08 /end MEASUREMENT
/begin MEASUREMENT CCU6_u32DrvClkLsDutyRaw "..." ULONG I_1 1 2 0 4294967295 ECU_ADDRESS 0x70006E04 /end MEASUREMENT
/begin MEASUREMENT CCU6_u32DrvClkLsPerdRaw "..." ULONG I_1 1 2 0 4294967295 ECU_ADDRESS 0x70006E00 /end MEASUREMENT
/begin MEASUREMENT CCU6_u32TrapCreq "..." ULONG I_1 1 2 0 4294967295 ECU_ADDRESS 0x70006DFC /end MEASUREMENT
/begin MEASUREMENT CCU6_u8AscRecoverCnt "CCU6 State" UBYTE I_1 1 2 0 255 ECU_ADDRESS 0x70006DF9 /end MEASUREMENT
/begin MEASUREMENT CCU6_u8McuAscSttStep "CCU6 State" UBYTE I_1 1 2 0 255 ECU_ADDRESS 0x70006DF8 /end MEASUREMENT
/begin MEASUREMENT CCU6_u8McuAscType "CCU6 ASC Type" UBYTE I_1 1 2 0 255 ECU_ADDRESS 0x70006DF7 /end MEASUREMENT
/begin MEASUREMENT CCU6_u8P5VHSFltCnt "..." UBYTE I_1 1 2 0 255 ECU_ADDRESS 0x70006DF6 /end MEASUREMENT
/begin MEASUREMENT CCU6_u8P5VLSFltCnt "..." UBYTE I_1 1 2 0 255 ECU_ADDRESS 0x70006DF5 /end MEASUREMENT
/begin MEASUREMENT CCU6_u8P5VPowerMngStt "..." UBYTE I_1 1 2 0 255 ECU_ADDRESS 0x70006DF4 /end MEASUREMENT
/begin MEASUREMENT CCU6_u8P5VSelfTstTimCnt "..." UBYTE I_1 1 2 0 255 ECU_ADDRESS 0x70006DF3 /end MEASUREMENT
/begin MEASUREMENT CCU6_u8PreTestStep "..." UBYTE I_1 1 2 0 255 ECU_ADDRESS 0x70006DF1 /end MEASUREMENT
/begin MEASUREMENT CCU6_u8PwmState "CCU6 State" UBYTE I_1 1 2 0 255 ECU_ADDRESS 0x70006DF0 /end MEASUREMENT
/begin MEASUREMENT CalUsr_bIsCalibUpdEna "Check whether OC enabled" UBYTE Bool_ON_OFF 1 2 0 1 BIT_MASK 0x01 ECU_ADDRESS 0x70006C04 /end MEASUREMENT
/begin MEASUREMENT CalUsr_u32ChkDataCrc "." ULONG I_1 1 2 0 4294967295 ECU_ADDRESS 0x70006C00 /end MEASUREMENT
/begin MEASUREMENT CalUsr_u32POCalibDnEnaMskA "." ULONG I_1 1 2 0 4294967295 ECU_ADDRESS 0x70006BFC /end MEASUREMENT
/begin MEASUREMENT CalUsr_u32POCalibDnEnaMskB "." ULONG I_1 1 2 0 4294967295 ECU_ADDRESS 0x70006BF8 /end MEASUREMENT
/begin MEASUREMENT CalUsr_u32PODataCRC "." ULONG I_1 1 2 0 4294967295 ECU_ADDRESS 0x70006BF4 /end MEASUREMENT
/begin MEASUREMENT DEVHAL_bIsInitialized "DEVHAL_bIsInitialized" UBYTE Bool_ON_OFF 1 2 0 1 BIT_MASK 0x01 ECU_ADDRESS 0x7000968C /end MEASUREMENT
/begin MEASUREMENT DEVHAL_u8CheckEngineState "DEVHAL_u8CheckEngineState" UBYTE I_1 1 2 0 255 ECU_ADDRESS 0x7000968B /end MEASUREMENT
/begin MEASUREMENT DFApp_u8DflashMainState "..." UBYTE I_1 1 2 0 255 ECU_ADDRESS 0x7000969D /end MEASUREMENT
/begin MEASUREMENT DSM_DtcNumber "DSM_DtcNumber" ULONG I_1 1 2 0 4294967295 MATRIX_DIM 10 1 1 ECU_ADDRESS 0x700096E8 /end MEASUREMENT
/begin MEASUREMENT DSM_DtcNumber[0] "DSM_DtcNumber[0]" ULONG I_1 1 2 0 4294967295 ECU_ADDRESS 0x700096E8 /end MEASUREMENT
/begin MEASUREMENT DSM_DtcNumber[1] "DSM_DtcNumber[1]" ULONG I_1 1 2 0 4294967295 ECU_ADDRESS 0x700096EC /end MEASUREMENT
/begin MEASUREMENT DSM_DtcNumber[2] "DSM_DtcNumber[2]" ULONG I_1 1 2 0 4294967295 ECU_ADDRESS 0x700096F0 /end MEASUREMENT
/begin MEASUREMENT DSM_DtcNumber[3] "DSM_DtcNumber[3]" ULONG I_1 1 2 0 4294967295 ECU_ADDRESS 0x700096F4 /end MEASUREMENT
/begin MEASUREMENT DSM_DtcNumber[4] "DSM_DtcNumber[4]" ULONG I_1 1 2 0 4294967295 ECU_ADDRESS 0x700096F8 /end MEASUREMENT
/begin MEASUREMENT DSM_DtcNumber[5] "DSM_DtcNumber[5]" ULONG I_1 1 2 0 4294967295 ECU_ADDRESS 0x700096FC /end MEASUREMENT
/begin MEASUREMENT DSM_DtcNumber[6] "DSM_DtcNumber[6]" ULONG I_1 1 2 0 4294967295 ECU_ADDRESS 0x70009700 /end MEASUREMENT
/begin MEASUREMENT DSM_DtcNumber[7] "DSM_DtcNumber[7]" ULONG I_1 1 2 0 4294967295 ECU_ADDRESS 0x70009704 /end MEASUREMENT
/begin MEASUREMENT DSM_DtcNumber[8] "DSM_DtcNumber[8]" ULONG I_1 1 2 0 4294967295 ECU_ADDRESS 0x70009708 /end MEASUREMENT
/begin MEASUREMENT DSM_DtcNumber[9] "DSM_DtcNumber[9]" ULONG I_1 1 2 0 4294967295 ECU_ADDRESS 0x7000970C /end MEASUREMENT
/begin MEASUREMENT DSM_DtcStatusNvm "DID 120 -> DTC Setting Control" UBYTE F_1_p0_4 1 2 0 255 MATRIX_DIM 10 1 1 ECU_ADDRESS 0x70009FF8 /end MEASUREMENT
/begin MEASUREMENT DSM_DtcStatusNvm[0] "DSM_DtcStatusNvm[0]" UBYTE F_1_p0_4 1 2 0 255 ECU_ADDRESS 0x70009FF8 /end MEASUREMENT
/begin MEASUREMENT DSM_DtcStatusNvm[1] "DSM_DtcStatusNvm[1]" UBYTE F_1_p0_4 1 2 0 255 ECU_ADDRESS 0x70009FF9 /end MEASUREMENT
/begin MEASUREMENT DSM_DtcStatusNvm[2] "DSM_DtcStatusNvm[2]" UBYTE F_1_p0_4 1 2 0 255 ECU_ADDRESS 0x70009FFA /end MEASUREMENT
/begin MEASUREMENT DSM_DtcStatusNvm[3] "DSM_DtcStatusNvm[3]" UBYTE F_1_p0_4 1 2 0 255 ECU_ADDRESS 0x70009FFB /end MEASUREMENT
/begin MEASUREMENT DSM_DtcStatusNvm[4] "DSM_DtcStatusNvm[4]" UBYTE F_1_p0_4 1 2 0 255 ECU_ADDRESS 0x70009FFC /end MEASUREMENT
/begin MEASUREMENT DSM_DtcStatusNvm[5] "DSM_DtcStatusNvm[5]" UBYTE F_1_p0_4 1 2 0 255 ECU_ADDRESS 0x70009FFD /end MEASUREMENT
/begin MEASUREMENT DSM_DtcStatusNvm[6] "DSM_DtcStatusNvm[6]" UBYTE F_1_p0_4 1 2 0 255 ECU_ADDRESS 0x70009FFE /end MEASUREMENT
/begin MEASUREMENT DSM_DtcStatusNvm[7] "DSM_DtcStatusNvm[7]" UBYTE F_1_p0_4 1 2 0 255 ECU_ADDRESS 0x70009FFF /end MEASUREMENT
/begin MEASUREMENT DSM_DtcStatusNvm[8] "DSM_DtcStatusNvm[8]" UBYTE F_1_p0_4 1 2 0 255 ECU_ADDRESS 0x7000A000 /end MEASUREMENT
/begin MEASUREMENT DSM_DtcStatusNvm[9] "DSM_DtcStatusNvm[9]" UBYTE F_1_p0_4 1 2 0 255 ECU_ADDRESS 0x7000A001 /end MEASUREMENT
/begin MEASUREMENT ESM_EcuState "ESM_EcuState" UBYTE I_1 1 2 0 255 ECU_ADDRESS 0x7000A0BE /end MEASUREMENT
/begin MEASUREMENT ESM_OPERATIONAL_MODE "ESM_OPERATIONAL_MODE" UBYTE Bool_ON_OFF 1 2 0 1 BIT_MASK 0x04 ECU_ADDRESS 0x7000A0BE /end MEASUREMENT
/begin MEASUREMENT ESM_POWERLATCH_MODE "ESM_POWERLATCH_MODE" UBYTE Bool_ON_OFF 1 2 0 1 BIT_MASK 0x08 ECU_ADDRESS 0x7000A0BE /end MEASUREMENT
/begin MEASUREMENT ESM_POWER_OFF_MODE "ESM_POWER_OFF_MODE" UBYTE Bool_ON_OFF 1 2 0 1 BIT_MASK 0x10 ECU_ADDRESS 0x7000A0BE /end MEASUREMENT
/begin MEASUREMENT ESM_STARTUP_II_MODE "ESM_STARTUP_II_MODE" UBYTE Bool_ON_OFF 1 2 0 1 BIT_MASK 0x02 ECU_ADDRESS 0x7000A0BE /end MEASUREMENT
/begin MEASUREMENT ESM_STARTUP_I_MODE "ESM_STARTUP_I_MODE" UBYTE Bool_ON_OFF 1 2 0 1 BIT_MASK 0x01 ECU_ADDRESS 0x7000A0BE /end MEASUREMENT
/begin MEASUREMENT ESM_u16PowerLatchTempo "ESM_u16PowerLatchTempo" UWORD F_5_p0_28 1 2 0 327675 ECU_ADDRESS 0x7000A0BC /end MEASUREMENT
/begin MEASUREMENT FAIL_bCanErrChkDisabled "Indicates if CAN error check is disabled" UBYTE Bool_ON_OFF 1 2 0 1 BIT_MASK 0x01 ECU_ADDRESS 0x7000A0E2 /end MEASUREMENT
/begin MEASUREMENT FAIL_bComLostDiagTEna "Indicates if external CAN communication started" UBYTE Bool_ON_OFF 1 2 0 1 BIT_MASK 0x01 ECU_ADDRESS 0x7000A0E1 /end MEASUREMENT
/begin MEASUREMENT FAIL_bComLostDiagVEna "Indicates if external CAN communication started" UBYTE Bool_ON_OFF 1 2 0 1 BIT_MASK 0x01 ECU_ADDRESS 0x7000A0E0 /end MEASUREMENT
/begin MEASUREMENT FAIL_bComLostDiagVHigh "Indicates if external CAN communication started" UBYTE Bool_ON_OFF 1 2 0 1 BIT_MASK 0x01 ECU_ADDRESS 0x7000A0DF /end MEASUREMENT
/begin MEASUREMENT FAIL_bComLostDiagVLow "Indicates if external CAN communication started" UBYTE Bool_ON_OFF 1 2 0 1 BIT_MASK 0x01 ECU_ADDRESS 0x7000A0DE /end MEASUREMENT
/begin MEASUREMENT FAIL_bDebug1 "FAIL_bDebug1" UBYTE Bool_ON_OFF 1 2 0 1 BIT_MASK 0x01 ECU_ADDRESS 0x7000A0DD /end MEASUREMENT
/begin MEASUREMENT FAIL_bRstHotFlag "Detection power off without OS TASK_POWER_DOWN activation" UBYTE Bool_ON_OFF 1 2 0 1 BIT_MASK 0x01 ECU_ADDRESS 0x7000A0DC /end MEASUREMENT
/begin MEASUREMENT FAIL_bRstHotFlagNvm "Flag to detect power off without OS TASK_POWER_DOWN activation (stored into NVM)" UBYTE Bool_ON_OFF 1 2 0 1 BIT_MASK 0x01 ECU_ADDRESS 0x7000A0F4 /end MEASUREMENT
/begin MEASUREMENT FAIL_bRstHotFlagNvm_def "Flag to detect power off without OS TASK_POWER_DOWN activation (stored into NVM)" UBYTE Bool_ON_OFF 1 2 0 1 BIT_MASK 0x01 ECU_ADDRESS 0xD0000008 /end MEASUREMENT
/begin MEASUREMENT FAIL_u16ComLostDiagEnaCnt "ECU communication lost detection delay count" UWORD F_10_p0_6 1 2 0 655350 ECU_ADDRESS 0x7000A0D8 /end MEASUREMENT
/begin MEASUREMENT FAIL_u16ComLostDiagVRecCnt "ECU communication lost detection delay count" UWORD F_10_p0_6 1 2 0 655350 ECU_ADDRESS 0x7000A0D6 /end MEASUREMENT
/begin MEASUREMENT FAIL_u16KeyOnDelay "..." UWORD Id_0x00 1 2 0 65535 ECU_ADDRESS 0x7000A0D4 /end MEASUREMENT
/begin MEASUREMENT FAIL_u16KeyOnValue "ECU communication lost detection delay count" UWORD I_1 1 2 0 65535 ECU_ADDRESS 0x7000A0D2 /end MEASUREMENT
/begin MEASUREMENT FAIL_u16LvBatVoltRaw "ECU communication lost detection delay count" UWORD F_0v006959707_p0_29 1 2 0 456.1043956 ECU_ADDRESS 0x7000A0D0 /end MEASUREMENT
/begin MEASUREMENT FAIL_u16RstHotCntNvm "Number of detection power off without OS TASK_POWER_DOWN activation (stored into NVM)" UWORD I_1 1 2 0 65535 ECU_ADDRESS 0x7000A0F6 /end MEASUREMENT
/begin MEASUREMENT FAIL_u16RstHotCntNvm_def "Number of detection power off without OS TASK_POWER_DOWN activation (stored into NVM)" UWORD I_1 1 2 0 65535 ECU_ADDRESS 0xD000000A /end MEASUREMENT
/begin MEASUREMENT FAIL_u16RstStartUpCntNvm "Number of power off detected with OS TASK_POWER_DOWN activation (stored into NVM)" UWORD I_1 1 2 0 65535 ECU_ADDRESS 0x7000A0F8 /end MEASUREMENT
/begin MEASUREMENT FAIL_u16RstStartUpCntNvm_def "Number of power off detected with OS TASK_POWER_DOWN activation (stored into NVM)" UWORD I_1 1 2 0 65535 ECU_ADDRESS 0xD000000C /end MEASUREMENT
/begin MEASUREMENT FAIL_u16TimestampIgnNvm "Inverter Ignition time stamp (s)" UWORD I_1 1 2 0 65535 ECU_ADDRESS 0x7000A0E4 /end MEASUREMENT
/begin MEASUREMENT FAIL_u16TimestampIgnNvm_def "Inverter Ignition time stamp (s)" UWORD I_1 1 2 0 65535 ECU_ADDRESS 0xD0000000 /end MEASUREMENT
/begin MEASUREMENT FAIL_u32TimestampLifeNvm "Inverter life time stamp (s)" ULONG I_1 1 2 0 4294967295 ECU_ADDRESS 0x7000A0E8 /end MEASUREMENT
/begin MEASUREMENT FAIL_u32TimestampLifeNvm_def "Inverter life time stamp (s)" ULONG I_1 1 2 0 4294967295 ECU_ADDRESS 0xD0000004 /end MEASUREMENT
/begin MEASUREMENT FAIL_u8CCP_FaultLevel "..." UBYTE I_1 1 2 0 255 ECU_ADDRESS 0x7000A0DA /end MEASUREMENT
/begin MEASUREMENT FaultBSW_COM_BusOff_CAN1Aut "FaultBSW_COM_BusOff_CAN1Aut" UBYTE Bool_ON_OFF 1 2 0 1 BIT_MASK 0x01 ECU_ADDRESS 0x7000A144 /end MEASUREMENT
/begin MEASUREMENT FaultBSW_COM_BusOff_CAN1Detected "FaultBSW_COM_BusOff_CAN1Detected" UBYTE Bool_ON_OFF 1 2 0 1 BIT_MASK 0x01 ECU_ADDRESS 0x7000A1BC /end MEASUREMENT
/begin MEASUREMENT FaultBSW_COM_BusOff_CAN1Logged "FaultBSW_COM_BusOff_CAN1Logged" UBYTE Bool_ON_OFF 1 2 0 1 BIT_MASK 0x01 ECU_ADDRESS 0x7000A180 /end MEASUREMENT
/begin MEASUREMENT FaultBSW_COM_ChecksumErrVCUAut "FaultBSW_COM_ChecksumErrVCUAut" UBYTE Bool_ON_OFF 1 2 0 1 BIT_MASK 0x02 ECU_ADDRESS 0x7000A144 /end MEASUREMENT
/begin MEASUREMENT FaultBSW_COM_ChecksumErrVCUDetected "FaultBSW_COM_ChecksumErrVCUDetected" UBYTE Bool_ON_OFF 1 2 0 1 BIT_MASK 0x02 ECU_ADDRESS 0x7000A1BC /end MEASUREMENT
/begin MEASUREMENT FaultBSW_COM_ChecksumErrVCULogged "FaultBSW_COM_ChecksumErrVCULogged" UBYTE Bool_ON_OFF 1 2 0 1 BIT_MASK 0x02 ECU_ADDRESS 0x7000A180 /end MEASUREMENT
/begin MEASUREMENT FaultBSW_COM_Detected "FaultBSW_COM_Detected" UWORD I_1 1 2 0 65535 ECU_ADDRESS 0x7000A1BC /end MEASUREMENT
/begin MEASUREMENT FaultBSW_COM_InterFaultVCUAut "FaultBSW_COM_InterFaultVCUAut" UBYTE Bool_ON_OFF 1 2 0 1 BIT_MASK 0x04 ECU_ADDRESS 0x7000A144 /end MEASUREMENT
/begin MEASUREMENT FaultBSW_COM_InterFaultVCUDetected "FaultBSW_COM_InterFaultVCUDetected" UBYTE Bool_ON_OFF 1 2 0 1 BIT_MASK 0x04 ECU_ADDRESS 0x7000A1BC /end MEASUREMENT
/begin MEASUREMENT FaultBSW_COM_InterFaultVCULogged "FaultBSW_COM_InterFaultVCULogged" UBYTE Bool_ON_OFF 1 2 0 1 BIT_MASK 0x04 ECU_ADDRESS 0x7000A180 /end MEASUREMENT
/begin MEASUREMENT FaultBSW_COM_Logged "FaultBSW_COM_Logged" UWORD I_1 1 2 0 65535 ECU_ADDRESS 0x7000A180 /end MEASUREMENT
/begin MEASUREMENT FaultBSW_COM_RollCntErrVCUAut "FaultBSW_COM_RollCntErrVCUAut" UBYTE Bool_ON_OFF 1 2 0 1 BIT_MASK 0x08 ECU_ADDRESS 0x7000A144 /end MEASUREMENT
/begin MEASUREMENT FaultBSW_COM_RollCntErrVCUDetected "FaultBSW_COM_RollCntErrVCUDetected" UBYTE Bool_ON_OFF 1 2 0 1 BIT_MASK 0x08 ECU_ADDRESS 0x7000A1BC /end MEASUREMENT
/begin MEASUREMENT FaultBSW_COM_RollCntErrVCULogged "FaultBSW_COM_RollCntErrVCULogged" UBYTE Bool_ON_OFF 1 2 0 1 BIT_MASK 0x08 ECU_ADDRESS 0x7000A180 /end MEASUREMENT
/begin MEASUREMENT FaultBSW_COM_TimoutRxBCMAut "FaultBSW_COM_TimoutRxBCMAut" UBYTE Bool_ON_OFF 1 2 0 1 BIT_MASK 0x10 ECU_ADDRESS 0x7000A144 /end MEASUREMENT
/begin MEASUREMENT FaultBSW_COM_TimoutRxBCMDetected "FaultBSW_COM_TimoutRxBCMDetected" UBYTE Bool_ON_OFF 1 2 0 1 BIT_MASK 0x10 ECU_ADDRESS 0x7000A1BC /end MEASUREMENT
/begin MEASUREMENT FaultBSW_COM_TimoutRxBCMLogged "FaultBSW_COM_TimoutRxBCMLogged" UBYTE Bool_ON_OFF 1 2 0 1 BIT_MASK 0x10 ECU_ADDRESS 0x7000A180 /end MEASUREMENT
/begin MEASUREMENT FaultBSW_COM_TimoutRxBMSHAut "FaultBSW_COM_TimoutRxBMSHAut" UBYTE Bool_ON_OFF 1 2 0 1 BIT_MASK 0x20 ECU_ADDRESS 0x7000A144 /end MEASUREMENT
/begin MEASUREMENT FaultBSW_COM_TimoutRxBMSHDetected "FaultBSW_COM_TimoutRxBMSHDetected" UBYTE Bool_ON_OFF 1 2 0 1 BIT_MASK 0x20 ECU_ADDRESS 0x7000A1BC /end MEASUREMENT
/begin MEASUREMENT FaultBSW_COM_TimoutRxBMSHLogged "FaultBSW_COM_TimoutRxBMSHLogged" UBYTE Bool_ON_OFF 1 2 0 1 BIT_MASK 0x20 ECU_ADDRESS 0x7000A180 /end MEASUREMENT
/begin MEASUREMENT FaultBSW_COM_TimoutRxEMSAut "FaultBSW_COM_TimoutRxEMSAut" UBYTE Bool_ON_OFF 1 2 0 1 BIT_MASK 0x40 ECU_ADDRESS 0x7000A144 /end MEASUREMENT
/begin MEASUREMENT FaultBSW_COM_TimoutRxEMSDetected "FaultBSW_COM_TimoutRxEMSDetected" UBYTE Bool_ON_OFF 1 2 0 1 BIT_MASK 0x40 ECU_ADDRESS 0x7000A1BC /end MEASUREMENT
/begin MEASUREMENT FaultBSW_COM_TimoutRxEMSLogged "FaultBSW_COM_TimoutRxEMSLogged" UBYTE Bool_ON_OFF 1 2 0 1 BIT_MASK 0x40 ECU_ADDRESS 0x7000A180 /end MEASUREMENT
/begin MEASUREMENT FaultBSW_COM_TimoutRxGCUAut "FaultBSW_COM_TimoutRxGCUAut" UBYTE Bool_ON_OFF 1 2 0 1 BIT_MASK 0x80 ECU_ADDRESS 0x7000A144 /end MEASUREMENT
/begin MEASUREMENT FaultBSW_COM_TimoutRxGCUDetected "FaultBSW_COM_TimoutRxGCUDetected" UBYTE Bool_ON_OFF 1 2 0 1 BIT_MASK 0x80 ECU_ADDRESS 0x7000A1BC /end MEASUREMENT
/begin MEASUREMENT FaultBSW_COM_TimoutRxGCULogged "FaultBSW_COM_TimoutRxGCULogged" UBYTE Bool_ON_OFF 1 2 0 1 BIT_MASK 0x80 ECU_ADDRESS 0x7000A180 /end MEASUREMENT
/begin MEASUREMENT FaultBSW_COM_TimoutRxIPCAut "FaultBSW_COM_TimoutRxIPCAut" UBYTE Bool_ON_OFF 1 2 0 1 BIT_MASK 0x01 ECU_ADDRESS 0x7000A145 /end MEASUREMENT
/begin MEASUREMENT FaultBSW_COM_TimoutRxIPCDetected "FaultBSW_COM_TimoutRxIPCDetected" UBYTE Bool_ON_OFF 1 2 0 1 BIT_MASK 0x01 ECU_ADDRESS 0x7000A1BD /end MEASUREMENT
/begin MEASUREMENT FaultBSW_COM_TimoutRxIPCLogged "FaultBSW_COM_TimoutRxIPCLogged" UBYTE Bool_ON_OFF 1 2 0 1 BIT_MASK 0x01 ECU_ADDRESS 0x7000A181 /end MEASUREMENT
/begin MEASUREMENT FaultBSW_COM_TimoutRxTBOXAut "FaultBSW_COM_TimoutRxTBOXAut" UBYTE Bool_ON_OFF 1 2 0 1 BIT_MASK 0x02 ECU_ADDRESS 0x7000A145 /end MEASUREMENT
/begin MEASUREMENT FaultBSW_COM_TimoutRxTBOXDetected "FaultBSW_COM_TimoutRxTBOXDetected" UBYTE Bool_ON_OFF 1 2 0 1 BIT_MASK 0x02 ECU_ADDRESS 0x7000A1BD /end MEASUREMENT
/begin MEASUREMENT FaultBSW_COM_TimoutRxTBOXLogged "FaultBSW_COM_TimoutRxTBOXLogged" UBYTE Bool_ON_OFF 1 2 0 1 BIT_MASK 0x02 ECU_ADDRESS 0x7000A181 /end MEASUREMENT
/begin MEASUREMENT FaultBSW_COM_TimoutRxVCUAut "FaultBSW_COM_TimoutRxVCUAut" UBYTE Bool_ON_OFF 1 2 0 1 BIT_MASK 0x04 ECU_ADDRESS 0x7000A145 /end MEASUREMENT
/begin MEASUREMENT FaultBSW_COM_TimoutRxVCUDetected "FaultBSW_COM_TimoutRxVCUDetected" UBYTE Bool_ON_OFF 1 2 0 1 BIT_MASK 0x04 ECU_ADDRESS 0x7000A1BD /end MEASUREMENT
/begin MEASUREMENT FaultBSW_COM_TimoutRxVCULogged "FaultBSW_COM_TimoutRxVCULogged" UBYTE Bool_ON_OFF 1 2 0 1 BIT_MASK 0x04 ECU_ADDRESS 0x7000A181 /end MEASUREMENT
/begin MEASUREMENT FaultBSW_HW2_Detected "FaultBSW_HW2_Detected" UWORD I_1 1 2 0 65535 ECU_ADDRESS 0x7000A1BE /end MEASUREMENT
/begin MEASUREMENT FaultBSW_HW2_FPGA_OverVoltVBatAut "FaultBSW_HW2_FPGA_OverVoltVBatAut" UBYTE Bool_ON_OFF 1 2 0 1 BIT_MASK 0x01 ECU_ADDRESS 0x7000A146 /end MEASUREMENT
/begin MEASUREMENT FaultBSW_HW2_FPGA_OverVoltVBatDetected "FaultBSW_HW2_FPGA_OverVoltVBatDetected" UBYTE Bool_ON_OFF 1 2 0 1 BIT_MASK 0x01 ECU_ADDRESS 0x7000A1BE /end MEASUREMENT
/begin MEASUREMENT FaultBSW_HW2_FPGA_OverVoltVBatLogged "FaultBSW_HW2_FPGA_OverVoltVBatLogged" UBYTE Bool_ON_OFF 1 2 0 1 BIT_MASK 0x01 ECU_ADDRESS 0x7000A182 /end MEASUREMENT
/begin MEASUREMENT FaultBSW_HW2_Logged "FaultBSW_HW2_Logged" UWORD I_1 1 2 0 65535 ECU_ADDRESS 0x7000A182 /end MEASUREMENT
/begin MEASUREMENT FaultBSW_HW2_SafeTlib_PreRunAut "FaultBSW_HW2_SafeTlib_PreRunAut" UBYTE Bool_ON_OFF 1 2 0 1 BIT_MASK 0x02 ECU_ADDRESS 0x7000A146 /end MEASUREMENT
/begin MEASUREMENT FaultBSW_HW2_SafeTlib_PreRunDetected "FaultBSW_HW2_SafeTlib_PreRunDetected" UBYTE Bool_ON_OFF 1 2 0 1 BIT_MASK 0x02 ECU_ADDRESS 0x7000A1BE /end MEASUREMENT
/begin MEASUREMENT FaultBSW_HW2_SafeTlib_PreRunLogged "FaultBSW_HW2_SafeTlib_PreRunLogged" UBYTE Bool_ON_OFF 1 2 0 1 BIT_MASK 0x02 ECU_ADDRESS 0x7000A182 /end MEASUREMENT
/begin MEASUREMENT FaultBSW_HW_Detected "FaultBSW_HW_Detected" UWORD I_1 1 2 0 65535 ECU_ADDRESS 0x7000A1C0 /end MEASUREMENT
/begin MEASUREMENT FaultBSW_HW_EasAckFailAut "FaultBSW_HW_EasAckFailAut" UBYTE Bool_ON_OFF 1 2 0 1 BIT_MASK 0x01 ECU_ADDRESS 0x7000A148 /end MEASUREMENT
/begin MEASUREMENT FaultBSW_HW_EasAckFailDetected "FaultBSW_HW_EasAckFailDetected" UBYTE Bool_ON_OFF 1 2 0 1 BIT_MASK 0x01 ECU_ADDRESS 0x7000A1C0 /end MEASUREMENT
/begin MEASUREMENT FaultBSW_HW_EasAckFailLogged "FaultBSW_HW_EasAckFailLogged" UBYTE Bool_ON_OFF 1 2 0 1 BIT_MASK 0x01 ECU_ADDRESS 0x7000A184 /end MEASUREMENT
/begin MEASUREMENT FaultBSW_HW_FPGA_IGBT_HAut "FaultBSW_HW_FPGA_IGBT_HAut" UBYTE Bool_ON_OFF 1 2 0 1 BIT_MASK 0x02 ECU_ADDRESS 0x7000A148 /end MEASUREMENT
/begin MEASUREMENT FaultBSW_HW_FPGA_IGBT_HDetected "FaultBSW_HW_FPGA_IGBT_HDetected" UBYTE Bool_ON_OFF 1 2 0 1 BIT_MASK 0x02 ECU_ADDRESS 0x7000A1C0 /end MEASUREMENT
/begin MEASUREMENT FaultBSW_HW_FPGA_IGBT_HLogged "FaultBSW_HW_FPGA_IGBT_HLogged" UBYTE Bool_ON_OFF 1 2 0 1 BIT_MASK 0x02 ECU_ADDRESS 0x7000A184 /end MEASUREMENT
/begin MEASUREMENT FaultBSW_HW_FPGA_IGBT_LAut "FaultBSW_HW_FPGA_IGBT_LAut" UBYTE Bool_ON_OFF 1 2 0 1 BIT_MASK 0x04 ECU_ADDRESS 0x7000A148 /end MEASUREMENT
/begin MEASUREMENT FaultBSW_HW_FPGA_IGBT_LDetected "FaultBSW_HW_FPGA_IGBT_LDetected" UBYTE Bool_ON_OFF 1 2 0 1 BIT_MASK 0x04 ECU_ADDRESS 0x7000A1C0 /end MEASUREMENT
/begin MEASUREMENT FaultBSW_HW_FPGA_IGBT_LLogged "FaultBSW_HW_FPGA_IGBT_LLogged" UBYTE Bool_ON_OFF 1 2 0 1 BIT_MASK 0x04 ECU_ADDRESS 0x7000A184 /end MEASUREMENT
/begin MEASUREMENT FaultBSW_HW_FPGA_OverUnderCurUIAut "FaultBSW_HW_FPGA_OverUnderCurUIAut" UBYTE Bool_ON_OFF 1 2 0 1 BIT_MASK 0x08 ECU_ADDRESS 0x7000A148 /end MEASUREMENT
/begin MEASUREMENT FaultBSW_HW_FPGA_OverUnderCurUIDetected "FaultBSW_HW_FPGA_OverUnderCurUIDetected" UBYTE Bool_ON_OFF 1 2 0 1 BIT_MASK 0x08 ECU_ADDRESS 0x7000A1C0 /end MEASUREMENT
/begin MEASUREMENT FaultBSW_HW_FPGA_OverUnderCurUILogged "FaultBSW_HW_FPGA_OverUnderCurUILogged" UBYTE Bool_ON_OFF 1 2 0 1 BIT_MASK 0x08 ECU_ADDRESS 0x7000A184 /end MEASUREMENT
/begin MEASUREMENT FaultBSW_HW_FPGA_OverUnderCurVIAut "FaultBSW_HW_FPGA_OverUnderCurVIAut" UBYTE Bool_ON_OFF 1 2 0 1 BIT_MASK 0x10 ECU_ADDRESS 0x7000A148 /end MEASUREMENT
/begin MEASUREMENT FaultBSW_HW_FPGA_OverUnderCurVIDetected "FaultBSW_HW_FPGA_OverUnderCurVIDetected" UBYTE Bool_ON_OFF 1 2 0 1 BIT_MASK 0x10 ECU_ADDRESS 0x7000A1C0 /end MEASUREMENT
/begin MEASUREMENT FaultBSW_HW_FPGA_OverUnderCurVILogged "FaultBSW_HW_FPGA_OverUnderCurVILogged" UBYTE Bool_ON_OFF 1 2 0 1 BIT_MASK 0x10 ECU_ADDRESS 0x7000A184 /end MEASUREMENT
/begin MEASUREMENT FaultBSW_HW_FPGA_OverUnderCurWIAut "FaultBSW_HW_FPGA_OverUnderCurWIAut" UBYTE Bool_ON_OFF 1 2 0 1 BIT_MASK 0x20 ECU_ADDRESS 0x7000A148 /end MEASUREMENT
/begin MEASUREMENT FaultBSW_HW_FPGA_OverUnderCurWIDetected "FaultBSW_HW_FPGA_OverUnderCurWIDetected" UBYTE Bool_ON_OFF 1 2 0 1 BIT_MASK 0x20 ECU_ADDRESS 0x7000A1C0 /end MEASUREMENT
/begin MEASUREMENT FaultBSW_HW_FPGA_OverUnderCurWILogged "FaultBSW_HW_FPGA_OverUnderCurWILogged" UBYTE Bool_ON_OFF 1 2 0 1 BIT_MASK 0x20 ECU_ADDRESS 0x7000A184 /end MEASUREMENT
/begin MEASUREMENT FaultBSW_HW_Logged "FaultBSW_HW_Logged" UWORD I_1 1 2 0 65535 ECU_ADDRESS 0x7000A184 /end MEASUREMENT
/begin MEASUREMENT FaultBSW_HW_OCDataNotRationalAut "FaultBSW_HW_OCDataNotRationalAut" UBYTE Bool_ON_OFF 1 2 0 1 BIT_MASK 0x40 ECU_ADDRESS 0x7000A148 /end MEASUREMENT
/begin MEASUREMENT FaultBSW_HW_OCDataNotRationalDetected "FaultBSW_HW_OCDataNotRationalDetected" UBYTE Bool_ON_OFF 1 2 0 1 BIT_MASK 0x40 ECU_ADDRESS 0x7000A1C0 /end MEASUREMENT
/begin MEASUREMENT FaultBSW_HW_OCDataNotRationalLogged "FaultBSW_HW_OCDataNotRationalLogged" UBYTE Bool_ON_OFF 1 2 0 1 BIT_MASK 0x40 ECU_ADDRESS 0x7000A184 /end MEASUREMENT
/begin MEASUREMENT FaultBSW_SYS_Detected "FaultBSW_SYS_Detected" UWORD I_1 1 2 0 65535 ECU_ADDRESS 0x7000A1C2 /end MEASUREMENT
/begin MEASUREMENT FaultBSW_SYS_Logged "FaultBSW_SYS_Logged" UWORD I_1 1 2 0 65535 ECU_ADDRESS 0x7000A186 /end MEASUREMENT
/begin MEASUREMENT FaultBSW_SYS_RstHotAut "FaultBSW_SYS_RstHotAut" UBYTE Bool_ON_OFF 1 2 0 1 BIT_MASK 0x01 ECU_ADDRESS 0x7000A14A /end MEASUREMENT
/begin MEASUREMENT FaultBSW_SYS_RstHotDetected "FaultBSW_SYS_RstHotDetected" UBYTE Bool_ON_OFF 1 2 0 1 BIT_MASK 0x01 ECU_ADDRESS 0x7000A1C2 /end MEASUREMENT
/begin MEASUREMENT FaultBSW_SYS_RstHotLogged "FaultBSW_SYS_RstHotLogged" UBYTE Bool_ON_OFF 1 2 0 1 BIT_MASK 0x01 ECU_ADDRESS 0x7000A186 /end MEASUREMENT
/begin MEASUREMENT FaultBSW_SYS_StackOverflowAut "FaultBSW_SYS_StackOverflowAut" UBYTE Bool_ON_OFF 1 2 0 1 BIT_MASK 0x02 ECU_ADDRESS 0x7000A14A /end MEASUREMENT
/begin MEASUREMENT FaultBSW_SYS_StackOverflowDetected "FaultBSW_SYS_StackOverflowDetected" UBYTE Bool_ON_OFF 1 2 0 1 BIT_MASK 0x02 ECU_ADDRESS 0x7000A1C2 /end MEASUREMENT
/begin MEASUREMENT FaultBSW_SYS_StackOverflowLogged "FaultBSW_SYS_StackOverflowLogged" UBYTE Bool_ON_OFF 1 2 0 1 BIT_MASK 0x02 ECU_ADDRESS 0x7000A186 /end MEASUREMENT
/begin MEASUREMENT FaultBSW_VSI_Detected "FaultBSW_VSI_Detected" UWORD I_1 1 2 0 65535 ECU_ADDRESS 0x7000A1C4 /end MEASUREMENT
/begin MEASUREMENT FaultBSW_VSI_Logged "FaultBSW_VSI_Logged" UWORD I_1 1 2 0 65535 ECU_ADDRESS 0x7000A188 /end MEASUREMENT
/begin MEASUREMENT FaultBSW_VSI_TimeoutTCalcAut "FaultBSW_VSI_TimeoutTCalcAut" UBYTE Bool_ON_OFF 1 2 0 1 BIT_MASK 0x01 ECU_ADDRESS 0x7000A14C /end MEASUREMENT
/begin MEASUREMENT FaultBSW_VSI_TimeoutTCalcDetected "FaultBSW_VSI_TimeoutTCalcDetected" UBYTE Bool_ON_OFF 1 2 0 1 BIT_MASK 0x01 ECU_ADDRESS 0x7000A1C4 /end MEASUREMENT
/begin MEASUREMENT FaultBSW_VSI_TimeoutTCalcLogged "FaultBSW_VSI_TimeoutTCalcLogged" UBYTE Bool_ON_OFF 1 2 0 1 BIT_MASK 0x01 ECU_ADDRESS 0x7000A188 /end MEASUREMENT
/begin MEASUREMENT FaultEraseRequest "FaultEraseRequest" UWORD I_1 1 2 0 65535 ECU_ADDRESS 0x700096E4 /end MEASUREMENT
/begin MEASUREMENT FaultFSEVBHV_Detected "FaultFSEVBHV_Detected" UWORD I_1 1 2 0 65535 ECU_ADDRESS 0x7000A1C6 /end MEASUREMENT
/begin MEASUREMENT FaultFSEVBHV_Logged "FaultFSEVBHV_Logged" UWORD I_1 1 2 0 65535 ECU_ADDRESS 0x7000A18A /end MEASUREMENT
/begin MEASUREMENT FaultFSEVBHV_OverVoltageAut "FaultFSEVBHV_OverVoltageAut" UBYTE Bool_ON_OFF 1 2 0 1 BIT_MASK 0x01 ECU_ADDRESS 0x7000A14E /end MEASUREMENT
/begin MEASUREMENT FaultFSEVBHV_OverVoltageDetected "FaultFSEVBHV_OverVoltageDetected" UBYTE Bool_ON_OFF 1 2 0 1 BIT_MASK 0x01 ECU_ADDRESS 0x7000A1C6 /end MEASUREMENT
/begin MEASUREMENT FaultFSEVBHV_OverVoltageLogged "FaultFSEVBHV_OverVoltageLogged" UBYTE Bool_ON_OFF 1 2 0 1 BIT_MASK 0x01 ECU_ADDRESS 0x7000A18A /end MEASUREMENT
/begin MEASUREMENT FaultFSEVBHV_SampleVolOutRngHAut "FaultFSEVBHV_SampleVolOutRngHAut" UBYTE Bool_ON_OFF 1 2 0 1 BIT_MASK 0x02 ECU_ADDRESS 0x7000A14E /end MEASUREMENT
/begin MEASUREMENT FaultFSEVBHV_SampleVolOutRngHDetected "FaultFSEVBHV_SampleVolOutRngHDetected" UBYTE Bool_ON_OFF 1 2 0 1 BIT_MASK 0x02 ECU_ADDRESS 0x7000A1C6 /end MEASUREMENT
/begin MEASUREMENT FaultFSEVBHV_SampleVolOutRngHLogged "FaultFSEVBHV_SampleVolOutRngHLogged" UBYTE Bool_ON_OFF 1 2 0 1 BIT_MASK 0x02 ECU_ADDRESS 0x7000A18A /end MEASUREMENT
/begin MEASUREMENT FaultFSEVBHV_SampleVolOutRngLAut "FaultFSEVBHV_SampleVolOutRngLAut" UBYTE Bool_ON_OFF 1 2 0 1 BIT_MASK 0x04 ECU_ADDRESS 0x7000A14E /end MEASUREMENT
/begin MEASUREMENT FaultFSEVBHV_SampleVolOutRngLDetected "FaultFSEVBHV_SampleVolOutRngLDetected" UBYTE Bool_ON_OFF 1 2 0 1 BIT_MASK 0x04 ECU_ADDRESS 0x7000A1C6 /end MEASUREMENT
/begin MEASUREMENT FaultFSEVBHV_SampleVolOutRngLLogged "FaultFSEVBHV_SampleVolOutRngLLogged" UBYTE Bool_ON_OFF 1 2 0 1 BIT_MASK 0x04 ECU_ADDRESS 0x7000A18A /end MEASUREMENT
/begin MEASUREMENT FaultFSEVBHV_UnderDetected "FaultFSEVBHV_UnderDetected" UWORD I_1 1 2 0 65535 ECU_ADDRESS 0x7000A1C8 /end MEASUREMENT
/begin MEASUREMENT FaultFSEVBHV_UnderLogged "FaultFSEVBHV_UnderLogged" UWORD I_1 1 2 0 65535 ECU_ADDRESS 0x7000A18C /end MEASUREMENT
/begin MEASUREMENT FaultFSEVBHV_UnderVoltageAut "FaultFSEVBHV_UnderVoltageAut" UBYTE Bool_ON_OFF 1 2 0 1 BIT_MASK 0x08 ECU_ADDRESS 0x7000A14E /end MEASUREMENT
/begin MEASUREMENT FaultFSEVBHV_UnderVoltageDetected "FaultFSEVBHV_UnderVoltageDetected" UBYTE Bool_ON_OFF 1 2 0 1 BIT_MASK 0x08 ECU_ADDRESS 0x7000A1C6 /end MEASUREMENT
/begin MEASUREMENT FaultFSEVBHV_UnderVoltageLogged "FaultFSEVBHV_UnderVoltageLogged" UBYTE Bool_ON_OFF 1 2 0 1 BIT_MASK 0x08 ECU_ADDRESS 0x7000A18A /end MEASUREMENT
/begin MEASUREMENT FaultFSEVBHV_UnderVoltageWarnAut "FaultFSEVBHV_UnderVoltageWarnAut" UBYTE Bool_ON_OFF 1 2 0 1 BIT_MASK 0x01 ECU_ADDRESS 0x7000A150 /end MEASUREMENT
/begin MEASUREMENT FaultFSEVBHV_UnderVoltageWarnDetected "FaultFSEVBHV_UnderVoltageWarnDetected" UBYTE Bool_ON_OFF 1 2 0 1 BIT_MASK 0x01 ECU_ADDRESS 0x7000A1C8 /end MEASUREMENT
/begin MEASUREMENT FaultFSEVBHV_UnderVoltageWarnLogged "FaultFSEVBHV_UnderVoltageWarnLogged" UBYTE Bool_ON_OFF 1 2 0 1 BIT_MASK 0x01 ECU_ADDRESS 0x7000A18C /end MEASUREMENT
/begin MEASUREMENT FaultFSEVBHV_VolNotRationalAut "FaultFSEVBHV_VolNotRationalAut" UBYTE Bool_ON_OFF 1 2 0 1 BIT_MASK 0x10 ECU_ADDRESS 0x7000A14E /end MEASUREMENT
/begin MEASUREMENT FaultFSEVBHV_VolNotRationalDetected "FaultFSEVBHV_VolNotRationalDetected" UBYTE Bool_ON_OFF 1 2 0 1 BIT_MASK 0x10 ECU_ADDRESS 0x7000A1C6 /end MEASUREMENT
/begin MEASUREMENT FaultFSEVBHV_VolNotRationalLogged "FaultFSEVBHV_VolNotRationalLogged" UBYTE Bool_ON_OFF 1 2 0 1 BIT_MASK 0x10 ECU_ADDRESS 0x7000A18A /end MEASUREMENT
/begin MEASUREMENT FaultFSEVBHV_VoltageGndAut "FaultFSEVBHV_VoltageGndAut" UBYTE Bool_ON_OFF 1 2 0 1 BIT_MASK 0x20 ECU_ADDRESS 0x7000A14E /end MEASUREMENT
/begin MEASUREMENT FaultFSEVBHV_VoltageGndDetected "FaultFSEVBHV_VoltageGndDetected" UBYTE Bool_ON_OFF 1 2 0 1 BIT_MASK 0x20 ECU_ADDRESS 0x7000A1C6 /end MEASUREMENT
/begin MEASUREMENT FaultFSEVBHV_VoltageGndLogged "FaultFSEVBHV_VoltageGndLogged" UBYTE Bool_ON_OFF 1 2 0 1 BIT_MASK 0x20 ECU_ADDRESS 0x7000A18A /end MEASUREMENT
/begin MEASUREMENT FaultFSEVBHV_VoltageVccAut "FaultFSEVBHV_VoltageVccAut" UBYTE Bool_ON_OFF 1 2 0 1 BIT_MASK 0x40 ECU_ADDRESS 0x7000A14E /end MEASUREMENT
/begin MEASUREMENT FaultFSEVBHV_VoltageVccDetected "FaultFSEVBHV_VoltageVccDetected" UBYTE Bool_ON_OFF 1 2 0 1 BIT_MASK 0x40 ECU_ADDRESS 0x7000A1C6 /end MEASUREMENT
/begin MEASUREMENT FaultFSEVBHV_VoltageVccLogged "FaultFSEVBHV_VoltageVccLogged" UBYTE Bool_ON_OFF 1 2 0 1 BIT_MASK 0x40 ECU_ADDRESS 0x7000A18A /end MEASUREMENT
/begin MEASUREMENT FaultFSEVBLV_Detected "FaultFSEVBLV_Detected" UWORD I_1 1 2 0 65535 ECU_ADDRESS 0x7000A1CA /end MEASUREMENT
/begin MEASUREMENT FaultFSEVBLV_Logged "FaultFSEVBLV_Logged" UWORD I_1 1 2 0 65535 ECU_ADDRESS 0x7000A18E /end MEASUREMENT
/begin MEASUREMENT FaultFSEVBLV_OverVoltageAut "FaultFSEVBLV_OverVoltageAut" UBYTE Bool_ON_OFF 1 2 0 1 BIT_MASK 0x01 ECU_ADDRESS 0x7000A152 /end MEASUREMENT
/begin MEASUREMENT FaultFSEVBLV_OverVoltageDetected "FaultFSEVBLV_OverVoltageDetected" UBYTE Bool_ON_OFF 1 2 0 1 BIT_MASK 0x01 ECU_ADDRESS 0x7000A1CA /end MEASUREMENT
/begin MEASUREMENT FaultFSEVBLV_OverVoltageLogged "FaultFSEVBLV_OverVoltageLogged" UBYTE Bool_ON_OFF 1 2 0 1 BIT_MASK 0x01 ECU_ADDRESS 0x7000A18E /end MEASUREMENT
/begin MEASUREMENT FaultFSEVBLV_P5VRefADCFltAut "FaultFSEVBLV_P5VRefADCFltAut" UBYTE Bool_ON_OFF 1 2 0 1 BIT_MASK 0x02 ECU_ADDRESS 0x7000A152 /end MEASUREMENT
/begin MEASUREMENT FaultFSEVBLV_P5VRefADCFltDetected "FaultFSEVBLV_P5VRefADCFltDetected" UBYTE Bool_ON_OFF 1 2 0 1 BIT_MASK 0x02 ECU_ADDRESS 0x7000A1CA /end MEASUREMENT
/begin MEASUREMENT FaultFSEVBLV_P5VRefADCFltLogged "FaultFSEVBLV_P5VRefADCFltLogged" UBYTE Bool_ON_OFF 1 2 0 1 BIT_MASK 0x02 ECU_ADDRESS 0x7000A18E /end MEASUREMENT
/begin MEASUREMENT FaultFSEVBLV_UnderDetected "FaultFSEVBLV_UnderDetected" UWORD I_1 1 2 0 65535 ECU_ADDRESS 0x7000A1CC /end MEASUREMENT
/begin MEASUREMENT FaultFSEVBLV_UnderLogged "FaultFSEVBLV_UnderLogged" UWORD I_1 1 2 0 65535 ECU_ADDRESS 0x7000A190 /end MEASUREMENT
/begin MEASUREMENT FaultFSEVBLV_UnderVoltageAut "FaultFSEVBLV_UnderVoltageAut" UBYTE Bool_ON_OFF 1 2 0 1 BIT_MASK 0x04 ECU_ADDRESS 0x7000A152 /end MEASUREMENT
/begin MEASUREMENT FaultFSEVBLV_UnderVoltageDetected "FaultFSEVBLV_UnderVoltageDetected" UBYTE Bool_ON_OFF 1 2 0 1 BIT_MASK 0x04 ECU_ADDRESS 0x7000A1CA /end MEASUREMENT
/begin MEASUREMENT FaultFSEVBLV_UnderVoltageLogged "FaultFSEVBLV_UnderVoltageLogged" UBYTE Bool_ON_OFF 1 2 0 1 BIT_MASK 0x04 ECU_ADDRESS 0x7000A18E /end MEASUREMENT
/begin MEASUREMENT FaultFSEVBLV_UnderVoltageWarnAut "FaultFSEVBLV_UnderVoltageWarnAut" UBYTE Bool_ON_OFF 1 2 0 1 BIT_MASK 0x01 ECU_ADDRESS 0x7000A154 /end MEASUREMENT
/begin MEASUREMENT FaultFSEVBLV_UnderVoltageWarnDetected "FaultFSEVBLV_UnderVoltageWarnDetected" UBYTE Bool_ON_OFF 1 2 0 1 BIT_MASK 0x01 ECU_ADDRESS 0x7000A1CC /end MEASUREMENT
/begin MEASUREMENT FaultFSEVBLV_UnderVoltageWarnLogged "FaultFSEVBLV_UnderVoltageWarnLogged" UBYTE Bool_ON_OFF 1 2 0 1 BIT_MASK 0x01 ECU_ADDRESS 0x7000A190 /end MEASUREMENT
/begin MEASUREMENT FaultFSEVBLV_VoltageGndAut "FaultFSEVBLV_VoltageGndAut" UBYTE Bool_ON_OFF 1 2 0 1 BIT_MASK 0x08 ECU_ADDRESS 0x7000A152 /end MEASUREMENT
/begin MEASUREMENT FaultFSEVBLV_VoltageGndDetected "FaultFSEVBLV_VoltageGndDetected" UBYTE Bool_ON_OFF 1 2 0 1 BIT_MASK 0x08 ECU_ADDRESS 0x7000A1CA /end MEASUREMENT
/begin MEASUREMENT FaultFSEVBLV_VoltageGndLogged "FaultFSEVBLV_VoltageGndLogged" UBYTE Bool_ON_OFF 1 2 0 1 BIT_MASK 0x08 ECU_ADDRESS 0x7000A18E /end MEASUREMENT
/begin MEASUREMENT FaultFSEVBLV_VoltageVccAut "FaultFSEVBLV_VoltageVccAut" UBYTE Bool_ON_OFF 1 2 0 1 BIT_MASK 0x10 ECU_ADDRESS 0x7000A152 /end MEASUREMENT
/begin MEASUREMENT FaultFSEVBLV_VoltageVccDetected "FaultFSEVBLV_VoltageVccDetected" UBYTE Bool_ON_OFF 1 2 0 1 BIT_MASK 0x10 ECU_ADDRESS 0x7000A1CA /end MEASUREMENT
/begin MEASUREMENT FaultFSEVBLV_VoltageVccLogged "FaultFSEVBLV_VoltageVccLogged" UBYTE Bool_ON_OFF 1 2 0 1 BIT_MASK 0x10 ECU_ADDRESS 0x7000A18E /end MEASUREMENT
/begin MEASUREMENT FaultFSEVETA_Detected "FaultFSEVETA_Detected" UWORD I_1 1 2 0 65535 ECU_ADDRESS 0x7000A1CE /end MEASUREMENT
/begin MEASUREMENT FaultFSEVETA_DrvTempRationAut "FaultFSEVETA_DrvTempRationAut" UBYTE Bool_ON_OFF 1 2 0 1 BIT_MASK 0x01 ECU_ADDRESS 0x7000A156 /end MEASUREMENT
/begin MEASUREMENT FaultFSEVETA_DrvTempRationDetected "FaultFSEVETA_DrvTempRationDetected" UBYTE Bool_ON_OFF 1 2 0 1 BIT_MASK 0x01 ECU_ADDRESS 0x7000A1CE /end MEASUREMENT
/begin MEASUREMENT FaultFSEVETA_DrvTempRationLogged "FaultFSEVETA_DrvTempRationLogged" UBYTE Bool_ON_OFF 1 2 0 1 BIT_MASK 0x01 ECU_ADDRESS 0x7000A192 /end MEASUREMENT
/begin MEASUREMENT FaultFSEVETA_IgbtTempRationalAut "FaultFSEVETA_IgbtTempRationalAut" UBYTE Bool_ON_OFF 1 2 0 1 BIT_MASK 0x02 ECU_ADDRESS 0x7000A156 /end MEASUREMENT
/begin MEASUREMENT FaultFSEVETA_IgbtTempRationalDetected "FaultFSEVETA_IgbtTempRationalDetected" UBYTE Bool_ON_OFF 1 2 0 1 BIT_MASK 0x02 ECU_ADDRESS 0x7000A1CE /end MEASUREMENT
/begin MEASUREMENT FaultFSEVETA_IgbtTempRationalLogged "FaultFSEVETA_IgbtTempRationalLogged" UBYTE Bool_ON_OFF 1 2 0 1 BIT_MASK 0x02 ECU_ADDRESS 0x7000A192 /end MEASUREMENT
/begin MEASUREMENT FaultFSEVETA_Logged "FaultFSEVETA_Logged" UWORD I_1 1 2 0 65535 ECU_ADDRESS 0x7000A192 /end MEASUREMENT
/begin MEASUREMENT FaultFSEVETA_OverDetected "FaultFSEVETA_OverDetected" UWORD I_1 1 2 0 65535 ECU_ADDRESS 0x7000A1D0 /end MEASUREMENT
/begin MEASUREMENT FaultFSEVETA_OverLogged "FaultFSEVETA_OverLogged" UWORD I_1 1 2 0 65535 ECU_ADDRESS 0x7000A194 /end MEASUREMENT
/begin MEASUREMENT FaultFSEVETA_OverTempDrvLeftAut "FaultFSEVETA_OverTempDrvLeftAut" UBYTE Bool_ON_OFF 1 2 0 1 BIT_MASK 0x01 ECU_ADDRESS 0x7000A158 /end MEASUREMENT
/begin MEASUREMENT FaultFSEVETA_OverTempDrvLeftDetected "FaultFSEVETA_OverTempDrvLeftDetected" UBYTE Bool_ON_OFF 1 2 0 1 BIT_MASK 0x01 ECU_ADDRESS 0x7000A1D0 /end MEASUREMENT
/begin MEASUREMENT FaultFSEVETA_OverTempDrvLeftLogged "FaultFSEVETA_OverTempDrvLeftLogged" UBYTE Bool_ON_OFF 1 2 0 1 BIT_MASK 0x01 ECU_ADDRESS 0x7000A194 /end MEASUREMENT
/begin MEASUREMENT FaultFSEVETA_OverTempIgbtLeftAut "FaultFSEVETA_OverTempIgbtLeftAut" UBYTE Bool_ON_OFF 1 2 0 1 BIT_MASK 0x02 ECU_ADDRESS 0x7000A158 /end MEASUREMENT
/begin MEASUREMENT FaultFSEVETA_OverTempIgbtLeftDetected "FaultFSEVETA_OverTempIgbtLeftDetected" UBYTE Bool_ON_OFF 1 2 0 1 BIT_MASK 0x02 ECU_ADDRESS 0x7000A1D0 /end MEASUREMENT
/begin MEASUREMENT FaultFSEVETA_OverTempIgbtLeftLogged "FaultFSEVETA_OverTempIgbtLeftLogged" UBYTE Bool_ON_OFF 1 2 0 1 BIT_MASK 0x02 ECU_ADDRESS 0x7000A194 /end MEASUREMENT
/begin MEASUREMENT FaultFSEVETA_OverTempNTC1CmdBoardAut "FaultFSEVETA_OverTempNTC1CmdBoardAut" UBYTE Bool_ON_OFF 1 2 0 1 BIT_MASK 0x04 ECU_ADDRESS 0x7000A158 /end MEASUREMENT
/begin MEASUREMENT FaultFSEVETA_OverTempNTC1CmdBoardDetected "FaultFSEVETA_OverTempNTC1CmdBoardDetected" UBYTE Bool_ON_OFF 1 2 0 1 BIT_MASK 0x04 ECU_ADDRESS 0x7000A1D0 /end MEASUREMENT
/begin MEASUREMENT FaultFSEVETA_OverTempNTC1CmdBoardLogged "FaultFSEVETA_OverTempNTC1CmdBoardLogged" UBYTE Bool_ON_OFF 1 2 0 1 BIT_MASK 0x04 ECU_ADDRESS 0x7000A194 /end MEASUREMENT
/begin MEASUREMENT FaultFSEVETA_SampleIgbtTempOutRngHAut "FaultFSEVETA_SampleIgbtTempOutRngHAut" UBYTE Bool_ON_OFF 1 2 0 1 BIT_MASK 0x04 ECU_ADDRESS 0x7000A156 /end MEASUREMENT
/begin MEASUREMENT FaultFSEVETA_SampleIgbtTempOutRngHDetected "FaultFSEVETA_SampleIgbtTempOutRngHDetected" UBYTE Bool_ON_OFF 1 2 0 1 BIT_MASK 0x04 ECU_ADDRESS 0x7000A1CE /end MEASUREMENT
/begin MEASUREMENT FaultFSEVETA_SampleIgbtTempOutRngHLogged "FaultFSEVETA_SampleIgbtTempOutRngHLogged" UBYTE Bool_ON_OFF 1 2 0 1 BIT_MASK 0x04 ECU_ADDRESS 0x7000A192 /end MEASUREMENT
/begin MEASUREMENT FaultFSEVETA_SampleIgbtTempOutRngLAut "FaultFSEVETA_SampleIgbtTempOutRngLAut" UBYTE Bool_ON_OFF 1 2 0 1 BIT_MASK 0x08 ECU_ADDRESS 0x7000A156 /end MEASUREMENT
/begin MEASUREMENT FaultFSEVETA_SampleIgbtTempOutRngLDetected "FaultFSEVETA_SampleIgbtTempOutRngLDetected" UBYTE Bool_ON_OFF 1 2 0 1 BIT_MASK 0x08 ECU_ADDRESS 0x7000A1CE /end MEASUREMENT
/begin MEASUREMENT FaultFSEVETA_SampleIgbtTempOutRngLLogged "FaultFSEVETA_SampleIgbtTempOutRngLLogged" UBYTE Bool_ON_OFF 1 2 0 1 BIT_MASK 0x08 ECU_ADDRESS 0x7000A192 /end MEASUREMENT
/begin MEASUREMENT FaultFSEVETA_TempDetected "FaultFSEVETA_TempDetected" UWORD I_1 1 2 0 65535 ECU_ADDRESS 0x7000A1D2 /end MEASUREMENT
/begin MEASUREMENT FaultFSEVETA_TempDrvBoardLeftGndAut "FaultFSEVETA_TempDrvBoardLeftGndAut" UBYTE Bool_ON_OFF 1 2 0 1 BIT_MASK 0x01 ECU_ADDRESS 0x7000A15A /end MEASUREMENT
/begin MEASUREMENT FaultFSEVETA_TempDrvBoardLeftGndDetected "FaultFSEVETA_TempDrvBoardLeftGndDetected" UBYTE Bool_ON_OFF 1 2 0 1 BIT_MASK 0x01 ECU_ADDRESS 0x7000A1D2 /end MEASUREMENT
/begin MEASUREMENT FaultFSEVETA_TempDrvBoardLeftGndLogged "FaultFSEVETA_TempDrvBoardLeftGndLogged" UBYTE Bool_ON_OFF 1 2 0 1 BIT_MASK 0x01 ECU_ADDRESS 0x7000A196 /end MEASUREMENT
/begin MEASUREMENT FaultFSEVETA_TempDrvBoardLeftVccAut "FaultFSEVETA_TempDrvBoardLeftVccAut" UBYTE Bool_ON_OFF 1 2 0 1 BIT_MASK 0x02 ECU_ADDRESS 0x7000A15A /end MEASUREMENT
/begin MEASUREMENT FaultFSEVETA_TempDrvBoardLeftVccDetected "FaultFSEVETA_TempDrvBoardLeftVccDetected" UBYTE Bool_ON_OFF 1 2 0 1 BIT_MASK 0x02 ECU_ADDRESS 0x7000A1D2 /end MEASUREMENT
/begin MEASUREMENT FaultFSEVETA_TempDrvBoardLeftVccLogged "FaultFSEVETA_TempDrvBoardLeftVccLogged" UBYTE Bool_ON_OFF 1 2 0 1 BIT_MASK 0x02 ECU_ADDRESS 0x7000A196 /end MEASUREMENT
/begin MEASUREMENT FaultFSEVETA_TempIgbtLeftGndAut "FaultFSEVETA_TempIgbtLeftGndAut" UBYTE Bool_ON_OFF 1 2 0 1 BIT_MASK 0x04 ECU_ADDRESS 0x7000A15A /end MEASUREMENT
/begin MEASUREMENT FaultFSEVETA_TempIgbtLeftGndDetected "FaultFSEVETA_TempIgbtLeftGndDetected" UBYTE Bool_ON_OFF 1 2 0 1 BIT_MASK 0x04 ECU_ADDRESS 0x7000A1D2 /end MEASUREMENT
/begin MEASUREMENT FaultFSEVETA_TempIgbtLeftGndLogged "FaultFSEVETA_TempIgbtLeftGndLogged" UBYTE Bool_ON_OFF 1 2 0 1 BIT_MASK 0x04 ECU_ADDRESS 0x7000A196 /end MEASUREMENT
/begin MEASUREMENT FaultFSEVETA_TempIgbtLeftVccAut "FaultFSEVETA_TempIgbtLeftVccAut" UBYTE Bool_ON_OFF 1 2 0 1 BIT_MASK 0x08 ECU_ADDRESS 0x7000A15A /end MEASUREMENT
/begin MEASUREMENT FaultFSEVETA_TempIgbtLeftVccDetected "FaultFSEVETA_TempIgbtLeftVccDetected" UBYTE Bool_ON_OFF 1 2 0 1 BIT_MASK 0x08 ECU_ADDRESS 0x7000A1D2 /end MEASUREMENT
/begin MEASUREMENT FaultFSEVETA_TempIgbtLeftVccLogged "FaultFSEVETA_TempIgbtLeftVccLogged" UBYTE Bool_ON_OFF 1 2 0 1 BIT_MASK 0x08 ECU_ADDRESS 0x7000A196 /end MEASUREMENT
/begin MEASUREMENT FaultFSEVETA_TempLogged "FaultFSEVETA_TempLogged" UWORD I_1 1 2 0 65535 ECU_ADDRESS 0x7000A196 /end MEASUREMENT
/begin MEASUREMENT FaultFSEVETA_TempNTC1CmdBoardGndAut "FaultFSEVETA_TempNTC1CmdBoardGndAut" UBYTE Bool_ON_OFF 1 2 0 1 BIT_MASK 0x10 ECU_ADDRESS 0x7000A15A /end MEASUREMENT
/begin MEASUREMENT FaultFSEVETA_TempNTC1CmdBoardGndDetected "FaultFSEVETA_TempNTC1CmdBoardGndDetected" UBYTE Bool_ON_OFF 1 2 0 1 BIT_MASK 0x10 ECU_ADDRESS 0x7000A1D2 /end MEASUREMENT
/begin MEASUREMENT FaultFSEVETA_TempNTC1CmdBoardGndLogged "FaultFSEVETA_TempNTC1CmdBoardGndLogged" UBYTE Bool_ON_OFF 1 2 0 1 BIT_MASK 0x10 ECU_ADDRESS 0x7000A196 /end MEASUREMENT
/begin MEASUREMENT FaultFSEVETA_TempNTC1CmdBoardVccAut "FaultFSEVETA_TempNTC1CmdBoardVccAut" UBYTE Bool_ON_OFF 1 2 0 1 BIT_MASK 0x20 ECU_ADDRESS 0x7000A15A /end MEASUREMENT
/begin MEASUREMENT FaultFSEVETA_TempNTC1CmdBoardVccDetected "FaultFSEVETA_TempNTC1CmdBoardVccDetected" UBYTE Bool_ON_OFF 1 2 0 1 BIT_MASK 0x20 ECU_ADDRESS 0x7000A1D2 /end MEASUREMENT
/begin MEASUREMENT FaultFSEVETA_TempNTC1CmdBoardVccLogged "FaultFSEVETA_TempNTC1CmdBoardVccLogged" UBYTE Bool_ON_OFF 1 2 0 1 BIT_MASK 0x20 ECU_ADDRESS 0x7000A196 /end MEASUREMENT
/begin MEASUREMENT FaultFSEVETA_UnderDetected "FaultFSEVETA_UnderDetected" UWORD I_1 1 2 0 65535 ECU_ADDRESS 0x7000A1D4 /end MEASUREMENT
/begin MEASUREMENT FaultFSEVETA_UnderLogged "FaultFSEVETA_UnderLogged" UWORD I_1 1 2 0 65535 ECU_ADDRESS 0x7000A198 /end MEASUREMENT
/begin MEASUREMENT FaultFSEVETA_UnderTempDrvLeftAut "FaultFSEVETA_UnderTempDrvLeftAut" UBYTE Bool_ON_OFF 1 2 0 1 BIT_MASK 0x01 ECU_ADDRESS 0x7000A15C /end MEASUREMENT
/begin MEASUREMENT FaultFSEVETA_UnderTempDrvLeftDetected "FaultFSEVETA_UnderTempDrvLeftDetected" UBYTE Bool_ON_OFF 1 2 0 1 BIT_MASK 0x01 ECU_ADDRESS 0x7000A1D4 /end MEASUREMENT
/begin MEASUREMENT FaultFSEVETA_UnderTempDrvLeftLogged "FaultFSEVETA_UnderTempDrvLeftLogged" UBYTE Bool_ON_OFF 1 2 0 1 BIT_MASK 0x01 ECU_ADDRESS 0x7000A198 /end MEASUREMENT
/begin MEASUREMENT FaultFSEVETA_UnderTempIgbtLeftAut "FaultFSEVETA_UnderTempIgbtLeftAut" UBYTE Bool_ON_OFF 1 2 0 1 BIT_MASK 0x02 ECU_ADDRESS 0x7000A15C /end MEASUREMENT
/begin MEASUREMENT FaultFSEVETA_UnderTempIgbtLeftDetected "FaultFSEVETA_UnderTempIgbtLeftDetected" UBYTE Bool_ON_OFF 1 2 0 1 BIT_MASK 0x02 ECU_ADDRESS 0x7000A1D4 /end MEASUREMENT
/begin MEASUREMENT FaultFSEVETA_UnderTempIgbtLeftLogged "FaultFSEVETA_UnderTempIgbtLeftLogged" UBYTE Bool_ON_OFF 1 2 0 1 BIT_MASK 0x02 ECU_ADDRESS 0x7000A198 /end MEASUREMENT
/begin MEASUREMENT FaultFSEVETA_UnderTempNTC1CmdBoardAut "FaultFSEVETA_UnderTempNTC1CmdBoardAut" UBYTE Bool_ON_OFF 1 2 0 1 BIT_MASK 0x04 ECU_ADDRESS 0x7000A15C /end MEASUREMENT
/begin MEASUREMENT FaultFSEVETA_UnderTempNTC1CmdBoardDetected "FaultFSEVETA_UnderTempNTC1CmdBoardDetected" UBYTE Bool_ON_OFF 1 2 0 1 BIT_MASK 0x04 ECU_ADDRESS 0x7000A1D4 /end MEASUREMENT
/begin MEASUREMENT FaultFSEVETA_UnderTempNTC1CmdBoardLogged "FaultFSEVETA_UnderTempNTC1CmdBoardLogged" UBYTE Bool_ON_OFF 1 2 0 1 BIT_MASK 0x04 ECU_ADDRESS 0x7000A198 /end MEASUREMENT
/begin MEASUREMENT FaultFSMTMTA_OverDetected "FaultFSMTMTA_OverDetected" UWORD I_1 1 2 0 65535 ECU_ADDRESS 0x7000A1D6 /end MEASUREMENT
/begin MEASUREMENT FaultFSMTMTA_OverLogged "FaultFSMTMTA_OverLogged" UWORD I_1 1 2 0 65535 ECU_ADDRESS 0x7000A19A /end MEASUREMENT
/begin MEASUREMENT FaultFSMTMTA_OverTempWdgHead1Aut "FaultFSMTMTA_OverTempWdgHead1Aut" UBYTE Bool_ON_OFF 1 2 0 1 BIT_MASK 0x01 ECU_ADDRESS 0x7000A15E /end MEASUREMENT
/begin MEASUREMENT FaultFSMTMTA_OverTempWdgHead1Detected "FaultFSMTMTA_OverTempWdgHead1Detected" UBYTE Bool_ON_OFF 1 2 0 1 BIT_MASK 0x01 ECU_ADDRESS 0x7000A1D6 /end MEASUREMENT
/begin MEASUREMENT FaultFSMTMTA_OverTempWdgHead1Logged "FaultFSMTMTA_OverTempWdgHead1Logged" UBYTE Bool_ON_OFF 1 2 0 1 BIT_MASK 0x01 ECU_ADDRESS 0x7000A19A /end MEASUREMENT
/begin MEASUREMENT FaultFSMTMTA_TempDetected "FaultFSMTMTA_TempDetected" UWORD I_1 1 2 0 65535 ECU_ADDRESS 0x7000A1D8 /end MEASUREMENT
/begin MEASUREMENT FaultFSMTMTA_TempLogged "FaultFSMTMTA_TempLogged" UWORD I_1 1 2 0 65535 ECU_ADDRESS 0x7000A19C /end MEASUREMENT
/begin MEASUREMENT FaultFSMTMTA_TempWindHead1OutRngHAut "FaultFSMTMTA_TempWindHead1OutRngHAut" UBYTE Bool_ON_OFF 1 2 0 1 BIT_MASK 0x01 ECU_ADDRESS 0x7000A160 /end MEASUREMENT
/begin MEASUREMENT FaultFSMTMTA_TempWindHead1OutRngHDetected "FaultFSMTMTA_TempWindHead1OutRngHDetected" UBYTE Bool_ON_OFF 1 2 0 1 BIT_MASK 0x01 ECU_ADDRESS 0x7000A1D8 /end MEASUREMENT
/begin MEASUREMENT FaultFSMTMTA_TempWindHead1OutRngHLogged "FaultFSMTMTA_TempWindHead1OutRngHLogged" UBYTE Bool_ON_OFF 1 2 0 1 BIT_MASK 0x01 ECU_ADDRESS 0x7000A19C /end MEASUREMENT
/begin MEASUREMENT FaultFSMTMTA_TempWindHead1OutRngLAut "FaultFSMTMTA_TempWindHead1OutRngLAut" UBYTE Bool_ON_OFF 1 2 0 1 BIT_MASK 0x02 ECU_ADDRESS 0x7000A160 /end MEASUREMENT
/begin MEASUREMENT FaultFSMTMTA_TempWindHead1OutRngLDetected "FaultFSMTMTA_TempWindHead1OutRngLDetected" UBYTE Bool_ON_OFF 1 2 0 1 BIT_MASK 0x02 ECU_ADDRESS 0x7000A1D8 /end MEASUREMENT
/begin MEASUREMENT FaultFSMTMTA_TempWindHead1OutRngLLogged "FaultFSMTMTA_TempWindHead1OutRngLLogged" UBYTE Bool_ON_OFF 1 2 0 1 BIT_MASK 0x02 ECU_ADDRESS 0x7000A19C /end MEASUREMENT
/begin MEASUREMENT FaultFSMTMTA_TempWindingHead1GndAut "FaultFSMTMTA_TempWindingHead1GndAut" UBYTE Bool_ON_OFF 1 2 0 1 BIT_MASK 0x04 ECU_ADDRESS 0x7000A160 /end MEASUREMENT
/begin MEASUREMENT FaultFSMTMTA_TempWindingHead1GndDetected "FaultFSMTMTA_TempWindingHead1GndDetected" UBYTE Bool_ON_OFF 1 2 0 1 BIT_MASK 0x04 ECU_ADDRESS 0x7000A1D8 /end MEASUREMENT
/begin MEASUREMENT FaultFSMTMTA_TempWindingHead1GndLogged "FaultFSMTMTA_TempWindingHead1GndLogged" UBYTE Bool_ON_OFF 1 2 0 1 BIT_MASK 0x04 ECU_ADDRESS 0x7000A19C /end MEASUREMENT
/begin MEASUREMENT FaultFSMTMTA_TempWindingHead1VccAut "FaultFSMTMTA_TempWindingHead1VccAut" UBYTE Bool_ON_OFF 1 2 0 1 BIT_MASK 0x08 ECU_ADDRESS 0x7000A160 /end MEASUREMENT
/begin MEASUREMENT FaultFSMTMTA_TempWindingHead1VccDetected "FaultFSMTMTA_TempWindingHead1VccDetected" UBYTE Bool_ON_OFF 1 2 0 1 BIT_MASK 0x08 ECU_ADDRESS 0x7000A1D8 /end MEASUREMENT
/begin MEASUREMENT FaultFSMTMTA_TempWindingHead1VccLogged "FaultFSMTMTA_TempWindingHead1VccLogged" UBYTE Bool_ON_OFF 1 2 0 1 BIT_MASK 0x08 ECU_ADDRESS 0x7000A19C /end MEASUREMENT
/begin MEASUREMENT FaultFSMTMTA_UnderDetected "FaultFSMTMTA_UnderDetected" UWORD I_1 1 2 0 65535 ECU_ADDRESS 0x7000A1DA /end MEASUREMENT
/begin MEASUREMENT FaultFSMTMTA_UnderLogged "FaultFSMTMTA_UnderLogged" UWORD I_1 1 2 0 65535 ECU_ADDRESS 0x7000A19E /end MEASUREMENT
/begin MEASUREMENT FaultFSMTMTA_UnderTempWdgHead1Aut "FaultFSMTMTA_UnderTempWdgHead1Aut" UBYTE Bool_ON_OFF 1 2 0 1 BIT_MASK 0x01 ECU_ADDRESS 0x7000A162 /end MEASUREMENT
/begin MEASUREMENT FaultFSMTMTA_UnderTempWdgHead1Detected "FaultFSMTMTA_UnderTempWdgHead1Detected" UBYTE Bool_ON_OFF 1 2 0 1 BIT_MASK 0x01 ECU_ADDRESS 0x7000A1DA /end MEASUREMENT
/begin MEASUREMENT FaultFSMTMTA_UnderTempWdgHead1Logged "FaultFSMTMTA_UnderTempWdgHead1Logged" UBYTE Bool_ON_OFF 1 2 0 1 BIT_MASK 0x01 ECU_ADDRESS 0x7000A19E /end MEASUREMENT
/begin MEASUREMENT FaultFSMTRDG_Detected "FaultFSMTRDG_Detected" UWORD I_1 1 2 0 65535 ECU_ADDRESS 0x7000A1DC /end MEASUREMENT
/begin MEASUREMENT FaultFSMTRDG_ExcGenerationAut "FaultFSMTRDG_ExcGenerationAut" UBYTE Bool_ON_OFF 1 2 0 1 BIT_MASK 0x01 ECU_ADDRESS 0x7000A164 /end MEASUREMENT
/begin MEASUREMENT FaultFSMTRDG_ExcGenerationDetected "FaultFSMTRDG_ExcGenerationDetected" UBYTE Bool_ON_OFF 1 2 0 1 BIT_MASK 0x01 ECU_ADDRESS 0x7000A1DC /end MEASUREMENT
/begin MEASUREMENT FaultFSMTRDG_ExcGenerationLogged "FaultFSMTRDG_ExcGenerationLogged" UBYTE Bool_ON_OFF 1 2 0 1 BIT_MASK 0x01 ECU_ADDRESS 0x7000A1A0 /end MEASUREMENT
/begin MEASUREMENT FaultFSMTRDG_ExcSignalGNDAut "FaultFSMTRDG_ExcSignalGNDAut" UBYTE Bool_ON_OFF 1 2 0 1 BIT_MASK 0x02 ECU_ADDRESS 0x7000A164 /end MEASUREMENT
/begin MEASUREMENT FaultFSMTRDG_ExcSignalGNDDetected "FaultFSMTRDG_ExcSignalGNDDetected" UBYTE Bool_ON_OFF 1 2 0 1 BIT_MASK 0x02 ECU_ADDRESS 0x7000A1DC /end MEASUREMENT
/begin MEASUREMENT FaultFSMTRDG_ExcSignalGNDLogged "FaultFSMTRDG_ExcSignalGNDLogged" UBYTE Bool_ON_OFF 1 2 0 1 BIT_MASK 0x02 ECU_ADDRESS 0x7000A1A0 /end MEASUREMENT
/begin MEASUREMENT FaultFSMTRDG_ExcSignalVCCAut "FaultFSMTRDG_ExcSignalVCCAut" UBYTE Bool_ON_OFF 1 2 0 1 BIT_MASK 0x04 ECU_ADDRESS 0x7000A164 /end MEASUREMENT
/begin MEASUREMENT FaultFSMTRDG_ExcSignalVCCDetected "FaultFSMTRDG_ExcSignalVCCDetected" UBYTE Bool_ON_OFF 1 2 0 1 BIT_MASK 0x04 ECU_ADDRESS 0x7000A1DC /end MEASUREMENT
/begin MEASUREMENT FaultFSMTRDG_ExcSignalVCCLogged "FaultFSMTRDG_ExcSignalVCCLogged" UBYTE Bool_ON_OFF 1 2 0 1 BIT_MASK 0x04 ECU_ADDRESS 0x7000A1A0 /end MEASUREMENT
/begin MEASUREMENT FaultFSMTRDG_Logged "FaultFSMTRDG_Logged" UWORD I_1 1 2 0 65535 ECU_ADDRESS 0x7000A1A0 /end MEASUREMENT
/begin MEASUREMENT FaultFSMTRDG_SinCosHLGndAut "FaultFSMTRDG_SinCosHLGndAut" UBYTE Bool_ON_OFF 1 2 0 1 BIT_MASK 0x08 ECU_ADDRESS 0x7000A164 /end MEASUREMENT
/begin MEASUREMENT FaultFSMTRDG_SinCosHLGndDetected "FaultFSMTRDG_SinCosHLGndDetected" UBYTE Bool_ON_OFF 1 2 0 1 BIT_MASK 0x08 ECU_ADDRESS 0x7000A1DC /end MEASUREMENT
/begin MEASUREMENT FaultFSMTRDG_SinCosHLGndLogged "FaultFSMTRDG_SinCosHLGndLogged" UBYTE Bool_ON_OFF 1 2 0 1 BIT_MASK 0x08 ECU_ADDRESS 0x7000A1A0 /end MEASUREMENT
/begin MEASUREMENT FaultFSMTRDG_SinCosHLOpenAut "FaultFSMTRDG_SinCosHLOpenAut" UBYTE Bool_ON_OFF 1 2 0 1 BIT_MASK 0x10 ECU_ADDRESS 0x7000A164 /end MEASUREMENT
/begin MEASUREMENT FaultFSMTRDG_SinCosHLOpenDetected "FaultFSMTRDG_SinCosHLOpenDetected" UBYTE Bool_ON_OFF 1 2 0 1 BIT_MASK 0x10 ECU_ADDRESS 0x7000A1DC /end MEASUREMENT
/begin MEASUREMENT FaultFSMTRDG_SinCosHLOpenLogged "FaultFSMTRDG_SinCosHLOpenLogged" UBYTE Bool_ON_OFF 1 2 0 1 BIT_MASK 0x10 ECU_ADDRESS 0x7000A1A0 /end MEASUREMENT
/begin MEASUREMENT FaultFSMTRDG_SinCosHLVccAut "FaultFSMTRDG_SinCosHLVccAut" UBYTE Bool_ON_OFF 1 2 0 1 BIT_MASK 0x20 ECU_ADDRESS 0x7000A164 /end MEASUREMENT
/begin MEASUREMENT FaultFSMTRDG_SinCosHLVccDetected "FaultFSMTRDG_SinCosHLVccDetected" UBYTE Bool_ON_OFF 1 2 0 1 BIT_MASK 0x20 ECU_ADDRESS 0x7000A1DC /end MEASUREMENT
/begin MEASUREMENT FaultFSMTRDG_SinCosHLVccLogged "FaultFSMTRDG_SinCosHLVccLogged" UBYTE Bool_ON_OFF 1 2 0 1 BIT_MASK 0x20 ECU_ADDRESS 0x7000A1A0 /end MEASUREMENT
/begin MEASUREMENT FaultFSSMACS_AkdFailFlagAut "FaultFSSMACS_AkdFailFlagAut" UBYTE Bool_ON_OFF 1 2 0 1 BIT_MASK 0x01 ECU_ADDRESS 0x7000A166 /end MEASUREMENT
/begin MEASUREMENT FaultFSSMACS_AkdFailFlagDetected "FaultFSSMACS_AkdFailFlagDetected" UBYTE Bool_ON_OFF 1 2 0 1 BIT_MASK 0x01 ECU_ADDRESS 0x7000A1DE /end MEASUREMENT
/begin MEASUREMENT FaultFSSMACS_AkdFailFlagLogged "FaultFSSMACS_AkdFailFlagLogged" UBYTE Bool_ON_OFF 1 2 0 1 BIT_MASK 0x01 ECU_ADDRESS 0x7000A1A2 /end MEASUREMENT
/begin MEASUREMENT FaultFSSMACS_Detected "FaultFSSMACS_Detected" UWORD I_1 1 2 0 65535 ECU_ADDRESS 0x7000A1DE /end MEASUREMENT
/begin MEASUREMENT FaultFSSMACS_Logged "FaultFSSMACS_Logged" UWORD I_1 1 2 0 65535 ECU_ADDRESS 0x7000A1A2 /end MEASUREMENT
/begin MEASUREMENT FaultFTASBDS_BattVoltDeratingActAut "FaultFTASBDS_BattVoltDeratingActAut" UBYTE Bool_ON_OFF 1 2 0 1 BIT_MASK 0x01 ECU_ADDRESS 0x7000A168 /end MEASUREMENT
/begin MEASUREMENT FaultFTASBDS_BattVoltDeratingActDetected "FaultFTASBDS_BattVoltDeratingActDetected" UBYTE Bool_ON_OFF 1 2 0 1 BIT_MASK 0x01 ECU_ADDRESS 0x7000A1E0 /end MEASUREMENT
/begin MEASUREMENT FaultFTASBDS_BattVoltDeratingActLogged "FaultFTASBDS_BattVoltDeratingActLogged" UBYTE Bool_ON_OFF 1 2 0 1 BIT_MASK 0x01 ECU_ADDRESS 0x7000A1A4 /end MEASUREMENT
/begin MEASUREMENT FaultFTASBDS_Detected "FaultFTASBDS_Detected" UWORD I_1 1 2 0 65535 ECU_ADDRESS 0x7000A1E0 /end MEASUREMENT
/begin MEASUREMENT FaultFTASBDS_Logged "FaultFTASBDS_Logged" UWORD I_1 1 2 0 65535 ECU_ADDRESS 0x7000A1A4 /end MEASUREMENT
/begin MEASUREMENT FaultFTASETP_Detected "FaultFTASETP_Detected" UWORD I_1 1 2 0 65535 ECU_ADDRESS 0x7000A1E2 /end MEASUREMENT
/begin MEASUREMENT FaultFTASETP_EstPmDeratingActAut "FaultFTASETP_EstPmDeratingActAut" UBYTE Bool_ON_OFF 1 2 0 1 BIT_MASK 0x01 ECU_ADDRESS 0x7000A16A /end MEASUREMENT
/begin MEASUREMENT FaultFTASETP_EstPmDeratingActDetected "FaultFTASETP_EstPmDeratingActDetected" UBYTE Bool_ON_OFF 1 2 0 1 BIT_MASK 0x01 ECU_ADDRESS 0x7000A1E2 /end MEASUREMENT
/begin MEASUREMENT FaultFTASETP_EstPmDeratingActLogged "FaultFTASETP_EstPmDeratingActLogged" UBYTE Bool_ON_OFF 1 2 0 1 BIT_MASK 0x01 ECU_ADDRESS 0x7000A1A6 /end MEASUREMENT
/begin MEASUREMENT FaultFTASETP_Logged "FaultFTASETP_Logged" UWORD I_1 1 2 0 65535 ECU_ADDRESS 0x7000A1A6 /end MEASUREMENT
/begin MEASUREMENT FaultFTASETP_PmDeratingActAut "FaultFTASETP_PmDeratingActAut" UBYTE Bool_ON_OFF 1 2 0 1 BIT_MASK 0x02 ECU_ADDRESS 0x7000A16A /end MEASUREMENT
/begin MEASUREMENT FaultFTASETP_PmDeratingActDetected "FaultFTASETP_PmDeratingActDetected" UBYTE Bool_ON_OFF 1 2 0 1 BIT_MASK 0x02 ECU_ADDRESS 0x7000A1E2 /end MEASUREMENT
/begin MEASUREMENT FaultFTASETP_PmDeratingActLogged "FaultFTASETP_PmDeratingActLogged" UBYTE Bool_ON_OFF 1 2 0 1 BIT_MASK 0x02 ECU_ADDRESS 0x7000A1A6 /end MEASUREMENT
/begin MEASUREMENT FaultFTASMTP_Detected "FaultFTASMTP_Detected" UWORD I_1 1 2 0 65535 ECU_ADDRESS 0x7000A1E4 /end MEASUREMENT
/begin MEASUREMENT FaultFTASMTP_Logged "FaultFTASMTP_Logged" UWORD I_1 1 2 0 65535 ECU_ADDRESS 0x7000A1A8 /end MEASUREMENT
/begin MEASUREMENT FaultFTASMTP_Wndg1DeratingActAut "FaultFTASMTP_Wndg1DeratingActAut" UBYTE Bool_ON_OFF 1 2 0 1 BIT_MASK 0x01 ECU_ADDRESS 0x7000A16C /end MEASUREMENT
/begin MEASUREMENT FaultFTASMTP_Wndg1DeratingActDetected "FaultFTASMTP_Wndg1DeratingActDetected" UBYTE Bool_ON_OFF 1 2 0 1 BIT_MASK 0x01 ECU_ADDRESS 0x7000A1E4 /end MEASUREMENT
/begin MEASUREMENT FaultFTASMTP_Wndg1DeratingActLogged "FaultFTASMTP_Wndg1DeratingActLogged" UBYTE Bool_ON_OFF 1 2 0 1 BIT_MASK 0x01 ECU_ADDRESS 0x7000A1A8 /end MEASUREMENT
/begin MEASUREMENT FaultFTASOSP_Detected "FaultFTASOSP_Detected" UWORD I_1 1 2 0 65535 ECU_ADDRESS 0x7000A1E6 /end MEASUREMENT
/begin MEASUREMENT FaultFTASOSP_Logged "FaultFTASOSP_Logged" UWORD I_1 1 2 0 65535 ECU_ADDRESS 0x7000A1AA /end MEASUREMENT
/begin MEASUREMENT FaultFTASOSP_MotorSpdDeratingActAut "FaultFTASOSP_MotorSpdDeratingActAut" UBYTE Bool_ON_OFF 1 2 0 1 BIT_MASK 0x01 ECU_ADDRESS 0x7000A16E /end MEASUREMENT
/begin MEASUREMENT FaultFTASOSP_MotorSpdDeratingActDetected "FaultFTASOSP_MotorSpdDeratingActDetected" UBYTE Bool_ON_OFF 1 2 0 1 BIT_MASK 0x01 ECU_ADDRESS 0x7000A1E6 /end MEASUREMENT
/begin MEASUREMENT FaultFTASOSP_MotorSpdDeratingActLogged "FaultFTASOSP_MotorSpdDeratingActLogged" UBYTE Bool_ON_OFF 1 2 0 1 BIT_MASK 0x01 ECU_ADDRESS 0x7000A1AA /end MEASUREMENT
/begin MEASUREMENT FaultFTCMSCS_CtrlSatTimoutAut "FaultFTCMSCS_CtrlSatTimoutAut" UBYTE Bool_ON_OFF 1 2 0 1 BIT_MASK 0x01 ECU_ADDRESS 0x7000A170 /end MEASUREMENT
/begin MEASUREMENT FaultFTCMSCS_CtrlSatTimoutDetected "FaultFTCMSCS_CtrlSatTimoutDetected" UBYTE Bool_ON_OFF 1 2 0 1 BIT_MASK 0x01 ECU_ADDRESS 0x7000A1E8 /end MEASUREMENT
/begin MEASUREMENT FaultFTCMSCS_CtrlSatTimoutLogged "FaultFTCMSCS_CtrlSatTimoutLogged" UBYTE Bool_ON_OFF 1 2 0 1 BIT_MASK 0x01 ECU_ADDRESS 0x7000A1AC /end MEASUREMENT
/begin MEASUREMENT FaultFTCMSCS_Detected "FaultFTCMSCS_Detected" UWORD I_1 1 2 0 65535 ECU_ADDRESS 0x7000A1E8 /end MEASUREMENT
/begin MEASUREMENT FaultFTCMSCS_Logged "FaultFTCMSCS_Logged" UWORD I_1 1 2 0 65535 ECU_ADDRESS 0x7000A1AC /end MEASUREMENT
/begin MEASUREMENT FaultFTCMSCS_SpdOvershootAut "FaultFTCMSCS_SpdOvershootAut" UBYTE Bool_ON_OFF 1 2 0 1 BIT_MASK 0x02 ECU_ADDRESS 0x7000A170 /end MEASUREMENT
/begin MEASUREMENT FaultFTCMSCS_SpdOvershootDetected "FaultFTCMSCS_SpdOvershootDetected" UBYTE Bool_ON_OFF 1 2 0 1 BIT_MASK 0x02 ECU_ADDRESS 0x7000A1E8 /end MEASUREMENT
/begin MEASUREMENT FaultFTCMSCS_SpdOvershootLogged "FaultFTCMSCS_SpdOvershootLogged" UBYTE Bool_ON_OFF 1 2 0 1 BIT_MASK 0x02 ECU_ADDRESS 0x7000A1AC /end MEASUREMENT
/begin MEASUREMENT FaultFTCMSCS_ZeroSpeedTimoutAut "FaultFTCMSCS_ZeroSpeedTimoutAut" UBYTE Bool_ON_OFF 1 2 0 1 BIT_MASK 0x04 ECU_ADDRESS 0x7000A170 /end MEASUREMENT
/begin MEASUREMENT FaultFTCMSCS_ZeroSpeedTimoutDetected "FaultFTCMSCS_ZeroSpeedTimoutDetected" UBYTE Bool_ON_OFF 1 2 0 1 BIT_MASK 0x04 ECU_ADDRESS 0x7000A1E8 /end MEASUREMENT
/begin MEASUREMENT FaultFTCMSCS_ZeroSpeedTimoutLogged "FaultFTCMSCS_ZeroSpeedTimoutLogged" UBYTE Bool_ON_OFF 1 2 0 1 BIT_MASK 0x04 ECU_ADDRESS 0x7000A1AC /end MEASUREMENT
/begin MEASUREMENT FaultFTCMTCS_Detected "FaultFTCMTCS_Detected" UWORD I_1 1 2 0 65535 ECU_ADDRESS 0x7000A1EA /end MEASUREMENT
/begin MEASUREMENT FaultFTCMTCS_Logged "FaultFTCMTCS_Logged" UWORD I_1 1 2 0 65535 ECU_ADDRESS 0x7000A1AE /end MEASUREMENT
/begin MEASUREMENT FaultFTCMTCS_VoltageMarginLowAut "FaultFTCMTCS_VoltageMarginLowAut" UBYTE Bool_ON_OFF 1 2 0 1 BIT_MASK 0x01 ECU_ADDRESS 0x7000A172 /end MEASUREMENT
/begin MEASUREMENT FaultFTCMTCS_VoltageMarginLowDetected "FaultFTCMTCS_VoltageMarginLowDetected" UBYTE Bool_ON_OFF 1 2 0 1 BIT_MASK 0x01 ECU_ADDRESS 0x7000A1EA /end MEASUREMENT
/begin MEASUREMENT FaultFTCMTCS_VoltageMarginLowLogged "FaultFTCMTCS_VoltageMarginLowLogged" UBYTE Bool_ON_OFF 1 2 0 1 BIT_MASK 0x01 ECU_ADDRESS 0x7000A1AE /end MEASUREMENT
/begin MEASUREMENT FaultFTEVEIT_Detected "FaultFTEVEIT_Detected" UWORD I_1 1 2 0 65535 ECU_ADDRESS 0x7000A1EC /end MEASUREMENT
/begin MEASUREMENT FaultFTEVEIT_EstOverTempAut "FaultFTEVEIT_EstOverTempAut" UBYTE Bool_ON_OFF 1 2 0 1 BIT_MASK 0x01 ECU_ADDRESS 0x7000A174 /end MEASUREMENT
/begin MEASUREMENT FaultFTEVEIT_EstOverTempDetected "FaultFTEVEIT_EstOverTempDetected" UBYTE Bool_ON_OFF 1 2 0 1 BIT_MASK 0x01 ECU_ADDRESS 0x7000A1EC /end MEASUREMENT
/begin MEASUREMENT FaultFTEVEIT_EstOverTempLogged "FaultFTEVEIT_EstOverTempLogged" UBYTE Bool_ON_OFF 1 2 0 1 BIT_MASK 0x01 ECU_ADDRESS 0x7000A1B0 /end MEASUREMENT
/begin MEASUREMENT FaultFTEVEIT_Logged "FaultFTEVEIT_Logged" UWORD I_1 1 2 0 65535 ECU_ADDRESS 0x7000A1B0 /end MEASUREMENT
/begin MEASUREMENT FaultFTMTLCS_CurSenrPhaU_GNDAut "FaultFTMTLCS_CurSenrPhaU_GNDAut" UBYTE Bool_ON_OFF 1 2 0 1 BIT_MASK 0x02 ECU_ADDRESS 0x7000A176 /end MEASUREMENT
/begin MEASUREMENT FaultFTMTLCS_CurSenrPhaU_GNDDetected "FaultFTMTLCS_CurSenrPhaU_GNDDetected" UBYTE Bool_ON_OFF 1 2 0 1 BIT_MASK 0x02 ECU_ADDRESS 0x7000A1EE /end MEASUREMENT
/begin MEASUREMENT FaultFTMTLCS_CurSenrPhaU_GNDLogged "FaultFTMTLCS_CurSenrPhaU_GNDLogged" UBYTE Bool_ON_OFF 1 2 0 1 BIT_MASK 0x02 ECU_ADDRESS 0x7000A1B2 /end MEASUREMENT
/begin MEASUREMENT FaultFTMTLCS_CurSenrPhaU_OutRngHAut "FaultFTMTLCS_CurSenrPhaU_OutRngHAut" UBYTE Bool_ON_OFF 1 2 0 1 BIT_MASK 0x04 ECU_ADDRESS 0x7000A176 /end MEASUREMENT
/begin MEASUREMENT FaultFTMTLCS_CurSenrPhaU_OutRngHDetected "FaultFTMTLCS_CurSenrPhaU_OutRngHDetected" UBYTE Bool_ON_OFF 1 2 0 1 BIT_MASK 0x04 ECU_ADDRESS 0x7000A1EE /end MEASUREMENT
/begin MEASUREMENT FaultFTMTLCS_CurSenrPhaU_OutRngHLogged "FaultFTMTLCS_CurSenrPhaU_OutRngHLogged" UBYTE Bool_ON_OFF 1 2 0 1 BIT_MASK 0x04 ECU_ADDRESS 0x7000A1B2 /end MEASUREMENT
/begin MEASUREMENT FaultFTMTLCS_CurSenrPhaU_OutRngLAut "FaultFTMTLCS_CurSenrPhaU_OutRngLAut" UBYTE Bool_ON_OFF 1 2 0 1 BIT_MASK 0x08 ECU_ADDRESS 0x7000A176 /end MEASUREMENT
/begin MEASUREMENT FaultFTMTLCS_CurSenrPhaU_OutRngLDetected "FaultFTMTLCS_CurSenrPhaU_OutRngLDetected" UBYTE Bool_ON_OFF 1 2 0 1 BIT_MASK 0x08 ECU_ADDRESS 0x7000A1EE /end MEASUREMENT
/begin MEASUREMENT FaultFTMTLCS_CurSenrPhaU_OutRngLLogged "FaultFTMTLCS_CurSenrPhaU_OutRngLLogged" UBYTE Bool_ON_OFF 1 2 0 1 BIT_MASK 0x08 ECU_ADDRESS 0x7000A1B2 /end MEASUREMENT
/begin MEASUREMENT FaultFTMTLCS_CurSenrPhaU_VCCAut "FaultFTMTLCS_CurSenrPhaU_VCCAut" UBYTE Bool_ON_OFF 1 2 0 1 BIT_MASK 0x10 ECU_ADDRESS 0x7000A176 /end MEASUREMENT
/begin MEASUREMENT FaultFTMTLCS_CurSenrPhaU_VCCDetected "FaultFTMTLCS_CurSenrPhaU_VCCDetected" UBYTE Bool_ON_OFF 1 2 0 1 BIT_MASK 0x10 ECU_ADDRESS 0x7000A1EE /end MEASUREMENT
/begin MEASUREMENT FaultFTMTLCS_CurSenrPhaU_VCCLogged "FaultFTMTLCS_CurSenrPhaU_VCCLogged" UBYTE Bool_ON_OFF 1 2 0 1 BIT_MASK 0x10 ECU_ADDRESS 0x7000A1B2 /end MEASUREMENT
/begin MEASUREMENT FaultFTMTLCS_CurSenrPhaV_GNDAut "FaultFTMTLCS_CurSenrPhaV_GNDAut" UBYTE Bool_ON_OFF 1 2 0 1 BIT_MASK 0x20 ECU_ADDRESS 0x7000A176 /end MEASUREMENT
/begin MEASUREMENT FaultFTMTLCS_CurSenrPhaV_GNDDetected "FaultFTMTLCS_CurSenrPhaV_GNDDetected" UBYTE Bool_ON_OFF 1 2 0 1 BIT_MASK 0x20 ECU_ADDRESS 0x7000A1EE /end MEASUREMENT
/begin MEASUREMENT FaultFTMTLCS_CurSenrPhaV_GNDLogged "FaultFTMTLCS_CurSenrPhaV_GNDLogged" UBYTE Bool_ON_OFF 1 2 0 1 BIT_MASK 0x20 ECU_ADDRESS 0x7000A1B2 /end MEASUREMENT
/begin MEASUREMENT FaultFTMTLCS_CurSenrPhaV_OutRngHAut "FaultFTMTLCS_CurSenrPhaV_OutRngHAut" UBYTE Bool_ON_OFF 1 2 0 1 BIT_MASK 0x40 ECU_ADDRESS 0x7000A176 /end MEASUREMENT
/begin MEASUREMENT FaultFTMTLCS_CurSenrPhaV_OutRngHDetected "FaultFTMTLCS_CurSenrPhaV_OutRngHDetected" UBYTE Bool_ON_OFF 1 2 0 1 BIT_MASK 0x40 ECU_ADDRESS 0x7000A1EE /end MEASUREMENT
/begin MEASUREMENT FaultFTMTLCS_CurSenrPhaV_OutRngHLogged "FaultFTMTLCS_CurSenrPhaV_OutRngHLogged" UBYTE Bool_ON_OFF 1 2 0 1 BIT_MASK 0x40 ECU_ADDRESS 0x7000A1B2 /end MEASUREMENT
/begin MEASUREMENT FaultFTMTLCS_CurSenrPhaV_OutRngLAut "FaultFTMTLCS_CurSenrPhaV_OutRngLAut" UBYTE Bool_ON_OFF 1 2 0 1 BIT_MASK 0x80 ECU_ADDRESS 0x7000A176 /end MEASUREMENT
/begin MEASUREMENT FaultFTMTLCS_CurSenrPhaV_OutRngLDetected "FaultFTMTLCS_CurSenrPhaV_OutRngLDetected" UBYTE Bool_ON_OFF 1 2 0 1 BIT_MASK 0x80 ECU_ADDRESS 0x7000A1EE /end MEASUREMENT
/begin MEASUREMENT FaultFTMTLCS_CurSenrPhaV_OutRngLLogged "FaultFTMTLCS_CurSenrPhaV_OutRngLLogged" UBYTE Bool_ON_OFF 1 2 0 1 BIT_MASK 0x80 ECU_ADDRESS 0x7000A1B2 /end MEASUREMENT
/begin MEASUREMENT FaultFTMTLCS_CurSenrPhaV_VCCAut "FaultFTMTLCS_CurSenrPhaV_VCCAut" UBYTE Bool_ON_OFF 1 2 0 1 BIT_MASK 0x01 ECU_ADDRESS 0x7000A177 /end MEASUREMENT
/begin MEASUREMENT FaultFTMTLCS_CurSenrPhaV_VCCDetected "FaultFTMTLCS_CurSenrPhaV_VCCDetected" UBYTE Bool_ON_OFF 1 2 0 1 BIT_MASK 0x01 ECU_ADDRESS 0x7000A1EF /end MEASUREMENT
/begin MEASUREMENT FaultFTMTLCS_CurSenrPhaV_VCCLogged "FaultFTMTLCS_CurSenrPhaV_VCCLogged" UBYTE Bool_ON_OFF 1 2 0 1 BIT_MASK 0x01 ECU_ADDRESS 0x7000A1B3 /end MEASUREMENT
/begin MEASUREMENT FaultFTMTLCS_CurSenrPhaW_GNDAut "FaultFTMTLCS_CurSenrPhaW_GNDAut" UBYTE Bool_ON_OFF 1 2 0 1 BIT_MASK 0x02 ECU_ADDRESS 0x7000A177 /end MEASUREMENT
/begin MEASUREMENT FaultFTMTLCS_CurSenrPhaW_GNDDetected "FaultFTMTLCS_CurSenrPhaW_GNDDetected" UBYTE Bool_ON_OFF 1 2 0 1 BIT_MASK 0x02 ECU_ADDRESS 0x7000A1EF /end MEASUREMENT
/begin MEASUREMENT FaultFTMTLCS_CurSenrPhaW_GNDLogged "FaultFTMTLCS_CurSenrPhaW_GNDLogged" UBYTE Bool_ON_OFF 1 2 0 1 BIT_MASK 0x02 ECU_ADDRESS 0x7000A1B3 /end MEASUREMENT
/begin MEASUREMENT FaultFTMTLCS_CurSenrPhaW_OutRngHAut "FaultFTMTLCS_CurSenrPhaW_OutRngHAut" UBYTE Bool_ON_OFF 1 2 0 1 BIT_MASK 0x04 ECU_ADDRESS 0x7000A177 /end MEASUREMENT
/begin MEASUREMENT FaultFTMTLCS_CurSenrPhaW_OutRngHDetected "FaultFTMTLCS_CurSenrPhaW_OutRngHDetected" UBYTE Bool_ON_OFF 1 2 0 1 BIT_MASK 0x04 ECU_ADDRESS 0x7000A1EF /end MEASUREMENT
/begin MEASUREMENT FaultFTMTLCS_CurSenrPhaW_OutRngHLogged "FaultFTMTLCS_CurSenrPhaW_OutRngHLogged" UBYTE Bool_ON_OFF 1 2 0 1 BIT_MASK 0x04 ECU_ADDRESS 0x7000A1B3 /end MEASUREMENT
/begin MEASUREMENT FaultFTMTLCS_CurSenrPhaW_OutRngLAut "FaultFTMTLCS_CurSenrPhaW_OutRngLAut" UBYTE Bool_ON_OFF 1 2 0 1 BIT_MASK 0x08 ECU_ADDRESS 0x7000A177 /end MEASUREMENT
/begin MEASUREMENT FaultFTMTLCS_CurSenrPhaW_OutRngLDetected "FaultFTMTLCS_CurSenrPhaW_OutRngLDetected" UBYTE Bool_ON_OFF 1 2 0 1 BIT_MASK 0x08 ECU_ADDRESS 0x7000A1EF /end MEASUREMENT
/begin MEASUREMENT FaultFTMTLCS_CurSenrPhaW_OutRngLLogged "FaultFTMTLCS_CurSenrPhaW_OutRngLLogged" UBYTE Bool_ON_OFF 1 2 0 1 BIT_MASK 0x08 ECU_ADDRESS 0x7000A1B3 /end MEASUREMENT
/begin MEASUREMENT FaultFTMTLCS_CurSenrPhaW_VCCAut "FaultFTMTLCS_CurSenrPhaW_VCCAut" UBYTE Bool_ON_OFF 1 2 0 1 BIT_MASK 0x10 ECU_ADDRESS 0x7000A177 /end MEASUREMENT
/begin MEASUREMENT FaultFTMTLCS_CurSenrPhaW_VCCDetected "FaultFTMTLCS_CurSenrPhaW_VCCDetected" UBYTE Bool_ON_OFF 1 2 0 1 BIT_MASK 0x10 ECU_ADDRESS 0x7000A1EF /end MEASUREMENT
/begin MEASUREMENT FaultFTMTLCS_CurSenrPhaW_VCCLogged "FaultFTMTLCS_CurSenrPhaW_VCCLogged" UBYTE Bool_ON_OFF 1 2 0 1 BIT_MASK 0x10 ECU_ADDRESS 0x7000A1B3 /end MEASUREMENT
/begin MEASUREMENT FaultFTMTLCS_CurrentSumErrorAut "FaultFTMTLCS_CurrentSumErrorAut" UBYTE Bool_ON_OFF 1 2 0 1 BIT_MASK 0x01 ECU_ADDRESS 0x7000A176 /end MEASUREMENT
/begin MEASUREMENT FaultFTMTLCS_CurrentSumErrorDetected "FaultFTMTLCS_CurrentSumErrorDetected" UBYTE Bool_ON_OFF 1 2 0 1 BIT_MASK 0x01 ECU_ADDRESS 0x7000A1EE /end MEASUREMENT
/begin MEASUREMENT FaultFTMTLCS_CurrentSumErrorLogged "FaultFTMTLCS_CurrentSumErrorLogged" UBYTE Bool_ON_OFF 1 2 0 1 BIT_MASK 0x01 ECU_ADDRESS 0x7000A1B2 /end MEASUREMENT
/begin MEASUREMENT FaultFTMTLCS_Detected "FaultFTMTLCS_Detected" UWORD I_1 1 2 0 65535 ECU_ADDRESS 0x7000A1EE /end MEASUREMENT
/begin MEASUREMENT FaultFTMTLCS_Logged "FaultFTMTLCS_Logged" UWORD I_1 1 2 0 65535 ECU_ADDRESS 0x7000A1B2 /end MEASUREMENT
/begin MEASUREMENT FaultFailureLevel "FaultFailureLevel" UBYTE I_1 1 2 0 255 ECU_ADDRESS 0x700096E6 /end MEASUREMENT
/begin MEASUREMENT FaultFunctionTypeDetectedArray "FaultFunctionTypeDetectedArray" UWORD I_1 1 2 0 65535 MATRIX_DIM 30 1 1 ECU_ADDRESS 0x7000A1BC /end MEASUREMENT
/begin MEASUREMENT FaultFunctionTypeDetectedArray[0] "FaultFunctionTypeDetectedArray[0]" UWORD I_1 1 2 0 65535 ECU_ADDRESS 0x7000A1BC /end MEASUREMENT
/begin MEASUREMENT FaultFunctionTypeDetectedArray[10] "FaultFunctionTypeDetectedArray[10]" UWORD I_1 1 2 0 65535 ECU_ADDRESS 0x7000A1D0 /end MEASUREMENT
/begin MEASUREMENT FaultFunctionTypeDetectedArray[11] "FaultFunctionTypeDetectedArray[11]" UWORD I_1 1 2 0 65535 ECU_ADDRESS 0x7000A1D2 /end MEASUREMENT
/begin MEASUREMENT FaultFunctionTypeDetectedArray[12] "FaultFunctionTypeDetectedArray[12]" UWORD I_1 1 2 0 65535 ECU_ADDRESS 0x7000A1D4 /end MEASUREMENT
/begin MEASUREMENT FaultFunctionTypeDetectedArray[13] "FaultFunctionTypeDetectedArray[13]" UWORD I_1 1 2 0 65535 ECU_ADDRESS 0x7000A1D6 /end MEASUREMENT
/begin MEASUREMENT FaultFunctionTypeDetectedArray[14] "FaultFunctionTypeDetectedArray[14]" UWORD I_1 1 2 0 65535 ECU_ADDRESS 0x7000A1D8 /end MEASUREMENT
/begin MEASUREMENT FaultFunctionTypeDetectedArray[15] "FaultFunctionTypeDetectedArray[15]" UWORD I_1 1 2 0 65535 ECU_ADDRESS 0x7000A1DA /end MEASUREMENT
/begin MEASUREMENT FaultFunctionTypeDetectedArray[16] "FaultFunctionTypeDetectedArray[16]" UWORD I_1 1 2 0 65535 ECU_ADDRESS 0x7000A1DC /end MEASUREMENT
/begin MEASUREMENT FaultFunctionTypeDetectedArray[17] "FaultFunctionTypeDetectedArray[17]" UWORD I_1 1 2 0 65535 ECU_ADDRESS 0x7000A1DE /end MEASUREMENT
/begin MEASUREMENT FaultFunctionTypeDetectedArray[18] "FaultFunctionTypeDetectedArray[18]" UWORD I_1 1 2 0 65535 ECU_ADDRESS 0x7000A1E0 /end MEASUREMENT
/begin MEASUREMENT FaultFunctionTypeDetectedArray[19] "FaultFunctionTypeDetectedArray[19]" UWORD I_1 1 2 0 65535 ECU_ADDRESS 0x7000A1E2 /end MEASUREMENT
/begin MEASUREMENT FaultFunctionTypeDetectedArray[1] "FaultFunctionTypeDetectedArray[1]" UWORD I_1 1 2 0 65535 ECU_ADDRESS 0x7000A1BE /end MEASUREMENT
/begin MEASUREMENT FaultFunctionTypeDetectedArray[20] "FaultFunctionTypeDetectedArray[20]" UWORD I_1 1 2 0 65535 ECU_ADDRESS 0x7000A1E4 /end MEASUREMENT
/begin MEASUREMENT FaultFunctionTypeDetectedArray[21] "FaultFunctionTypeDetectedArray[21]" UWORD I_1 1 2 0 65535 ECU_ADDRESS 0x7000A1E6 /end MEASUREMENT
/begin MEASUREMENT FaultFunctionTypeDetectedArray[22] "FaultFunctionTypeDetectedArray[22]" UWORD I_1 1 2 0 65535 ECU_ADDRESS 0x7000A1E8 /end MEASUREMENT
/begin MEASUREMENT FaultFunctionTypeDetectedArray[23] "FaultFunctionTypeDetectedArray[23]" UWORD I_1 1 2 0 65535 ECU_ADDRESS 0x7000A1EA /end MEASUREMENT
/begin MEASUREMENT FaultFunctionTypeDetectedArray[24] "FaultFunctionTypeDetectedArray[24]" UWORD I_1 1 2 0 65535 ECU_ADDRESS 0x7000A1EC /end MEASUREMENT
/begin MEASUREMENT FaultFunctionTypeDetectedArray[25] "FaultFunctionTypeDetectedArray[25]" UWORD I_1 1 2 0 65535 ECU_ADDRESS 0x7000A1EE /end MEASUREMENT
/begin MEASUREMENT FaultFunctionTypeDetectedArray[26] "FaultFunctionTypeDetectedArray[26]" UWORD I_1 1 2 0 65535 ECU_ADDRESS 0x7000A1F0 /end MEASUREMENT
/begin MEASUREMENT FaultFunctionTypeDetectedArray[27] "FaultFunctionTypeDetectedArray[27]" UWORD I_1 1 2 0 65535 ECU_ADDRESS 0x7000A1F2 /end MEASUREMENT
/begin MEASUREMENT FaultFunctionTypeDetectedArray[28] "FaultFunctionTypeDetectedArray[28]" UWORD I_1 1 2 0 65535 ECU_ADDRESS 0x7000A1F4 /end MEASUREMENT
/begin MEASUREMENT FaultFunctionTypeDetectedArray[29] "FaultFunctionTypeDetectedArray[29]" UWORD I_1 1 2 0 65535 ECU_ADDRESS 0x7000A1F6 /end MEASUREMENT
/begin MEASUREMENT FaultFunctionTypeDetectedArray[2] "FaultFunctionTypeDetectedArray[2]" UWORD I_1 1 2 0 65535 ECU_ADDRESS 0x7000A1C0 /end MEASUREMENT
/begin MEASUREMENT FaultFunctionTypeDetectedArray[3] "FaultFunctionTypeDetectedArray[3]" UWORD I_1 1 2 0 65535 ECU_ADDRESS 0x7000A1C2 /end MEASUREMENT
/begin MEASUREMENT FaultFunctionTypeDetectedArray[4] "FaultFunctionTypeDetectedArray[4]" UWORD I_1 1 2 0 65535 ECU_ADDRESS 0x7000A1C4 /end MEASUREMENT
/begin MEASUREMENT FaultFunctionTypeDetectedArray[5] "FaultFunctionTypeDetectedArray[5]" UWORD I_1 1 2 0 65535 ECU_ADDRESS 0x7000A1C6 /end MEASUREMENT
/begin MEASUREMENT FaultFunctionTypeDetectedArray[6] "FaultFunctionTypeDetectedArray[6]" UWORD I_1 1 2 0 65535 ECU_ADDRESS 0x7000A1C8 /end MEASUREMENT
/begin MEASUREMENT FaultFunctionTypeDetectedArray[7] "FaultFunctionTypeDetectedArray[7]" UWORD I_1 1 2 0 65535 ECU_ADDRESS 0x7000A1CA /end MEASUREMENT
/begin MEASUREMENT FaultFunctionTypeDetectedArray[8] "FaultFunctionTypeDetectedArray[8]" UWORD I_1 1 2 0 65535 ECU_ADDRESS 0x7000A1CC /end MEASUREMENT
/begin MEASUREMENT FaultFunctionTypeDetectedArray[9] "FaultFunctionTypeDetectedArray[9]" UWORD I_1 1 2 0 65535 ECU_ADDRESS 0x7000A1CE /end MEASUREMENT
/begin MEASUREMENT FaultFunctionTypeLoggedArray "FaultFunctionTypeLoggedArray" UWORD I_1 1 2 0 65535 MATRIX_DIM 30 1 1 ECU_ADDRESS 0x7000A180 /end MEASUREMENT
/begin MEASUREMENT FaultFunctionTypeLoggedArray[0] "FaultFunctionTypeLoggedArray[0]" UWORD I_1 1 2 0 65535 ECU_ADDRESS 0x7000A180 /end MEASUREMENT
/begin MEASUREMENT FaultFunctionTypeLoggedArray[10] "FaultFunctionTypeLoggedArray[10]" UWORD I_1 1 2 0 65535 ECU_ADDRESS 0x7000A194 /end MEASUREMENT
/begin MEASUREMENT FaultFunctionTypeLoggedArray[11] "FaultFunctionTypeLoggedArray[11]" UWORD I_1 1 2 0 65535 ECU_ADDRESS 0x7000A196 /end MEASUREMENT
/begin MEASUREMENT FaultFunctionTypeLoggedArray[12] "FaultFunctionTypeLoggedArray[12]" UWORD I_1 1 2 0 65535 ECU_ADDRESS 0x7000A198 /end MEASUREMENT
/begin MEASUREMENT FaultFunctionTypeLoggedArray[13] "FaultFunctionTypeLoggedArray[13]" UWORD I_1 1 2 0 65535 ECU_ADDRESS 0x7000A19A /end MEASUREMENT
/begin MEASUREMENT FaultFunctionTypeLoggedArray[14] "FaultFunctionTypeLoggedArray[14]" UWORD I_1 1 2 0 65535 ECU_ADDRESS 0x7000A19C /end MEASUREMENT
/begin MEASUREMENT FaultFunctionTypeLoggedArray[15] "FaultFunctionTypeLoggedArray[15]" UWORD I_1 1 2 0 65535 ECU_ADDRESS 0x7000A19E /end MEASUREMENT
/begin MEASUREMENT FaultFunctionTypeLoggedArray[16] "FaultFunctionTypeLoggedArray[16]" UWORD I_1 1 2 0 65535 ECU_ADDRESS 0x7000A1A0 /end MEASUREMENT
/begin MEASUREMENT FaultFunctionTypeLoggedArray[17] "FaultFunctionTypeLoggedArray[17]" UWORD I_1 1 2 0 65535 ECU_ADDRESS 0x7000A1A2 /end MEASUREMENT
/begin MEASUREMENT FaultFunctionTypeLoggedArray[18] "FaultFunctionTypeLoggedArray[18]" UWORD I_1 1 2 0 65535 ECU_ADDRESS 0x7000A1A4 /end MEASUREMENT
/begin MEASUREMENT FaultFunctionTypeLoggedArray[19] "FaultFunctionTypeLoggedArray[19]" UWORD I_1 1 2 0 65535 ECU_ADDRESS 0x7000A1A6 /end MEASUREMENT
/begin MEASUREMENT FaultFunctionTypeLoggedArray[1] "FaultFunctionTypeLoggedArray[1]" UWORD I_1 1 2 0 65535 ECU_ADDRESS 0x7000A182 /end MEASUREMENT
/begin MEASUREMENT FaultFunctionTypeLoggedArray[20] "FaultFunctionTypeLoggedArray[20]" UWORD I_1 1 2 0 65535 ECU_ADDRESS 0x7000A1A8 /end MEASUREMENT
/begin MEASUREMENT FaultFunctionTypeLoggedArray[21] "FaultFunctionTypeLoggedArray[21]" UWORD I_1 1 2 0 65535 ECU_ADDRESS 0x7000A1AA /end MEASUREMENT
/begin MEASUREMENT FaultFunctionTypeLoggedArray[22] "FaultFunctionTypeLoggedArray[22]" UWORD I_1 1 2 0 65535 ECU_ADDRESS 0x7000A1AC /end MEASUREMENT
/begin MEASUREMENT FaultFunctionTypeLoggedArray[23] "FaultFunctionTypeLoggedArray[23]" UWORD I_1 1 2 0 65535 ECU_ADDRESS 0x7000A1AE /end MEASUREMENT
/begin MEASUREMENT FaultFunctionTypeLoggedArray[24] "FaultFunctionTypeLoggedArray[24]" UWORD I_1 1 2 0 65535 ECU_ADDRESS 0x7000A1B0 /end MEASUREMENT
/begin MEASUREMENT FaultFunctionTypeLoggedArray[25] "FaultFunctionTypeLoggedArray[25]" UWORD I_1 1 2 0 65535 ECU_ADDRESS 0x7000A1B2 /end MEASUREMENT
/begin MEASUREMENT FaultFunctionTypeLoggedArray[26] "FaultFunctionTypeLoggedArray[26]" UWORD I_1 1 2 0 65535 ECU_ADDRESS 0x7000A1B4 /end MEASUREMENT
/begin MEASUREMENT FaultFunctionTypeLoggedArray[27] "FaultFunctionTypeLoggedArray[27]" UWORD I_1 1 2 0 65535 ECU_ADDRESS 0x7000A1B6 /end MEASUREMENT
/begin MEASUREMENT FaultFunctionTypeLoggedArray[28] "FaultFunctionTypeLoggedArray[28]" UWORD I_1 1 2 0 65535 ECU_ADDRESS 0x7000A1B8 /end MEASUREMENT
/begin MEASUREMENT FaultFunctionTypeLoggedArray[29] "FaultFunctionTypeLoggedArray[29]" UWORD I_1 1 2 0 65535 ECU_ADDRESS 0x7000A1BA /end MEASUREMENT
/begin MEASUREMENT FaultFunctionTypeLoggedArray[2] "FaultFunctionTypeLoggedArray[2]" UWORD I_1 1 2 0 65535 ECU_ADDRESS 0x7000A184 /end MEASUREMENT
/begin MEASUREMENT FaultFunctionTypeLoggedArray[3] "FaultFunctionTypeLoggedArray[3]" UWORD I_1 1 2 0 65535 ECU_ADDRESS 0x7000A186 /end MEASUREMENT
/begin MEASUREMENT FaultFunctionTypeLoggedArray[4] "FaultFunctionTypeLoggedArray[4]" UWORD I_1 1 2 0 65535 ECU_ADDRESS 0x7000A188 /end MEASUREMENT
/begin MEASUREMENT FaultFunctionTypeLoggedArray[5] "FaultFunctionTypeLoggedArray[5]" UWORD I_1 1 2 0 65535 ECU_ADDRESS 0x7000A18A /end MEASUREMENT
/begin MEASUREMENT FaultFunctionTypeLoggedArray[6] "FaultFunctionTypeLoggedArray[6]" UWORD I_1 1 2 0 65535 ECU_ADDRESS 0x7000A18C /end MEASUREMENT
/begin MEASUREMENT FaultFunctionTypeLoggedArray[7] "FaultFunctionTypeLoggedArray[7]" UWORD I_1 1 2 0 65535 ECU_ADDRESS 0x7000A18E /end MEASUREMENT
/begin MEASUREMENT FaultFunctionTypeLoggedArray[8] "FaultFunctionTypeLoggedArray[8]" UWORD I_1 1 2 0 65535 ECU_ADDRESS 0x7000A190 /end MEASUREMENT
/begin MEASUREMENT FaultFunctionTypeLoggedArray[9] "FaultFunctionTypeLoggedArray[9]" UWORD I_1 1 2 0 65535 ECU_ADDRESS 0x7000A192 /end MEASUREMENT
/begin MEASUREMENT FaultSDMTMEP_CosGndAut "FaultSDMTMEP_CosGndAut" UBYTE Bool_ON_OFF 1 2 0 1 BIT_MASK 0x01 ECU_ADDRESS 0x7000A178 /end MEASUREMENT
/begin MEASUREMENT FaultSDMTMEP_CosGndDetected "FaultSDMTMEP_CosGndDetected" UBYTE Bool_ON_OFF 1 2 0 1 BIT_MASK 0x01 ECU_ADDRESS 0x7000A1F0 /end MEASUREMENT
/begin MEASUREMENT FaultSDMTMEP_CosGndLogged "FaultSDMTMEP_CosGndLogged" UBYTE Bool_ON_OFF 1 2 0 1 BIT_MASK 0x01 ECU_ADDRESS 0x7000A1B4 /end MEASUREMENT
/begin MEASUREMENT FaultSDMTMEP_CosOutRangeHighAut "FaultSDMTMEP_CosOutRangeHighAut" UBYTE Bool_ON_OFF 1 2 0 1 BIT_MASK 0x02 ECU_ADDRESS 0x7000A178 /end MEASUREMENT
/begin MEASUREMENT FaultSDMTMEP_CosOutRangeHighDetected "FaultSDMTMEP_CosOutRangeHighDetected" UBYTE Bool_ON_OFF 1 2 0 1 BIT_MASK 0x02 ECU_ADDRESS 0x7000A1F0 /end MEASUREMENT
/begin MEASUREMENT FaultSDMTMEP_CosOutRangeHighLogged "FaultSDMTMEP_CosOutRangeHighLogged" UBYTE Bool_ON_OFF 1 2 0 1 BIT_MASK 0x02 ECU_ADDRESS 0x7000A1B4 /end MEASUREMENT
/begin MEASUREMENT FaultSDMTMEP_CosOutRangeLowAut "FaultSDMTMEP_CosOutRangeLowAut" UBYTE Bool_ON_OFF 1 2 0 1 BIT_MASK 0x04 ECU_ADDRESS 0x7000A178 /end MEASUREMENT
/begin MEASUREMENT FaultSDMTMEP_CosOutRangeLowDetected "FaultSDMTMEP_CosOutRangeLowDetected" UBYTE Bool_ON_OFF 1 2 0 1 BIT_MASK 0x04 ECU_ADDRESS 0x7000A1F0 /end MEASUREMENT
/begin MEASUREMENT FaultSDMTMEP_CosOutRangeLowLogged "FaultSDMTMEP_CosOutRangeLowLogged" UBYTE Bool_ON_OFF 1 2 0 1 BIT_MASK 0x04 ECU_ADDRESS 0x7000A1B4 /end MEASUREMENT
/begin MEASUREMENT FaultSDMTMEP_CosVccAut "FaultSDMTMEP_CosVccAut" UBYTE Bool_ON_OFF 1 2 0 1 BIT_MASK 0x08 ECU_ADDRESS 0x7000A178 /end MEASUREMENT
/begin MEASUREMENT FaultSDMTMEP_CosVccDetected "FaultSDMTMEP_CosVccDetected" UBYTE Bool_ON_OFF 1 2 0 1 BIT_MASK 0x08 ECU_ADDRESS 0x7000A1F0 /end MEASUREMENT
/begin MEASUREMENT FaultSDMTMEP_CosVccLogged "FaultSDMTMEP_CosVccLogged" UBYTE Bool_ON_OFF 1 2 0 1 BIT_MASK 0x08 ECU_ADDRESS 0x7000A1B4 /end MEASUREMENT
/begin MEASUREMENT FaultSDMTMEP_Detected "FaultSDMTMEP_Detected" UWORD I_1 1 2 0 65535 ECU_ADDRESS 0x7000A1F0 /end MEASUREMENT
/begin MEASUREMENT FaultSDMTMEP_Logged "FaultSDMTMEP_Logged" UWORD I_1 1 2 0 65535 ECU_ADDRESS 0x7000A1B4 /end MEASUREMENT
/begin MEASUREMENT FaultSDMTMEP_OverSpeedAut "FaultSDMTMEP_OverSpeedAut" UBYTE Bool_ON_OFF 1 2 0 1 BIT_MASK 0x10 ECU_ADDRESS 0x7000A178 /end MEASUREMENT
/begin MEASUREMENT FaultSDMTMEP_OverSpeedDetected "FaultSDMTMEP_OverSpeedDetected" UBYTE Bool_ON_OFF 1 2 0 1 BIT_MASK 0x10 ECU_ADDRESS 0x7000A1F0 /end MEASUREMENT
/begin MEASUREMENT FaultSDMTMEP_OverSpeedLogged "FaultSDMTMEP_OverSpeedLogged" UBYTE Bool_ON_OFF 1 2 0 1 BIT_MASK 0x10 ECU_ADDRESS 0x7000A1B4 /end MEASUREMENT
/begin MEASUREMENT FaultSDMTMEP_ResSquaSumErrByFTAut "FaultSDMTMEP_ResSquaSumErrByFTAut" UBYTE Bool_ON_OFF 1 2 0 1 BIT_MASK 0x20 ECU_ADDRESS 0x7000A178 /end MEASUREMENT
/begin MEASUREMENT FaultSDMTMEP_ResSquaSumErrByFTDetected "FaultSDMTMEP_ResSquaSumErrByFTDetected" UBYTE Bool_ON_OFF 1 2 0 1 BIT_MASK 0x20 ECU_ADDRESS 0x7000A1F0 /end MEASUREMENT
/begin MEASUREMENT FaultSDMTMEP_ResSquaSumErrByFTLogged "FaultSDMTMEP_ResSquaSumErrByFTLogged" UBYTE Bool_ON_OFF 1 2 0 1 BIT_MASK 0x20 ECU_ADDRESS 0x7000A1B4 /end MEASUREMENT
/begin MEASUREMENT FaultSDMTMEP_SinGndAut "FaultSDMTMEP_SinGndAut" UBYTE Bool_ON_OFF 1 2 0 1 BIT_MASK 0x40 ECU_ADDRESS 0x7000A178 /end MEASUREMENT
/begin MEASUREMENT FaultSDMTMEP_SinGndDetected "FaultSDMTMEP_SinGndDetected" UBYTE Bool_ON_OFF 1 2 0 1 BIT_MASK 0x40 ECU_ADDRESS 0x7000A1F0 /end MEASUREMENT
/begin MEASUREMENT FaultSDMTMEP_SinGndLogged "FaultSDMTMEP_SinGndLogged" UBYTE Bool_ON_OFF 1 2 0 1 BIT_MASK 0x40 ECU_ADDRESS 0x7000A1B4 /end MEASUREMENT
/begin MEASUREMENT FaultSDMTMEP_SinOutRangeHighAut "FaultSDMTMEP_SinOutRangeHighAut" UBYTE Bool_ON_OFF 1 2 0 1 BIT_MASK 0x80 ECU_ADDRESS 0x7000A178 /end MEASUREMENT
/begin MEASUREMENT FaultSDMTMEP_SinOutRangeHighDetected "FaultSDMTMEP_SinOutRangeHighDetected" UBYTE Bool_ON_OFF 1 2 0 1 BIT_MASK 0x80 ECU_ADDRESS 0x7000A1F0 /end MEASUREMENT
/begin MEASUREMENT FaultSDMTMEP_SinOutRangeHighLogged "FaultSDMTMEP_SinOutRangeHighLogged" UBYTE Bool_ON_OFF 1 2 0 1 BIT_MASK 0x80 ECU_ADDRESS 0x7000A1B4 /end MEASUREMENT
/begin MEASUREMENT FaultSDMTMEP_SinOutRangeLowAut "FaultSDMTMEP_SinOutRangeLowAut" UBYTE Bool_ON_OFF 1 2 0 1 BIT_MASK 0x01 ECU_ADDRESS 0x7000A179 /end MEASUREMENT
/begin MEASUREMENT FaultSDMTMEP_SinOutRangeLowDetected "FaultSDMTMEP_SinOutRangeLowDetected" UBYTE Bool_ON_OFF 1 2 0 1 BIT_MASK 0x01 ECU_ADDRESS 0x7000A1F1 /end MEASUREMENT
/begin MEASUREMENT FaultSDMTMEP_SinOutRangeLowLogged "FaultSDMTMEP_SinOutRangeLowLogged" UBYTE Bool_ON_OFF 1 2 0 1 BIT_MASK 0x01 ECU_ADDRESS 0x7000A1B5 /end MEASUREMENT
/begin MEASUREMENT FaultSDMTMEP_SinVccAut "FaultSDMTMEP_SinVccAut" UBYTE Bool_ON_OFF 1 2 0 1 BIT_MASK 0x02 ECU_ADDRESS 0x7000A179 /end MEASUREMENT
/begin MEASUREMENT FaultSDMTMEP_SinVccDetected "FaultSDMTMEP_SinVccDetected" UBYTE Bool_ON_OFF 1 2 0 1 BIT_MASK 0x02 ECU_ADDRESS 0x7000A1F1 /end MEASUREMENT
/begin MEASUREMENT FaultSDMTMEP_SinVccLogged "FaultSDMTMEP_SinVccLogged" UBYTE Bool_ON_OFF 1 2 0 1 BIT_MASK 0x02 ECU_ADDRESS 0x7000A1B5 /end MEASUREMENT
/begin MEASUREMENT FaultSDMTMEP_UnderSpeedAut "FaultSDMTMEP_UnderSpeedAut" UBYTE Bool_ON_OFF 1 2 0 1 BIT_MASK 0x04 ECU_ADDRESS 0x7000A179 /end MEASUREMENT
/begin MEASUREMENT FaultSDMTMEP_UnderSpeedDetected "FaultSDMTMEP_UnderSpeedDetected" UBYTE Bool_ON_OFF 1 2 0 1 BIT_MASK 0x04 ECU_ADDRESS 0x7000A1F1 /end MEASUREMENT
/begin MEASUREMENT FaultSDMTMEP_UnderSpeedLogged "FaultSDMTMEP_UnderSpeedLogged" UBYTE Bool_ON_OFF 1 2 0 1 BIT_MASK 0x04 ECU_ADDRESS 0x7000A1B5 /end MEASUREMENT
/begin MEASUREMENT FaultTCUCAP0_CAPPressureHAut "FaultTCUCAP0_CAPPressureHAut" UBYTE Bool_ON_OFF 1 2 0 1 BIT_MASK 0x01 ECU_ADDRESS 0x7000A17A /end MEASUREMENT
/begin MEASUREMENT FaultTCUCAP0_CAPPressureHDetected "FaultTCUCAP0_CAPPressureHDetected" UBYTE Bool_ON_OFF 1 2 0 1 BIT_MASK 0x01 ECU_ADDRESS 0x7000A1F2 /end MEASUREMENT
/begin MEASUREMENT FaultTCUCAP0_CAPPressureHLogged "FaultTCUCAP0_CAPPressureHLogged" UBYTE Bool_ON_OFF 1 2 0 1 BIT_MASK 0x01 ECU_ADDRESS 0x7000A1B6 /end MEASUREMENT
/begin MEASUREMENT FaultTCUCAP0_CAPPressureLAut "FaultTCUCAP0_CAPPressureLAut" UBYTE Bool_ON_OFF 1 2 0 1 BIT_MASK 0x02 ECU_ADDRESS 0x7000A17A /end MEASUREMENT
/begin MEASUREMENT FaultTCUCAP0_CAPPressureLDetected "FaultTCUCAP0_CAPPressureLDetected" UBYTE Bool_ON_OFF 1 2 0 1 BIT_MASK 0x02 ECU_ADDRESS 0x7000A1F2 /end MEASUREMENT
/begin MEASUREMENT FaultTCUCAP0_CAPPressureLLogged "FaultTCUCAP0_CAPPressureLLogged" UBYTE Bool_ON_OFF 1 2 0 1 BIT_MASK 0x02 ECU_ADDRESS 0x7000A1B6 /end MEASUREMENT
/begin MEASUREMENT FaultTCUCAP0_CAPPressureOverHAut "FaultTCUCAP0_CAPPressureOverHAut" UBYTE Bool_ON_OFF 1 2 0 1 BIT_MASK 0x04 ECU_ADDRESS 0x7000A17A /end MEASUREMENT
/begin MEASUREMENT FaultTCUCAP0_CAPPressureOverHDetected "FaultTCUCAP0_CAPPressureOverHDetected" UBYTE Bool_ON_OFF 1 2 0 1 BIT_MASK 0x04 ECU_ADDRESS 0x7000A1F2 /end MEASUREMENT
/begin MEASUREMENT FaultTCUCAP0_CAPPressureOverHLogged "FaultTCUCAP0_CAPPressureOverHLogged" UBYTE Bool_ON_OFF 1 2 0 1 BIT_MASK 0x04 ECU_ADDRESS 0x7000A1B6 /end MEASUREMENT
/begin MEASUREMENT FaultTCUCAP0_CAPSlipAut "FaultTCUCAP0_CAPSlipAut" UBYTE Bool_ON_OFF 1 2 0 1 BIT_MASK 0x08 ECU_ADDRESS 0x7000A17A /end MEASUREMENT
/begin MEASUREMENT FaultTCUCAP0_CAPSlipDetected "FaultTCUCAP0_CAPSlipDetected" UBYTE Bool_ON_OFF 1 2 0 1 BIT_MASK 0x08 ECU_ADDRESS 0x7000A1F2 /end MEASUREMENT
/begin MEASUREMENT FaultTCUCAP0_CAPSlipLogged "FaultTCUCAP0_CAPSlipLogged" UBYTE Bool_ON_OFF 1 2 0 1 BIT_MASK 0x08 ECU_ADDRESS 0x7000A1B6 /end MEASUREMENT
/begin MEASUREMENT FaultTCUCAP0_Detected "FaultTCUCAP0_Detected" UWORD I_1 1 2 0 65535 ECU_ADDRESS 0x7000A1F2 /end MEASUREMENT
/begin MEASUREMENT FaultTCUCAP0_DragMomentHAut "FaultTCUCAP0_DragMomentHAut" UBYTE Bool_ON_OFF 1 2 0 1 BIT_MASK 0x10 ECU_ADDRESS 0x7000A17A /end MEASUREMENT
/begin MEASUREMENT FaultTCUCAP0_DragMomentHDetected "FaultTCUCAP0_DragMomentHDetected" UBYTE Bool_ON_OFF 1 2 0 1 BIT_MASK 0x10 ECU_ADDRESS 0x7000A1F2 /end MEASUREMENT
/begin MEASUREMENT FaultTCUCAP0_DragMomentHLogged "FaultTCUCAP0_DragMomentHLogged" UBYTE Bool_ON_OFF 1 2 0 1 BIT_MASK 0x10 ECU_ADDRESS 0x7000A1B6 /end MEASUREMENT
/begin MEASUREMENT FaultTCUCAP0_HLSinInvalidAut "FaultTCUCAP0_HLSinInvalidAut" UBYTE Bool_ON_OFF 1 2 0 1 BIT_MASK 0x20 ECU_ADDRESS 0x7000A17A /end MEASUREMENT
/begin MEASUREMENT FaultTCUCAP0_HLSinInvalidDetected "FaultTCUCAP0_HLSinInvalidDetected" UBYTE Bool_ON_OFF 1 2 0 1 BIT_MASK 0x20 ECU_ADDRESS 0x7000A1F2 /end MEASUREMENT
/begin MEASUREMENT FaultTCUCAP0_HLSinInvalidLogged "FaultTCUCAP0_HLSinInvalidLogged" UBYTE Bool_ON_OFF 1 2 0 1 BIT_MASK 0x20 ECU_ADDRESS 0x7000A1B6 /end MEASUREMENT
/begin MEASUREMENT FaultTCUCAP0_HLSinUndefineAut "FaultTCUCAP0_HLSinUndefineAut" UBYTE Bool_ON_OFF 1 2 0 1 BIT_MASK 0x40 ECU_ADDRESS 0x7000A17A /end MEASUREMENT
/begin MEASUREMENT FaultTCUCAP0_HLSinUndefineDetected "FaultTCUCAP0_HLSinUndefineDetected" UBYTE Bool_ON_OFF 1 2 0 1 BIT_MASK 0x40 ECU_ADDRESS 0x7000A1F2 /end MEASUREMENT
/begin MEASUREMENT FaultTCUCAP0_HLSinUndefineLogged "FaultTCUCAP0_HLSinUndefineLogged" UBYTE Bool_ON_OFF 1 2 0 1 BIT_MASK 0x40 ECU_ADDRESS 0x7000A1B6 /end MEASUREMENT
/begin MEASUREMENT FaultTCUCAP0_HLSupplyHAut "FaultTCUCAP0_HLSupplyHAut" UBYTE Bool_ON_OFF 1 2 0 1 BIT_MASK 0x80 ECU_ADDRESS 0x7000A17A /end MEASUREMENT
/begin MEASUREMENT FaultTCUCAP0_HLSupplyHDetected "FaultTCUCAP0_HLSupplyHDetected" UBYTE Bool_ON_OFF 1 2 0 1 BIT_MASK 0x80 ECU_ADDRESS 0x7000A1F2 /end MEASUREMENT
/begin MEASUREMENT FaultTCUCAP0_HLSupplyHLogged "FaultTCUCAP0_HLSupplyHLogged" UBYTE Bool_ON_OFF 1 2 0 1 BIT_MASK 0x80 ECU_ADDRESS 0x7000A1B6 /end MEASUREMENT
/begin MEASUREMENT FaultTCUCAP0_HLSupplyLAut "FaultTCUCAP0_HLSupplyLAut" UBYTE Bool_ON_OFF 1 2 0 1 BIT_MASK 0x01 ECU_ADDRESS 0x7000A17B /end MEASUREMENT
/begin MEASUREMENT FaultTCUCAP0_HLSupplyLDetected "FaultTCUCAP0_HLSupplyLDetected" UBYTE Bool_ON_OFF 1 2 0 1 BIT_MASK 0x01 ECU_ADDRESS 0x7000A1F3 /end MEASUREMENT
/begin MEASUREMENT FaultTCUCAP0_HLSupplyLLogged "FaultTCUCAP0_HLSupplyLLogged" UBYTE Bool_ON_OFF 1 2 0 1 BIT_MASK 0x01 ECU_ADDRESS 0x7000A1B7 /end MEASUREMENT
/begin MEASUREMENT FaultTCUCAP0_Logged "FaultTCUCAP0_Logged" UWORD I_1 1 2 0 65535 ECU_ADDRESS 0x7000A1B6 /end MEASUREMENT
/begin MEASUREMENT FaultTCUCAP0_MotorPhaseVolHAut "FaultTCUCAP0_MotorPhaseVolHAut" UBYTE Bool_ON_OFF 1 2 0 1 BIT_MASK 0x02 ECU_ADDRESS 0x7000A17B /end MEASUREMENT
/begin MEASUREMENT FaultTCUCAP0_MotorPhaseVolHDetected "FaultTCUCAP0_MotorPhaseVolHDetected" UBYTE Bool_ON_OFF 1 2 0 1 BIT_MASK 0x02 ECU_ADDRESS 0x7000A1F3 /end MEASUREMENT
/begin MEASUREMENT FaultTCUCAP0_MotorPhaseVolHLogged "FaultTCUCAP0_MotorPhaseVolHLogged" UBYTE Bool_ON_OFF 1 2 0 1 BIT_MASK 0x02 ECU_ADDRESS 0x7000A1B7 /end MEASUREMENT
/begin MEASUREMENT FaultTCUCAP0_PressureRationalAut "FaultTCUCAP0_PressureRationalAut" UBYTE Bool_ON_OFF 1 2 0 1 BIT_MASK 0x04 ECU_ADDRESS 0x7000A17B /end MEASUREMENT
/begin MEASUREMENT FaultTCUCAP0_PressureRationalDetected "FaultTCUCAP0_PressureRationalDetected" UBYTE Bool_ON_OFF 1 2 0 1 BIT_MASK 0x04 ECU_ADDRESS 0x7000A1F3 /end MEASUREMENT
/begin MEASUREMENT FaultTCUCAP0_PressureRationalLogged "FaultTCUCAP0_PressureRationalLogged" UBYTE Bool_ON_OFF 1 2 0 1 BIT_MASK 0x04 ECU_ADDRESS 0x7000A1B7 /end MEASUREMENT
/begin MEASUREMENT FaultTCUCAP0_SenSigOpenOrGNDAut "FaultTCUCAP0_SenSigOpenOrGNDAut" UBYTE Bool_ON_OFF 1 2 0 1 BIT_MASK 0x08 ECU_ADDRESS 0x7000A17B /end MEASUREMENT
/begin MEASUREMENT FaultTCUCAP0_SenSigOpenOrGNDDetected "FaultTCUCAP0_SenSigOpenOrGNDDetected" UBYTE Bool_ON_OFF 1 2 0 1 BIT_MASK 0x08 ECU_ADDRESS 0x7000A1F3 /end MEASUREMENT
/begin MEASUREMENT FaultTCUCAP0_SenSigOpenOrGNDLogged "FaultTCUCAP0_SenSigOpenOrGNDLogged" UBYTE Bool_ON_OFF 1 2 0 1 BIT_MASK 0x08 ECU_ADDRESS 0x7000A1B7 /end MEASUREMENT
/begin MEASUREMENT FaultTCUCAP0_SenSigVCCAut "FaultTCUCAP0_SenSigVCCAut" UBYTE Bool_ON_OFF 1 2 0 1 BIT_MASK 0x10 ECU_ADDRESS 0x7000A17B /end MEASUREMENT
/begin MEASUREMENT FaultTCUCAP0_SenSigVCCDetected "FaultTCUCAP0_SenSigVCCDetected" UBYTE Bool_ON_OFF 1 2 0 1 BIT_MASK 0x10 ECU_ADDRESS 0x7000A1F3 /end MEASUREMENT
/begin MEASUREMENT FaultTCUCAP0_SenSigVCCLogged "FaultTCUCAP0_SenSigVCCLogged" UBYTE Bool_ON_OFF 1 2 0 1 BIT_MASK 0x10 ECU_ADDRESS 0x7000A1B7 /end MEASUREMENT
/begin MEASUREMENT FaultTCUCAP0_SensorPerforErrAut "FaultTCUCAP0_SensorPerforErrAut" UBYTE Bool_ON_OFF 1 2 0 1 BIT_MASK 0x20 ECU_ADDRESS 0x7000A17B /end MEASUREMENT
/begin MEASUREMENT FaultTCUCAP0_SensorPerforErrDetected "FaultTCUCAP0_SensorPerforErrDetected" UBYTE Bool_ON_OFF 1 2 0 1 BIT_MASK 0x20 ECU_ADDRESS 0x7000A1F3 /end MEASUREMENT
/begin MEASUREMENT FaultTCUCAP0_SensorPerforErrLogged "FaultTCUCAP0_SensorPerforErrLogged" UBYTE Bool_ON_OFF 1 2 0 1 BIT_MASK 0x20 ECU_ADDRESS 0x7000A1B7 /end MEASUREMENT
/begin MEASUREMENT FaultTCUCAP1_COM_GCUAut "FaultTCUCAP1_COM_GCUAut" UBYTE Bool_ON_OFF 1 2 0 1 BIT_MASK 0x01 ECU_ADDRESS 0x7000A17C /end MEASUREMENT
/begin MEASUREMENT FaultTCUCAP1_COM_GCUDetected "FaultTCUCAP1_COM_GCUDetected" UBYTE Bool_ON_OFF 1 2 0 1 BIT_MASK 0x01 ECU_ADDRESS 0x7000A1F4 /end MEASUREMENT
/begin MEASUREMENT FaultTCUCAP1_COM_GCULogged "FaultTCUCAP1_COM_GCULogged" UBYTE Bool_ON_OFF 1 2 0 1 BIT_MASK 0x01 ECU_ADDRESS 0x7000A1B8 /end MEASUREMENT
/begin MEASUREMENT FaultTCUCAP1_Detected "FaultTCUCAP1_Detected" UWORD I_1 1 2 0 65535 ECU_ADDRESS 0x7000A1F4 /end MEASUREMENT
/begin MEASUREMENT FaultTCUCAP1_DriverTempHAut "FaultTCUCAP1_DriverTempHAut" UBYTE Bool_ON_OFF 1 2 0 1 BIT_MASK 0x02 ECU_ADDRESS 0x7000A17C /end MEASUREMENT
/begin MEASUREMENT FaultTCUCAP1_DriverTempHDetected "FaultTCUCAP1_DriverTempHDetected" UBYTE Bool_ON_OFF 1 2 0 1 BIT_MASK 0x02 ECU_ADDRESS 0x7000A1F4 /end MEASUREMENT
/begin MEASUREMENT FaultTCUCAP1_DriverTempHLogged "FaultTCUCAP1_DriverTempHLogged" UBYTE Bool_ON_OFF 1 2 0 1 BIT_MASK 0x02 ECU_ADDRESS 0x7000A1B8 /end MEASUREMENT
/begin MEASUREMENT FaultTCUCAP1_FETShortAut "FaultTCUCAP1_FETShortAut" UBYTE Bool_ON_OFF 1 2 0 1 BIT_MASK 0x04 ECU_ADDRESS 0x7000A17C /end MEASUREMENT
/begin MEASUREMENT FaultTCUCAP1_FETShortDetected "FaultTCUCAP1_FETShortDetected" UBYTE Bool_ON_OFF 1 2 0 1 BIT_MASK 0x04 ECU_ADDRESS 0x7000A1F4 /end MEASUREMENT
/begin MEASUREMENT FaultTCUCAP1_FETShortLogged "FaultTCUCAP1_FETShortLogged" UBYTE Bool_ON_OFF 1 2 0 1 BIT_MASK 0x04 ECU_ADDRESS 0x7000A1B8 /end MEASUREMENT
/begin MEASUREMENT FaultTCUCAP1_HWOverCurAut "FaultTCUCAP1_HWOverCurAut" UBYTE Bool_ON_OFF 1 2 0 1 BIT_MASK 0x08 ECU_ADDRESS 0x7000A17C /end MEASUREMENT
/begin MEASUREMENT FaultTCUCAP1_HWOverCurDetected "FaultTCUCAP1_HWOverCurDetected" UBYTE Bool_ON_OFF 1 2 0 1 BIT_MASK 0x08 ECU_ADDRESS 0x7000A1F4 /end MEASUREMENT
/begin MEASUREMENT FaultTCUCAP1_HWOverCurLogged "FaultTCUCAP1_HWOverCurLogged" UBYTE Bool_ON_OFF 1 2 0 1 BIT_MASK 0x08 ECU_ADDRESS 0x7000A1B8 /end MEASUREMENT
/begin MEASUREMENT FaultTCUCAP1_Logged "FaultTCUCAP1_Logged" UWORD I_1 1 2 0 65535 ECU_ADDRESS 0x7000A1B8 /end MEASUREMENT
/begin MEASUREMENT FaultTCUCAP1_MotorPhaseDriveErrAut "FaultTCUCAP1_MotorPhaseDriveErrAut" UBYTE Bool_ON_OFF 1 2 0 1 BIT_MASK 0x10 ECU_ADDRESS 0x7000A17C /end MEASUREMENT
/begin MEASUREMENT FaultTCUCAP1_MotorPhaseDriveErrDetected "FaultTCUCAP1_MotorPhaseDriveErrDetected" UBYTE Bool_ON_OFF 1 2 0 1 BIT_MASK 0x10 ECU_ADDRESS 0x7000A1F4 /end MEASUREMENT
/begin MEASUREMENT FaultTCUCAP1_MotorPhaseDriveErrLogged "FaultTCUCAP1_MotorPhaseDriveErrLogged" UBYTE Bool_ON_OFF 1 2 0 1 BIT_MASK 0x10 ECU_ADDRESS 0x7000A1B8 /end MEASUREMENT
/begin MEASUREMENT FaultTCUCAP1_MotorStallAut "FaultTCUCAP1_MotorStallAut" UBYTE Bool_ON_OFF 1 2 0 1 BIT_MASK 0x20 ECU_ADDRESS 0x7000A17C /end MEASUREMENT
/begin MEASUREMENT FaultTCUCAP1_MotorStallDetected "FaultTCUCAP1_MotorStallDetected" UBYTE Bool_ON_OFF 1 2 0 1 BIT_MASK 0x20 ECU_ADDRESS 0x7000A1F4 /end MEASUREMENT
/begin MEASUREMENT FaultTCUCAP1_MotorStallLogged "FaultTCUCAP1_MotorStallLogged" UBYTE Bool_ON_OFF 1 2 0 1 BIT_MASK 0x20 ECU_ADDRESS 0x7000A1B8 /end MEASUREMENT
/begin MEASUREMENT FaultTCUCAP1_OverVoltageAut "FaultTCUCAP1_OverVoltageAut" UBYTE Bool_ON_OFF 1 2 0 1 BIT_MASK 0x40 ECU_ADDRESS 0x7000A17C /end MEASUREMENT
/begin MEASUREMENT FaultTCUCAP1_OverVoltageDetected "FaultTCUCAP1_OverVoltageDetected" UBYTE Bool_ON_OFF 1 2 0 1 BIT_MASK 0x40 ECU_ADDRESS 0x7000A1F4 /end MEASUREMENT
/begin MEASUREMENT FaultTCUCAP1_OverVoltageLogged "FaultTCUCAP1_OverVoltageLogged" UBYTE Bool_ON_OFF 1 2 0 1 BIT_MASK 0x40 ECU_ADDRESS 0x7000A1B8 /end MEASUREMENT
/begin MEASUREMENT FaultTCUCAP1_PhaseDetectGNDAut "FaultTCUCAP1_PhaseDetectGNDAut" UBYTE Bool_ON_OFF 1 2 0 1 BIT_MASK 0x80 ECU_ADDRESS 0x7000A17C /end MEASUREMENT
/begin MEASUREMENT FaultTCUCAP1_PhaseDetectGNDDetected "FaultTCUCAP1_PhaseDetectGNDDetected" UBYTE Bool_ON_OFF 1 2 0 1 BIT_MASK 0x80 ECU_ADDRESS 0x7000A1F4 /end MEASUREMENT
/begin MEASUREMENT FaultTableFuncTypeCounter1 "FaultTableFuncTypeCounter1" UBYTE I_1 1 2 0 255 MATRIX_DIM 133 1 1 ECU_ADDRESS 0x7000A1F8 /end MEASUREMENT
/begin MEASUREMENT FaultTableFuncTypeCounter1[0] "FaultTableFuncTypeCounter1[0]" UBYTE I_1 1 2 0 255 ECU_ADDRESS 0x7000A1F8 /end MEASUREMENT
/begin MEASUREMENT FaultTableFuncTypeCounter1[100] "FaultTableFuncTypeCounter1[100]" UBYTE I_1 1 2 0 255 ECU_ADDRESS 0x7000A25C /end MEASUREMENT
/begin MEASUREMENT FaultTableFuncTypeCounter1[101] "FaultTableFuncTypeCounter1[101]" UBYTE I_1 1 2 0 255 ECU_ADDRESS 0x7000A25D /end MEASUREMENT
/begin MEASUREMENT FaultTableFuncTypeCounter1[102] "FaultTableFuncTypeCounter1[102]" UBYTE I_1 1 2 0 255 ECU_ADDRESS 0x7000A25E /end MEASUREMENT
/begin MEASUREMENT FaultTableFuncTypeCounter1[103] "FaultTableFuncTypeCounter1[103]" UBYTE I_1 1 2 0 255 ECU_ADDRESS 0x7000A25F /end MEASUREMENT
/begin MEASUREMENT FaultTableFuncTypeCounter1[104] "FaultTableFuncTypeCounter1[104]" UBYTE I_1 1 2 0 255 ECU_ADDRESS 0x7000A260 /end MEASUREMENT
/begin MEASUREMENT FaultTableFuncTypeCounter1[105] "FaultTableFuncTypeCounter1[105]" UBYTE I_1 1 2 0 255 ECU_ADDRESS 0x7000A261 /end MEASUREMENT
/begin MEASUREMENT FaultTableFuncTypeCounter1[106] "FaultTableFuncTypeCounter1[106]" UBYTE I_1 1 2 0 255 ECU_ADDRESS 0x7000A262 /end MEASUREMENT
/begin MEASUREMENT FaultTableFuncTypeCounter1[107] "FaultTableFuncTypeCounter1[107]" UBYTE I_1 1 2 0 255 ECU_ADDRESS 0x7000A263 /end MEASUREMENT
/begin MEASUREMENT FaultTableFuncTypeCounter1[108] "FaultTableFuncTypeCounter1[108]" UBYTE I_1 1 2 0 255 ECU_ADDRESS 0x7000A264 /end MEASUREMENT
/begin MEASUREMENT FaultTableFuncTypeCounter1[109] "FaultTableFuncTypeCounter1[109]" UBYTE I_1 1 2 0 255 ECU_ADDRESS 0x7000A265 /end MEASUREMENT
/begin MEASUREMENT FaultTableFuncTypeCounter1[10] "FaultTableFuncTypeCounter1[10]" UBYTE I_1 1 2 0 255 ECU_ADDRESS 0x7000A202 /end MEASUREMENT
/begin MEASUREMENT FaultTableFuncTypeCounter1[110] "FaultTableFuncTypeCounter1[110]" UBYTE I_1 1 2 0 255 ECU_ADDRESS 0x7000A266 /end MEASUREMENT
/begin MEASUREMENT FaultTableFuncTypeCounter1[111] "FaultTableFuncTypeCounter1[111]" UBYTE I_1 1 2 0 255 ECU_ADDRESS 0x7000A267 /end MEASUREMENT
/begin MEASUREMENT FaultTableFuncTypeCounter1[112] "FaultTableFuncTypeCounter1[112]" UBYTE I_1 1 2 0 255 ECU_ADDRESS 0x7000A268 /end MEASUREMENT
/begin MEASUREMENT FaultTableFuncTypeCounter1[113] "FaultTableFuncTypeCounter1[113]" UBYTE I_1 1 2 0 255 ECU_ADDRESS 0x7000A269 /end MEASUREMENT
/begin MEASUREMENT FaultTableFuncTypeCounter1[114] "FaultTableFuncTypeCounter1[114]" UBYTE I_1 1 2 0 255 ECU_ADDRESS 0x7000A26A /end MEASUREMENT
/begin MEASUREMENT FaultTableFuncTypeCounter1[115] "FaultTableFuncTypeCounter1[115]" UBYTE I_1 1 2 0 255 ECU_ADDRESS 0x7000A26B /end MEASUREMENT
/begin MEASUREMENT FaultTableFuncTypeCounter1[116] "FaultTableFuncTypeCounter1[116]" UBYTE I_1 1 2 0 255 ECU_ADDRESS 0x7000A26C /end MEASUREMENT
/begin MEASUREMENT FaultTableFuncTypeCounter1[117] "FaultTableFuncTypeCounter1[117]" UBYTE I_1 1 2 0 255 ECU_ADDRESS 0x7000A26D /end MEASUREMENT
/begin MEASUREMENT FaultTableFuncTypeCounter1[118] "FaultTableFuncTypeCounter1[118]" UBYTE I_1 1 2 0 255 ECU_ADDRESS 0x7000A26E /end MEASUREMENT
/begin MEASUREMENT FaultTableFuncTypeCounter1[119] "FaultTableFuncTypeCounter1[119]" UBYTE I_1 1 2 0 255 ECU_ADDRESS 0x7000A26F /end MEASUREMENT
/begin MEASUREMENT FaultTableFuncTypeCounter1[11] "FaultTableFuncTypeCounter1[11]" UBYTE I_1 1 2 0 255 ECU_ADDRESS 0x7000A203 /end MEASUREMENT
/begin MEASUREMENT FaultTableFuncTypeCounter1[120] "FaultTableFuncTypeCounter1[120]" UBYTE I_1 1 2 0 255 ECU_ADDRESS 0x7000A270 /end MEASUREMENT
/begin MEASUREMENT FaultTableFuncTypeCounter1[121] "FaultTableFuncTypeCounter1[121]" UBYTE I_1 1 2 0 255 ECU_ADDRESS 0x7000A271 /end MEASUREMENT
/begin MEASUREMENT FaultTableFuncTypeCounter1[122] "FaultTableFuncTypeCounter1[122]" UBYTE I_1 1 2 0 255 ECU_ADDRESS 0x7000A272 /end MEASUREMENT
/begin MEASUREMENT FaultTableFuncTypeCounter1[123] "FaultTableFuncTypeCounter1[123]" UBYTE I_1 1 2 0 255 ECU_ADDRESS 0x7000A273 /end MEASUREMENT
/begin MEASUREMENT FaultTableFuncTypeCounter1[124] "FaultTableFuncTypeCounter1[124]" UBYTE I_1 1 2 0 255 ECU_ADDRESS 0x7000A274 /end MEASUREMENT
/begin MEASUREMENT FaultTableFuncTypeCounter1[125] "FaultTableFuncTypeCounter1[125]" UBYTE I_1 1 2 0 255 ECU_ADDRESS 0x7000A275 /end MEASUREMENT
/begin MEASUREMENT FaultTableFuncTypeCounter1[126] "FaultTableFuncTypeCounter1[126]" UBYTE I_1 1 2 0 255 ECU_ADDRESS 0x7000A276 /end MEASUREMENT
/begin MEASUREMENT FaultTableFuncTypeCounter1[127] "FaultTableFuncTypeCounter1[127]" UBYTE I_1 1 2 0 255 ECU_ADDRESS 0x7000A277 /end MEASUREMENT
/begin MEASUREMENT FaultTableFuncTypeCounter1[128] "FaultTableFuncTypeCounter1[128]" UBYTE I_1 1 2 0 255 ECU_ADDRESS 0x7000A278 /end MEASUREMENT
/begin MEASUREMENT FaultTableFuncTypeCounter1[129] "FaultTableFuncTypeCounter1[129]" UBYTE I_1 1 2 0 255 ECU_ADDRESS 0x7000A279 /end MEASUREMENT
/begin MEASUREMENT FaultTableFuncTypeCounter1[12] "FaultTableFuncTypeCounter1[12]" UBYTE I_1 1 2 0 255 ECU_ADDRESS 0x7000A204 /end MEASUREMENT
/begin MEASUREMENT FaultTableFuncTypeCounter1[130] "FaultTableFuncTypeCounter1[130]" UBYTE I_1 1 2 0 255 ECU_ADDRESS 0x7000A27A /end MEASUREMENT
/begin MEASUREMENT FaultTableFuncTypeCounter1[131] "FaultTableFuncTypeCounter1[131]" UBYTE I_1 1 2 0 255 ECU_ADDRESS 0x7000A27B /end MEASUREMENT
/begin MEASUREMENT FaultTableFuncTypeCounter1[132] "FaultTableFuncTypeCounter1[132]" UBYTE I_1 1 2 0 255 ECU_ADDRESS 0x7000A27C /end MEASUREMENT
/begin MEASUREMENT FaultTableFuncTypeCounter1[13] "FaultTableFuncTypeCounter1[13]" UBYTE I_1 1 2 0 255 ECU_ADDRESS 0x7000A205 /end MEASUREMENT
/begin MEASUREMENT FaultTableFuncTypeCounter1[14] "FaultTableFuncTypeCounter1[14]" UBYTE I_1 1 2 0 255 ECU_ADDRESS 0x7000A206 /end MEASUREMENT
/begin MEASUREMENT FaultTableFuncTypeCounter1[15] "FaultTableFuncTypeCounter1[15]" UBYTE I_1 1 2 0 255 ECU_ADDRESS 0x7000A207 /end MEASUREMENT
/begin MEASUREMENT FaultTableFuncTypeCounter1[16] "FaultTableFuncTypeCounter1[16]" UBYTE I_1 1 2 0 255 ECU_ADDRESS 0x7000A208 /end MEASUREMENT
/begin MEASUREMENT FaultTableFuncTypeCounter1[17] "FaultTableFuncTypeCounter1[17]" UBYTE I_1 1 2 0 255 ECU_ADDRESS 0x7000A209 /end MEASUREMENT
/begin MEASUREMENT FaultTableFuncTypeCounter1[18] "FaultTableFuncTypeCounter1[18]" UBYTE I_1 1 2 0 255 ECU_ADDRESS 0x7000A20A /end MEASUREMENT
/begin MEASUREMENT FaultTableFuncTypeCounter1[19] "FaultTableFuncTypeCounter1[19]" UBYTE I_1 1 2 0 255 ECU_ADDRESS 0x7000A20B /end MEASUREMENT
/begin MEASUREMENT FaultTableFuncTypeCounter1[1] "FaultTableFuncTypeCounter1[1]" UBYTE I_1 1 2 0 255 ECU_ADDRESS 0x7000A1F9 /end MEASUREMENT
/begin MEASUREMENT FaultTableFuncTypeCounter1[20] "FaultTableFuncTypeCounter1[20]" UBYTE I_1 1 2 0 255 ECU_ADDRESS 0x7000A20C /end MEASUREMENT
/begin MEASUREMENT FaultTableFuncTypeCounter1[21] "FaultTableFuncTypeCounter1[21]" UBYTE I_1 1 2 0 255 ECU_ADDRESS 0x7000A20D /end MEASUREMENT
/begin MEASUREMENT FaultTableFuncTypeCounter1[22] "FaultTableFuncTypeCounter1[22]" UBYTE I_1 1 2 0 255 ECU_ADDRESS 0x7000A20E /end MEASUREMENT
/begin MEASUREMENT FaultTableFuncTypeCounter1[23] "FaultTableFuncTypeCounter1[23]" UBYTE I_1 1 2 0 255 ECU_ADDRESS 0x7000A20F /end MEASUREMENT
/begin MEASUREMENT FaultTableFuncTypeCounter1[24] "FaultTableFuncTypeCounter1[24]" UBYTE I_1 1 2 0 255 ECU_ADDRESS 0x7000A210 /end MEASUREMENT
/begin MEASUREMENT FaultTableFuncTypeCounter1[25] "FaultTableFuncTypeCounter1[25]" UBYTE I_1 1 2 0 255 ECU_ADDRESS 0x7000A211 /end MEASUREMENT
/begin MEASUREMENT FaultTableFuncTypeCounter1[26] "FaultTableFuncTypeCounter1[26]" UBYTE I_1 1 2 0 255 ECU_ADDRESS 0x7000A212 /end MEASUREMENT
/begin MEASUREMENT FaultTableFuncTypeCounter1[27] "FaultTableFuncTypeCounter1[27]" UBYTE I_1 1 2 0 255 ECU_ADDRESS 0x7000A213 /end MEASUREMENT
/begin MEASUREMENT FaultTableFuncTypeCounter1[28] "FaultTableFuncTypeCounter1[28]" UBYTE I_1 1 2 0 255 ECU_ADDRESS 0x7000A214 /end MEASUREMENT
/begin MEASUREMENT FaultTableFuncTypeCounter1[29] "FaultTableFuncTypeCounter1[29]" UBYTE I_1 1 2 0 255 ECU_ADDRESS 0x7000A215 /end MEASUREMENT
/begin MEASUREMENT FaultTableFuncTypeCounter1[2] "FaultTableFuncTypeCounter1[2]" UBYTE I_1 1 2 0 255 ECU_ADDRESS 0x7000A1FA /end MEASUREMENT
/begin MEASUREMENT FaultTableFuncTypeCounter1[30] "FaultTableFuncTypeCounter1[30]" UBYTE I_1 1 2 0 255 ECU_ADDRESS 0x7000A216 /end MEASUREMENT
/begin MEASUREMENT FaultTableFuncTypeCounter1[31] "FaultTableFuncTypeCounter1[31]" UBYTE I_1 1 2 0 255 ECU_ADDRESS 0x7000A217 /end MEASUREMENT
/begin MEASUREMENT FaultTableFuncTypeCounter1[32] "FaultTableFuncTypeCounter1[32]" UBYTE I_1 1 2 0 255 ECU_ADDRESS 0x7000A218 /end MEASUREMENT
/begin MEASUREMENT FaultTableFuncTypeCounter1[33] "FaultTableFuncTypeCounter1[33]" UBYTE I_1 1 2 0 255 ECU_ADDRESS 0x7000A219 /end MEASUREMENT
/begin MEASUREMENT FaultTableFuncTypeCounter1[34] "FaultTableFuncTypeCounter1[34]" UBYTE I_1 1 2 0 255 ECU_ADDRESS 0x7000A21A /end MEASUREMENT
/begin MEASUREMENT FaultTableFuncTypeCounter1[35] "FaultTableFuncTypeCounter1[35]" UBYTE I_1 1 2 0 255 ECU_ADDRESS 0x7000A21B /end MEASUREMENT
/begin MEASUREMENT FaultTableFuncTypeCounter1[36] "FaultTableFuncTypeCounter1[36]" UBYTE I_1 1 2 0 255 ECU_ADDRESS 0x7000A21C /end MEASUREMENT
/begin MEASUREMENT FaultTableFuncTypeCounter1[37] "FaultTableFuncTypeCounter1[37]" UBYTE I_1 1 2 0 255 ECU_ADDRESS 0x7000A21D /end MEASUREMENT
/begin MEASUREMENT FaultTableFuncTypeCounter1[38] "FaultTableFuncTypeCounter1[38]" UBYTE I_1 1 2 0 255 ECU_ADDRESS 0x7000A21E /end MEASUREMENT
/begin MEASUREMENT FaultTableFuncTypeCounter1[39] "FaultTableFuncTypeCounter1[39]" UBYTE I_1 1 2 0 255 ECU_ADDRESS 0x7000A21F /end MEASUREMENT
/begin MEASUREMENT FaultTableFuncTypeCounter1[3] "FaultTableFuncTypeCounter1[3]" UBYTE I_1 1 2 0 255 ECU_ADDRESS 0x7000A1FB /end MEASUREMENT
/begin MEASUREMENT FaultTableFuncTypeCounter1[40] "FaultTableFuncTypeCounter1[40]" UBYTE I_1 1 2 0 255 ECU_ADDRESS 0x7000A220 /end MEASUREMENT
/begin MEASUREMENT FaultTableFuncTypeCounter1[41] "FaultTableFuncTypeCounter1[41]" UBYTE I_1 1 2 0 255 ECU_ADDRESS 0x7000A221 /end MEASUREMENT
/begin MEASUREMENT FaultTableFuncTypeCounter1[42] "FaultTableFuncTypeCounter1[42]" UBYTE I_1 1 2 0 255 ECU_ADDRESS 0x7000A222 /end MEASUREMENT
/begin MEASUREMENT FaultTableFuncTypeCounter1[43] "FaultTableFuncTypeCounter1[43]" UBYTE I_1 1 2 0 255 ECU_ADDRESS 0x7000A223 /end MEASUREMENT
/begin MEASUREMENT FaultTableFuncTypeCounter1[44] "FaultTableFuncTypeCounter1[44]" UBYTE I_1 1 2 0 255 ECU_ADDRESS 0x7000A224 /end MEASUREMENT
/begin MEASUREMENT FaultTableFuncTypeCounter1[45] "FaultTableFuncTypeCounter1[45]" UBYTE I_1 1 2 0 255 ECU_ADDRESS 0x7000A225 /end MEASUREMENT
/begin MEASUREMENT FaultTableFuncTypeCounter1[46] "FaultTableFuncTypeCounter1[46]" UBYTE I_1 1 2 0 255 ECU_ADDRESS 0x7000A226 /end MEASUREMENT
/begin MEASUREMENT FaultTableFuncTypeCounter1[47] "FaultTableFuncTypeCounter1[47]" UBYTE I_1 1 2 0 255 ECU_ADDRESS 0x7000A227 /end MEASUREMENT
/begin MEASUREMENT FaultTableFuncTypeCounter1[48] "FaultTableFuncTypeCounter1[48]" UBYTE I_1 1 2 0 255 ECU_ADDRESS 0x7000A228 /end MEASUREMENT
/begin MEASUREMENT FaultTableFuncTypeCounter1[49] "FaultTableFuncTypeCounter1[49]" UBYTE I_1 1 2 0 255 ECU_ADDRESS 0x7000A229 /end MEASUREMENT
/begin MEASUREMENT FaultTableFuncTypeCounter1[4] "FaultTableFuncTypeCounter1[4]" UBYTE I_1 1 2 0 255 ECU_ADDRESS 0x7000A1FC /end MEASUREMENT
/begin MEASUREMENT FaultTableFuncTypeCounter1[50] "FaultTableFuncTypeCounter1[50]" UBYTE I_1 1 2 0 255 ECU_ADDRESS 0x7000A22A /end MEASUREMENT
/begin MEASUREMENT FaultTableFuncTypeCounter1[51] "FaultTableFuncTypeCounter1[51]" UBYTE I_1 1 2 0 255 ECU_ADDRESS 0x7000A22B /end MEASUREMENT
/begin MEASUREMENT FaultTableFuncTypeCounter1[52] "FaultTableFuncTypeCounter1[52]" UBYTE I_1 1 2 0 255 ECU_ADDRESS 0x7000A22C /end MEASUREMENT
/begin MEASUREMENT FaultTableFuncTypeCounter1[53] "FaultTableFuncTypeCounter1[53]" UBYTE I_1 1 2 0 255 ECU_ADDRESS 0x7000A22D /end MEASUREMENT
/begin MEASUREMENT FaultTableFuncTypeCounter1[54] "FaultTableFuncTypeCounter1[54]" UBYTE I_1 1 2 0 255 ECU_ADDRESS 0x7000A22E /end MEASUREMENT
/begin MEASUREMENT FaultTableFuncTypeCounter1[55] "FaultTableFuncTypeCounter1[55]" UBYTE I_1 1 2 0 255 ECU_ADDRESS 0x7000A22F /end MEASUREMENT
/begin MEASUREMENT FaultTableFuncTypeCounter1[56] "FaultTableFuncTypeCounter1[56]" UBYTE I_1 1 2 0 255 ECU_ADDRESS 0x7000A230 /end MEASUREMENT
/begin MEASUREMENT FaultTableFuncTypeCounter1[57] "FaultTableFuncTypeCounter1[57]" UBYTE I_1 1 2 0 255 ECU_ADDRESS 0x7000A231 /end MEASUREMENT
/begin MEASUREMENT FaultTableFuncTypeCounter1[58] "FaultTableFuncTypeCounter1[58]" UBYTE I_1 1 2 0 255 ECU_ADDRESS 0x7000A232 /end MEASUREMENT
/begin MEASUREMENT FaultTableFuncTypeCounter1[59] "FaultTableFuncTypeCounter1[59]" UBYTE I_1 1 2 0 255 ECU_ADDRESS 0x7000A233 /end MEASUREMENT
/begin MEASUREMENT FaultTableFuncTypeCounter1[5] "FaultTableFuncTypeCounter1[5]" UBYTE I_1 1 2 0 255 ECU_ADDRESS 0x7000A1FD /end MEASUREMENT
/begin MEASUREMENT FaultTableFuncTypeCounter1[60] "FaultTableFuncTypeCounter1[60]" UBYTE I_1 1 2 0 255 ECU_ADDRESS 0x7000A234 /end MEASUREMENT
/begin MEASUREMENT FaultTableFuncTypeCounter1[61] "FaultTableFuncTypeCounter1[61]" UBYTE I_1 1 2 0 255 ECU_ADDRESS 0x7000A235 /end MEASUREMENT
/begin MEASUREMENT FaultTableFuncTypeCounter1[62] "FaultTableFuncTypeCounter1[62]" UBYTE I_1 1 2 0 255 ECU_ADDRESS 0x7000A236 /end MEASUREMENT
/begin MEASUREMENT FaultTableFuncTypeCounter1[63] "FaultTableFuncTypeCounter1[63]" UBYTE I_1 1 2 0 255 ECU_ADDRESS 0x7000A237 /end MEASUREMENT
/begin MEASUREMENT FaultTableFuncTypeCounter1[64] "FaultTableFuncTypeCounter1[64]" UBYTE I_1 1 2 0 255 ECU_ADDRESS 0x7000A238 /end MEASUREMENT
/begin MEASUREMENT FaultTableFuncTypeCounter1[65] "FaultTableFuncTypeCounter1[65]" UBYTE I_1 1 2 0 255 ECU_ADDRESS 0x7000A239 /end MEASUREMENT
/begin MEASUREMENT FaultTableFuncTypeCounter1[66] "FaultTableFuncTypeCounter1[66]" UBYTE I_1 1 2 0 255 ECU_ADDRESS 0x7000A23A /end MEASUREMENT
/begin MEASUREMENT FaultTableFuncTypeCounter1[67] "FaultTableFuncTypeCounter1[67]" UBYTE I_1 1 2 0 255 ECU_ADDRESS 0x7000A23B /end MEASUREMENT
/begin MEASUREMENT FaultTableFuncTypeCounter1[68] "FaultTableFuncTypeCounter1[68]" UBYTE I_1 1 2 0 255 ECU_ADDRESS 0x7000A23C /end MEASUREMENT
/begin MEASUREMENT FaultTableFuncTypeCounter1[69] "FaultTableFuncTypeCounter1[69]" UBYTE I_1 1 2 0 255 ECU_ADDRESS 0x7000A23D /end MEASUREMENT
/begin MEASUREMENT FaultTableFuncTypeCounter1[6] "FaultTableFuncTypeCounter1[6]" UBYTE I_1 1 2 0 255 ECU_ADDRESS 0x7000A1FE /end MEASUREMENT
/begin MEASUREMENT FaultTableFuncTypeCounter1[70] "FaultTableFuncTypeCounter1[70]" UBYTE I_1 1 2 0 255 ECU_ADDRESS 0x7000A23E /end MEASUREMENT
/begin MEASUREMENT FaultTableFuncTypeCounter1[71] "FaultTableFuncTypeCounter1[71]" UBYTE I_1 1 2 0 255 ECU_ADDRESS 0x7000A23F /end MEASUREMENT
/begin MEASUREMENT FaultTableFuncTypeCounter1[72] "FaultTableFuncTypeCounter1[72]" UBYTE I_1 1 2 0 255 ECU_ADDRESS 0x7000A240 /end MEASUREMENT
/begin MEASUREMENT FaultTableFuncTypeCounter1[73] "FaultTableFuncTypeCounter1[73]" UBYTE I_1 1 2 0 255 ECU_ADDRESS 0x7000A241 /end MEASUREMENT
/begin MEASUREMENT FaultTableFuncTypeCounter1[74] "FaultTableFuncTypeCounter1[74]" UBYTE I_1 1 2 0 255 ECU_ADDRESS 0x7000A242 /end MEASUREMENT
/begin MEASUREMENT FaultTableFuncTypeCounter1[75] "FaultTableFuncTypeCounter1[75]" UBYTE I_1 1 2 0 255 ECU_ADDRESS 0x7000A243 /end MEASUREMENT
/begin MEASUREMENT FaultTableFuncTypeCounter1[76] "FaultTableFuncTypeCounter1[76]" UBYTE I_1 1 2 0 255 ECU_ADDRESS 0x7000A244 /end MEASUREMENT
/begin MEASUREMENT FaultTableFuncTypeCounter1[77] "FaultTableFuncTypeCounter1[77]" UBYTE I_1 1 2 0 255 ECU_ADDRESS 0x7000A245 /end MEASUREMENT
/begin MEASUREMENT FaultTableFuncTypeCounter1[78] "FaultTableFuncTypeCounter1[78]" UBYTE I_1 1 2 0 255 ECU_ADDRESS 0x7000A246 /end MEASUREMENT
/begin MEASUREMENT FaultTableFuncTypeCounter1[79] "FaultTableFuncTypeCounter1[79]" UBYTE I_1 1 2 0 255 ECU_ADDRESS 0x7000A247 /end MEASUREMENT
/begin MEASUREMENT FaultTableFuncTypeCounter1[7] "FaultTableFuncTypeCounter1[7]" UBYTE I_1 1 2 0 255 ECU_ADDRESS 0x7000A1FF /end MEASUREMENT
/begin MEASUREMENT FaultTableFuncTypeCounter1[80] "FaultTableFuncTypeCounter1[80]" UBYTE I_1 1 2 0 255 ECU_ADDRESS 0x7000A248 /end MEASUREMENT
/begin MEASUREMENT FaultTableFuncTypeCounter1[81] "FaultTableFuncTypeCounter1[81]" UBYTE I_1 1 2 0 255 ECU_ADDRESS 0x7000A249 /end MEASUREMENT
/begin MEASUREMENT FaultTableFuncTypeCounter1[82] "FaultTableFuncTypeCounter1[82]" UBYTE I_1 1 2 0 255 ECU_ADDRESS 0x7000A24A /end MEASUREMENT
/begin MEASUREMENT FaultTableFuncTypeCounter1[83] "FaultTableFuncTypeCounter1[83]" UBYTE I_1 1 2 0 255 ECU_ADDRESS 0x7000A24B /end MEASUREMENT
/begin MEASUREMENT FaultTableFuncTypeCounter1[84] "FaultTableFuncTypeCounter1[84]" UBYTE I_1 1 2 0 255 ECU_ADDRESS 0x7000A24C /end MEASUREMENT
/begin MEASUREMENT FaultTableFuncTypeCounter1[85] "FaultTableFuncTypeCounter1[85]" UBYTE I_1 1 2 0 255 ECU_ADDRESS 0x7000A24D /end MEASUREMENT
/begin MEASUREMENT FaultTableFuncTypeCounter1[86] "FaultTableFuncTypeCounter1[86]" UBYTE I_1 1 2 0 255 ECU_ADDRESS 0x7000A24E /end MEASUREMENT
/begin MEASUREMENT FaultTableFuncTypeCounter1[87] "FaultTableFuncTypeCounter1[87]" UBYTE I_1 1 2 0 255 ECU_ADDRESS 0x7000A24F /end MEASUREMENT
/begin MEASUREMENT FaultTableFuncTypeCounter1[88] "FaultTableFuncTypeCounter1[88]" UBYTE I_1 1 2 0 255 ECU_ADDRESS 0x7000A250 /end MEASUREMENT
/begin MEASUREMENT FaultTableFuncTypeCounter1[89] "FaultTableFuncTypeCounter1[89]" UBYTE I_1 1 2 0 255 ECU_ADDRESS 0x7000A251 /end MEASUREMENT
/begin MEASUREMENT FaultTableFuncTypeCounter1[8] "FaultTableFuncTypeCounter1[8]" UBYTE I_1 1 2 0 255 ECU_ADDRESS 0x7000A200 /end MEASUREMENT
/begin MEASUREMENT FaultTableFuncTypeCounter1[90] "FaultTableFuncTypeCounter1[90]" UBYTE I_1 1 2 0 255 ECU_ADDRESS 0x7000A252 /end MEASUREMENT
/begin MEASUREMENT FaultTableFuncTypeCounter1[91] "FaultTableFuncTypeCounter1[91]" UBYTE I_1 1 2 0 255 ECU_ADDRESS 0x7000A253 /end MEASUREMENT
/begin MEASUREMENT FaultTableFuncTypeCounter1[92] "FaultTableFuncTypeCounter1[92]" UBYTE I_1 1 2 0 255 ECU_ADDRESS 0x7000A254 /end MEASUREMENT
/begin MEASUREMENT FaultTableFuncTypeCounter1[93] "FaultTableFuncTypeCounter1[93]" UBYTE I_1 1 2 0 255 ECU_ADDRESS 0x7000A255 /end MEASUREMENT
/begin MEASUREMENT FaultTableFuncTypeCounter1[94] "FaultTableFuncTypeCounter1[94]" UBYTE I_1 1 2 0 255 ECU_ADDRESS 0x7000A256 /end MEASUREMENT
/begin MEASUREMENT FaultTableFuncTypeCounter1[95] "FaultTableFuncTypeCounter1[95]" UBYTE I_1 1 2 0 255 ECU_ADDRESS 0x7000A257 /end MEASUREMENT
/begin MEASUREMENT FaultTableFuncTypeCounter1[96] "FaultTableFuncTypeCounter1[96]" UBYTE I_1 1 2 0 255 ECU_ADDRESS 0x7000A258 /end MEASUREMENT
/begin MEASUREMENT FaultTableFuncTypeCounter1[97] "FaultTableFuncTypeCounter1[97]" UBYTE I_1 1 2 0 255 ECU_ADDRESS 0x7000A259 /end MEASUREMENT
/begin MEASUREMENT FaultTableFuncTypeCounter1[98] "FaultTableFuncTypeCounter1[98]" UBYTE I_1 1 2 0 255 ECU_ADDRESS 0x7000A25A /end MEASUREMENT
/begin MEASUREMENT FaultTableFuncTypeCounter1[99] "FaultTableFuncTypeCounter1[99]" UBYTE I_1 1 2 0 255 ECU_ADDRESS 0x7000A25B /end MEASUREMENT
/begin MEASUREMENT FaultTableFuncTypeCounter1[9] "FaultTableFuncTypeCounter1[9]" UBYTE I_1 1 2 0 255 ECU_ADDRESS 0x7000A201 /end MEASUREMENT
/begin MEASUREMENT Presence_devaid "Presence_devaid" UWORD I_1 1 2 0 65535 ECU_ADDRESS 0x70006A88 /end MEASUREMENT
/begin COMPU_METHOD I_1 "" RAT_FUNC "%9.2" "-" COEFFS 0 1 0 0 0 1 /end COMPU_METHOD
/begin COMPU_METHOD I_3 "" RAT_FUNC "%9.2" "" COEFFS 0 1 0 0 0 1 /end COMPU_METHOD
/begin COMPU_METHOD F_1_p0_4 "" RAT_FUNC "%9.2" "-" COEFFS 0 1 0 0 0 1 /end COMPU_METHOD
/begin COMPU_METHOD F_100_p0_5 "" RAT_FUNC "%9.2" "%" COEFFS 0 1 0 0 0 100 /end COMPU_METHOD
/begin COMPU_METHOD F_10_p0_6 "" RAT_FUNC "%9.2" "ms" COEFFS 0 1 0 0 0 10 /end COMPU_METHOD
/begin COMPU_METHOD F_0v05_p0_7 "" RAT_FUNC "%9.2" "ms" COEFFS 0 1 0 0 0 0.05 /end COMPU_METHOD
/begin COMPU_METHOD F_0v001_p0_9 "" RAT_FUNC "%9.3" "s" COEFFS 0 1 0 0 0 0.001 /end COMPU_METHOD
/begin COMPU_METHOD F_0v0012210012_p0_10 "" RAT_FUNC "%9.3" "V" COEFFS 0 1 0 0 0 0.001221 /end COMPU_METHOD
/begin COMPU_METHOD F_4_p0_11 "" RAT_FUNC "%9.2" "Bytes" COEFFS 0 1 0 0 0 4 /end COMPU_METHOD
/begin COMPU_METHOD F_0v01_p0_12 "" RAT_FUNC "%9.2" "µs" COEFFS 0 1 0 0 0 0.01 /end COMPU_METHOD
/begin COMPU_METHOD I_15 "" RAT_FUNC "%9.2" "V" COEFFS 0 1 0 0 0 1 /end COMPU_METHOD
/begin COMPU_METHOD F_5_p0_28 "" RAT_FUNC "%9.2" "ms" COEFFS 0 1 0 0 0 5 /end COMPU_METHOD
/begin COMPU_METHOD F_0v006959707_p0_29 "" RAT_FUNC "%9.3" "V" COEFFS 0 1 0 0 0 0.00695971 /end COMPU_METHOD
/begin COMPU_METHOD Id_0x00 "" RAT_FUNC "%9.2" "." COEFFS 0 1 0 0 0 1 /end COMPU_METHOD
/begin COMPU_METHOD Bool_ON_OFF "" TAB_VERB "%8.4" "." COMPU_TAB_REF Bool_ON_OFF_table /end COMPU_METHOD
/begin COMPU_VTAB Bool_ON_OFF_table "" TAB_VERB 2 0 "OFF" 1 "ON" /end COMPU_VTAB
/begin FUNCTION BLDC ""
 /begin DEF_CHARACTERISTIC BLDC_bHallInvalidFltTestOnC BLDC_bHallUndefFltTestOnC BLDC_bHwPinAscEnaC BLDC_bOilPressShortGndFltTestOnC BLDC_bOilPressShortVccFltTestOnC BLDC_bP5vAD2SOverVolFltTestOnC BLDC_bP5vAD2SUnderVolFltTestOnC BLDC_bTestPinEnaC BLDC_kf32LVThdHighC BLDC_kf32LVThdLowC BLDC_kf32MidPotMaxMonitorDutyC BLDC_kf32MidPotMinMonitorDutyC BLDC_kf32MidPotShrtGndDutyC BLDC_kf32MidPotShrtVccDutyC BLDC_kf32MidPotTgtHighC BLDC_kf32MidPotTgtLowC BLDC_kf32MotorSpeedC BLDC_kf32P5vAD2SOverVolC BLDC_kf32P5vAD2SUnderVolC BLDC_kf32TgtDutyDeltMaxC BLDC_ku16MidPotFltConfirmC BLDC_ku16MidPotFltIncStepC BLDC_ku16MidPotRcvTimC BLDC_ku16RvsDutyDelayC BLDC_ku16TgtDutyRisingTimC /end DEF_CHARACTERISTIC
 /begin OUT_MEASUREMENT BLDC_bClrTrapReq BLDC_bEnterSleepMod BLDC_bHallInvalidFlt BLDC_bHallUndefFlt BLDC_bHwFaultDcOvVolt BLDC_bHwFaultIgbtH BLDC_bHwFaultIgbtL BLDC_bHwFaultOvcU BLDC_bHwFaultOvcV BLDC_bHwFaultOvcW BLDC_bIsBldcStart BLDC_bMotorSpdRdy BLDC_bOilPressShortGndFlt BLDC_bOilPressShortVccFlt BLDC_bP5vAD2SOverVolFlt BLDC_bP5vAD2SUnderVolFlt BLDC_bTrapTrigger BLDC_bUShortGnd BLDC_bUShortVs BLDC_bUvwShortGnd BLDC_bUvwShortVs BLDC_bVShortGnd BLDC_bVShortVs BLDC_bWShortGnd BLDC_bWShortVs BLDC_f32BatteryVoltage BLDC_f32BkpVoltage BLDC_f32BldcPosDuty BLDC_f32MotorSpeed BLDC_f32P5vAD2SPhys BLDC_f32Pfb1DutyPhys BLDC_f32Pfb1DutyPhys[0] BLDC_f32Pfb1DutyPhys[1] BLDC_f32Pfb1DutyPhys[2] BLDC_f32Pfb1DutyPhys[3] BLDC_f32Pfb1DutyPhys[4] BLDC_f32Pfb1DutyPhys[5] BLDC_f32Pfb1DutyPhys[6] BLDC_f32Pfb1DutyPhys[7] BLDC_f32Pfb1DutyPhysSum BLDC_f32Pfb2DutyPhys BLDC_f32Pfb2DutyPhys[0] BLDC_f32Pfb2DutyPhys[1] BLDC_f32Pfb2DutyPhys[2] BLDC_f32Pfb2DutyPhys[3] BLDC_f32Pfb2DutyPhys[4] BLDC_f32Pfb2DutyPhys[5] BLDC_f32Pfb2DutyPhys[6] BLDC_f32Pfb2DutyPhys[7] BLDC_f32Pfb2DutyPhysSum BLDC_f32Pfb3DutyPhys BLDC_f32Pfb3DutyPhys[0] BLDC_f32Pfb3DutyPhys[1] BLDC_f32Pfb3DutyPhys[2] BLDC_f32Pfb3DutyPhys[3] BLDC_f32Pfb3DutyPhys[4] BLDC_f32Pfb3DutyPhys[5] BLDC_f32Pfb3DutyPhys[6] BLDC_f32Pfb3DutyPhys[7] BLDC_f32Pfb3DutyPhysSum BLDC_f32PrevTgtDuty BLDC_f32TgtDutyDeltVal BLDC_f32TgtDutyPhys BLDC_f32TgtDutyPhys[0] BLDC_f32TgtDutyPhys[1] BLDC_f32TgtDutyPhys[2] BLDC_f32TgtDutyPhys[3] BLDC_f32TgtDutyPhys[4] BLDC_f32TgtDutyPhys[5] BLDC_f32TgtDutyPhys[6] BLDC_f32TgtDutyPhys[7] BLDC_f32TgtDutyPhysSum BLDC_u16DutyDelayCnt BLDC_u16McuAscSttDelay BLDC_u16OilPressureRaw BLDC_u16P5vAD2SRaw BLDC_u16PowerOnDelay BLDC_u16PwmMaxDutyCyc BLDC_u16PwmMinDutyCyc BLDC_u16ShortConfirmCnt BLDC_u16ShortRecoveryCnt BLDC_u16T12PeriodVal BLDC_u16T13CmpVal BLDC_u16T13PeriodVal BLDC_u16TgtDutyRisingDelay BLDC_u32MotPosSigDuty BLDC_u32MotPosSigPerd BLDC_u32T12IsrCounter BLDC_u32TrapCreq BLDC_u8ConfirmDirSts BLDC_u8CurDirSts BLDC_u8CurHallStt BLDC_u8DiagHallStt BLDC_u8DiagHallSttPre BLDC_u8DutyModeStt BLDC_u8HallStt BLDC_u8McuAscSttStep BLDC_u8PfbDutyCnt BLDC_u8PrevDirSts BLDC_u8PwmState BLDC_u8WrCurHallStt BLDC_u8WrExpHallStt BLDC_u8WrExpOutput BLDC_u8WrExpOutputLast /end OUT_MEASUREMENT
/end FUNCTION
/begin FUNCTION BSW ""
 /begin DEF_CHARACTERISTIC BSW_bGCUTOutTestOnC BSW_bIntLockDetEnaC BSW_bOBDEnaC BSW_bSPYBenchOnC BSW_ku16VSIRdyChkTimoutC RTE_bGCUTOutTestOnC /end DEF_CHARACTERISTIC
 /begin OUT_MEASUREMENT BSW_bAppMsgTxEna BSW_bCAN0BusOff BSW_bCAN1BusOff BSW_bCbkRxTOutFlag_SGBCM_pepsReq BSW_bCbkRxTOutFlag_SGEMS1Req BSW_bCbkRxTOutFlag_SGEMS3Req BSW_bCbkRxTOutFlag_SGEMS5Req BSW_bCbkRxTOutFlag_SGEMS8Req BSW_bCbkRxTOutFlag_SGG2m1Req BSW_bCbkRxTOutFlag_SGG2m2Req BSW_bCbkRxTOutFlag_SGG2m3Req BSW_bCbkRxTOutFlag_SGGCU2Req BSW_bCbkRxTOutFlag_SGGCU4Req BSW_bCbkRxTOutFlag_SGIPB4Req BSW_bCbkRxTOutFlag_SGIPB5Req BSW_bCbkRxTOutFlag_SGIPB7Req BSW_bCbkRxTOutFlag_SGIVI_timeAndGPSReq BSW_bCbkRxTOutFlag_SGPDCM10Req BSW_bCbkRxTOutFlag_SGPDCM1Req BSW_bCbkRxTOutFlag_SGPDCM21Req BSW_bCbkRxTOutFlag_SGPDCM22Req BSW_bCbkRxTOutFlag_SGPDCM24Req BSW_bCbkRxTOutFlag_SGPDCM30Req BSW_bCbkRxTOutFlag_SGPDCM38Req BSW_bCbkRxTOutFlag_SGPDCM5Req BSW_bCbkRxTOutFlag_SGPDCM_ACU_EPSReq BSW_bCbkRxTOutFlag_SGPDCM_Body_ICReq BSW_bCbkRxTOutFlag_SGPDCM_GCUReq BSW_bCbkRxTOutFlag_SGPDCM_IC_ACUReq BSW_bCbkRxTOutFlag_SGPDCM_OBDReq BSW_bCbkRxTOutFlag_SGPDCM_SelfHeatReq BSW_bCbkRxTOutFlag_SGTBOX_engineOFFReq BSW_bCbkRxTOutFlag_SGTBOX_VehicleModeReq BSW_bCsumErrFlag_SGEms1Req BSW_bCsumErrFlag_SGEms3Req BSW_bCsumErrFlag_SGEms8Req BSW_bCsumErrFlag_SGIpb4Req BSW_bCsumErrFlag_SGIpb5Req BSW_bCsumErrFlag_SGIpb7Req BSW_bCsumErrFlag_SGPdcm10Req BSW_bCsumErrFlag_SGPdcm21Req BSW_bCsumErrFlag_SGPdcm22Req BSW_bCsumErrFlag_SGPdcm24Req BSW_bCsumErrFlag_SGPdcm30Req BSW_bCsumErrFlag_SGPdcmGcuReq BSW_bCsumErrFlag_SGTbox_vehiclemodeReq BSW_bEnableCalcWriteNvMMaxTime BSW_bIntLockDetEna BSW_bIntLockOccurFlg BSW_bMKeyOnStatus BSW_bMSGTrigTxFlag_Mcu7Req BSW_bNvmWrTrig BSW_bOCDataNotRation BSW_bRcErrFlag_SGEms1Req BSW_bRcErrFlag_SGEms3Req BSW_bRcErrFlag_SGEms8Req BSW_bRcErrFlag_SGIpb4Req BSW_bRcErrFlag_SGIpb5Req BSW_bRcErrFlag_SGIpb7Req BSW_bRcErrFlag_SGPdcm10Req BSW_bRcErrFlag_SGPdcm21Req BSW_bRcErrFlag_SGPdcm22Req BSW_bRcErrFlag_SGPdcm24Req BSW_bRcErrFlag_SGPdcm30Req BSW_bRcErrFlag_SGPdcmGcuReq BSW_bRcErrFlag_SGTbox_vehiclemodeReq BSW_bStackOverflowWarning BSW_bUdsFunctionReqFlg BSW_bVsiReadySts BSW_u16CurWriteNvMTime BSW_u16IntLockDelayTim BSW_u16NvmStoreDelay BSW_u16NvMWriteCmd BSW_u16RawVolMonCurOcpH BSW_u16RawVolMonCurOcpL BSW_u16RawVolMonDcOvpSele BSW_u16RawVolP16VMulti BSW_u16RawVolP5VHS BSW_u16RawVolP5VHsREF BSW_u16RawVolP5VLS BSW_u16RawVolP5VLsREF BSW_u16RawVolP5VREF BSW_u16RawVolt15VRdc BSW_u16RawVoltDclinkFIL BSW_u16SelfChkDelay BSW_u16Var1 BSW_u16VsiReadyDelay BSW_u16WriteNvMMaxTime BSW_u32CbkRxAckCntSGPepsMsgSts BSW_u32FeeNextFreePageAddr BSW_u32RcvUdsCanId BSW_u32StackUsed BSW_u32VSICounterCkreq BSW_u32VSICounterSafeCkreq BSW_u32VSICounterTimeoutCs BSW_u32VSICounterTimeoutFrame BSW_u32VSICounterTimeoutSafeTCalc BSW_u32VSICounterTimeoutSyncPos BSW_u32VSICounterTimeoutTCalc BSW_u32VSISafeTimeDuration BSW_u32VSISafeTimeDurationMax BSW_u32VSISafeTimeDurationMin BSW_u32VSITimeDuration BSW_u32VSITimeDurationMax BSW_u32VSITimeDurationMin BSW_u8CAN0BusOffCounter BSW_u8CAN1BusOffCounter BSW_u8Ems1CsumErrCnt BSW_u8Ems1RcErrCnt BSW_u8Ems1RcLast BSW_u8Ems1RcNow BSW_u8Ems3CsumErrCnt BSW_u8Ems3RcErrCnt BSW_u8Ems3RcLast BSW_u8Ems3RcNow BSW_u8Ems8CsumErrCnt BSW_u8Ems8RcErrCnt BSW_u8Ems8RcLast BSW_u8Ems8RcNow BSW_u8FeeCurSector BSW_u8FeeSectorChangeCnt BSW_u8IntLockErrCnt BSW_u8Ipb4CsumErrCnt BSW_u8Ipb4RcErrCnt BSW_u8Ipb4RcLast BSW_u8Ipb4RcNow BSW_u8Ipb5CsumErrCnt BSW_u8Ipb5RcErrCnt BSW_u8Ipb5RcLast BSW_u8Ipb5RcNow BSW_u8Ipb7CsumErrCnt BSW_u8Ipb7RcErrCnt BSW_u8Ipb7RcLast BSW_u8Ipb7RcNow BSW_u8McuMotTrqRollCnt BSW_u8McuStsRollCnt BSW_u8NvmMngStt BSW_u8NvMReturnResult BSW_u8Pdcm10CsumErrCnt BSW_u8Pdcm10RcErrCnt BSW_u8Pdcm10RcLast BSW_u8Pdcm10RcNow BSW_u8Pdcm21CsumErrCnt BSW_u8Pdcm21RcErrCnt BSW_u8Pdcm21RcLast BSW_u8Pdcm21RcNow BSW_u8Pdcm22CsumErrCnt BSW_u8Pdcm22RcErrCnt BSW_u8Pdcm22RcLast BSW_u8Pdcm22RcNow BSW_u8Pdcm24CsumErrCnt BSW_u8Pdcm24RcErrCnt BSW_u8Pdcm24RcLast BSW_u8Pdcm24RcNow BSW_u8Pdcm30CsumErrCnt BSW_u8Pdcm30RcErrCnt BSW_u8Pdcm30RcLast BSW_u8Pdcm30RcNow BSW_u8PdcmGcuCsumErrCnt BSW_u8PdcmGcuRcErrCnt BSW_u8PdcmGcuRcLast BSW_u8PdcmGcuRcNow BSW_u8SelfChkErr BSW_u8Tbox_vehiclemodeCsumErrCnt BSW_u8Tbox_vehiclemodeRcErrCnt BSW_u8Tbox_vehiclemodeRcLast BSW_u8Tbox_vehiclemodeRcNow Presence_devaid /end OUT_MEASUREMENT
/end FUNCTION
/begin FUNCTION CALUSR "" /begin DEF_CHARACTERISTIC CalUsr_ku32CalibUpdEnaMskA CalUsr_ku32CalibUpdEnaMskB /end DEF_CHARACTERISTIC
 /begin OUT_MEASUREMENT CalUsr_bIsCalibUpdEna CalUsr_u32ChkDataCrc CalUsr_u32POCalibDnEnaMskA CalUsr_u32POCalibDnEnaMskB CalUsr_u32PODataCRC /end OUT_MEASUREMENT
/end FUNCTION
/begin FUNCTION CCU6 ""
 /begin DEF_CHARACTERISTIC CCU6_bAlimFreqChgEnaC CCU6_bDualSmpEnaC CCU6_bHwOvcFltDetEnaC CCU6_bHwPinAscEnaC CCU6_f32DrvClkDutyThdHighC CCU6_f32DrvClkDutyThdLowC CCU6_kbDrvBdClkEnaC CCU6_kf32MidPointDutyHC CCU6_kf32MidPointDutyLC CCU6_ku16AlimDutyCycRawC CCU6_ku32AlimFreqRawC CCU6_ku8AscRecoverCntMaxC CCU6_ku8PwmMidPointFaultC /end DEF_CHARACTERISTIC
 /begin OUT_MEASUREMENT CCU6_au32PWMOnTime CCU6_au32PWMOnTime[0] CCU6_au32PWMOnTime[1] CCU6_au32PWMOnTime[2] CCU6_bAkdAfterAscReq CCU6_bClrTrapReq CCU6_bHwFaultDcOvVolt CCU6_bHwFaultIgbtH CCU6_bHwFaultIgbtL CCU6_bHwFaultOvcU CCU6_bHwFaultOvcV CCU6_bHwFaultOvcW CCU6_bIgbtHighSideShort CCU6_bIgbtLowSideShort CCU6_bIsCCU6Start CCU6_bIuvwCompReq CCU6_bMotorSpdRdy CCU6_bP5VDiagReinitCmd CCU6_bP5VHSFltFlg CCU6_bP5VLSFltFlg CCU6_bPwmMidPointU CCU6_bPwmMidPointV CCU6_bPwmMidPointW CCU6_bPwmOnGoingFlg CCU6_bT12ZeroMatchFlg CCU6_bTrapTrigger CCU6_f32DrvClkHsDuty CCU6_f32DrvClkLsDuty CCU6_f32HighVolPhys CCU6_f32PwmDutyPhysUZ CCU6_f32PwmDutyPhysVZ CCU6_f32PwmDutyPhysWZ CCU6_u16AlimPowerOnDelay CCU6_u16CCU6T13CmpVal CCU6_u16HighVolAdc CCU6_u16McuAscSttDelay CCU6_u16P5VHSAdc CCU6_u16PowerOnDelay CCU6_u16PwmMaxDutyCyc CCU6_u16PwmMidPointErrCnt CCU6_u16PwmMinDutyCyc CCU6_u16PwmModReq CCU6_u16T12CntVal CCU6_u16T12PeriodVal CCU6_u16T13PeriodVal CCU6_u32DrvClkHsDutyRaw CCU6_u32DrvClkHsPerdRaw CCU6_u32DrvClkLsDutyRaw CCU6_u32DrvClkLsPerdRaw CCU6_u32TrapCreq CCU6_u8AscRecoverCnt CCU6_u8McuAscSttStep CCU6_u8McuAscType CCU6_u8P5VHSFltCnt CCU6_u8P5VLSFltCnt CCU6_u8P5VPowerMngStt CCU6_u8P5VSelfTstTimCnt CCU6_u8PreTestStep CCU6_u8PwmState /end OUT_MEASUREMENT
/end FUNCTION
/begin FUNCTION COMMUSR ""
 /begin OUT_MEASUREMENT ASWNM_bBusSleep ASWNM_bStayAwake ASWNM_u16AfterRunDelayTimes ASWNM_u16Kl15Sts /end OUT_MEASUREMENT
/end FUNCTION
/begin FUNCTION DEVHAL "" /begin OUT_MEASUREMENT DEVHAL_bIsInitialized DEVHAL_u8CheckEngineState /end OUT_MEASUREMENT /end FUNCTION
/begin FUNCTION DFLASH "" /begin OUT_MEASUREMENT DFApp_u8DflashMainState /end OUT_MEASUREMENT /end FUNCTION
/begin FUNCTION DSM "" /begin DEF_CHARACTERISTIC FaultEraseRequestC /end DEF_CHARACTERISTIC
 /begin OUT_MEASUREMENT DSM_DtcNumber DSM_DtcNumber[0] DSM_DtcNumber[1] DSM_DtcNumber[2] DSM_DtcNumber[3] DSM_DtcNumber[4] DSM_DtcNumber[5] DSM_DtcNumber[6] DSM_DtcNumber[7] DSM_DtcNumber[8] DSM_DtcNumber[9] DSM_DtcStatusNvm DSM_DtcStatusNvm[0] DSM_DtcStatusNvm[1] DSM_DtcStatusNvm[2] DSM_DtcStatusNvm[3] DSM_DtcStatusNvm[4] DSM_DtcStatusNvm[5] DSM_DtcStatusNvm[6] DSM_DtcStatusNvm[7] DSM_DtcStatusNvm[8] DSM_DtcStatusNvm[9] FaultEraseRequest FaultFailureLevel /end OUT_MEASUREMENT
/end FUNCTION
/begin FUNCTION ESM "" /begin DEF_CHARACTERISTIC ESM_u16PowerLatchTempoC ESM_u8RestartDelayCntC /end DEF_CHARACTERISTIC
 /begin OUT_MEASUREMENT ESM_EcuState ESM_OPERATIONAL_MODE ESM_POWER_OFF_MODE ESM_POWERLATCH_MODE ESM_STARTUP_I_MODE ESM_STARTUP_II_MODE ESM_u16PowerLatchTempo /end OUT_MEASUREMENT
/end FUNCTION
/begin FUNCTION FAIL "" /begin DEF_CHARACTERISTIC FAIL_bCanErrCheckonC /end DEF_CHARACTERISTIC
 /begin OUT_MEASUREMENT FAIL_bCanErrChkDisabled FAIL_bComLostDiagTEna FAIL_bComLostDiagVEna FAIL_bComLostDiagVHigh FAIL_bComLostDiagVLow FAIL_bDebug1 FAIL_bRstHotFlag FAIL_bRstHotFlagNvm FAIL_bRstHotFlagNvm_def FAIL_u16ComLostDiagEnaCnt FAIL_u16ComLostDiagVRecCnt FAIL_u16KeyOnDelay FAIL_u16KeyOnValue FAIL_u16LvBatVoltRaw FAIL_u16RstHotCntNvm FAIL_u16RstHotCntNvm_def FAIL_u16RstStartUpCntNvm FAIL_u16RstStartUpCntNvm_def FAIL_u16TimestampIgnNvm FAIL_u16TimestampIgnNvm_def FAIL_u32TimestampLifeNvm FAIL_u32TimestampLifeNvm_def FAIL_u8CCP_FaultLevel /end OUT_MEASUREMENT
/end FUNCTION
/begin FUNCTION FAULT ""
 /begin OUT_MEASUREMENT FaultBSW_COM_BusOff_CAN1Aut FaultBSW_COM_BusOff_CAN1Detected FaultBSW_COM_BusOff_CAN1Logged FaultBSW_COM_ChecksumErrVCUAut FaultBSW_COM_ChecksumErrVCUDetected FaultBSW_COM_ChecksumErrVCULogged FaultBSW_COM_Detected FaultBSW_COM_InterFaultVCUAut FaultBSW_COM_InterFaultVCUDetected FaultBSW_COM_InterFaultVCULogged FaultBSW_COM_Logged FaultBSW_COM_RollCntErrVCUAut FaultBSW_COM_RollCntErrVCUDetected FaultBSW_COM_RollCntErrVCULogged FaultBSW_COM_TimoutRxBCMAut FaultBSW_COM_TimoutRxBCMDetected FaultBSW_COM_TimoutRxBCMLogged FaultBSW_COM_TimoutRxBMSHAut FaultBSW_COM_TimoutRxBMSHDetected FaultBSW_COM_TimoutRxBMSHLogged FaultBSW_COM_TimoutRxEMSAut FaultBSW_COM_TimoutRxEMSDetected FaultBSW_COM_TimoutRxEMSLogged FaultBSW_COM_TimoutRxGCUAut FaultBSW_COM_TimoutRxGCUDetected FaultBSW_COM_TimoutRxGCULogged FaultBSW_COM_TimoutRxIPCAut FaultBSW_COM_TimoutRxIPCDetected FaultBSW_COM_TimoutRxIPCLogged FaultBSW_COM_TimoutRxTBOXAut FaultBSW_COM_TimoutRxTBOXDetected FaultBSW_COM_TimoutRxTBOXLogged FaultBSW_COM_TimoutRxVCUAut FaultBSW_COM_TimoutRxVCUDetected FaultBSW_COM_TimoutRxVCULogged FaultBSW_HW2_Detected FaultBSW_HW2_FPGA_OverVoltVBatAut FaultBSW_HW2_FPGA_OverVoltVBatDetected FaultBSW_HW2_FPGA_OverVoltVBatLogged FaultBSW_HW2_Logged FaultBSW_HW2_SafeTlib_PreRunAut FaultBSW_HW2_SafeTlib_PreRunDetected FaultBSW_HW2_SafeTlib_PreRunLogged FaultBSW_HW_Detected FaultBSW_HW_EasAckFailAut FaultBSW_HW_EasAckFailDetected FaultBSW_HW_EasAckFailLogged FaultBSW_HW_FPGA_IGBT_HAut FaultBSW_HW_FPGA_IGBT_HDetected FaultBSW_HW_FPGA_IGBT_HLogged FaultBSW_HW_FPGA_IGBT_LAut FaultBSW_HW_FPGA_IGBT_LDetected FaultBSW_HW_FPGA_IGBT_LLogged FaultBSW_HW_FPGA_OverUnderCurUIAut FaultBSW_HW_FPGA_OverUnderCurUIDetected FaultBSW_HW_FPGA_OverUnderCurUILogged FaultBSW_HW_FPGA_OverUnderCurVIAut FaultBSW_HW_FPGA_OverUnderCurVIDetected FaultBSW_HW_FPGA_OverUnderCurVILogged FaultBSW_HW_FPGA_OverUnderCurWIAut FaultBSW_HW_FPGA_OverUnderCurWIDetected FaultBSW_HW_FPGA_OverUnderCurWILogged FaultBSW_HW_Logged FaultBSW_HW_OCDataNotRationalAut FaultBSW_HW_OCDataNotRationalDetected FaultBSW_HW_OCDataNotRationalLogged FaultBSW_SYS_Detected FaultBSW_SYS_Logged FaultBSW_SYS_RstHotAut FaultBSW_SYS_RstHotDetected FaultBSW_SYS_RstHotLogged FaultBSW_SYS_StackOverflowAut FaultBSW_SYS_StackOverflowDetected FaultBSW_SYS_StackOverflowLogged FaultBSW_VSI_Detected FaultBSW_VSI_Logged FaultBSW_VSI_TimeoutTCalcAut FaultBSW_VSI_TimeoutTCalcDetected FaultBSW_VSI_TimeoutTCalcLogged FaultFSEVBHV_Detected FaultFSEVBHV_Logged FaultFSEVBHV_OverVoltageAut FaultFSEVBHV_OverVoltageDetected FaultFSEVBHV_OverVoltageLogged FaultFSEVBHV_SampleVolOutRngHAut FaultFSEVBHV_SampleVolOutRngHDetected FaultFSEVBHV_SampleVolOutRngHLogged FaultFSEVBHV_SampleVolOutRngLAut FaultFSEVBHV_SampleVolOutRngLDetected FaultFSEVBHV_SampleVolOutRngLLogged FaultFSEVBHV_UnderDetected FaultFSEVBHV_UnderLogged FaultFSEVBHV_UnderVoltageAut FaultFSEVBHV_UnderVoltageDetected FaultFSEVBHV_UnderVoltageLogged FaultFSEVBHV_UnderVoltageWarnAut FaultFSEVBHV_UnderVoltageWarnDetected FaultFSEVBHV_UnderVoltageWarnLogged FaultFSEVBHV_VolNotRationalAut FaultFSEVBHV_VolNotRationalDetected FaultFSEVBHV_VolNotRationalLogged FaultFSEVBHV_VoltageGndAut FaultFSEVBHV_VoltageGndDetected FaultFSEVBHV_VoltageGndLogged FaultFSEVBHV_VoltageVccAut FaultFSEVBHV_VoltageVccDetected FaultFSEVBHV_VoltageVccLogged FaultFSEVBLV_Detected FaultFSEVBLV_Logged FaultFSEVBLV_OverVoltageAut FaultFSEVBLV_OverVoltageDetected FaultFSEVBLV_OverVoltageLogged FaultFSEVBLV_P5VRefADCFltAut FaultFSEVBLV_P5VRefADCFltDetected FaultFSEVBLV_P5VRefADCFltLogged FaultFSEVBLV_UnderDetected FaultFSEVBLV_UnderLogged FaultFSEVBLV_UnderVoltageAut FaultFSEVBLV_UnderVoltageDetected FaultFSEVBLV_UnderVoltageLogged FaultFSEVBLV_UnderVoltageWarnAut FaultFSEVBLV_UnderVoltageWarnDetected FaultFSEVBLV_UnderVoltageWarnLogged FaultFSEVBLV_VoltageGndAut FaultFSEVBLV_VoltageGndDetected FaultFSEVBLV_VoltageGndLogged FaultFSEVBLV_VoltageVccAut FaultFSEVBLV_VoltageVccDetected FaultFSEVBLV_VoltageVccLogged FaultFSEVETA_Detected FaultFSEVETA_DrvTempRationAut FaultFSEVETA_DrvTempRationDetected FaultFSEVETA_DrvTempRationLogged FaultFSEVETA_IgbtTempRationalAut FaultFSEVETA_IgbtTempRationalDetected FaultFSEVETA_IgbtTempRationalLogged FaultFSEVETA_Logged FaultFSEVETA_OverDetected FaultFSEVETA_OverLogged FaultFSEVETA_OverTempDrvLeftAut FaultFSEVETA_OverTempDrvLeftDetected FaultFSEVETA_OverTempDrvLeftLogged FaultFSEVETA_OverTempIgbtLeftAut FaultFSEVETA_OverTempIgbtLeftDetected FaultFSEVETA_OverTempIgbtLeftLogged FaultFSEVETA_OverTempNTC1CmdBoardAut FaultFSEVETA_OverTempNTC1CmdBoardDetected FaultFSEVETA_OverTempNTC1CmdBoardLogged FaultFSEVETA_SampleIgbtTempOutRngHAut FaultFSEVETA_SampleIgbtTempOutRngHDetected FaultFSEVETA_SampleIgbtTempOutRngHLogged FaultFSEVETA_SampleIgbtTempOutRngLAut FaultFSEVETA_SampleIgbtTempOutRngLDetected FaultFSEVETA_SampleIgbtTempOutRngLLogged FaultFSEVETA_TempDetected FaultFSEVETA_TempDrvBoardLeftGndAut FaultFSEVETA_TempDrvBoardLeftGndDetected FaultFSEVETA_TempDrvBoardLeftGndLogged FaultFSEVETA_TempDrvBoardLeftVccAut FaultFSEVETA_TempDrvBoardLeftVccDetected FaultFSEVETA_TempDrvBoardLeftVccLogged FaultFSEVETA_TempIgbtLeftGndAut FaultFSEVETA_TempIgbtLeftGndDetected FaultFSEVETA_TempIgbtLeftGndLogged FaultFSEVETA_TempIgbtLeftVccAut FaultFSEVETA_TempIgbtLeftVccDetected FaultFSEVETA_TempIgbtLeftVccLogged FaultFSEVETA_TempLogged FaultFSEVETA_TempNTC1CmdBoardGndAut FaultFSEVETA_TempNTC1CmdBoardGndDetected FaultFSEVETA_TempNTC1CmdBoardGndLogged FaultFSEVETA_TempNTC1CmdBoardVccAut FaultFSEVETA_TempNTC1CmdBoardVccDetected FaultFSEVETA_TempNTC1CmdBoardVccLogged FaultFSEVETA_UnderDetected FaultFSEVETA_UnderLogged FaultFSEVETA_UnderTempDrvLeftAut FaultFSEVETA_UnderTempDrvLeftDetected FaultFSEVETA_UnderTempDrvLeftLogged FaultFSEVETA_UnderTempIgbtLeftAut FaultFSEVETA_UnderTempIgbtLeftDetected FaultFSEVETA_UnderTempIgbtLeftLogged FaultFSEVETA_UnderTempNTC1CmdBoardAut FaultFSEVETA_UnderTempNTC1CmdBoardDetected FaultFSEVETA_UnderTempNTC1CmdBoardLogged FaultFSMTMTA_OverDetected FaultFSMTMTA_OverLogged FaultFSMTMTA_OverTempWdgHead1Aut FaultFSMTMTA_OverTempWdgHead1Detected FaultFSMTMTA_OverTempWdgHead1Logged FaultFSMTMTA_TempDetected FaultFSMTMTA_TempLogged FaultFSMTMTA_TempWindHead1OutRngHAut FaultFSMTMTA_TempWindHead1OutRngHDetected FaultFSMTMTA_TempWindHead1OutRngHLogged FaultFSMTMTA_TempWindHead1OutRngLAut FaultFSMTMTA_TempWindHead1OutRngLDetected FaultFSMTMTA_TempWindHead1OutRngLLogged FaultFSMTMTA_TempWindingHead1GndAut FaultFSMTMTA_TempWindingHead1GndDetected FaultFSMTMTA_TempWindingHead1GndLogged FaultFSMTMTA_TempWindingHead1VccAut FaultFSMTMTA_TempWindingHead1VccDetected FaultFSMTMTA_TempWindingHead1VccLogged FaultFSMTMTA_UnderDetected FaultFSMTMTA_UnderLogged FaultFSMTMTA_UnderTempWdgHead1Aut FaultFSMTMTA_UnderTempWdgHead1Detected FaultFSMTMTA_UnderTempWdgHead1Logged FaultFSMTRDG_Detected FaultFSMTRDG_ExcGenerationAut FaultFSMTRDG_ExcGenerationDetected FaultFSMTRDG_ExcGenerationLogged FaultFSMTRDG_ExcSignalGNDAut FaultFSMTRDG_ExcSignalGNDDetected FaultFSMTRDG_ExcSignalGNDLogged FaultFSMTRDG_ExcSignalVCCAut FaultFSMTRDG_ExcSignalVCCDetected FaultFSMTRDG_ExcSignalVCCLogged FaultFSMTRDG_Logged FaultFSMTRDG_SinCosHLGndAut FaultFSMTRDG_SinCosHLGndDetected FaultFSMTRDG_SinCosHLGndLogged FaultFSMTRDG_SinCosHLOpenAut FaultFSMTRDG_SinCosHLOpenDetected FaultFSMTRDG_SinCosHLOpenLogged FaultFSMTRDG_SinCosHLVccAut FaultFSMTRDG_SinCosHLVccDetected FaultFSMTRDG_SinCosHLVccLogged FaultFSSMACS_AkdFailFlagAut FaultFSSMACS_AkdFailFlagDetected FaultFSSMACS_AkdFailFlagLogged FaultFSSMACS_Detected FaultFSSMACS_Logged FaultFTASBDS_BattVoltDeratingActAut FaultFTASBDS_BattVoltDeratingActDetected FaultFTASBDS_BattVoltDeratingActLogged FaultFTASBDS_Detected FaultFTASBDS_Logged FaultFTASETP_Detected FaultFTASETP_EstPmDeratingActAut FaultFTASETP_EstPmDeratingActDetected FaultFTASETP_EstPmDeratingActLogged FaultFTASETP_Logged FaultFTASETP_PmDeratingActAut FaultFTASETP_PmDeratingActDetected FaultFTASETP_PmDeratingActLogged FaultFTASMTP_Detected FaultFTASMTP_Logged FaultFTASMTP_Wndg1DeratingActAut FaultFTASMTP_Wndg1DeratingActDetected FaultFTASMTP_Wndg1DeratingActLogged FaultFTASOSP_Detected FaultFTASOSP_Logged FaultFTASOSP_MotorSpdDeratingActAut FaultFTASOSP_MotorSpdDeratingActDetected FaultFTASOSP_MotorSpdDeratingActLogged FaultFTCMSCS_CtrlSatTimoutAut FaultFTCMSCS_CtrlSatTimoutDetected FaultFTCMSCS_CtrlSatTimoutLogged FaultFTCMSCS_Detected FaultFTCMSCS_Logged FaultFTCMSCS_SpdOvershootAut FaultFTCMSCS_SpdOvershootDetected FaultFTCMSCS_SpdOvershootLogged FaultFTCMSCS_ZeroSpeedTimoutAut FaultFTCMSCS_ZeroSpeedTimoutDetected FaultFTCMSCS_ZeroSpeedTimoutLogged FaultFTCMTCS_Detected FaultFTCMTCS_Logged FaultFTCMTCS_VoltageMarginLowAut FaultFTCMTCS_VoltageMarginLowDetected FaultFTCMTCS_VoltageMarginLowLogged FaultFTEVEIT_Detected FaultFTEVEIT_EstOverTempAut FaultFTEVEIT_EstOverTempDetected FaultFTEVEIT_EstOverTempLogged FaultFTEVEIT_Logged FaultFTMTLCS_CurrentSumErrorAut FaultFTMTLCS_CurrentSumErrorDetected FaultFTMTLCS_CurrentSumErrorLogged FaultFTMTLCS_CurSenrPhaU_GNDAut FaultFTMTLCS_CurSenrPhaU_GNDDetected FaultFTMTLCS_CurSenrPhaU_GNDLogged FaultFTMTLCS_CurSenrPhaU_OutRngHAut FaultFTMTLCS_CurSenrPhaU_OutRngHDetected FaultFTMTLCS_CurSenrPhaU_OutRngHLogged FaultFTMTLCS_CurSenrPhaU_OutRngLAut FaultFTMTLCS_CurSenrPhaU_OutRngLDetected FaultFTMTLCS_CurSenrPhaU_OutRngLLogged FaultFTMTLCS_CurSenrPhaU_VCCAut FaultFTMTLCS_CurSenrPhaU_VCCDetected FaultFTMTLCS_CurSenrPhaU_VCCLogged FaultFTMTLCS_CurSenrPhaV_GNDAut FaultFTMTLCS_CurSenrPhaV_GNDDetected FaultFTMTLCS_CurSenrPhaV_GNDLogged FaultFTMTLCS_CurSenrPhaV_OutRngHAut FaultFTMTLCS_CurSenrPhaV_OutRngHDetected FaultFTMTLCS_CurSenrPhaV_OutRngHLogged FaultFTMTLCS_CurSenrPhaV_OutRngLAut FaultFTMTLCS_CurSenrPhaV_OutRngLDetected FaultFTMTLCS_CurSenrPhaV_OutRngLLogged FaultFTMTLCS_CurSenrPhaV_VCCAut FaultFTMTLCS_CurSenrPhaV_VCCDetected FaultFTMTLCS_CurSenrPhaV_VCCLogged FaultFTMTLCS_CurSenrPhaW_GNDAut FaultFTMTLCS_CurSenrPhaW_GNDDetected FaultFTMTLCS_CurSenrPhaW_GNDLogged FaultFTMTLCS_CurSenrPhaW_OutRngHAut FaultFTMTLCS_CurSenrPhaW_OutRngHDetected FaultFTMTLCS_CurSenrPhaW_OutRngHLogged FaultFTMTLCS_CurSenrPhaW_OutRngLAut FaultFTMTLCS_CurSenrPhaW_OutRngLDetected FaultFTMTLCS_CurSenrPhaW_OutRngLLogged FaultFTMTLCS_CurSenrPhaW_VCCAut FaultFTMTLCS_CurSenrPhaW_VCCDetected FaultFTMTLCS_CurSenrPhaW_VCCLogged FaultFTMTLCS_Detected FaultFTMTLCS_Logged FaultFunctionTypeDetectedArray FaultFunctionTypeDetectedArray[0] FaultFunctionTypeDetectedArray[10] FaultFunctionTypeDetectedArray[11] FaultFunctionTypeDetectedArray[12] FaultFunctionTypeDetectedArray[13] FaultFunctionTypeDetectedArray[14] FaultFunctionTypeDetectedArray[15] FaultFunctionTypeDetectedArray[16] FaultFunctionTypeDetectedArray[17] FaultFunctionTypeDetectedArray[18] FaultFunctionTypeDetectedArray[19] FaultFunctionTypeDetectedArray[1] FaultFunctionTypeDetectedArray[20] FaultFunctionTypeDetectedArray[21] FaultFunctionTypeDetectedArray[22] FaultFunctionTypeDetectedArray[23] FaultFunctionTypeDetectedArray[24] FaultFunctionTypeDetectedArray[25] FaultFunctionTypeDetectedArray[26] FaultFunctionTypeDetectedArray[27] FaultFunctionTypeDetectedArray[28] FaultFunctionTypeDetectedArray[29] FaultFunctionTypeDetectedArray[2] FaultFunctionTypeDetectedArray[3] FaultFunctionTypeDetectedArray[4] FaultFunctionTypeDetectedArray[5] FaultFunctionTypeDetectedArray[6] FaultFunctionTypeDetectedArray[7] FaultFunctionTypeDetectedArray[8] FaultFunctionTypeDetectedArray[9] FaultFunctionTypeLoggedArray FaultFunctionTypeLoggedArray[0] FaultFunctionTypeLoggedArray[10] FaultFunctionTypeLoggedArray[11] FaultFunctionTypeLoggedArray[12] FaultFunctionTypeLoggedArray[13] FaultFunctionTypeLoggedArray[14] FaultFunctionTypeLoggedArray[15] FaultFunctionTypeLoggedArray[16] FaultFunctionTypeLoggedArray[17] FaultFunctionTypeLoggedArray[18] FaultFunctionTypeLoggedArray[19] FaultFunctionTypeLoggedArray[1] FaultFunctionTypeLoggedArray[20] FaultFunctionTypeLoggedArray[21] FaultFunctionTypeLoggedArray[22] FaultFunctionTypeLoggedArray[23] FaultFunctionTypeLoggedArray[24] FaultFunctionTypeLoggedArray[25] FaultFunctionTypeLoggedArray[26] FaultFunctionTypeLoggedArray[27] FaultFunctionTypeLoggedArray[28] FaultFunctionTypeLoggedArray[29] FaultFunctionTypeLoggedArray[2] FaultFunctionTypeLoggedArray[3] FaultFunctionTypeLoggedArray[4] FaultFunctionTypeLoggedArray[5] FaultFunctionTypeLoggedArray[6] FaultFunctionTypeLoggedArray[7] FaultFunctionTypeLoggedArray[8] FaultFunctionTypeLoggedArray[9] FaultSDMTMEP_CosGndAut FaultSDMTMEP_CosGndDetected FaultSDMTMEP_CosGndLogged FaultSDMTMEP_CosOutRangeHighAut FaultSDMTMEP_CosOutRangeHighDetected FaultSDMTMEP_CosOutRangeHighLogged FaultSDMTMEP_CosOutRangeLowAut FaultSDMTMEP_CosOutRangeLowDetected FaultSDMTMEP_CosOutRangeLowLogged FaultSDMTMEP_CosVccAut FaultSDMTMEP_CosVccDetected FaultSDMTMEP_CosVccLogged FaultSDMTMEP_Detected FaultSDMTMEP_Logged FaultSDMTMEP_OverSpeedAut FaultSDMTMEP_OverSpeedDetected FaultSDMTMEP_OverSpeedLogged FaultSDMTMEP_ResSquaSumErrByFTAut FaultSDMTMEP_ResSquaSumErrByFTDetected FaultSDMTMEP_ResSquaSumErrByFTLogged FaultSDMTMEP_SinGndAut FaultSDMTMEP_SinGndDetected FaultSDMTMEP_SinGndLogged FaultSDMTMEP_SinOutRangeHighAut FaultSDMTMEP_SinOutRangeHighDetected FaultSDMTMEP_SinOutRangeHighLogged FaultSDMTMEP_SinOutRangeLowAut FaultSDMTMEP_SinOutRangeLowDetected FaultSDMTMEP_SinOutRangeLowLogged FaultSDMTMEP_SinVccAut FaultSDMTMEP_SinVccDetected FaultSDMTMEP_SinVccLogged FaultSDMTMEP_UnderSpeedAut FaultSDMTMEP_UnderSpeedDetected FaultSDMTMEP_UnderSpeedLogged FaultTableFuncTypeCounter1 FaultTableFuncTypeCounter1[0] FaultTableFuncTypeCounter1[100] FaultTableFuncTypeCounter1[101] FaultTableFuncTypeCounter1[102] FaultTableFuncTypeCounter1[103] FaultTableFuncTypeCounter1[104] FaultTableFuncTypeCounter1[105] FaultTableFuncTypeCounter1[106] FaultTableFuncTypeCounter1[107] FaultTableFuncTypeCounter1[108] FaultTableFuncTypeCounter1[109] FaultTableFuncTypeCounter1[10] FaultTableFuncTypeCounter1[110] FaultTableFuncTypeCounter1[111] FaultTableFuncTypeCounter1[112] FaultTableFuncTypeCounter1[113] FaultTableFuncTypeCounter1[114] FaultTableFuncTypeCounter1[115] FaultTableFuncTypeCounter1[116] FaultTableFuncTypeCounter1[117] FaultTableFuncTypeCounter1[118] FaultTableFuncTypeCounter1[119] FaultTableFuncTypeCounter1[11] FaultTableFuncTypeCounter1[120] FaultTableFuncTypeCounter1[121] FaultTableFuncTypeCounter1[122] FaultTableFuncTypeCounter1[123] FaultTableFuncTypeCounter1[124] FaultTableFuncTypeCounter1[125] FaultTableFuncTypeCounter1[126] FaultTableFuncTypeCounter1[127] FaultTableFuncTypeCounter1[128] FaultTableFuncTypeCounter1[129] FaultTableFuncTypeCounter1[12] FaultTableFuncTypeCounter1[130] FaultTableFuncTypeCounter1[131] FaultTableFuncTypeCounter1[132] FaultTableFuncTypeCounter1[13] FaultTableFuncTypeCounter1[14] FaultTableFuncTypeCounter1[15] FaultTableFuncTypeCounter1[16] FaultTableFuncTypeCounter1[17] FaultTableFuncTypeCounter1[18] FaultTableFuncTypeCounter1[19] FaultTableFuncTypeCounter1[1] FaultTableFuncTypeCounter1[20] FaultTableFuncTypeCounter1[21] FaultTableFuncTypeCounter1[22] FaultTableFuncTypeCounter1[23] FaultTableFuncTypeCounter1[24] FaultTableFuncTypeCounter1[25] FaultTableFuncTypeCounter1[26] FaultTableFuncTypeCounter1[27] FaultTableFuncTypeCounter1[28] FaultTableFuncTypeCounter1[29] FaultTableFuncTypeCounter1[2] FaultTableFuncTypeCounter1[30] FaultTableFuncTypeCounter1[31] FaultTableFuncTypeCounter1[32] FaultTableFuncTypeCounter1[33] FaultTableFuncTypeCounter1[34] FaultTableFuncTypeCounter1[35] FaultTableFuncTypeCounter1[36] FaultTableFuncTypeCounter1[37] FaultTableFuncTypeCounter1[38] FaultTableFuncTypeCounter1[39] FaultTableFuncTypeCounter1[3] FaultTableFuncTypeCounter1[40] FaultTableFuncTypeCounter1[41] FaultTableFuncTypeCounter1[42] FaultTableFuncTypeCounter1[43] FaultTableFuncTypeCounter1[44] FaultTableFuncTypeCounter1[45] FaultTableFuncTypeCounter1[46] FaultTableFuncTypeCounter1[47] FaultTableFuncTypeCounter1[48] FaultTableFuncTypeCounter1[49] FaultTableFuncTypeCounter1[4] FaultTableFuncTypeCounter1[50] FaultTableFuncTypeCounter1[51] FaultTableFuncTypeCounter1[52] FaultTableFuncTypeCounter1[53] FaultTableFuncTypeCounter1[54] FaultTableFuncTypeCounter1[55] FaultTableFuncTypeCounter1[56] FaultTableFuncTypeCounter1[57] FaultTableFuncTypeCounter1[58] FaultTableFuncTypeCounter1[59] FaultTableFuncTypeCounter1[5] FaultTableFuncTypeCounter1[60] FaultTableFuncTypeCounter1[61] FaultTableFuncTypeCounter1[62] FaultTableFuncTypeCounter1[63] FaultTableFuncTypeCounter1[64] FaultTableFuncTypeCounter1[65] FaultTableFuncTypeCounter1[66] FaultTableFuncTypeCounter1[67] FaultTableFuncTypeCounter1[68] FaultTableFuncTypeCounter1[69] FaultTableFuncTypeCounter1[6] FaultTableFuncTypeCounter1[70] FaultTableFuncTypeCounter1[71] FaultTableFuncTypeCounter1[72] FaultTableFuncTypeCounter1[73] FaultTableFuncTypeCounter1[74] FaultTableFuncTypeCounter1[75] FaultTableFuncTypeCounter1[76] FaultTableFuncTypeCounter1[77] FaultTableFuncTypeCounter1[78] FaultTableFuncTypeCounter1[79] FaultTableFuncTypeCounter1[7] FaultTableFuncTypeCounter1[80] FaultTableFuncTypeCounter1[81] FaultTableFuncTypeCounter1[82] FaultTableFuncTypeCounter1[83] FaultTableFuncTypeCounter1[84] FaultTableFuncTypeCounter1[85] FaultTableFuncTypeCounter1[86] FaultTableFuncTypeCounter1[87] FaultTableFuncTypeCounter1[88] FaultTableFuncTypeCounter1[89] FaultTableFuncTypeCounter1[8] FaultTableFuncTypeCounter1[90] FaultTableFuncTypeCounter1[91] FaultTableFuncTypeCounter1[92] FaultTableFuncTypeCounter1[93] FaultTableFuncTypeCounter1[94] FaultTableFuncTypeCounter1[95] FaultTableFuncTypeCounter1[96] FaultTableFuncTypeCounter1[97] FaultTableFuncTypeCounter1[98] FaultTableFuncTypeCounter1[99] FaultTableFuncTypeCounter1[9] FaultTCUCAP0_CAPPressureHAut FaultTCUCAP0_CAPPressureHDetected FaultTCUCAP0_CAPPressureHLogged FaultTCUCAP0_CAPPressureLAut FaultTCUCAP0_CAPPressureLDetected FaultTCUCAP0_CAPPressureLLogged FaultTCUCAP0_CAPPressureOverHAut FaultTCUCAP0_CAPPressureOverHDetected FaultTCUCAP0_CAPPressureOverHLogged FaultTCUCAP0_CAPSlipAut FaultTCUCAP0_CAPSlipDetected FaultTCUCAP0_CAPSlipLogged FaultTCUCAP0_Detected FaultTCUCAP0_DragMomentHAut FaultTCUCAP0_DragMomentHDetected FaultTCUCAP0_DragMomentHLogged FaultTCUCAP0_HLSinInvalidAut FaultTCUCAP0_HLSinInvalidDetected FaultTCUCAP0_HLSinInvalidLogged FaultTCUCAP0_HLSinUndefineAut FaultTCUCAP0_HLSinUndefineDetected FaultTCUCAP0_HLSinUndefineLogged FaultTCUCAP0_HLSupplyHAut FaultTCUCAP0_HLSupplyHDetected FaultTCUCAP0_HLSupplyHLogged FaultTCUCAP0_HLSupplyLAut FaultTCUCAP0_HLSupplyLDetected FaultTCUCAP0_HLSupplyLLogged FaultTCUCAP0_Logged FaultTCUCAP0_MotorPhaseVolHAut FaultTCUCAP0_MotorPhaseVolHDetected FaultTCUCAP0_MotorPhaseVolHLogged FaultTCUCAP0_PressureRationalAut FaultTCUCAP0_PressureRationalDetected FaultTCUCAP0_PressureRationalLogged FaultTCUCAP0_SenSigOpenOrGNDAut FaultTCUCAP0_SenSigOpenOrGNDDetected FaultTCUCAP0_SenSigOpenOrGNDLogged FaultTCUCAP0_SenSigVCCAut FaultTCUCAP0_SenSigVCCDetected FaultTCUCAP0_SenSigVCCLogged FaultTCUCAP0_SensorPerforErrAut FaultTCUCAP0_SensorPerforErrDetected FaultTCUCAP0_SensorPerforErrLogged FaultTCUCAP1_COM_GCUAut FaultTCUCAP1_COM_GCUDetected FaultTCUCAP1_COM_GCULogged FaultTCUCAP1_Detected FaultTCUCAP1_DriverTempHAut FaultTCUCAP1_DriverTempHDetected FaultTCUCAP1_DriverTempHLogged FaultTCUCAP1_FETShortAut FaultTCUCAP1_FETShortDetected FaultTCUCAP1_FETShortLogged FaultTCUCAP1_HWOverCurAut FaultTCUCAP1_HWOverCurDetected FaultTCUCAP1_HWOverCurLogged FaultTCUCAP1_Logged FaultTCUCAP1_MotorPhaseDriveErrAut FaultTCUCAP1_MotorPhaseDriveErrDetected FaultTCUCAP1_MotorPhaseDriveErrLogged FaultTCUCAP1_MotorStallAut FaultTCUCAP1_MotorStallDetected FaultTCUCAP1_MotorStallLogged FaultTCUCAP1_OverVoltageAut FaultTCUCAP1_OverVoltageDetected FaultTCUCAP1_OverVoltageLogged FaultTCUCAP1_PhaseDetectGNDAut FaultTCUCAP1_PhaseDetectGNDDetected /end OUT_MEASUREMENT
/end FUNCTION
/end MODULE
/end PROJECT
/* (add any file trailer comments here) */ /* EOF VSPE.a2l */
