ASAP2_VERSION 1 31
/begin PROJECT ProjectName "Project Comment Goes Here"
/begin HEADER "Header Comments go here" /end HEADER
/begin MODULE ModuleName "Module Comment Goes Here"
/begin MOD_COMMON "Mod Common Comment Here" BYTE_ORDER MSB_FIRST /end MOD_COMMON
/* EOF PORS.a2l */
/begin RECORD_LAYOUT DATA_RECORD_UBYTE FNC_VALUES 1 UBYTE ROW_DIR DIRECT /end RECORD_LAYOUT
/begin RECORD_LAYOUT DATA_RECORD_UWORD FNC_VALUES 1 UWORD ROW_DIR DIRECT /end RECORD_LAYOUT
/begin RECORD_LAYOUT DATA_RECORD_SLONG FNC_VALUES 1 SLONG ROW_DIR DIRECT /end RECORD_LAYOUT
/begin RECORD_LAYOUT DATA_RECORD_FLOAT32_IEEE FNC_VALUES 1 FLOAT32_IEEE ROW_DIR DIRECT /end RECORD_LAYOUT
/begin CHARACTERISTIC FTASBDS_BatVoltDrtEnableC "FTASBDS_BatVoltDrtEnableC" VALUE 0x80061844 DATA_RECORD_UBYTE 1 Bool_ON_OFF 0 1 BIT_MASK 0x01 /end CHARACTERISTIC
/begin CHARACTERISTIC FTASBDS_LutBatteryDeratingGainC "FTASBDS_LutBatteryDeratingGainC" CURVE 0x8006182C DATA_RECORD_FLOAT32_IEEE 1 F_1_p0_55 0 1
 /begin AXIS_DESCR FIX_AXIS NO_INPUT_QUANTITY Id_0x00 6 0 5 MAX_GRAD 100.0 FIX_AXIS_PAR_DIST 0 1 6 /end AXIS_DESCR
/end CHARACTERISTIC
/begin CHARACTERISTIC FTASBDS_LutBatteryVoltageC "FTASBDS_LutBatteryVoltageC" CURVE 0x80061814 DATA_RECORD_FLOAT32_IEEE 1200 F_1_p0_38 0 1200
 /begin AXIS_DESCR FIX_AXIS NO_INPUT_QUANTITY Id_0x00 6 0 5 MAX_GRAD 100.0 FIX_AXIS_PAR_DIST 0 1 6 /end AXIS_DESCR
/end CHARACTERISTIC
/begin CHARACTERISTIC FTASBDS_LutInMecaSpeedRpmC "FTASBDS_LutInMecaSpeedRpmC" CURVE 0x80061808 DATA_RECORD_FLOAT32_IEEE 30000 F_1_p0_52 0 30000
 /begin AXIS_DESCR FIX_AXIS NO_INPUT_QUANTITY Id_0x00 3 0 2 MAX_GRAD 100.0 FIX_AXIS_PAR_DIST 0 1 3 /end AXIS_DESCR
/end CHARACTERISTIC
/begin CHARACTERISTIC FTASBDS_LutOutDeratingGainC "FTASBDS_LutOutDeratingGainC" CURVE 0x800617FC DATA_RECORD_FLOAT32_IEEE 1 F_1_p0_55 0 1
 /begin AXIS_DESCR FIX_AXIS NO_INPUT_QUANTITY Id_0x00 3 0 2 MAX_GRAD 100.0 FIX_AXIS_PAR_DIST 0 1 3 /end AXIS_DESCR
/end CHARACTERISTIC
/begin CHARACTERISTIC FTASBDS_ManualDeratingGainC "FTASBDS_ManualDeratingGainC" VALUE 0x800617F8 DATA_RECORD_FLOAT32_IEEE 1 F_1_p0_55 0 1 /end CHARACTERISTIC
/begin CHARACTERISTIC FTASBDS_MaxDeratingGainC "FTASBDS_MaxDeratingGainC" VALUE 0x800617F4 DATA_RECORD_FLOAT32_IEEE 1 F_1_p0_55 0 1 /end CHARACTERISTIC
/begin CHARACTERISTIC FTASBDS_MinDeratingGainC "FTASBDS_MinDeratingGainC" VALUE 0x800617F0 DATA_RECORD_FLOAT32_IEEE 1 F_1_p0_55 0 1 /end CHARACTERISTIC
/begin CHARACTERISTIC FTASBDS_UbatHVNominalC "FTASBDS_UbatHVNominalC" VALUE 0x800617EC DATA_RECORD_FLOAT32_IEEE 1200 F_1_p0_38 0 1200 /end CHARACTERISTIC
/begin CHARACTERISTIC FTASBDS_ZeroSpdC "FTASBDS_ZeroSpdC" VALUE 0x800617E8 DATA_RECORD_FLOAT32_IEEE 3.402823466E+038 F_1_p0_55 -3.402823466E+038 3.402823466E+038 /end CHARACTERISTIC
/begin CHARACTERISTIC FTASDPM_I0DeratingMaxC "FTASDPM_I0DeratingMaxC" VALUE 0x80061864 DATA_RECORD_FLOAT32_IEEE 1200 F_1_p0_46 0 1200 /end CHARACTERISTIC
/begin CHARACTERISTIC FTASDPM_I0DeratingMinC "FTASDPM_I0DeratingMinC" VALUE 0x80061860 DATA_RECORD_FLOAT32_IEEE 1200 F_1_p0_46 -1200 0 /end CHARACTERISTIC
/begin CHARACTERISTIC FTASDPM_IdDeratingMaxC "FTASDPM_IdDeratingMaxC" VALUE 0x8006185C DATA_RECORD_FLOAT32_IEEE 1200 F_1_p0_46 0 1200 /end CHARACTERISTIC
/begin CHARACTERISTIC FTASDPM_IdDeratingMinC "FTASDPM_IdDeratingMinC" VALUE 0x80061858 DATA_RECORD_FLOAT32_IEEE 1200 F_1_p0_46 -1200 0 /end CHARACTERISTIC
/begin CHARACTERISTIC FTASDPM_IqDeratingMaxC "FTASDPM_IqDeratingMaxC" VALUE 0x80061854 DATA_RECORD_FLOAT32_IEEE 1200 F_1_p0_46 0 1200 /end CHARACTERISTIC
/begin CHARACTERISTIC FTASDPM_IqDeratingMinC "FTASDPM_IqDeratingMinC" VALUE 0x80061850 DATA_RECORD_FLOAT32_IEEE 1200 F_1_p0_46 -1200 0 /end CHARACTERISTIC
/begin CHARACTERISTIC FTASDPM_SpeedDrtMaxRpmC "FTASDPM_SpeedDrtMaxRpmC" VALUE 0x8006184C DATA_RECORD_FLOAT32_IEEE 25000 F_1_p0_52 0 25000 /end CHARACTERISTIC
/begin CHARACTERISTIC FTASDPM_SpeedDrtMinRpmC "FTASDPM_SpeedDrtMinRpmC" VALUE 0x80061848 DATA_RECORD_FLOAT32_IEEE 25000 F_1_p0_52 -25000 0 /end CHARACTERISTIC
/begin CHARACTERISTIC FTASETP_ControllerEstPmKiC "Controller integral coefficient." VALUE 0x800618D4 DATA_RECORD_FLOAT32_IEEE 1000 F_1_p0_57 0 1000 /end CHARACTERISTIC
/begin CHARACTERISTIC FTASETP_ControllerEstPmKpC "Controller proportional coefficient." VALUE 0x800618D0 DATA_RECORD_FLOAT32_IEEE 1000 F_1_p0_57 0 1000 /end CHARACTERISTIC
/begin CHARACTERISTIC FTASETP_ControllerPmKiC "Controller integral coefficient." VALUE 0x800618CC DATA_RECORD_FLOAT32_IEEE 1000 F_1_p0_57 0 1000 /end CHARACTERISTIC
/begin CHARACTERISTIC FTASETP_ControllerPmKpC "Controller proportional coefficient." VALUE 0x800618C8 DATA_RECORD_FLOAT32_IEEE 1000 F_1_p0_57 0 1000 /end CHARACTERISTIC
/begin CHARACTERISTIC FTASETP_EstPmDrtEnableC "Enable derating" VALUE 0x800618C4 DATA_RECORD_UBYTE 1 Bool_ON_OFF 0 1 BIT_MASK 0x01 /end CHARACTERISTIC
/begin CHARACTERISTIC FTASETP_EstPmKiMaxC "FTASETP_EstPmKiMaxC" VALUE 0x800618C0 DATA_RECORD_FLOAT32_IEEE 1 F_1_p0_57 0 1 /end CHARACTERISTIC
/begin CHARACTERISTIC FTASETP_EstPmMaximalTempC "FTASETP_EstPmMaximalTempC" VALUE 0x800618BC DATA_RECORD_FLOAT32_IEEE 200 F_1_p0_58 0 200 /end CHARACTERISTIC
/begin CHARACTERISTIC FTASETP_LutInMecaSpeedRpmC "FTASETP_LutInMecaSpeedRpmC" CURVE 0x8006189C DATA_RECORD_FLOAT32_IEEE 40000 F_1_p0_52 -20000 20000
 /begin AXIS_DESCR FIX_AXIS NO_INPUT_QUANTITY Id_0x00 8 0 7 MAX_GRAD 100.0 FIX_AXIS_PAR_DIST 0 1 8 /end AXIS_DESCR
/end CHARACTERISTIC
/begin CHARACTERISTIC FTASETP_MaxDeratingGainC "Gain maximal value." VALUE 0x80061898 DATA_RECORD_FLOAT32_IEEE 1 F_1_p0_47 0 1 /end CHARACTERISTIC
/begin CHARACTERISTIC FTASETP_MinDeratingGainC "Gain minimal value." VALUE 0x80061894 DATA_RECORD_FLOAT32_IEEE 1 F_1_p0_47 0 1 /end CHARACTERISTIC
/begin CHARACTERISTIC FTASETP_OpenLoopEstPmDrtGainC "FTASETP_OpenLoopEstPmDrtGainC" CURVE 0x80061874 DATA_RECORD_FLOAT32_IEEE 1 F_1_p0_55 0 1
 /begin AXIS_DESCR FIX_AXIS NO_INPUT_QUANTITY Id_0x00 8 0 7 MAX_GRAD 100.0 FIX_AXIS_PAR_DIST 0 1 8 /end AXIS_DESCR
/end CHARACTERISTIC
/begin CHARACTERISTIC FTASETP_PmDrtEnableC "Enable derating" VALUE 0x80061870 DATA_RECORD_UBYTE 1 Bool_ON_OFF 0 1 BIT_MASK 0x01 /end CHARACTERISTIC
/begin CHARACTERISTIC FTASETP_PmKiMaxC "FTASETP_PmKiMaxC" VALUE 0x8006186C DATA_RECORD_FLOAT32_IEEE 1 F_1_p0_57 0 1 /end CHARACTERISTIC
/begin CHARACTERISTIC FTASETP_PmMaximalTempC "FTASETP_PmMaximalTempC" VALUE 0x80061868 DATA_RECORD_FLOAT32_IEEE 200 F_1_p0_58 0 200 /end CHARACTERISTIC
/begin CHARACTERISTIC FTASMTP_ControllerWndgKiC "Controller integral coefficient." VALUE 0x800618F0 DATA_RECORD_FLOAT32_IEEE 1000 F_1_p0_57 0 1000 /end CHARACTERISTIC
/begin CHARACTERISTIC FTASMTP_ControllerWndgKpC "Controller proportional coefficient." VALUE 0x800618EC DATA_RECORD_FLOAT32_IEEE 1000 F_1_p0_57 0 1000 /end CHARACTERISTIC
/begin CHARACTERISTIC FTASMTP_MaxDeratingGainC "Gain maximal value." VALUE 0x800618E8 DATA_RECORD_FLOAT32_IEEE 1 F_1_p0_47 0 1 /end CHARACTERISTIC
/begin CHARACTERISTIC FTASMTP_MinDeratingGainC "Gain minimal value." VALUE 0x800618E4 DATA_RECORD_FLOAT32_IEEE 1 F_1_p0_47 0 1 /end CHARACTERISTIC
/begin CHARACTERISTIC FTASMTP_WndgDrtEnableC "Enable derating" VALUE 0x800618E0 DATA_RECORD_UBYTE 1 Bool_ON_OFF 0 1 BIT_MASK 0x01 /end CHARACTERISTIC
/begin CHARACTERISTIC FTASMTP_WndgKiMaxC "FTASMTP_WndgKiMaxC" VALUE 0x800618DC DATA_RECORD_FLOAT32_IEEE 1 F_1_p0_57 0 1 /end CHARACTERISTIC
/begin CHARACTERISTIC FTASMTP_WndgMaximalTempC "FTASMTP_WndgMaximalTempC" VALUE 0x800618D8 DATA_RECORD_FLOAT32_IEEE 200 F_1_p0_58 0 200 /end CHARACTERISTIC
/begin CHARACTERISTIC FTASOSP_LutMotDeratingGainC "FTASOSP_LutMotDeratingGainC" CURVE 0x8006190C DATA_RECORD_FLOAT32_IEEE 1 F_1_p0_55 0 1
 /begin AXIS_DESCR FIX_AXIS NO_INPUT_QUANTITY Id_0x00 2 0 1 MAX_GRAD 100.0 FIX_AXIS_PAR_DIST 0 1 2 /end AXIS_DESCR
/end CHARACTERISTIC
/begin CHARACTERISTIC FTASOSP_LutMotorSpeedC "FTASOSP_LutMotorSpeedC" CURVE 0x80061904 DATA_RECORD_FLOAT32_IEEE 20000 F_1_p0_52 0 20000
 /begin AXIS_DESCR FIX_AXIS NO_INPUT_QUANTITY Id_0x00 2 0 1 MAX_GRAD 100.0 FIX_AXIS_PAR_DIST 0 1 2 /end AXIS_DESCR
/end CHARACTERISTIC
/begin CHARACTERISTIC FTASOSP_ManualDeratingGainC "FTASOSP_ManualDeratingGainC" VALUE 0x80061900 DATA_RECORD_FLOAT32_IEEE 1 F_1_p0_55 0 1 /end CHARACTERISTIC
/begin CHARACTERISTIC FTASOSP_MaxDeratingGainC "FTASOSP_MaxDeratingGainC" VALUE 0x800618FC DATA_RECORD_FLOAT32_IEEE 1 F_1_p0_55 0 1 /end CHARACTERISTIC
/begin CHARACTERISTIC FTASOSP_MinDeratingGainC "FTASOSP_MinDeratingGainC" VALUE 0x800618F8 DATA_RECORD_FLOAT32_IEEE 1 F_1_p0_55 0 1 /end CHARACTERISTIC
/begin CHARACTERISTIC FTASOSP_MotorSpdDrtEnableC "FTASOSP_MotorSpdDrtEnableC" VALUE 0x800618F4 DATA_RECORD_UBYTE 1 Bool_ON_OFF 0 1 BIT_MASK 0x01 /end CHARACTERISTIC
/begin CHARACTERISTIC FTCIVDC_Concordia33C "FTCIVDC_Concordia33C" MAP 0x80061A1C DATA_RECORD_FLOAT32_IEEE 2 F_1_p0_4 -1 1
 /begin AXIS_DESCR FIX_AXIS NO_INPUT_QUANTITY Id_0x00 3 0 2 MAX_GRAD 100.0 FIX_AXIS_PAR_DIST 0 1 3 /end AXIS_DESCR
 /begin AXIS_DESCR FIX_AXIS NO_INPUT_QUANTITY Id_0x00 3 0 2 MAX_GRAD 100.0 FIX_AXIS_PAR_DIST 0 1 3 /end AXIS_DESCR
/end CHARACTERISTIC
/begin CHARACTERISTIC FTCIVDC_DeadComDisableIsC "FTCIVDC_DeadComDisableIsC" VALUE 0x80061A18 DATA_RECORD_FLOAT32_IEEE 3.402823466E+038 F_1_p0_46 -3.402823466E+038 3.402823466E+038 /end CHARACTERISTIC
/begin CHARACTERISTIC FTCIVDC_DeadComEnableIsC "FTCIVDC_DeadComEnableIsC" VALUE 0x80061A14 DATA_RECORD_FLOAT32_IEEE 3.402823466E+038 F_1_p0_46 -3.402823466E+038 3.402823466E+038 /end CHARACTERISTIC
/begin CHARACTERISTIC FTCIVDC_DeadCompCurFildNumC "FTCIVDC_DeadCompCurFildNumC" VALUE 0x80061A10 DATA_RECORD_FLOAT32_IEEE 3.402823466E+038 F_1_p0_4 -3.402823466E+038 3.402823466E+038 /end CHARACTERISTIC
/begin CHARACTERISTIC FTCIVDC_DeadCompDutyFildNumC "FTCIVDC_DeadCompDutyFildNumC" VALUE 0x80061A0C DATA_RECORD_FLOAT32_IEEE 3.402823466E+038 F_1_p0_4 -3.402823466E+038 3.402823466E+038 /end CHARACTERISTIC
/begin CHARACTERISTIC FTCIVDC_DeadCurrentSwitchC "FTCIVDC_DeadCurrentSwitchC" VALUE 0x80061A08 DATA_RECORD_UBYTE 1 Bool_ON_OFF 0 1 BIT_MASK 0x01 /end CHARACTERISTIC
/begin CHARACTERISTIC FTCIVDC_DeadZnCompEnaC "FTCIVDC_DeadZnCompEnaC" VALUE 0x80061A04 DATA_RECORD_UBYTE 1 Bool_ON_OFF 0 1 BIT_MASK 0x01 /end CHARACTERISTIC
/begin CHARACTERISTIC FTCIVDC_DeadZnCompSpeedHighC "FTCIVDC_DeadZnCompSpeedHighC" VALUE 0x80061A00 DATA_RECORD_FLOAT32_IEEE 3.402823466E+038 F_1_p0_52 -3.402823466E+038 3.402823466E+038 /end CHARACTERISTIC
/begin CHARACTERISTIC FTCIVDC_DeadZnCompSpeedLowC "FTCIVDC_DeadZnCompSpeedLowC" VALUE 0x800619FC DATA_RECORD_FLOAT32_IEEE 3.402823466E+038 F_1_p0_52 -3.402823466E+038 3.402823466E+038 /end CHARACTERISTIC
/begin CHARACTERISTIC FTCIVDC_DeadZoneTimeUsC "FTCIVDC_DeadZoneTimeUsC" VALUE 0x800619F8 DATA_RECORD_FLOAT32_IEEE 10 F_1_p0_60 0 10 /end CHARACTERISTIC
/begin CHARACTERISTIC FTCIVDC_DefaultPwmFrequencyC "FTCIVDC_DefaultPwmFrequencyC" VALUE 0x800619F4 DATA_RECORD_UWORD 65535 F_1_p0_35 0 65535 /end CHARACTERISTIC
/begin CHARACTERISTIC FTCIVDC_DutyCycleMaxC "FTCIVDC_DutyCycleMaxC" VALUE 0x800619F0 DATA_RECORD_FLOAT32_IEEE 1 F_1_p0_4 0 1 /end CHARACTERISTIC
/begin CHARACTERISTIC FTCIVDC_DutyCycleMinC "FTCIVDC_DutyCycleMinC" VALUE 0x800619EC DATA_RECORD_FLOAT32_IEEE 1 F_1_p0_4 0 1 /end CHARACTERISTIC
/begin CHARACTERISTIC FTCIVDC_ExtPwmOnOff3C "FTCIVDC_ExtPwmOnOff3C" CURVE 0x800619E8 DATA_RECORD_UBYTE 1 Bool_ON_OFF 0 1 BIT_MASK 0x01
 /begin AXIS_DESCR FIX_AXIS NO_INPUT_QUANTITY Id_0x00 3 0 2 MAX_GRAD 100.0 FIX_AXIS_PAR_DIST 0 1 3 /end AXIS_DESCR
/end CHARACTERISTIC
/begin CHARACTERISTIC FTCIVDC_FpgaDutyCycleMinMaxC "FTCIVDC_FpgaDutyCycleMinMaxC" CURVE 0x800619E0 DATA_RECORD_FLOAT32_IEEE 1 F_1_p0_4 0 1
 /begin AXIS_DESCR FIX_AXIS NO_INPUT_QUANTITY Id_0x00 2 0 1 MAX_GRAD 100.0 FIX_AXIS_PAR_DIST 0 1 2 /end AXIS_DESCR
/end CHARACTERISTIC
/begin CHARACTERISTIC FTCIVDC_FreqRangC "FTCIVDC_FreqRangC" VALUE 0x800619DC DATA_RECORD_FLOAT32_IEEE 3.402823466E+038 F_1_p0_4 -3.402823466E+038 3.402823466E+038 /end CHARACTERISTIC
/begin CHARACTERISTIC FTCIVDC_InitDutyCycle3C "FTCIVDC_InitDutyCycle3C" CURVE 0x800619D0 DATA_RECORD_FLOAT32_IEEE 1 F_1_p0_4 0 1
 /begin AXIS_DESCR FIX_AXIS NO_INPUT_QUANTITY Id_0x00 3 0 2 MAX_GRAD 100.0 FIX_AXIS_PAR_DIST 0 1 3 /end AXIS_DESCR
/end CHARACTERISTIC
/begin CHARACTERISTIC FTCIVDC_InitPwmOnOff3C "FTCIVDC_InitPwmOnOff3C" CURVE 0x800619CC DATA_RECORD_UBYTE 1 Bool_ON_OFF 0 1 BIT_MASK 0x01
 /begin AXIS_DESCR FIX_AXIS NO_INPUT_QUANTITY Id_0x00 3 0 2 MAX_GRAD 100.0 FIX_AXIS_PAR_DIST 0 1 3 /end AXIS_DESCR
/end CHARACTERISTIC
/begin CHARACTERISTIC FTCIVDC_LutInSpeedC "FTCIVDC_LutInSpeedC" CURVE 0x800619B8 DATA_RECORD_FLOAT32_IEEE 3.402823466E+038 F_1_p0_4 -3.402823466E+038 3.402823466E+038
 /begin AXIS_DESCR FIX_AXIS NO_INPUT_QUANTITY Id_0x00 5 0 4 MAX_GRAD 100.0 FIX_AXIS_PAR_DIST 0 1 5 /end AXIS_DESCR
/end CHARACTERISTIC
/begin CHARACTERISTIC FTCIVDC_LutInTorqueC "FTCIVDC_LutInTorqueC" CURVE 0x800619A4 DATA_RECORD_FLOAT32_IEEE 3.402823466E+038 F_1_p0_4 -3.402823466E+038 3.402823466E+038
 /begin AXIS_DESCR FIX_AXIS NO_INPUT_QUANTITY Id_0x00 5 0 4 MAX_GRAD 100.0 FIX_AXIS_PAR_DIST 0 1 5 /end AXIS_DESCR
/end CHARACTERISTIC
/begin CHARACTERISTIC FTCIVDC_LutMecaspeedRpmC "FTCIVDC_LutMecaspeedRpmC" CURVE 0x80061988 DATA_RECORD_FLOAT32_IEEE 3.402823466E+038 F_1_p0_4 -3.402823466E+038 3.402823466E+038
 /begin AXIS_DESCR FIX_AXIS NO_INPUT_QUANTITY Id_0x00 7 0 6 MAX_GRAD 100.0 FIX_AXIS_PAR_DIST 0 1 7 /end AXIS_DESCR
/end CHARACTERISTIC
/begin CHARACTERISTIC FTCIVDC_LutOutFreqLmtC "FTCIVDC_LutOutFreqLmtC" MAP 0x80061954 DATA_RECORD_UWORD 65535 F_1_p0_4 0 65535
 /begin AXIS_DESCR FIX_AXIS NO_INPUT_QUANTITY Id_0x00 5 0 4 MAX_GRAD 100.0 FIX_AXIS_PAR_DIST 0 1 5 /end AXIS_DESCR
 /begin AXIS_DESCR FIX_AXIS NO_INPUT_QUANTITY Id_0x00 5 0 4 MAX_GRAD 100.0 FIX_AXIS_PAR_DIST 0 1 5 /end AXIS_DESCR
/end CHARACTERISTIC
/begin CHARACTERISTIC FTCIVDC_LutPwmFrequenceC "FTCIVDC_LutPwmFrequenceC" CURVE 0x80061944 DATA_RECORD_UWORD 65535 F_1_p0_4 0 65535
 /begin AXIS_DESCR FIX_AXIS NO_INPUT_QUANTITY Id_0x00 7 0 6 MAX_GRAD 100.0 FIX_AXIS_PAR_DIST 0 1 7 /end AXIS_DESCR
/end CHARACTERISTIC
/begin CHARACTERISTIC FTCIVDC_MecaSpdCutOffFrequencyC "FTCIVDC_MecaSpdCutOffFrequencyC" VALUE 0x80061940 DATA_RECORD_FLOAT32_IEEE 3.402823466E+038 F_1_p0_4 -3.402823466E+038 3.402823466E+038 /end CHARACTERISTIC
/begin CHARACTERISTIC FTCIVDC_OperationnalPwmOnOff3C "FTCIVDC_OperationnalPwmOnOff3C" CURVE 0x8006193C DATA_RECORD_UBYTE 1 Bool_ON_OFF 0 1 BIT_MASK 0x01
 /begin AXIS_DESCR FIX_AXIS NO_INPUT_QUANTITY Id_0x00 3 0 2 MAX_GRAD 100.0 FIX_AXIS_PAR_DIST 0 1 3 /end AXIS_DESCR
/end CHARACTERISTIC
/begin CHARACTERISTIC FTCIVDC_PwmFrequenceMaxC "FTCIVDC_PwmFrequenceMaxC" VALUE 0x80061938 DATA_RECORD_UWORD 65535 F_1_p0_35 0 65535 /end CHARACTERISTIC
/begin CHARACTERISTIC FTCIVDC_PwmFrequenceMinC "FTCIVDC_PwmFrequenceMinC" VALUE 0x80061934 DATA_RECORD_UWORD 65535 F_1_p0_35 0 65535 /end CHARACTERISTIC
/begin CHARACTERISTIC FTCIVDC_PwmZeroMatchEnC "FTCIVDC_PwmZeroMatchEnC" VALUE 0x80061930 DATA_RECORD_UBYTE 1 Bool_ON_OFF 0 1 BIT_MASK 0x01 /end CHARACTERISTIC
/begin CHARACTERISTIC FTCIVDC_PwmZeroMatchRevC "FTCIVDC_PwmZeroMatchRevC" VALUE 0x8006192C DATA_RECORD_UBYTE 1 Bool_ON_OFF 0 1 BIT_MASK 0x01 /end CHARACTERISTIC
/begin CHARACTERISTIC FTCIVDC_RandFreqEnC "FTCIVDC_RandFreqEnC" VALUE 0x80061928 DATA_RECORD_UBYTE 1 Bool_ON_OFF 0 1 BIT_MASK 0x01 /end CHARACTERISTIC
/begin CHARACTERISTIC FTCIVDC_RdFreqTimeC "FTCIVDC_RdFreqTimeC" VALUE 0x80061924 DATA_RECORD_UWORD 65535 F_1_p0_40 0 65535 /end CHARACTERISTIC
/begin CHARACTERISTIC FTCIVDC_SpdMaxC "FTCIVDC_SpdMaxC" VALUE 0x80061920 DATA_RECORD_FLOAT32_IEEE 3.402823466E+038 F_1_p0_50 -3.402823466E+038 3.402823466E+038 /end CHARACTERISTIC
/begin CHARACTERISTIC FTCIVDC_SpdMinC "FTCIVDC_SpdMinC" VALUE 0x8006191C DATA_RECORD_FLOAT32_IEEE 3.402823466E+038 F_1_p0_50 -3.402823466E+038 3.402823466E+038 /end CHARACTERISTIC
/begin CHARACTERISTIC FTCIVDC_UbatHVLowSatC "FTCIVDC_UbatHVLowSatC" VALUE 0x80061918 DATA_RECORD_FLOAT32_IEEE 99 F_1_p0_38 1 100 /end CHARACTERISTIC
/begin CHARACTERISTIC FTCIVDC_VFreqEnableC "FTCIVDC_VFreqEnableC" VALUE 0x80061914 DATA_RECORD_UBYTE 1 Bool_ON_OFF 0 1 BIT_MASK 0x01 /end CHARACTERISTIC
/begin CHARACTERISTIC FTCMCCS_CurrentLoopOrgEnC "FTCMCCS_CurrentLoopOrgEnC" VALUE 0x80061EF4 DATA_RECORD_UBYTE 1 Bool_ON_OFF 0 1 BIT_MASK 0x01 /end CHARACTERISTIC
/begin CHARACTERISTIC FTCMCCS_EM1dOpenLoopGainC "FTCMCCS_EM1dOpenLoopGainC" VALUE 0x80061EF0 DATA_RECORD_FLOAT32_IEEE 3.402823466E+038 F_1_p0_4 -3.402823466E+038 3.402823466E+038 /end CHARACTERISTIC
/begin CHARACTERISTIC FTCMCCS_EM1qOpenLoopGainC "FTCMCCS_EM1qOpenLoopGainC" VALUE 0x80061EEC DATA_RECORD_FLOAT32_IEEE 3.402823466E+038 F_1_p0_4 -3.402823466E+038 3.402823466E+038 /end CHARACTERISTIC
/begin CHARACTERISTIC FTCMCCS_GenTableTorqueThrdC "FTCMCCS_GenTableTorqueThrdC" VALUE 0x80061EE8 DATA_RECORD_FLOAT32_IEEE 3.402823466E+038 F_1_p0_45 -3.402823466E+038 3.402823466E+038 /end CHARACTERISTIC
/begin CHARACTERISTIC FTCMCCS_IdCurrLoopParOnOffC "FTCMCCS_IdCurrLoopParOnOffC" VALUE 0x80061EE4 DATA_RECORD_UBYTE 1 Bool_ON_OFF 0 1 BIT_MASK 0x01 /end CHARACTERISTIC
/begin CHARACTERISTIC FTCMCCS_InitU0dqTgt3C "FTCMCCS_InitU0dqTgt3C" CURVE 0x80061ED8 DATA_RECORD_FLOAT32_IEEE 3.402823466E+038 F_1_p0_38 -3.402823466E+038 3.402823466E+038
 /begin AXIS_DESCR FIX_AXIS NO_INPUT_QUANTITY Id_0x00 3 0 2 MAX_GRAD 100.0 FIX_AXIS_PAR_DIST 0 1 3 /end AXIS_DESCR
/end CHARACTERISTIC
/begin CHARACTERISTIC FTCMCCS_IqCurrLoopParOnOffC "FTCMCCS_IqCurrLoopParOnOffC" VALUE 0x80061ED4 DATA_RECORD_UBYTE 1 Bool_ON_OFF 0 1 BIT_MASK 0x01 /end CHARACTERISTIC
/begin CHARACTERISTIC FTCMCCS_Lm0C "FTCMCCS_Lm0C" VALUE 0x80061ED0 DATA_RECORD_FLOAT32_IEEE 3.402823466E+038 F_1_p0_4 -3.402823466E+038 3.402823466E+038 /end CHARACTERISTIC
/begin CHARACTERISTIC FTCMCCS_Lm1dC "FTCMCCS_Lm1dC" VALUE 0x80061ECC DATA_RECORD_FLOAT32_IEEE 3.402823466E+038 F_1_p0_4 -3.402823466E+038 3.402823466E+038 /end CHARACTERISTIC
/begin CHARACTERISTIC FTCMCCS_Lm1qC "FTCMCCS_Lm1qC" VALUE 0x80061EC8 DATA_RECORD_FLOAT32_IEEE 3.402823466E+038 F_1_p0_4 -3.402823466E+038 3.402823466E+038 /end CHARACTERISTIC
/begin CHARACTERISTIC FTCMCCS_LutElecSpeedRds3C "FTCMCCS_LutElecSpeedRds3C" CURVE 0x80061EBC DATA_RECORD_FLOAT32_IEEE 3.402823466E+038 F_1_p0_4 -3.402823466E+038 3.402823466E+038
 /begin AXIS_DESCR FIX_AXIS NO_INPUT_QUANTITY Id_0x00 3 0 2 MAX_GRAD 100.0 FIX_AXIS_PAR_DIST 0 1 3 /end AXIS_DESCR
/end CHARACTERISTIC
/begin CHARACTERISTIC FTCMCCS_LutInSpeedRpmC "FTCMCCS_LutInSpeedRpmC" CURVE 0x8008EA68 DATA_RECORD_FLOAT32_IEEE 3.402823466E+038 F_1_p0_4 -3.402823466E+038 3.402823466E+038
 /begin AXIS_DESCR FIX_AXIS NO_INPUT_QUANTITY Id_0x00 17 0 16 MAX_GRAD 100.0 FIX_AXIS_PAR_DIST 0 1 17 /end AXIS_DESCR
/end CHARACTERISTIC
/begin CHARACTERISTIC FTCMCCS_LutInUbatC "FTCMCCS_LutInUbatC" CURVE 0x8008EA58 DATA_RECORD_FLOAT32_IEEE 3.402823466E+038 F_1_p0_4 -3.402823466E+038 3.402823466E+038
 /begin AXIS_DESCR FIX_AXIS NO_INPUT_QUANTITY Id_0x00 4 0 3 MAX_GRAD 100.0 FIX_AXIS_PAR_DIST 0 1 4 /end AXIS_DESCR
/end CHARACTERISTIC
/begin CHARACTERISTIC FTCMCCS_LutM0CtrlTrC "FTCMCCS_LutM0CtrlTrC" CURVE 0x80061EB0 DATA_RECORD_FLOAT32_IEEE 999.9999 F_1_p0_53 0.0001 1000
 /begin AXIS_DESCR FIX_AXIS NO_INPUT_QUANTITY Id_0x00 3 0 2 MAX_GRAD 100.0 FIX_AXIS_PAR_DIST 0 1 3 /end AXIS_DESCR
/end CHARACTERISTIC
/begin CHARACTERISTIC FTCMCCS_LutOutM1dCtrlTrGC "FTCMCCS_LutOutM1dCtrlTrGC" MAP 0x80061DA0 DATA_RECORD_FLOAT32_IEEE 3.402823466E+038 F_1_p0_4 -3.402823466E+038 3.402823466E+038
 /begin AXIS_DESCR FIX_AXIS NO_INPUT_QUANTITY Id_0x00 4 0 3 MAX_GRAD 100.0 FIX_AXIS_PAR_DIST 0 1 4 /end AXIS_DESCR
 /begin AXIS_DESCR FIX_AXIS NO_INPUT_QUANTITY Id_0x00 17 0 16 MAX_GRAD 100.0 FIX_AXIS_PAR_DIST 0 1 17 /end AXIS_DESCR
/end CHARACTERISTIC
/begin CHARACTERISTIC FTCMCCS_LutOutM1dCtrlTrMC "FTCMCCS_LutOutM1dCtrlTrMC" MAP 0x80061C90 DATA_RECORD_FLOAT32_IEEE 3.402823466E+038 F_1_p0_4 -3.402823466E+038 3.402823466E+038
 /begin AXIS_DESCR FIX_AXIS NO_INPUT_QUANTITY Id_0x00 4 0 3 MAX_GRAD 100.0 FIX_AXIS_PAR_DIST 0 1 4 /end AXIS_DESCR
 /begin AXIS_DESCR FIX_AXIS NO_INPUT_QUANTITY Id_0x00 17 0 16 MAX_GRAD 100.0 FIX_AXIS_PAR_DIST 0 1 17 /end AXIS_DESCR
/end CHARACTERISTIC
/begin CHARACTERISTIC FTCMCCS_LutOutM1qCtrlTrGC "FTCMCCS_LutOutM1qCtrlTrGC" MAP 0x80061B80 DATA_RECORD_FLOAT32_IEEE 3.402823466E+038 F_1_p0_4 -3.402823466E+038 3.402823466E+038
 /begin AXIS_DESCR FIX_AXIS NO_INPUT_QUANTITY Id_0x00 4 0 3 MAX_GRAD 100.0 FIX_AXIS_PAR_DIST 0 1 4 /end AXIS_DESCR
 /begin AXIS_DESCR FIX_AXIS NO_INPUT_QUANTITY Id_0x00 17 0 16 MAX_GRAD 100.0 FIX_AXIS_PAR_DIST 0 1 17 /end AXIS_DESCR
/end CHARACTERISTIC
/begin CHARACTERISTIC FTCMCCS_LutOutM1qCtrlTrMC "FTCMCCS_LutOutM1qCtrlTrMC" MAP 0x80061A70 DATA_RECORD_FLOAT32_IEEE 3.402823466E+038 F_1_p0_4 -3.402823466E+038 3.402823466E+038
 /begin AXIS_DESCR FIX_AXIS NO_INPUT_QUANTITY Id_0x00 4 0 3 MAX_GRAD 100.0 FIX_AXIS_PAR_DIST 0 1 4 /end AXIS_DESCR
 /begin AXIS_DESCR FIX_AXIS NO_INPUT_QUANTITY Id_0x00 17 0 16 MAX_GRAD 100.0 FIX_AXIS_PAR_DIST 0 1 17 /end AXIS_DESCR
/end CHARACTERISTIC
/begin CHARACTERISTIC FTCMCCS_M1dCtrlTrC "FTCMCCS_M1dCtrlTrC" VALUE 0x80061A6C DATA_RECORD_FLOAT32_IEEE 999.9999 F_1_p0_53 0.0001 1000 /end CHARACTERISTIC
/begin CHARACTERISTIC FTCMCCS_M1qCtrlTrC "FTCMCCS_M1qCtrlTrC" VALUE 0x80061A68 DATA_RECORD_FLOAT32_IEEE 999.9999 F_1_p0_53 0.0001 1000 /end CHARACTERISTIC
/begin CHARACTERISTIC FTCMCCS_PhimC "FTCMCCS_PhimC" VALUE 0x80061A64 DATA_RECORD_FLOAT32_IEEE 3.402823466E+038 F_1_p0_4 -3.402823466E+038 3.402823466E+038 /end CHARACTERISTIC
/begin CHARACTERISTIC FTCMCCS_RsC "FTCMCCS_RsC" VALUE 0x80061A60 DATA_RECORD_FLOAT32_IEEE 3.402823466E+038 F_1_p0_61 -3.402823466E+038 3.402823466E+038 /end CHARACTERISTIC
/begin CHARACTERISTIC FTCMCCS_SampleTimeFactC "FTCMCCS_SampleTimeFactC" VALUE 0x80061A5C DATA_RECORD_FLOAT32_IEEE 3.402823466E+038 F_1_p0_4 -3.402823466E+038 3.402823466E+038 /end CHARACTERISTIC
/begin CHARACTERISTIC FTCMCCS_TransEmfM1dGainC "FTCMCCS_TransEmfM1dGainC" VALUE 0x80061A58 DATA_RECORD_FLOAT32_IEEE 3.402823466E+038 F_1_p0_4 -3.402823466E+038 3.402823466E+038 /end CHARACTERISTIC
/begin CHARACTERISTIC FTCMCCS_TransEmfM1qGainC "FTCMCCS_TransEmfM1qGainC" VALUE 0x80061A54 DATA_RECORD_FLOAT32_IEEE 3.402823466E+038 F_1_p0_4 -3.402823466E+038 3.402823466E+038 /end CHARACTERISTIC
/begin CHARACTERISTIC FTCMCCS_VariableLm1dOnOffC "FTCMCCS_VariableLm1dOnOffC" VALUE 0x80061A50 DATA_RECORD_UBYTE 1 Bool_ON_OFF 0 1 BIT_MASK 0x01 /end CHARACTERISTIC
/begin CHARACTERISTIC FTCMCCS_VariableLm1qOnOffC "FTCMCCS_VariableLm1qOnOffC" VALUE 0x80061A4C DATA_RECORD_UBYTE 1 Bool_ON_OFF 0 1 BIT_MASK 0x01 /end CHARACTERISTIC
/begin CHARACTERISTIC FTCMCCS_VariablePhimOnOffC "FTCMCCS_VariablePhimOnOffC" VALUE 0x80061A48 DATA_RECORD_UBYTE 1 Bool_ON_OFF 0 1 BIT_MASK 0x01 /end CHARACTERISTIC
/begin CHARACTERISTIC FTCMCCS_iM1dTgtFildTrC "FTCMCCS_iM1dTgtFildTrC" VALUE 0x80061A44 DATA_RECORD_FLOAT32_IEEE 999.9999 F_1_p0_53 0.0001 1000 /end CHARACTERISTIC
/begin CHARACTERISTIC FTCMCCS_iM1qTgtFildTrC "FTCMCCS_iM1qTgtFildTrC" VALUE 0x80061A40 DATA_RECORD_FLOAT32_IEEE 999.9999 F_1_p0_53 0.0001 1000 /end CHARACTERISTIC
/begin CHARACTERISTIC FTCMCTC_CoggingCompGainC "FTCMCTC_CoggingCompGainC" VALUE 0x80061F3C DATA_RECORD_FLOAT32_IEEE 3.402823466E+038 F_1_p0_4 -3.402823466E+038 3.402823466E+038 /end CHARACTERISTIC
/begin CHARACTERISTIC FTCMCTC_CoggingCompOnOffC "FTCMCTC_CoggingCompOnOffC" VALUE 0x80061F38 DATA_RECORD_UBYTE 1 Bool_ON_OFF 0 1 BIT_MASK 0x01 /end CHARACTERISTIC
/begin CHARACTERISTIC FTCMCTC_CoggingPhaseRdC "FTCMCTC_CoggingPhaseRdC" VALUE 0x80061F34 DATA_RECORD_FLOAT32_IEEE 3.402823466E+038 F_1_p0_62 -3.402823466E+038 3.402823466E+038 /end CHARACTERISTIC
/begin CHARACTERISTIC FTCMCTC_H3CurrentOnOffC "FTCMCTC_H3CurrentOnOffC" VALUE 0x80061F30 DATA_RECORD_UBYTE 1 Bool_ON_OFF 0 1 BIT_MASK 0x01 /end CHARACTERISTIC
/begin CHARACTERISTIC FTCMCTC_H3CurrentRatioC "FTCMCTC_H3CurrentRatioC" VALUE 0x80061F2C DATA_RECORD_FLOAT32_IEEE 3.402823466E+038 F_1_p0_4 -3.402823466E+038 3.402823466E+038 /end CHARACTERISTIC
/begin CHARACTERISTIC FTCMCTC_LutCoggingCompGainC "FTCMCTC_LutCoggingCompGainC" CURVE 0x80061F20 DATA_RECORD_FLOAT32_IEEE 3.402823466E+038 F_1_p0_4 -3.402823466E+038 3.402823466E+038
 /begin AXIS_DESCR FIX_AXIS NO_INPUT_QUANTITY Id_0x00 3 0 2 MAX_GRAD 100.0 FIX_AXIS_PAR_DIST 0 1 3 /end AXIS_DESCR
/end CHARACTERISTIC
/begin CHARACTERISTIC FTCMCTC_LutElecSpeedRds2C "FTCMCTC_LutElecSpeedRds2C" CURVE 0x80061F14 DATA_RECORD_FLOAT32_IEEE 3.402823466E+038 F_1_p0_4 -3.402823466E+038 3.402823466E+038
 /begin AXIS_DESCR FIX_AXIS NO_INPUT_QUANTITY Id_0x00 3 0 2 MAX_GRAD 100.0 FIX_AXIS_PAR_DIST 0 1 3 /end AXIS_DESCR
/end CHARACTERISTIC
/begin CHARACTERISTIC FTCMCTC_LutElecSpeedRdsC "FTCMCTC_LutElecSpeedRdsC" CURVE 0x80061F08 DATA_RECORD_FLOAT32_IEEE 3.402823466E+038 F_1_p0_4 -3.402823466E+038 3.402823466E+038
 /begin AXIS_DESCR FIX_AXIS NO_INPUT_QUANTITY Id_0x00 3 0 2 MAX_GRAD 100.0 FIX_AXIS_PAR_DIST 0 1 3 /end AXIS_DESCR
/end CHARACTERISTIC
/begin CHARACTERISTIC FTCMCTC_LutH3CompGainC "FTCMCTC_LutH3CompGainC" CURVE 0x80061EFC DATA_RECORD_FLOAT32_IEEE 3.402823466E+038 F_1_p0_4 -3.402823466E+038 3.402823466E+038
 /begin AXIS_DESCR FIX_AXIS NO_INPUT_QUANTITY Id_0x00 3 0 2 MAX_GRAD 100.0 FIX_AXIS_PAR_DIST 0 1 3 /end AXIS_DESCR
/end CHARACTERISTIC
/begin CHARACTERISTIC FTCMCTC_SpyThresholdC "FTCMCTC_SpyThresholdC" VALUE 0x80061EF8 DATA_RECORD_FLOAT32_IEEE 3.402823466E+038 F_1_p0_46 -3.402823466E+038 3.402823466E+038 /end CHARACTERISTIC
/begin CHARACTERISTIC FTCMHIJ_24IdEnableC "FTCMHIJ_24IdEnableC" VALUE 0x800639A8 DATA_RECORD_UBYTE 1 Bool_ON_OFF 0 1 BIT_MASK 0x01 /end CHARACTERISTIC
/begin CHARACTERISTIC FTCMHIJ_24IqEnableC "FTCMHIJ_24IqEnableC" VALUE 0x800639A4 DATA_RECORD_UBYTE 1 Bool_ON_OFF 0 1 BIT_MASK 0x01 /end CHARACTERISTIC
/begin CHARACTERISTIC FTCMHIJ_24thTimesIdC "FTCMHIJ_24thTimesIdC" VALUE 0x800639A0 DATA_RECORD_FLOAT32_IEEE 3.402823466E+038 F_1_p0_4 -3.402823466E+038 3.402823466E+038 /end CHARACTERISTIC
/begin CHARACTERISTIC FTCMHIJ_24thTimesIqC "FTCMHIJ_24thTimesIqC" VALUE 0x8006399C DATA_RECORD_FLOAT32_IEEE 3.402823466E+038 F_1_p0_4 -3.402823466E+038 3.402823466E+038 /end CHARACTERISTIC
/begin CHARACTERISTIC FTCMHIJ_HijCurrentOnOffC "FTCMHIJ_HijCurrentOnOffC" VALUE 0x80063998 DATA_RECORD_UBYTE 1 Bool_ON_OFF 0 1 BIT_MASK 0x01 /end CHARACTERISTIC
/begin CHARACTERISTIC FTCMHIJ_HijMecaSpdRpmMaxC "speed greater than this value ,stop HIJ" VALUE 0x80063994 DATA_RECORD_FLOAT32_IEEE 3.402823466E+038 F_1_p0_4 -3.402823466E+038 3.402823466E+038 /end CHARACTERISTIC
/begin CHARACTERISTIC FTCMHIJ_IdqMaxLmtC "FTCMHIJ_IdqMaxLmtC" VALUE 0x80063990 DATA_RECORD_FLOAT32_IEEE 3.402823466E+038 F_1_p0_4 -3.402823466E+038 3.402823466E+038 /end CHARACTERISTIC
/begin CHARACTERISTIC FTCMHIJ_IdqMinLmtC "FTCMHIJ_IdqMinLmtC" VALUE 0x8006398C DATA_RECORD_FLOAT32_IEEE 3.402823466E+038 F_1_p0_4 -3.402823466E+038 3.402823466E+038 /end CHARACTERISTIC
/begin CHARACTERISTIC FTCMHIJ_LutInSpeed24C "FTCMHIJ_LutInSpeed24C" CURVE 0x8006395C DATA_RECORD_FLOAT32_IEEE 3.402823466E+038 F_1_p0_4 -3.402823466E+038 3.402823466E+038
 /begin AXIS_DESCR FIX_AXIS NO_INPUT_QUANTITY Id_0x00 12 0 11 MAX_GRAD 100.0 FIX_AXIS_PAR_DIST 0 1 12 /end AXIS_DESCR
/end CHARACTERISTIC
/begin CHARACTERISTIC FTCMHIJ_LutInSpeed6dC "FTCMHIJ_LutInSpeed6dC" CURVE 0x8006392C DATA_RECORD_FLOAT32_IEEE 3.402823466E+038 F_1_p0_4 -3.402823466E+038 3.402823466E+038
 /begin AXIS_DESCR FIX_AXIS NO_INPUT_QUANTITY Id_0x00 12 0 11 MAX_GRAD 100.0 FIX_AXIS_PAR_DIST 0 1 12 /end AXIS_DESCR
/end CHARACTERISTIC
/begin CHARACTERISTIC FTCMHIJ_LutInSpeedC "FTCMHIJ_LutInSpeedC" CURVE 0x80063908 DATA_RECORD_FLOAT32_IEEE 3.402823466E+038 F_1_p0_4 -3.402823466E+038 3.402823466E+038
 /begin AXIS_DESCR FIX_AXIS NO_INPUT_QUANTITY Id_0x00 9 0 8 MAX_GRAD 100.0 FIX_AXIS_PAR_DIST 0 1 9 /end AXIS_DESCR
/end CHARACTERISTIC
/begin CHARACTERISTIC FTCMHIJ_LutInSpeedPhaseIdC "FTCMHIJ_LutInSpeedPhaseIdC" CURVE 0x800638CC DATA_RECORD_FLOAT32_IEEE 3.402823466E+038 F_1_p0_4 -3.402823466E+038 3.402823466E+038
 /begin AXIS_DESCR FIX_AXIS NO_INPUT_QUANTITY Id_0x00 15 0 14 MAX_GRAD 100.0 FIX_AXIS_PAR_DIST 0 1 15 /end AXIS_DESCR
/end CHARACTERISTIC
/begin CHARACTERISTIC FTCMHIJ_LutInSpeedPhaseIqC "FTCMHIJ_LutInSpeedPhaseIqC" CURVE 0x80063890 DATA_RECORD_FLOAT32_IEEE 3.402823466E+038 F_1_p0_4 -3.402823466E+038 3.402823466E+038
 /begin AXIS_DESCR FIX_AXIS NO_INPUT_QUANTITY Id_0x00 15 0 14 MAX_GRAD 100.0 FIX_AXIS_PAR_DIST 0 1 15 /end AXIS_DESCR
/end CHARACTERISTIC
/begin CHARACTERISTIC FTCMHIJ_LutInTorque24C "FTCMHIJ_LutInTorque24C" CURVE 0x80063864 DATA_RECORD_FLOAT32_IEEE 3.402823466E+038 F_1_p0_4 -3.402823466E+038 3.402823466E+038
 /begin AXIS_DESCR FIX_AXIS NO_INPUT_QUANTITY Id_0x00 11 0 10 MAX_GRAD 100.0 FIX_AXIS_PAR_DIST 0 1 11 /end AXIS_DESCR
/end CHARACTERISTIC
/begin CHARACTERISTIC FTCMHIJ_LutInTorqueC "FTCMHIJ_LutInTorqueC" CURVE 0x80063838 DATA_RECORD_FLOAT32_IEEE 3.402823466E+038 F_1_p0_4 -3.402823466E+038 3.402823466E+038
 /begin AXIS_DESCR FIX_AXIS NO_INPUT_QUANTITY Id_0x00 11 0 10 MAX_GRAD 100.0 FIX_AXIS_PAR_DIST 0 1 11 /end AXIS_DESCR
/end CHARACTERISTIC
/begin CHARACTERISTIC FTCMHIJ_LutInTorqueGen24C "FTCMHIJ_LutInTorqueGen24C" CURVE 0x80063820 DATA_RECORD_FLOAT32_IEEE 3.402823466E+038 F_1_p0_4 -3.402823466E+038 3.402823466E+038
 /begin AXIS_DESCR FIX_AXIS NO_INPUT_QUANTITY Id_0x00 6 0 5 MAX_GRAD 100.0 FIX_AXIS_PAR_DIST 0 1 6 /end AXIS_DESCR
/end CHARACTERISTIC
/begin CHARACTERISTIC FTCMHIJ_LutInTorqueGenC "FTCMHIJ_LutInTorqueGenC" CURVE 0x80063808 DATA_RECORD_FLOAT32_IEEE 3.402823466E+038 F_1_p0_4 -3.402823466E+038 3.402823466E+038
 /begin AXIS_DESCR FIX_AXIS NO_INPUT_QUANTITY Id_0x00 6 0 5 MAX_GRAD 100.0 FIX_AXIS_PAR_DIST 0 1 6 /end AXIS_DESCR
/end CHARACTERISTIC
/begin CHARACTERISTIC FTCMHIJ_LutOut24thPhaseIdC "FTCMHIJ_LutOut24thPhaseIdC" MAP 0x800635F8 DATA_RECORD_FLOAT32_IEEE 3.402823466E+038 F_1_p0_4 -3.402823466E+038 3.402823466E+038
 /begin AXIS_DESCR FIX_AXIS NO_INPUT_QUANTITY Id_0x00 11 0 10 MAX_GRAD 100.0 FIX_AXIS_PAR_DIST 0 1 11 /end AXIS_DESCR
 /begin AXIS_DESCR FIX_AXIS NO_INPUT_QUANTITY Id_0x00 12 0 11 MAX_GRAD 100.0 FIX_AXIS_PAR_DIST 0 1 12 /end AXIS_DESCR
/end CHARACTERISTIC
/begin CHARACTERISTIC FTCMHIJ_LutOut24thPhaseIdGenC "FTCMHIJ_LutOut24thPhaseIdGenC" MAP 0x800634D8 DATA_RECORD_FLOAT32_IEEE 3.402823466E+038 F_1_p0_4 -3.402823466E+038 3.402823466E+038
 /begin AXIS_DESCR FIX_AXIS NO_INPUT_QUANTITY Id_0x00 6 0 5 MAX_GRAD 100.0 FIX_AXIS_PAR_DIST 0 1 6 /end AXIS_DESCR
 /begin AXIS_DESCR FIX_AXIS NO_INPUT_QUANTITY Id_0x00 12 0 11 MAX_GRAD 100.0 FIX_AXIS_PAR_DIST 0 1 12 /end AXIS_DESCR
/end CHARACTERISTIC
/begin CHARACTERISTIC FTCMHIJ_LutOut24thPhaseIqC "FTCMHIJ_LutOut24thPhaseIqC" MAP 0x800632C8 DATA_RECORD_FLOAT32_IEEE 3.402823466E+038 F_1_p0_4 -3.402823466E+038 3.402823466E+038
 /begin AXIS_DESCR FIX_AXIS NO_INPUT_QUANTITY Id_0x00 11 0 10 MAX_GRAD 100.0 FIX_AXIS_PAR_DIST 0 1 11 /end AXIS_DESCR
 /begin AXIS_DESCR FIX_AXIS NO_INPUT_QUANTITY Id_0x00 12 0 11 MAX_GRAD 100.0 FIX_AXIS_PAR_DIST 0 1 12 /end AXIS_DESCR
/end CHARACTERISTIC
/begin CHARACTERISTIC FTCMHIJ_LutOut24thPhaseIqGenC "FTCMHIJ_LutOut24thPhaseIqGenC" MAP 0x800631A8 DATA_RECORD_FLOAT32_IEEE 3.402823466E+038 F_1_p0_4 -3.402823466E+038 3.402823466E+038
 /begin AXIS_DESCR FIX_AXIS NO_INPUT_QUANTITY Id_0x00 6 0 5 MAX_GRAD 100.0 FIX_AXIS_PAR_DIST 0 1 6 /end AXIS_DESCR
 /begin AXIS_DESCR FIX_AXIS NO_INPUT_QUANTITY Id_0x00 12 0 11 MAX_GRAD 100.0 FIX_AXIS_PAR_DIST 0 1 12 /end AXIS_DESCR
/end CHARACTERISTIC
/begin CHARACTERISTIC FTCMHIJ_LutOutBaseMagnitude12IdC "FTCMHIJ_LutOutBaseMagnitude12IdC" CURVE 0x80063184 DATA_RECORD_FLOAT32_IEEE 3.402823466E+038 F_1_p0_4 -3.402823466E+038 3.402823466E+038
 /begin AXIS_DESCR FIX_AXIS NO_INPUT_QUANTITY Id_0x00 9 0 8 MAX_GRAD 100.0 FIX_AXIS_PAR_DIST 0 1 9 /end AXIS_DESCR
/end CHARACTERISTIC
/begin CHARACTERISTIC FTCMHIJ_LutOutBaseMagnitude12IqC "FTCMHIJ_LutOutBaseMagnitude12IqC" MAP 0x80062FF8 DATA_RECORD_FLOAT32_IEEE 3.402823466E+038 F_1_p0_4 -3.402823466E+038 3.402823466E+038
 /begin AXIS_DESCR FIX_AXIS NO_INPUT_QUANTITY Id_0x00 11 0 10 MAX_GRAD 100.0 FIX_AXIS_PAR_DIST 0 1 11 /end AXIS_DESCR
 /begin AXIS_DESCR FIX_AXIS NO_INPUT_QUANTITY Id_0x00 9 0 8 MAX_GRAD 100.0 FIX_AXIS_PAR_DIST 0 1 9 /end AXIS_DESCR
/end CHARACTERISTIC
/begin CHARACTERISTIC FTCMHIJ_LutOutBaseMagnitude12IqGenC "FTCMHIJ_LutOutBaseMagnitude12IqGenC" MAP 0x80062F20 DATA_RECORD_FLOAT32_IEEE 3.402823466E+038 F_1_p0_4 -3.402823466E+038 3.402823466E+038
 /begin AXIS_DESCR FIX_AXIS NO_INPUT_QUANTITY Id_0x00 6 0 5 MAX_GRAD 100.0 FIX_AXIS_PAR_DIST 0 1 6 /end AXIS_DESCR
 /begin AXIS_DESCR FIX_AXIS NO_INPUT_QUANTITY Id_0x00 9 0 8 MAX_GRAD 100.0 FIX_AXIS_PAR_DIST 0 1 9 /end AXIS_DESCR
/end CHARACTERISTIC
/begin CHARACTERISTIC FTCMHIJ_LutOutBaseMagnitude24IdC "FTCMHIJ_LutOutBaseMagnitude24IdC" MAP 0x80062D10 DATA_RECORD_FLOAT32_IEEE 3.402823466E+038 F_1_p0_4 -3.402823466E+038 3.402823466E+038
 /begin AXIS_DESCR FIX_AXIS NO_INPUT_QUANTITY Id_0x00 11 0 10 MAX_GRAD 100.0 FIX_AXIS_PAR_DIST 0 1 11 /end AXIS_DESCR
 /begin AXIS_DESCR FIX_AXIS NO_INPUT_QUANTITY Id_0x00 12 0 11 MAX_GRAD 100.0 FIX_AXIS_PAR_DIST 0 1 12 /end AXIS_DESCR
/end CHARACTERISTIC
/begin CHARACTERISTIC FTCMHIJ_LutOutBaseMagnitude24IdGenC "FTCMHIJ_LutOutBaseMagnitude24IdGenC" MAP 0x80062BF0 DATA_RECORD_FLOAT32_IEEE 3.402823466E+038 F_1_p0_4 -3.402823466E+038 3.402823466E+038
 /begin AXIS_DESCR FIX_AXIS NO_INPUT_QUANTITY Id_0x00 6 0 5 MAX_GRAD 100.0 FIX_AXIS_PAR_DIST 0 1 6 /end AXIS_DESCR
 /begin AXIS_DESCR FIX_AXIS NO_INPUT_QUANTITY Id_0x00 12 0 11 MAX_GRAD 100.0 FIX_AXIS_PAR_DIST 0 1 12 /end AXIS_DESCR
/end CHARACTERISTIC
/begin CHARACTERISTIC FTCMHIJ_LutOutBaseMagnitude24IqC "FTCMHIJ_LutOutBaseMagnitude24IqC" MAP 0x800629E0 DATA_RECORD_FLOAT32_IEEE 3.402823466E+038 F_1_p0_4 -3.402823466E+038 3.402823466E+038
 /begin AXIS_DESCR FIX_AXIS NO_INPUT_QUANTITY Id_0x00 11 0 10 MAX_GRAD 100.0 FIX_AXIS_PAR_DIST 0 1 11 /end AXIS_DESCR
 /begin AXIS_DESCR FIX_AXIS NO_INPUT_QUANTITY Id_0x00 12 0 11 MAX_GRAD 100.0 FIX_AXIS_PAR_DIST 0 1 12 /end AXIS_DESCR
/end CHARACTERISTIC
/begin CHARACTERISTIC FTCMHIJ_LutOutBaseMagnitude24IqGenC "FTCMHIJ_LutOutBaseMagnitude24IqGenC" MAP 0x800628C0 DATA_RECORD_FLOAT32_IEEE 3.402823466E+038 F_1_p0_4 -3.402823466E+038 3.402823466E+038
 /begin AXIS_DESCR FIX_AXIS NO_INPUT_QUANTITY Id_0x00 6 0 5 MAX_GRAD 100.0 FIX_AXIS_PAR_DIST 0 1 6 /end AXIS_DESCR
 /begin AXIS_DESCR FIX_AXIS NO_INPUT_QUANTITY Id_0x00 12 0 11 MAX_GRAD 100.0 FIX_AXIS_PAR_DIST 0 1 12 /end AXIS_DESCR
/end CHARACTERISTIC
/begin CHARACTERISTIC FTCMHIJ_LutOutBaseMagnitude6IdC "FTCMHIJ_LutOutBaseMagnitude6IdC" MAP 0x800626B0 DATA_RECORD_FLOAT32_IEEE 3.402823466E+038 F_1_p0_4 -3.402823466E+038 3.402823466E+038
 /begin AXIS_DESCR FIX_AXIS NO_INPUT_QUANTITY Id_0x00 11 0 10 MAX_GRAD 100.0 FIX_AXIS_PAR_DIST 0 1 11 /end AXIS_DESCR
 /begin AXIS_DESCR FIX_AXIS NO_INPUT_QUANTITY Id_0x00 12 0 11 MAX_GRAD 100.0 FIX_AXIS_PAR_DIST 0 1 12 /end AXIS_DESCR
/end CHARACTERISTIC
/begin CHARACTERISTIC FTCMHIJ_LutOutBaseMagnitude6IdGenC "FTCMHIJ_LutOutBaseMagnitude6IdGenC" MAP 0x80062590 DATA_RECORD_FLOAT32_IEEE 3.402823466E+038 F_1_p0_4 -3.402823466E+038 3.402823466E+038
 /begin AXIS_DESCR FIX_AXIS NO_INPUT_QUANTITY Id_0x00 6 0 5 MAX_GRAD 100.0 FIX_AXIS_PAR_DIST 0 1 6 /end AXIS_DESCR
 /begin AXIS_DESCR FIX_AXIS NO_INPUT_QUANTITY Id_0x00 12 0 11 MAX_GRAD 100.0 FIX_AXIS_PAR_DIST 0 1 12 /end AXIS_DESCR
/end CHARACTERISTIC
/begin CHARACTERISTIC FTCMHIJ_LutOutBaseMagnitude6IqC "FTCMHIJ_LutOutBaseMagnitude6IqC" CURVE 0x8006256C DATA_RECORD_FLOAT32_IEEE 3.402823466E+038 F_1_p0_4 -3.402823466E+038 3.402823466E+038
 /begin AXIS_DESCR FIX_AXIS NO_INPUT_QUANTITY Id_0x00 9 0 8 MAX_GRAD 100.0 FIX_AXIS_PAR_DIST 0 1 9 /end AXIS_DESCR
/end CHARACTERISTIC
/begin CHARACTERISTIC FTCMHIJ_LutOutSixthPhaseIdC "FTCMHIJ_LutOutSixthPhaseIdC" MAP 0x8006235C DATA_RECORD_FLOAT32_IEEE 3.402823466E+038 F_1_p0_4 -3.402823466E+038 3.402823466E+038
 /begin AXIS_DESCR FIX_AXIS NO_INPUT_QUANTITY Id_0x00 11 0 10 MAX_GRAD 100.0 FIX_AXIS_PAR_DIST 0 1 11 /end AXIS_DESCR
 /begin AXIS_DESCR FIX_AXIS NO_INPUT_QUANTITY Id_0x00 12 0 11 MAX_GRAD 100.0 FIX_AXIS_PAR_DIST 0 1 12 /end AXIS_DESCR
/end CHARACTERISTIC
/begin CHARACTERISTIC FTCMHIJ_LutOutSixthPhaseIdGenC "FTCMHIJ_LutOutSixthPhaseIdGenC" MAP 0x8006223C DATA_RECORD_FLOAT32_IEEE 3.402823466E+038 F_1_p0_4 -3.402823466E+038 3.402823466E+038
 /begin AXIS_DESCR FIX_AXIS NO_INPUT_QUANTITY Id_0x00 6 0 5 MAX_GRAD 100.0 FIX_AXIS_PAR_DIST 0 1 6 /end AXIS_DESCR
 /begin AXIS_DESCR FIX_AXIS NO_INPUT_QUANTITY Id_0x00 12 0 11 MAX_GRAD 100.0 FIX_AXIS_PAR_DIST 0 1 12 /end AXIS_DESCR
/end CHARACTERISTIC
/begin CHARACTERISTIC FTCMHIJ_LutOutSixthPhaseIqC "FTCMHIJ_LutOutSixthPhaseIqC" CURVE 0x80062200 DATA_RECORD_FLOAT32_IEEE 3.402823466E+038 F_1_p0_4 -3.402823466E+038 3.402823466E+038
 /begin AXIS_DESCR FIX_AXIS NO_INPUT_QUANTITY Id_0x00 15 0 14 MAX_GRAD 100.0 FIX_AXIS_PAR_DIST 0 1 15 /end AXIS_DESCR
/end CHARACTERISTIC
/begin CHARACTERISTIC FTCMHIJ_LutOutTwelfthPhaseIdC "FTCMHIJ_LutOutTwelfthPhaseIdC" CURVE 0x800621C4 DATA_RECORD_FLOAT32_IEEE 3.402823466E+038 F_1_p0_4 -3.402823466E+038 3.402823466E+038
 /begin AXIS_DESCR FIX_AXIS NO_INPUT_QUANTITY Id_0x00 15 0 14 MAX_GRAD 100.0 FIX_AXIS_PAR_DIST 0 1 15 /end AXIS_DESCR
/end CHARACTERISTIC
/begin CHARACTERISTIC FTCMHIJ_LutOutTwelfthPhaseIqC "FTCMHIJ_LutOutTwelfthPhaseIqC" MAP 0x80062038 DATA_RECORD_FLOAT32_IEEE 3.402823466E+038 F_1_p0_4 -3.402823466E+038 3.402823466E+038
 /begin AXIS_DESCR FIX_AXIS NO_INPUT_QUANTITY Id_0x00 11 0 10 MAX_GRAD 100.0 FIX_AXIS_PAR_DIST 0 1 11 /end AXIS_DESCR
 /begin AXIS_DESCR FIX_AXIS NO_INPUT_QUANTITY Id_0x00 9 0 8 MAX_GRAD 100.0 FIX_AXIS_PAR_DIST 0 1 9 /end AXIS_DESCR
/end CHARACTERISTIC
/begin CHARACTERISTIC FTCMHIJ_LutOutTwelfthPhaseIqGenC "FTCMHIJ_LutOutTwelfthPhaseIqGenC" MAP 0x80061F60 DATA_RECORD_FLOAT32_IEEE 3.402823466E+038 F_1_p0_4 -3.402823466E+038 3.402823466E+038
 /begin AXIS_DESCR FIX_AXIS NO_INPUT_QUANTITY Id_0x00 6 0 5 MAX_GRAD 100.0 FIX_AXIS_PAR_DIST 0 1 6 /end AXIS_DESCR
 /begin AXIS_DESCR FIX_AXIS NO_INPUT_QUANTITY Id_0x00 9 0 8 MAX_GRAD 100.0 FIX_AXIS_PAR_DIST 0 1 9 /end AXIS_DESCR
/end CHARACTERISTIC
/begin CHARACTERISTIC FTCMHIJ_SixIdEnableC "FTCMHIJ_SixIdEnableC" VALUE 0x80061F5C DATA_RECORD_UBYTE 1 Bool_ON_OFF 0 1 BIT_MASK 0x01 /end CHARACTERISTIC
/begin CHARACTERISTIC FTCMHIJ_SixIqEnableC "FTCMHIJ_SixIqEnableC" VALUE 0x80061F58 DATA_RECORD_UBYTE 1 Bool_ON_OFF 0 1 BIT_MASK 0x01 /end CHARACTERISTIC
/begin CHARACTERISTIC FTCMHIJ_SixTimesIdC "FTCMHIJ_SixTimesIdC" VALUE 0x80061F54 DATA_RECORD_FLOAT32_IEEE 3.402823466E+038 F_1_p0_4 -3.402823466E+038 3.402823466E+038 /end CHARACTERISTIC
/begin CHARACTERISTIC FTCMHIJ_SixTimesIqC "FTCMHIJ_SixTimesIqC" VALUE 0x80061F50 DATA_RECORD_FLOAT32_IEEE 3.402823466E+038 F_1_p0_4 -3.402823466E+038 3.402823466E+038 /end CHARACTERISTIC
/begin CHARACTERISTIC FTCMHIJ_TwelveIdEnableC "FTCMHIJ_TwelveIdEnableC" VALUE 0x80061F4C DATA_RECORD_UBYTE 1 Bool_ON_OFF 0 1 BIT_MASK 0x01 /end CHARACTERISTIC
/begin CHARACTERISTIC FTCMHIJ_TwelveIqEnableC "FTCMHIJ_TwelveIqEnableC" VALUE 0x80061F48 DATA_RECORD_UBYTE 1 Bool_ON_OFF 0 1 BIT_MASK 0x01 /end CHARACTERISTIC
/begin CHARACTERISTIC FTCMHIJ_TwelveTimesIdC "FTCMHIJ_TwelveTimesIdC" VALUE 0x80061F44 DATA_RECORD_FLOAT32_IEEE 3.402823466E+038 F_1_p0_4 -3.402823466E+038 3.402823466E+038 /end CHARACTERISTIC
/begin CHARACTERISTIC FTCMHIJ_TwelveTimesIqC "FTCMHIJ_TwelveTimesIqC" VALUE 0x80061F40 DATA_RECORD_FLOAT32_IEEE 3.402823466E+038 F_1_p0_4 -3.402823466E+038 3.402823466E+038 /end CHARACTERISTIC
/begin CHARACTERISTIC FTCMRPC_ConcordiaTrans33C "concordia transformation matrix" MAP 0x800639AC DATA_RECORD_FLOAT32_IEEE 3.402823466E+038 F_1_p0_55 -3.402823466E+038 3.402823466E+038
 /begin AXIS_DESCR FIX_AXIS NO_INPUT_QUANTITY Id_0x00 3 0 2 MAX_GRAD 100.0 FIX_AXIS_PAR_DIST 0 1 3 /end AXIS_DESCR
 /begin AXIS_DESCR FIX_AXIS NO_INPUT_QUANTITY Id_0x00 3 0 2 MAX_GRAD 100.0 FIX_AXIS_PAR_DIST 0 1 3 /end AXIS_DESCR
/end CHARACTERISTIC
/begin CHARACTERISTIC FTCMSCS_CtrlSatToC "FTCMSCS_CtrlSatToC" VALUE 0x800639F0 DATA_RECORD_FLOAT32_IEEE 3.402823466E+038 F_1_p0_66 -3.402823466E+038 3.402823466E+038 /end CHARACTERISTIC
/begin CHARACTERISTIC FTCMSCS_CtrlTrC "FTCMSCS_CtrlTrC" VALUE 0x800639EC DATA_RECORD_FLOAT32_IEEE 3.402823466E+038 F_1_p0_4 -3.402823466E+038 3.402823466E+038 /end CHARACTERISTIC
/begin CHARACTERISTIC FTCMSCS_InitalValueEnC "FTCMSCS_InitalValueEnC" VALUE 0x800639E8 DATA_RECORD_UBYTE 1 Bool_ON_OFF 0 1 BIT_MASK 0x01 /end CHARACTERISTIC
/begin CHARACTERISTIC FTCMSCS_SpdAccPerMsThrC "FTCMSCS_SpdAccPerMsThrC" VALUE 0x800639E4 DATA_RECORD_FLOAT32_IEEE 3.402823466E+038 F_1_p0_52 -3.402823466E+038 3.402823466E+038 /end CHARACTERISTIC
/begin CHARACTERISTIC FTCMSCS_SpdOvershootFaultC "FTCMSCS_SpdOvershootFaultC" VALUE 0x800639E0 DATA_RECORD_FLOAT32_IEEE 3.402823466E+038 F_1_p0_4 -3.402823466E+038 3.402823466E+038 /end CHARACTERISTIC
/begin CHARACTERISTIC FTCMSCS_ZeroSpdThrC "FTCMSCS_ZeroSpdThrC" VALUE 0x800639DC DATA_RECORD_FLOAT32_IEEE 3.402823466E+038 F_1_p0_52 -3.402823466E+038 3.402823466E+038 /end CHARACTERISTIC
/begin CHARACTERISTIC FTCMSCS_ZeroSpdTimoutC "FTCMSCS_ZeroSpdTimoutC" VALUE 0x800639D8 DATA_RECORD_FLOAT32_IEEE 3.402823466E+038 F_1_p0_66 -3.402823466E+038 3.402823466E+038 /end CHARACTERISTIC
/begin CHARACTERISTIC FTCMSCS_fC "FTCMSCS_fC" VALUE 0x800639D4 DATA_RECORD_FLOAT32_IEEE 3.402823466E+038 F_1_p0_4 -3.402823466E+038 3.402823466E+038 /end CHARACTERISTIC
/begin CHARACTERISTIC FTCMSCS_jC "FTCMSCS_jC" VALUE 0x800639D0 DATA_RECORD_FLOAT32_IEEE 3.402823466E+038 F_1_p0_4 -3.402823466E+038 3.402823466E+038 /end CHARACTERISTIC
/begin CHARACTERISTIC FTCMSTC_AccelNegRpmBySecondC "target max acceleration toward negative infinity" VALUE 0x800639F8 DATA_RECORD_FLOAT32_IEEE 3.402823466E+038 F_1_p0_67 -3.402823466E+038 3.402823466E+038 /end CHARACTERISTIC
/begin CHARACTERISTIC FTCMSTC_AccelPosRpmBySecondC "target max acceleration toward positive infinity" VALUE 0x800639F4 DATA_RECORD_FLOAT32_IEEE 3.402823466E+038 F_1_p0_67 -3.402823466E+038 3.402823466E+038 /end CHARACTERISTIC
/begin CHARACTERISTIC FTCMTCS_AccelPosRpmBySecondC "FTCMTCS_AccelPosRpmBySecondC" VALUE 0x80064260 DATA_RECORD_FLOAT32_IEEE 3.402823466E+038 F_1_p0_4 -3.402823466E+038 3.402823466E+038 /end CHARACTERISTIC
/begin CHARACTERISTIC FTCMTCS_AntiSlideEnaCountMaxC "FTCMTCS_AntiSlideEnaCountMaxC" VALUE 0x8006425C DATA_RECORD_SLONG 4294967295 F_1_p0_4 -2147483648 2147483647 /end CHARACTERISTIC
/begin CHARACTERISTIC FTCMTCS_AntiSlideEnableC "FTCMTCS_AntiSlideEnableC" VALUE 0x80064258 DATA_RECORD_UBYTE 1 Bool_ON_OFF 0 1 BIT_MASK 0x01 /end CHARACTERISTIC
/begin CHARACTERISTIC FTCMTCS_AntiSlideTorqueThrC "FTCMTCS_AntiSlideTorqueThrC" VALUE 0x80064254 DATA_RECORD_FLOAT32_IEEE 255 F_1_p0_4 0 255 /end CHARACTERISTIC
/begin CHARACTERISTIC FTCMTCS_BenchElecPowerMaxC "FTCMTCS_BenchElecPowerMaxC" VALUE 0x80064250 DATA_RECORD_FLOAT32_IEEE 3.402823466E+038 F_1_p0_69 -3.402823466E+038 3.402823466E+038 /end CHARACTERISTIC
/begin CHARACTERISTIC FTCMTCS_BenchElecTorqueMaxC "FTCMTCS_BenchElecTorqueMaxC" VALUE 0x8006424C DATA_RECORD_FLOAT32_IEEE 3.402823466E+038 F_1_p0_56 -3.402823466E+038 3.402823466E+038 /end CHARACTERISTIC
/begin CHARACTERISTIC FTCMTCS_CutOffFrequencySpdRpmC "FTCMTCS_CutOffFrequencySpdRpmC" VALUE 0x80064248 DATA_RECORD_FLOAT32_IEEE 3.402823466E+038 F_1_p0_4 -3.402823466E+038 3.402823466E+038 /end CHARACTERISTIC
/begin CHARACTERISTIC FTCMTCS_DivideTorqMinC "FTCMTCS_DivideTorqMinC" VALUE 0x80064244 DATA_RECORD_FLOAT32_IEEE 3.402823466E+038 F_1_p0_4 -3.402823466E+038 3.402823466E+038 /end CHARACTERISTIC
/begin CHARACTERISTIC FTCMTCS_EntrySlideCountMaxC "FTCMTCS_EntrySlideCountMaxC" VALUE 0x80064240 DATA_RECORD_SLONG 4294967295 F_1_p0_4 -2147483648 2147483647 /end CHARACTERISTIC
/begin CHARACTERISTIC FTCMTCS_ExtTorqueMaxMinC "FTCMTCS_ExtTorqueMaxMinC" CURVE 0x80064238 DATA_RECORD_FLOAT32_IEEE 3.402823466E+038 F_1_p0_56 -3.402823466E+038 3.402823466E+038
 /begin AXIS_DESCR FIX_AXIS NO_INPUT_QUANTITY Id_0x00 2 0 1 MAX_GRAD 100.0 FIX_AXIS_PAR_DIST 0 1 2 /end AXIS_DESCR
/end CHARACTERISTIC
/begin CHARACTERISTIC FTCMTCS_FluxControllerGainC "FTCMTCS_FluxControllerGainC" VALUE 0x80064234 DATA_RECORD_FLOAT32_IEEE 3.402823466E+038 F_1_p0_4 -3.402823466E+038 3.402823466E+038 /end CHARACTERISTIC
/begin CHARACTERISTIC FTCMTCS_FluxControllerGainKiC "FTCMTCS_FluxControllerGainKiC" VALUE 0x80064230 DATA_RECORD_FLOAT32_IEEE 3.402823466E+038 F_1_p0_4 -3.402823466E+038 3.402823466E+038 /end CHARACTERISTIC
/begin CHARACTERISTIC FTCMTCS_FluxControllerGainKpC "FTCMTCS_FluxControllerGainKpC" VALUE 0x8006422C DATA_RECORD_FLOAT32_IEEE 3.402823466E+038 F_1_p0_4 -3.402823466E+038 3.402823466E+038 /end CHARACTERISTIC
/begin CHARACTERISTIC FTCMTCS_FluxCtrPiEnableC "FTCMTCS_FluxCtrPiEnableC" VALUE 0x80064228 DATA_RECORD_UBYTE 1 Bool_ON_OFF 0 1 BIT_MASK 0x01 /end CHARACTERISTIC
/begin CHARACTERISTIC FTCMTCS_GainPhaseVoltagePeakC "FTCMTCS_GainPhaseVoltagePeakC" VALUE 0x80064224 DATA_RECORD_FLOAT32_IEEE 3.402823466E+038 F_1_p0_4 -3.402823466E+038 3.402823466E+038 /end CHARACTERISTIC
/begin CHARACTERISTIC FTCMTCS_GenTableTorqueThrdC "FTCMTCS_GenTableTorqueThrdC" VALUE 0x80064220 DATA_RECORD_FLOAT32_IEEE 3.402823466E+038 F_1_p0_4 -3.402823466E+038 3.402823466E+038 /end CHARACTERISTIC
/begin CHARACTERISTIC FTCMTCS_IdModeOnOffC "FTCMTCS_IdModeOnOffC" VALUE 0x8006421C DATA_RECORD_UBYTE 1 Bool_ON_OFF 0 1 BIT_MASK 0x01 /end CHARACTERISTIC
/begin CHARACTERISTIC FTCMTCS_IdentificationAngleDegC "FTCMTCS_IdentificationAngleDegC" VALUE 0x80064218 DATA_RECORD_FLOAT32_IEEE 3.402823466E+038 F_1_p0_4 -3.402823466E+038 3.402823466E+038 /end CHARACTERISTIC
/begin CHARACTERISTIC FTCMTCS_IdentificationIsTgtC "FTCMTCS_IdentificationIsTgtC" VALUE 0x80064214 DATA_RECORD_FLOAT32_IEEE 3.402823466E+038 F_1_p0_46 -3.402823466E+038 3.402823466E+038 /end CHARACTERISTIC
/begin CHARACTERISTIC FTCMTCS_InitTorqueMaxMinC "FTCMTCS_InitTorqueMaxMinC" CURVE 0x8006420C DATA_RECORD_FLOAT32_IEEE 3.402823466E+038 F_1_p0_56 -3.402823466E+038 3.402823466E+038
 /begin AXIS_DESCR FIX_AXIS NO_INPUT_QUANTITY Id_0x00 2 0 1 MAX_GRAD 100.0 FIX_AXIS_PAR_DIST 0 1 2 /end AXIS_DESCR
/end CHARACTERISTIC
/begin CHARACTERISTIC FTCMTCS_Initi0dqTgt3C "FTCMTCS_Initi0dqTgt3C" CURVE 0x80064200 DATA_RECORD_FLOAT32_IEEE 3.402823466E+038 F_1_p0_46 -3.402823466E+038 3.402823466E+038
 /begin AXIS_DESCR FIX_AXIS NO_INPUT_QUANTITY Id_0x00 3 0 2 MAX_GRAD 100.0 FIX_AXIS_PAR_DIST 0 1 3 /end AXIS_DESCR
/end CHARACTERISTIC
/begin CHARACTERISTIC FTCMTCS_KilLmtC "FTCMTCS_KilLmtC" VALUE 0x800641FC DATA_RECORD_FLOAT32_IEEE 3.402823466E+038 F_1_p0_4 -3.402823466E+038 3.402823466E+038 /end CHARACTERISTIC
/begin CHARACTERISTIC FTCMTCS_LutCutOffFreqSlideC "FTCMTCS_LutCutOffFreqSlideC" CURVE 0x800641F4 DATA_RECORD_FLOAT32_IEEE 3.402823466E+038 F_1_p0_4 -3.402823466E+038 3.402823466E+038
 /begin AXIS_DESCR FIX_AXIS NO_INPUT_QUANTITY Id_0x00 2 0 1 MAX_GRAD 100.0 FIX_AXIS_PAR_DIST 0 1 2 /end AXIS_DESCR
/end CHARACTERISTIC
/begin CHARACTERISTIC FTCMTCS_LutInAddSpeedRpmC "FTCMTCS_LutInAddSpeedRpmC" CURVE 0x800641C4 DATA_RECORD_FLOAT32_IEEE 3.402823466E+038 F_1_p0_4 -3.402823466E+038 3.402823466E+038
 /begin AXIS_DESCR FIX_AXIS NO_INPUT_QUANTITY Id_0x00 12 0 11 MAX_GRAD 100.0 FIX_AXIS_PAR_DIST 0 1 12 /end AXIS_DESCR
/end CHARACTERISTIC
/begin CHARACTERISTIC FTCMTCS_LutInAddUbatC "FTCMTCS_LutInAddUbatC" CURVE 0x800641B4 DATA_RECORD_FLOAT32_IEEE 3.402823466E+038 F_1_p0_38 -3.402823466E+038 3.402823466E+038
 /begin AXIS_DESCR FIX_AXIS NO_INPUT_QUANTITY Id_0x00 4 0 3 MAX_GRAD 100.0 FIX_AXIS_PAR_DIST 0 1 4 /end AXIS_DESCR
/end CHARACTERISTIC
/begin CHARACTERISTIC FTCMTCS_LutInMecaSpeedRpmC "FTCMTCS_LutInMecaSpeedRpmC" CURVE 0x80064134 DATA_RECORD_FLOAT32_IEEE 3.402823466E+038 F_1_p0_52 -3.402823466E+038 3.402823466E+038
 /begin AXIS_DESCR FIX_AXIS NO_INPUT_QUANTITY Id_0x00 32 0 31 MAX_GRAD 100.0 FIX_AXIS_PAR_DIST 0 1 32 /end AXIS_DESCR
/end CHARACTERISTIC
/begin CHARACTERISTIC FTCMTCS_LutInSpeedRpmC "FTCMTCS_LutInSpeedRpmC" CURVE 0x8008F284 DATA_RECORD_FLOAT32_IEEE 3.402823466E+038 F_1_p0_4 -3.402823466E+038 3.402823466E+038
 /begin AXIS_DESCR FIX_AXIS NO_INPUT_QUANTITY Id_0x00 11 0 10 MAX_GRAD 100.0 FIX_AXIS_PAR_DIST 0 1 11 /end AXIS_DESCR
/end CHARACTERISTIC
/begin CHARACTERISTIC FTCMTCS_LutInTorqueTgtC "FTCMTCS_LutInTorqueTgtC" CURVE 0x8008F0C0 DATA_RECORD_FLOAT32_IEEE 3.402823466E+038 F_1_p0_56 -3.402823466E+038 3.402823466E+038
 /begin AXIS_DESCR FIX_AXIS NO_INPUT_QUANTITY Id_0x00 113 0 112 MAX_GRAD 100.0 FIX_AXIS_PAR_DIST 0 1 113 /end AXIS_DESCR
/end CHARACTERISTIC
/begin CHARACTERISTIC FTCMTCS_LutInUbatC "FTCMTCS_LutInUbatC" CURVE 0x8008F0AC DATA_RECORD_FLOAT32_IEEE 3.402823466E+038 F_1_p0_4 -3.402823466E+038 3.402823466E+038
 /begin AXIS_DESCR FIX_AXIS NO_INPUT_QUANTITY Id_0x00 5 0 4 MAX_GRAD 100.0 FIX_AXIS_PAR_DIST 0 1 5 /end AXIS_DESCR
/end CHARACTERISTIC
/begin CHARACTERISTIC FTCMTCS_LutInUbatHVC "FTCMTCS_LutInUbatHVC" CURVE 0x8006411C DATA_RECORD_FLOAT32_IEEE 3.402823466E+038 F_1_p0_38 -3.402823466E+038 3.402823466E+038
 /begin AXIS_DESCR FIX_AXIS NO_INPUT_QUANTITY Id_0x00 6 0 5 MAX_GRAD 100.0 FIX_AXIS_PAR_DIST 0 1 6 /end AXIS_DESCR
/end CHARACTERISTIC
/begin CHARACTERISTIC FTCMTCS_LutOutAddElecTorqPoitC "FTCMTCS_LutOutAddElecTorqPoitC" MAP 0x8006405C DATA_RECORD_FLOAT32_IEEE 3.402823466E+038 F_1_p0_56 -3.402823466E+038 3.402823466E+038
 /begin AXIS_DESCR FIX_AXIS NO_INPUT_QUANTITY Id_0x00 4 0 3 MAX_GRAD 100.0 FIX_AXIS_PAR_DIST 0 1 4 /end AXIS_DESCR
 /begin AXIS_DESCR FIX_AXIS NO_INPUT_QUANTITY Id_0x00 12 0 11 MAX_GRAD 100.0 FIX_AXIS_PAR_DIST 0 1 12 /end AXIS_DESCR
/end CHARACTERISTIC
/begin CHARACTERISTIC FTCMTCS_LutOutIdAdd0C "FTCMTCS_LutOutIdAdd0C" MAP 0x80063F9C DATA_RECORD_FLOAT32_IEEE 3.402823466E+038 F_1_p0_46 -3.402823466E+038 3.402823466E+038
 /begin AXIS_DESCR FIX_AXIS NO_INPUT_QUANTITY Id_0x00 4 0 3 MAX_GRAD 100.0 FIX_AXIS_PAR_DIST 0 1 4 /end AXIS_DESCR
 /begin AXIS_DESCR FIX_AXIS NO_INPUT_QUANTITY Id_0x00 12 0 11 MAX_GRAD 100.0 FIX_AXIS_PAR_DIST 0 1 12 /end AXIS_DESCR
/end CHARACTERISTIC
/begin CHARACTERISTIC FTCMTCS_LutOutIdAdd0MotC "FTCMTCS_LutOutIdAdd0MotC" MAP 0x80063EDC DATA_RECORD_FLOAT32_IEEE 3.402823466E+038 F_1_p0_46 -3.402823466E+038 3.402823466E+038
 /begin AXIS_DESCR FIX_AXIS NO_INPUT_QUANTITY Id_0x00 4 0 3 MAX_GRAD 100.0 FIX_AXIS_PAR_DIST 0 1 4 /end AXIS_DESCR
 /begin AXIS_DESCR FIX_AXIS NO_INPUT_QUANTITY Id_0x00 12 0 11 MAX_GRAD 100.0 FIX_AXIS_PAR_DIST 0 1 12 /end AXIS_DESCR
/end CHARACTERISTIC
/begin CHARACTERISTIC FTCMTCS_LutOutIdAddGenC "FTCMTCS_LutOutIdAddGenC" MAP 0x80063E1C DATA_RECORD_FLOAT32_IEEE 3.402823466E+038 F_1_p0_46 -3.402823466E+038 3.402823466E+038
 /begin AXIS_DESCR FIX_AXIS NO_INPUT_QUANTITY Id_0x00 4 0 3 MAX_GRAD 100.0 FIX_AXIS_PAR_DIST 0 1 4 /end AXIS_DESCR
 /begin AXIS_DESCR FIX_AXIS NO_INPUT_QUANTITY Id_0x00 12 0 11 MAX_GRAD 100.0 FIX_AXIS_PAR_DIST 0 1 12 /end AXIS_DESCR
/end CHARACTERISTIC
/begin CHARACTERISTIC FTCMTCS_LutOutIdAddMotC "FTCMTCS_LutOutIdAddMotC" MAP 0x80063D5C DATA_RECORD_FLOAT32_IEEE 3.402823466E+038 F_1_p0_46 -3.402823466E+038 3.402823466E+038
 /begin AXIS_DESCR FIX_AXIS NO_INPUT_QUANTITY Id_0x00 4 0 3 MAX_GRAD 100.0 FIX_AXIS_PAR_DIST 0 1 4 /end AXIS_DESCR
 /begin AXIS_DESCR FIX_AXIS NO_INPUT_QUANTITY Id_0x00 12 0 11 MAX_GRAD 100.0 FIX_AXIS_PAR_DIST 0 1 12 /end AXIS_DESCR
/end CHARACTERISTIC
/begin CHARACTERISTIC FTCMTCS_LutOutIqAddGenC "FTCMTCS_LutOutIqAddGenC" MAP 0x80063C9C DATA_RECORD_FLOAT32_IEEE 3.402823466E+038 F_1_p0_46 -3.402823466E+038 3.402823466E+038
 /begin AXIS_DESCR FIX_AXIS NO_INPUT_QUANTITY Id_0x00 4 0 3 MAX_GRAD 100.0 FIX_AXIS_PAR_DIST 0 1 4 /end AXIS_DESCR
 /begin AXIS_DESCR FIX_AXIS NO_INPUT_QUANTITY Id_0x00 12 0 11 MAX_GRAD 100.0 FIX_AXIS_PAR_DIST 0 1 12 /end AXIS_DESCR
/end CHARACTERISTIC
/begin CHARACTERISTIC FTCMTCS_LutOutIqAddMotC "FTCMTCS_LutOutIqAddMotC" MAP 0x80063BDC DATA_RECORD_FLOAT32_IEEE 3.402823466E+038 F_1_p0_46 -3.402823466E+038 3.402823466E+038
 /begin AXIS_DESCR FIX_AXIS NO_INPUT_QUANTITY Id_0x00 4 0 3 MAX_GRAD 100.0 FIX_AXIS_PAR_DIST 0 1 4 /end AXIS_DESCR
 /begin AXIS_DESCR FIX_AXIS NO_INPUT_QUANTITY Id_0x00 12 0 11 MAX_GRAD 100.0 FIX_AXIS_PAR_DIST 0 1 12 /end AXIS_DESCR
/end CHARACTERISTIC
/begin CHARACTERISTIC FTCMTCS_LutOutTorqueMaxC "FTCMTCS_LutOutTorqueMaxC" MAP 0x8008EDAC DATA_RECORD_FLOAT32_IEEE 3.402823466E+038 F_1_p0_56 -3.402823466E+038 3.402823466E+038
 /begin AXIS_DESCR FIX_AXIS NO_INPUT_QUANTITY Id_0x00 6 0 5 MAX_GRAD 100.0 FIX_AXIS_PAR_DIST 0 1 6 /end AXIS_DESCR
 /begin AXIS_DESCR FIX_AXIS NO_INPUT_QUANTITY Id_0x00 32 0 31 MAX_GRAD 100.0 FIX_AXIS_PAR_DIST 0 1 32 /end AXIS_DESCR
/end CHARACTERISTIC
/begin CHARACTERISTIC FTCMTCS_LutOutTorqueMinC "FTCMTCS_LutOutTorqueMinC" MAP 0x8008EAAC DATA_RECORD_FLOAT32_IEEE 3.402823466E+038 F_1_p0_56 -3.402823466E+038 3.402823466E+038
 /begin AXIS_DESCR FIX_AXIS NO_INPUT_QUANTITY Id_0x00 6 0 5 MAX_GRAD 100.0 FIX_AXIS_PAR_DIST 0 1 6 /end AXIS_DESCR
 /begin AXIS_DESCR FIX_AXIS NO_INPUT_QUANTITY Id_0x00 32 0 31 MAX_GRAD 100.0 FIX_AXIS_PAR_DIST 0 1 32 /end AXIS_DESCR
/end CHARACTERISTIC
/begin CHARACTERISTIC FTCMTCS_deg2radC "FTCMTCS_deg2radC" VALUE 0x80063A00 DATA_RECORD_FLOAT32_IEEE 3.402823466E+038 F_1_p0_4 -3.402823466E+038 3.402823466E+038 /end CHARACTERISTIC
/begin CHARACTERISTIC FTCMTCS_iqCorEnaC "FTCMTCS_iqCorEnaC" VALUE 0x800639FC DATA_RECORD_UBYTE 1 Bool_ON_OFF 0 1 BIT_MASK 0x01 /end CHARACTERISTIC
/begin MEASUREMENT FTASDPM_DrtGainMin "FTASDPM_DrtGainMin" FLOAT32_IEEE F_1_p0_55 1 2 0 1 ECU_ADDRESS 0x70003EE8 /end MEASUREMENT
/begin MEASUREMENT FTASDPM_MaxMinI0dqDrtVect "FTASDPM_MaxMinI0dqDrtVect" FLOAT32_IEEE F_1_p0_46 1 2 -1200 1200 MATRIX_DIM 1 6 1 ECU_ADDRESS 0x70003ED0 /end MEASUREMENT
/begin MEASUREMENT FTASDPM_MaxMinI0dqDrtVect[0] "FTASDPM_MaxMinI0dqDrtVect[0]" FLOAT32_IEEE F_1_p0_46 1 2 -1200 1200 ECU_ADDRESS 0x70003ED0 /end MEASUREMENT
/begin MEASUREMENT FTASDPM_MaxMinI0dqDrtVect[1] "FTASDPM_MaxMinI0dqDrtVect[1]" FLOAT32_IEEE F_1_p0_46 1 2 -1200 1200 ECU_ADDRESS 0x70003ED4 /end MEASUREMENT
/begin MEASUREMENT FTASDPM_MaxMinI0dqDrtVect[2] "FTASDPM_MaxMinI0dqDrtVect[2]" FLOAT32_IEEE F_1_p0_46 1 2 -1200 1200 ECU_ADDRESS 0x70003ED8 /end MEASUREMENT
/begin MEASUREMENT FTASDPM_MaxMinI0dqDrtVect[3] "FTASDPM_MaxMinI0dqDrtVect[3]" FLOAT32_IEEE F_1_p0_46 1 2 -1200 1200 ECU_ADDRESS 0x70003EDC /end MEASUREMENT
/begin MEASUREMENT FTASDPM_MaxMinI0dqDrtVect[4] "FTASDPM_MaxMinI0dqDrtVect[4]" FLOAT32_IEEE F_1_p0_46 1 2 -1200 1200 ECU_ADDRESS 0x70003EE0 /end MEASUREMENT
/begin MEASUREMENT FTASDPM_MaxMinI0dqDrtVect[5] "FTASDPM_MaxMinI0dqDrtVect[5]" FLOAT32_IEEE F_1_p0_46 1 2 -1200 1200 ECU_ADDRESS 0x70003EE4 /end MEASUREMENT
/begin MEASUREMENT FTASDPM_MaxMinSpdDrtVect "FTASDPM_MaxMinSpdDrtVect" FLOAT32_IEEE F_1_p0_52 1 2 -25000 25000 MATRIX_DIM 1 2 1 ECU_ADDRESS 0x70003EC8 /end MEASUREMENT
/begin MEASUREMENT FTASDPM_MaxMinSpdDrtVect[0] "FTASDPM_MaxMinSpdDrtVect[0]" FLOAT32_IEEE F_1_p0_52 1 2 -25000 25000 ECU_ADDRESS 0x70003EC8 /end MEASUREMENT
/begin MEASUREMENT FTASDPM_MaxMinSpdDrtVect[1] "FTASDPM_MaxMinSpdDrtVect[1]" FLOAT32_IEEE F_1_p0_52 1 2 -25000 25000 ECU_ADDRESS 0x70003ECC /end MEASUREMENT
/begin MEASUREMENT FTASDPM_MaxMinTorqueDrtVect "FTASDPM_MaxMinTorqueDrtVect" FLOAT32_IEEE F_1_p0_56 1 2 -500 500 MATRIX_DIM 1 2 1 ECU_ADDRESS 0x70003EC0 /end MEASUREMENT
/begin MEASUREMENT FTASDPM_MaxMinTorqueDrtVect[0] "FTASDPM_MaxMinTorqueDrtVect[0]" FLOAT32_IEEE F_1_p0_56 1 2 -500 500 ECU_ADDRESS 0x70003EC0 /end MEASUREMENT
/begin MEASUREMENT FTASDPM_MaxMinTorqueDrtVect[1] "FTASDPM_MaxMinTorqueDrtVect[1]" FLOAT32_IEEE F_1_p0_56 1 2 -500 500 ECU_ADDRESS 0x70003EC4 /end MEASUREMENT
/begin MEASUREMENT FTASDPM_MaxTorqueDerating "FTASDPM_MaxTorqueDerating" FLOAT32_IEEE F_1_p0_49 1 2 -3.402823466E+038 3.402823466E+038 ECU_ADDRESS 0x70003EBC /end MEASUREMENT
/begin MEASUREMENT FTASDPM_MinTorqueDerating "FTASDPM_MinTorqueDerating" FLOAT32_IEEE F_1_p0_49 1 2 -3.402823466E+038 3.402823466E+038 ECU_ADDRESS 0x70003EB8 /end MEASUREMENT
/begin MEASUREMENT FTASETP_EstPmDeratingAct "FTASETP_EstPmDeratingAct" UBYTE Bool_ON_OFF 1 2 0 1 BIT_MASK 0x01 ECU_ADDRESS 0x70003F18 /end MEASUREMENT
/begin MEASUREMENT FTASETP_EstPmDrtGain "FTASETP_EstPmDrtGain" FLOAT32_IEEE F_1_p0_55 1 2 0 1 ECU_ADDRESS 0x70003F14 /end MEASUREMENT
/begin MEASUREMENT FTASETP_EstPmMaxTemp "FTASETP_EstPmMaxTemp" FLOAT32_IEEE F_1_p0_58 1 2 -40 200 ECU_ADDRESS 0x70003F10 /end MEASUREMENT
/begin MEASUREMENT FTASETP_EstPmResetZ "FTASETP_EstPmResetZ" UBYTE Bool_ON_OFF 1 2 0 1 BIT_MASK 0x01 ECU_ADDRESS 0x70003F0C /end MEASUREMENT
/begin MEASUREMENT FTASETP_IntegralEstPmDrtGainZ "FTASETP_IntegralEstPmDrtGainZ" FLOAT32_IEEE F_1_p0_57 1 2 0 1 ECU_ADDRESS 0x70003F08 /end MEASUREMENT
/begin MEASUREMENT FTASETP_IntegralPmDrtGainZ "FTASETP_IntegralPmDrtGainZ" FLOAT32_IEEE F_1_p0_57 1 2 0 1 ECU_ADDRESS 0x70003F04 /end MEASUREMENT
/begin MEASUREMENT FTASETP_OpenLoopEstPmDrtGain "FTASETP_OpenLoopEstPmDrtGain" FLOAT32_IEEE F_1_p0_55 1 2 0 1 ECU_ADDRESS 0x70003F00 /end MEASUREMENT
/begin MEASUREMENT FTASETP_PmDeratingAct "FTASETP_PmDeratingAct" UBYTE Bool_ON_OFF 1 2 0 1 BIT_MASK 0x01 ECU_ADDRESS 0x70003EFC /end MEASUREMENT
/begin MEASUREMENT FTASETP_PmDrtGain "FTASETP_PmDrtGain" FLOAT32_IEEE F_1_p0_55 1 2 0 1 ECU_ADDRESS 0x70003EF8 /end MEASUREMENT
/begin MEASUREMENT FTASETP_PmMaxTemp "FTASETP_PmMaxTemp" FLOAT32_IEEE F_1_p0_58 1 2 -40 200 ECU_ADDRESS 0x70003EF4 /end MEASUREMENT
/begin MEASUREMENT FTASETP_PmResetZ "FTASETP_PmResetZ" UBYTE Bool_ON_OFF 1 2 0 1 BIT_MASK 0x01 ECU_ADDRESS 0x70003EF1 /end MEASUREMENT
/begin MEASUREMENT FTASMTP_IntegralWndg1DrtGainZ "FTASMTP_IntegralWndg1DrtGainZ" FLOAT32_IEEE F_1_p0_57 1 2 0 1 ECU_ADDRESS 0x70003F34 /end MEASUREMENT
/begin MEASUREMENT FTASMTP_IntegralWndg2DrtGainZ "FTASMTP_IntegralWndg2DrtGainZ" FLOAT32_IEEE F_1_p0_57 1 2 0 1 ECU_ADDRESS 0x70003F30 /end MEASUREMENT
/begin MEASUREMENT FTASMTP_Wndg1ResetZ "FTASMTP_Wndg1ResetZ" UBYTE Bool_ON_OFF 1 2 0 1 BIT_MASK 0x01 ECU_ADDRESS 0x70003F2C /end MEASUREMENT
/begin MEASUREMENT FTASMTP_Wndg1Temp "FTASMTP_Wndg1Temp" FLOAT32_IEEE F_1_p0_58 1 2 -40 200 ECU_ADDRESS 0x70003F28 /end MEASUREMENT
/begin MEASUREMENT FTASMTP_Wndg2DeratingActDetn "FTASMTP_Wndg2DeratingActDetn" UBYTE Bool_ON_OFF 1 2 0 1 BIT_MASK 0x01 ECU_ADDRESS 0x70003F25 /end MEASUREMENT
/begin MEASUREMENT FTASMTP_Wndg2ResetZ "FTASMTP_Wndg2ResetZ" UBYTE Bool_ON_OFF 1 2 0 1 BIT_MASK 0x01 ECU_ADDRESS 0x70003F24 /end MEASUREMENT
/begin MEASUREMENT FTASMTP_Wndg2Temp "FTASMTP_Wndg2Temp" FLOAT32_IEEE F_1_p0_58 1 2 -40 200 ECU_ADDRESS 0x70003F20 /end MEASUREMENT
/begin MEASUREMENT FTASMTP_WndgDrtGain "FTASMTP_WndgDrtGain" FLOAT32_IEEE F_1_p0_55 1 2 0 1 ECU_ADDRESS 0x70003F1C /end MEASUREMENT
/begin MEASUREMENT FTASOSP_MotorSpeedDrtGainMax "FTASOSP_MotorSpeedDrtGainMax" FLOAT32_IEEE F_1_p0_55 1 2 0 1 ECU_ADDRESS 0x70003F3C /end MEASUREMENT
/begin MEASUREMENT FTASOSP_MotorSpeedDrtGainMin "FTASOSP_MotorSpeedDrtGainMin" FLOAT32_IEEE F_1_p0_55 1 2 0 1 ECU_ADDRESS 0x70003F38 /end MEASUREMENT
/begin MEASUREMENT FTCIVDC_1ByUbatHV "FTCIVDC_1ByUbatHV" FLOAT32_IEEE F_1_p0_59 1 2 0.0001 1 ECU_ADDRESS 0x70003FD8 /end MEASUREMENT
/begin MEASUREMENT FTCIVDC_CntTimeZ "FTCIVDC_CntTimeZ" UWORD F_1_p0_4 1 2 0 65535 ECU_ADDRESS 0x70003FD4 /end MEASUREMENT
/begin MEASUREMENT FTCIVDC_CompDutyUZ "FTCIVDC_CompDutyUZ" FLOAT32_IEEE F_1_p0_4 1 2 -3.402823466E+038 3.402823466E+038 ECU_ADDRESS 0x70003FD0 /end MEASUREMENT
/begin MEASUREMENT FTCIVDC_CompDutyVZ "FTCIVDC_CompDutyVZ" FLOAT32_IEEE F_1_p0_4 1 2 -3.402823466E+038 3.402823466E+038 ECU_ADDRESS 0x70003FCC /end MEASUREMENT
/begin MEASUREMENT FTCIVDC_CompDutyWZ "FTCIVDC_CompDutyWZ" FLOAT32_IEEE F_1_p0_4 1 2 -3.402823466E+038 3.402823466E+038 ECU_ADDRESS 0x70003FC8 /end MEASUREMENT
/begin MEASUREMENT FTCIVDC_CurrDeltaThetaRd "FTCIVDC_CurrDeltaThetaRd" FLOAT32_IEEE F_1_p0_4 1 2 -3.402823466E+038 3.402823466E+038 ECU_ADDRESS 0x70003FC4 /end MEASUREMENT
/begin MEASUREMENT FTCIVDC_DeadCompEnRelayZ "FTCIVDC_DeadCompEnRelayZ" UBYTE Bool_ON_OFF 1 2 0 1 BIT_MASK 0x01 ECU_ADDRESS 0x70003FC3 /end MEASUREMENT
/begin MEASUREMENT FTCIVDC_DeadCompNumberZ "FTCIVDC_DeadCompNumberZ" UBYTE F_1_p0_4 1 2 0 255 ECU_ADDRESS 0x70003FC2 /end MEASUREMENT
/begin MEASUREMENT FTCIVDC_DeadZnCompSpdEnZ "FTCIVDC_DeadZnCompSpdEnZ" UBYTE Bool_ON_OFF 1 2 0 1 BIT_MASK 0x01 ECU_ADDRESS 0x70003FC1 /end MEASUREMENT
/begin MEASUREMENT FTCIVDC_DeadZnEnaFlg "FTCIVDC_DeadZnEnaFlg" UBYTE Bool_ON_OFF 1 2 0 1 BIT_MASK 0x01 ECU_ADDRESS 0x70003FC0 /end MEASUREMENT
/begin MEASUREMENT FTCIVDC_DutyCycle3[0] "FTCIVDC_DutyCycle3" FLOAT32_IEEE F_1_p0_4 1 2 0 1 ECU_ADDRESS 0x70003FB4 /end MEASUREMENT
/begin MEASUREMENT FTCIVDC_DutyCycle3[1] "FTCIVDC_DutyCycle3" FLOAT32_IEEE F_1_p0_4 1 2 0 1 ECU_ADDRESS 0x70003FB8 /end MEASUREMENT
/begin MEASUREMENT FTCIVDC_DutyCycle3[2] "FTCIVDC_DutyCycle3" FLOAT32_IEEE F_1_p0_4 1 2 0 1 ECU_ADDRESS 0x70003FBC /end MEASUREMENT
/begin MEASUREMENT FTCIVDC_DutyCycleMinMax[0] "FTCIVDC_DutyCycleMinMax" FLOAT32_IEEE F_1_p0_4 1 2 0 1 ECU_ADDRESS 0x70003FAC /end MEASUREMENT
/begin MEASUREMENT FTCIVDC_DutyCycleMinMax[1] "FTCIVDC_DutyCycleMinMax" FLOAT32_IEEE F_1_p0_4 1 2 0 1 ECU_ADDRESS 0x70003FB0 /end MEASUREMENT
/begin MEASUREMENT FTCIVDC_DutyCycleOrg3[0] "FTCIVDC_DutyCycleOrg3" FLOAT32_IEEE F_1_p0_4 1 2 -3.402823466E+038 3.402823466E+038 ECU_ADDRESS 0x70003FA0 /end MEASUREMENT
/begin MEASUREMENT FTCIVDC_DutyCycleOrg3[1] "FTCIVDC_DutyCycleOrg3" FLOAT32_IEEE F_1_p0_4 1 2 -3.402823466E+038 3.402823466E+038 ECU_ADDRESS 0x70003FA4 /end MEASUREMENT
/begin MEASUREMENT FTCIVDC_DutyCycleOrg3[2] "FTCIVDC_DutyCycleOrg3" FLOAT32_IEEE F_1_p0_4 1 2 -3.402823466E+038 3.402823466E+038 ECU_ADDRESS 0x70003FA8 /end MEASUREMENT
/begin MEASUREMENT FTCIVDC_DutyCycleTemp3[0] "FTCIVDC_DutyCycleTemp3" FLOAT32_IEEE F_1_p0_4 1 2 0 1 ECU_ADDRESS 0x70003F94 /end MEASUREMENT
/begin MEASUREMENT FTCIVDC_DutyCycleTemp3[1] "FTCIVDC_DutyCycleTemp3" FLOAT32_IEEE F_1_p0_4 1 2 0 1 ECU_ADDRESS 0x70003F98 /end MEASUREMENT
/begin MEASUREMENT FTCIVDC_DutyCycleTemp3[2] "FTCIVDC_DutyCycleTemp3" FLOAT32_IEEE F_1_p0_4 1 2 0 1 ECU_ADDRESS 0x70003F9C /end MEASUREMENT
/begin MEASUREMENT FTCIVDC_IdFildZ "FTCIVDC_IdFildZ" FLOAT32_IEEE F_1_p0_4 1 2 -3.402823466E+038 3.402823466E+038 ECU_ADDRESS 0x70003F90 /end MEASUREMENT
/begin MEASUREMENT FTCIVDC_IqFildZ "FTCIVDC_IqFildZ" FLOAT32_IEEE F_1_p0_4 1 2 -3.402823466E+038 3.402823466E+038 ECU_ADDRESS 0x70003F8C /end MEASUREMENT
/begin MEASUREMENT FTCIVDC_Iuvw3Z[0] "FTCIVDC_Iuvw3Z" FLOAT32_IEEE F_1_p0_4 1 2 -3.402823466E+038 3.402823466E+038 ECU_ADDRESS 0x70003F80 /end MEASUREMENT
/begin MEASUREMENT FTCIVDC_Iuvw3Z[1] "FTCIVDC_Iuvw3Z" FLOAT32_IEEE F_1_p0_4 1 2 -3.402823466E+038 3.402823466E+038 ECU_ADDRESS 0x70003F84 /end MEASUREMENT
/begin MEASUREMENT FTCIVDC_Iuvw3Z[2] "FTCIVDC_Iuvw3Z" FLOAT32_IEEE F_1_p0_4 1 2 -3.402823466E+038 3.402823466E+038 ECU_ADDRESS 0x70003F88 /end MEASUREMENT
/begin MEASUREMENT FTCIVDC_LutOutFreq "FTCIVDC_LutOutFreq" UWORD F_1_p0_4 1 2 0 65535 ECU_ADDRESS 0x70003F7C /end MEASUREMENT
/begin MEASUREMENT FTCIVDC_MecaSpeedRpmFild "FTCIVDC_MecaSpeedRpmFild" FLOAT32_IEEE F_1_p0_4 1 2 -3.402823466E+038 3.402823466E+038 ECU_ADDRESS 0x70003F78 /end MEASUREMENT
/begin MEASUREMENT FTCIVDC_MecaSpeedRpmZ "FTCIVDC_MecaSpeedRpmZ" FLOAT32_IEEE F_1_p0_4 1 2 -3.402823466E+038 3.402823466E+038 ECU_ADDRESS 0x70003F74 /end MEASUREMENT
/begin MEASUREMENT FTCIVDC_PwmFrequence "FTCIVDC_PwmFrequence" UWORD F_1_p0_4 1 2 0 65535 ECU_ADDRESS 0x70003F72 /end MEASUREMENT
/begin MEASUREMENT FTCIVDC_PwmFrequenceZ "FTCIVDC_PwmFrequenceZ" UWORD F_1_p0_4 1 2 0 65535 ECU_ADDRESS 0x70003F70 /end MEASUREMENT
/begin MEASUREMENT FTCIVDC_PwmOnOff3[0] "FTCIVDC_PwmOnOff3" UBYTE Bool_ON_OFF 1 2 0 1 BIT_MASK 0x01 ECU_ADDRESS 0x70003F6C /end MEASUREMENT
/begin MEASUREMENT FTCIVDC_PwmOnOff3[1] "FTCIVDC_PwmOnOff3" UBYTE Bool_ON_OFF 1 2 0 1 BIT_MASK 0x01 ECU_ADDRESS 0x70003F6D /end MEASUREMENT
/begin MEASUREMENT FTCIVDC_PwmOnOff3[2] "FTCIVDC_PwmOnOff3" UBYTE Bool_ON_OFF 1 2 0 1 BIT_MASK 0x01 ECU_ADDRESS 0x70003F6E /end MEASUREMENT
/begin MEASUREMENT FTCIVDC_RandFreq "FTCIVDC_RandFreq" FLOAT32_IEEE F_1_p0_35 1 2 -3.402823466E+038 3.402823466E+038 ECU_ADDRESS 0x70003F68 /end MEASUREMENT
/begin MEASUREMENT FTCIVDC_RandNumScal "FTCIVDC_RandNumScal" FLOAT32_IEEE F_1_p0_4 1 2 -3.402823466E+038 3.402823466E+038 ECU_ADDRESS 0x70003F64 /end MEASUREMENT
/begin MEASUREMENT FTCIVDC_RandomNum "FTCIVDC_RandomNum" FLOAT32_IEEE F_1_p0_47 1 2 -3.402823466E+038 3.402823466E+038 ECU_ADDRESS 0x70003F60 /end MEASUREMENT
/begin MEASUREMENT FTCIVDC_SimpleUVW3[0] "FTCIVDC_SimpleUVW3" FLOAT32_IEEE F_1_p0_38 1 2 0 2000 ECU_ADDRESS 0x70003F54 /end MEASUREMENT
/begin MEASUREMENT FTCIVDC_SimpleUVW3[1] "FTCIVDC_SimpleUVW3" FLOAT32_IEEE F_1_p0_38 1 2 0 2000 ECU_ADDRESS 0x70003F58 /end MEASUREMENT
/begin MEASUREMENT FTCIVDC_SimpleUVW3[2] "FTCIVDC_SimpleUVW3" FLOAT32_IEEE F_1_p0_38 1 2 0 2000 ECU_ADDRESS 0x70003F5C /end MEASUREMENT
/begin MEASUREMENT FTCIVDC_TimeEnableZ "FTCIVDC_TimeEnableZ" UBYTE Bool_ON_OFF 1 2 0 1 BIT_MASK 0x01 ECU_ADDRESS 0x70003F50 /end MEASUREMENT
/begin MEASUREMENT FTCIVDC_UM0zeroTgt "FTCIVDC_UM0zeroTgt" FLOAT32_IEEE F_1_p0_38 1 2 0 2000 ECU_ADDRESS 0x70003F4C /end MEASUREMENT
/begin MEASUREMENT FTCIVDC_UM1AlphaTgt "FTCIVDC_UM1AlphaTgt" FLOAT32_IEEE F_1_p0_38 1 2 0 2000 ECU_ADDRESS 0x70003F48 /end MEASUREMENT
/begin MEASUREMENT FTCIVDC_UM1BetaTgt "FTCIVDC_UM1BetaTgt" FLOAT32_IEEE F_1_p0_38 1 2 0 2000 ECU_ADDRESS 0x70003F44 /end MEASUREMENT
/begin MEASUREMENT FTCIVDC_UbatHV "FTCIVDC_UbatHV" FLOAT32_IEEE F_1_p0_38 1 2 0 2000 ECU_ADDRESS 0x70003F40 /end MEASUREMENT
/begin MEASUREMENT FTCMCCS_AAfilterVar1Z "FTCMCCS_AAfilterVar1Z" FLOAT32_IEEE F_1_p0_4 1 2 -3.402823466E+038 3.402823466E+038 ECU_ADDRESS 0x700040BC /end MEASUREMENT
/begin MEASUREMENT FTCMCCS_AAfilterVar2Z "FTCMCCS_AAfilterVar2Z" FLOAT32_IEEE F_1_p0_4 1 2 -3.402823466E+038 3.402823466E+038 ECU_ADDRESS 0x700040B8 /end MEASUREMENT
/begin MEASUREMENT FTCMCCS_AAfilterVar3Z "FTCMCCS_AAfilterVar3Z" FLOAT32_IEEE F_1_p0_4 1 2 -3.402823466E+038 3.402823466E+038 ECU_ADDRESS 0x700040B4 /end MEASUREMENT
/begin MEASUREMENT FTCMCCS_AAfilterVar4Z "FTCMCCS_AAfilterVar4Z" FLOAT32_IEEE F_1_p0_4 1 2 -3.402823466E+038 3.402823466E+038 ECU_ADDRESS 0x700040B0 /end MEASUREMENT
/begin MEASUREMENT FTCMCCS_AAfilterVar5Z "FTCMCCS_AAfilterVar5Z" FLOAT32_IEEE F_1_p0_4 1 2 -3.402823466E+038 3.402823466E+038 ECU_ADDRESS 0x700040AC /end MEASUREMENT
/begin MEASUREMENT FTCMCCS_EM1dOpenLoopEst "FTCMCCS_EM1dOpenLoopEst" FLOAT32_IEEE F_1_p0_4 1 2 -3.402823466E+038 3.402823466E+038 ECU_ADDRESS 0x700040A8 /end MEASUREMENT
/begin MEASUREMENT FTCMCCS_EM1qOpenLoopEst "FTCMCCS_EM1qOpenLoopEst" FLOAT32_IEEE F_1_p0_4 1 2 -3.402823466E+038 3.402823466E+038 ECU_ADDRESS 0x700040A4 /end MEASUREMENT
/begin MEASUREMENT FTCMCCS_EpsilonM0Ctrl "FTCMCCS_EpsilonM0Ctrl" FLOAT32_IEEE F_1_p0_4 1 2 -3.402823466E+038 3.402823466E+038 ECU_ADDRESS 0x700040A0 /end MEASUREMENT
/begin MEASUREMENT FTCMCCS_EpsilonM1dCtrl "FTCMCCS_EpsilonM1dCtrl" FLOAT32_IEEE F_1_p0_4 1 2 -3.402823466E+038 3.402823466E+038 ECU_ADDRESS 0x7000409C /end MEASUREMENT
/begin MEASUREMENT FTCMCCS_EpsilonM1qCtrl "FTCMCCS_EpsilonM1qCtrl" FLOAT32_IEEE F_1_p0_4 1 2 -3.402823466E+038 3.402823466E+038 ECU_ADDRESS 0x70004098 /end MEASUREMENT
/begin MEASUREMENT FTCMCCS_Lm1d "FTCMCCS_Lm1d" FLOAT32_IEEE F_1_p0_4 1 2 -3.402823466E+038 3.402823466E+038 ECU_ADDRESS 0x70004094 /end MEASUREMENT
/begin MEASUREMENT FTCMCCS_Lm1q "FTCMCCS_Lm1q" FLOAT32_IEEE F_1_p0_4 1 2 -3.402823466E+038 3.402823466E+038 ECU_ADDRESS 0x70004090 /end MEASUREMENT
/begin MEASUREMENT FTCMCCS_LutOutM1dCtrlTr "FTCMCCS_LutOutM1dCtrlTr" FLOAT32_IEEE F_1_p0_4 1 2 -3.402823466E+038 3.402823466E+038 ECU_ADDRESS 0x7000408C /end MEASUREMENT
/begin MEASUREMENT FTCMCCS_LutOutM1qCtrlTr "FTCMCCS_LutOutM1qCtrlTr" FLOAT32_IEEE F_1_p0_4 1 2 -3.402823466E+038 3.402823466E+038 ECU_ADDRESS 0x70004088 /end MEASUREMENT
/begin MEASUREMENT FTCMCCS_LutOutiM1dTgtFildTr "FTCMCCS_LutOutiM1dTgtFildTr" FLOAT32_IEEE F_1_p0_4 1 2 -3.402823466E+038 3.402823466E+038 ECU_ADDRESS 0x70004084 /end MEASUREMENT
/begin MEASUREMENT FTCMCCS_LutOutiM1qTgtFildTr "FTCMCCS_LutOutiM1qTgtFildTr" FLOAT32_IEEE F_1_p0_4 1 2 -3.402823466E+038 3.402823466E+038 ECU_ADDRESS 0x70004080 /end MEASUREMENT
/begin MEASUREMENT FTCMCCS_M0CtrlIntegratorZ "FTCMCCS_M0CtrlIntegratorZ" FLOAT32_IEEE F_1_p0_4 1 2 -3.402823466E+038 3.402823466E+038 ECU_ADDRESS 0x7000407C /end MEASUREMENT
/begin MEASUREMENT FTCMCCS_M0CtrlKi "FTCMCCS_M0CtrlKi" FLOAT32_IEEE F_1_p0_4 1 2 -3.402823466E+038 3.402823466E+038 ECU_ADDRESS 0x70004078 /end MEASUREMENT
/begin MEASUREMENT FTCMCCS_M0CtrlKp "FTCMCCS_M0CtrlKp" FLOAT32_IEEE F_1_p0_4 1 2 -3.402823466E+038 3.402823466E+038 ECU_ADDRESS 0x70004074 /end MEASUREMENT
/begin MEASUREMENT FTCMCCS_M0CtrlTgt "FTCMCCS_M0CtrlTgt" FLOAT32_IEEE F_1_p0_4 1 2 -3.402823466E+038 3.402823466E+038 ECU_ADDRESS 0x70004070 /end MEASUREMENT
/begin MEASUREMENT FTCMCCS_M1dCtrlIntegratorZ "FTCMCCS_M1dCtrlIntegratorZ" FLOAT32_IEEE F_1_p0_4 1 2 -3.402823466E+038 3.402823466E+038 ECU_ADDRESS 0x7000406C /end MEASUREMENT
/begin MEASUREMENT FTCMCCS_M1dCtrlKi "FTCMCCS_M1dCtrlKi" FLOAT32_IEEE F_1_p0_4 1 2 -3.402823466E+038 3.402823466E+038 ECU_ADDRESS 0x70004068 /end MEASUREMENT
/begin MEASUREMENT FTCMCCS_M1dCtrlKp "FTCMCCS_M1dCtrlKp" FLOAT32_IEEE F_1_p0_4 1 2 -3.402823466E+038 3.402823466E+038 ECU_ADDRESS 0x70004064 /end MEASUREMENT
/begin MEASUREMENT FTCMCCS_M1dCtrlTgt "FTCMCCS_M1dCtrlTgt" FLOAT32_IEEE F_1_p0_4 1 2 -3.402823466E+038 3.402823466E+038 ECU_ADDRESS 0x70004060 /end MEASUREMENT
/begin MEASUREMENT FTCMCCS_M1dCtrlTr "FTCMCCS_M1dCtrlTr" FLOAT32_IEEE F_1_p0_4 1 2 -3.402823466E+038 3.402823466E+038 ECU_ADDRESS 0x7000405C /end MEASUREMENT
/begin MEASUREMENT FTCMCCS_M1dObsIntegratorZ "FTCMCCS_M1dObsIntegratorZ" FLOAT32_IEEE F_1_p0_4 1 2 -3.402823466E+038 3.402823466E+038 ECU_ADDRESS 0x70004058 /end MEASUREMENT
/begin MEASUREMENT FTCMCCS_M1qCtrlIntegratorZ "FTCMCCS_M1qCtrlIntegratorZ" FLOAT32_IEEE F_1_p0_4 1 2 -3.402823466E+038 3.402823466E+038 ECU_ADDRESS 0x70004054 /end MEASUREMENT
/begin MEASUREMENT FTCMCCS_M1qCtrlKi "FTCMCCS_M1qCtrlKi" FLOAT32_IEEE F_1_p0_4 1 2 -3.402823466E+038 3.402823466E+038 ECU_ADDRESS 0x70004050 /end MEASUREMENT
/begin MEASUREMENT FTCMCCS_M1qCtrlKp "FTCMCCS_M1qCtrlKp" FLOAT32_IEEE F_1_p0_4 1 2 -3.402823466E+038 3.402823466E+038 ECU_ADDRESS 0x7000404C /end MEASUREMENT
/begin MEASUREMENT FTCMCCS_M1qCtrlTgt "FTCMCCS_M1qCtrlTgt" FLOAT32_IEEE F_1_p0_4 1 2 -3.402823466E+038 3.402823466E+038 ECU_ADDRESS 0x70004048 /end MEASUREMENT
/begin MEASUREMENT FTCMCCS_M1qCtrlTr "FTCMCCS_M1qCtrlTr" FLOAT32_IEEE F_1_p0_4 1 2 -3.402823466E+038 3.402823466E+038 ECU_ADDRESS 0x70004044 /end MEASUREMENT
/begin MEASUREMENT FTCMCCS_M1qObsIntegratorZ "FTCMCCS_M1qObsIntegratorZ" FLOAT32_IEEE F_1_p0_4 1 2 -3.402823466E+038 3.402823466E+038 ECU_ADDRESS 0x70004040 /end MEASUREMENT
/begin MEASUREMENT FTCMCCS_Phim "FTCMCCS_Phim" FLOAT32_IEEE F_1_p0_4 1 2 -3.402823466E+038 3.402823466E+038 ECU_ADDRESS 0x7000403C /end MEASUREMENT
/begin MEASUREMENT FTCMCCS_Rs "FTCMCCS_Rs" FLOAT32_IEEE F_1_p0_4 1 2 -3.402823466E+038 3.402823466E+038 ECU_ADDRESS 0x70004038 /end MEASUREMENT
/begin MEASUREMENT FTCMCCS_RsiM1dEstZ "FTCMCCS_RsiM1dEstZ" FLOAT32_IEEE F_1_p0_4 1 2 -3.402823466E+038 3.402823466E+038 ECU_ADDRESS 0x70004034 /end MEASUREMENT
/begin MEASUREMENT FTCMCCS_RsiM1qEstZ "FTCMCCS_RsiM1qEstZ" FLOAT32_IEEE F_1_p0_4 1 2 -3.402823466E+038 3.402823466E+038 ECU_ADDRESS 0x70004030 /end MEASUREMENT
/begin MEASUREMENT FTCMCCS_SampleTime3ST "FTCMCCS_SampleTime3ST" FLOAT32_IEEE F_1_p0_53 1 2 -3.402823466E+038 3.402823466E+038 ECU_ADDRESS 0x7000402C /end MEASUREMENT
/begin MEASUREMENT FTCMCCS_SampleTimeF32 "FTCMCCS_SampleTimeF32" FLOAT32_IEEE F_1_p0_53 1 2 -3.402823466E+038 3.402823466E+038 ECU_ADDRESS 0x70004028 /end MEASUREMENT
/begin MEASUREMENT FTCMCCS_TotalI0dqTgt3[0] "FTCMCCS_TotalI0dqTgt3" FLOAT32_IEEE F_1_p0_46 1 2 -3.402823466E+038 3.402823466E+038 ECU_ADDRESS 0x7000401C /end MEASUREMENT
/begin MEASUREMENT FTCMCCS_TotalI0dqTgt3[1] "FTCMCCS_TotalI0dqTgt3" FLOAT32_IEEE F_1_p0_46 1 2 -3.402823466E+038 3.402823466E+038 ECU_ADDRESS 0x70004020 /end MEASUREMENT
/begin MEASUREMENT FTCMCCS_TotalI0dqTgt3[2] "FTCMCCS_TotalI0dqTgt3" FLOAT32_IEEE F_1_p0_46 1 2 -3.402823466E+038 3.402823466E+038 ECU_ADDRESS 0x70004024 /end MEASUREMENT
/begin MEASUREMENT FTCMCCS_TransEmfM1d "FTCMCCS_TransEmfM1d" FLOAT32_IEEE F_1_p0_4 1 2 -3.402823466E+038 3.402823466E+038 ECU_ADDRESS 0x70004018 /end MEASUREMENT
/begin MEASUREMENT FTCMCCS_TransEmfM1q "FTCMCCS_TransEmfM1q" FLOAT32_IEEE F_1_p0_4 1 2 -3.402823466E+038 3.402823466E+038 ECU_ADDRESS 0x70004014 /end MEASUREMENT
/begin MEASUREMENT FTCMCCS_TransUd "FTCMCCS_TransUd" FLOAT32_IEEE F_1_p0_4 1 2 -3.402823466E+038 3.402823466E+038 ECU_ADDRESS 0x70004010 /end MEASUREMENT
/begin MEASUREMENT FTCMCCS_TransUq "FTCMCCS_TransUq" FLOAT32_IEEE F_1_p0_4 1 2 -3.402823466E+038 3.402823466E+038 ECU_ADDRESS 0x7000400C /end MEASUREMENT
/begin MEASUREMENT FTCMCCS_U0dqTgt3[0] "FTCMCCS_U0dqTgt3" FLOAT32_IEEE F_1_p0_38 1 2 -3.402823466E+038 3.402823466E+038 ECU_ADDRESS 0x70004000 /end MEASUREMENT
/begin MEASUREMENT FTCMCCS_U0dqTgt3[1] "FTCMCCS_U0dqTgt3" FLOAT32_IEEE F_1_p0_38 1 2 -3.402823466E+038 3.402823466E+038 ECU_ADDRESS 0x70004004 /end MEASUREMENT
/begin MEASUREMENT FTCMCCS_U0dqTgt3[2] "FTCMCCS_U0dqTgt3" FLOAT32_IEEE F_1_p0_38 1 2 -3.402823466E+038 3.402823466E+038 ECU_ADDRESS 0x70004008 /end MEASUREMENT
/begin MEASUREMENT FTCMCCS_UM1dTgt "FTCMCCS_UM1dTgt" FLOAT32_IEEE F_1_p0_4 1 2 -3.402823466E+038 3.402823466E+038 ECU_ADDRESS 0x70003FFC /end MEASUREMENT
/begin MEASUREMENT FTCMCCS_UM1qTgt "FTCMCCS_UM1qTgt" FLOAT32_IEEE F_1_p0_4 1 2 -3.402823466E+038 3.402823466E+038 ECU_ADDRESS 0x70003FF8 /end MEASUREMENT
/begin MEASUREMENT FTCMCCS_UdqNorm "FTCMCCS_UdqNorm" FLOAT32_IEEE F_1_p0_4 1 2 -3.402823466E+038 3.402823466E+038 ECU_ADDRESS 0x70003FF4 /end MEASUREMENT
/begin MEASUREMENT FTCMCCS_iM1dTgtFild "FTCMCCS_iM1dTgtFild" FLOAT32_IEEE F_1_p0_4 1 2 -3.402823466E+038 3.402823466E+038 ECU_ADDRESS 0x70003FF0 /end MEASUREMENT
/begin MEASUREMENT FTCMCCS_iM1dTgtFildTr "FTCMCCS_iM1dTgtFildTr" FLOAT32_IEEE F_1_p0_4 1 2 -3.402823466E+038 3.402823466E+038 ECU_ADDRESS 0x70003FEC /end MEASUREMENT
/begin MEASUREMENT FTCMCCS_iM1dTgtFildZ "FTCMCCS_iM1dTgtFildZ" FLOAT32_IEEE F_1_p0_4 1 2 -3.402823466E+038 3.402823466E+038 ECU_ADDRESS 0x70003FE8 /end MEASUREMENT
/begin MEASUREMENT FTCMCCS_iM1qTgtFild "FTCMCCS_iM1qTgtFild" FLOAT32_IEEE F_1_p0_4 1 2 -3.402823466E+038 3.402823466E+038 ECU_ADDRESS 0x70003FE4 /end MEASUREMENT
/begin MEASUREMENT FTCMCCS_iM1qTgtFildTr "FTCMCCS_iM1qTgtFildTr" FLOAT32_IEEE F_1_p0_4 1 2 -3.402823466E+038 3.402823466E+038 ECU_ADDRESS 0x70003FE0 /end MEASUREMENT
/begin MEASUREMENT FTCMCCS_iM1qTgtFildZ "FTCMCCS_iM1qTgtFildZ" FLOAT32_IEEE F_1_p0_4 1 2 -3.402823466E+038 3.402823466E+038 ECU_ADDRESS 0x70003FDC /end MEASUREMENT
/begin MEASUREMENT FTCMCTC_CoggingComp "FTCMCTC_CoggingComp" FLOAT32_IEEE F_1_p0_46 1 2 -3.402823466E+038 3.402823466E+038 ECU_ADDRESS 0x700040F0 /end MEASUREMENT
/begin MEASUREMENT FTCMCTC_H3CurrentTgt "FTCMCTC_H3CurrentTgt" FLOAT32_IEEE F_1_p0_4 1 2 -3.402823466E+038 3.402823466E+038 ECU_ADDRESS 0x700040EC /end MEASUREMENT
/begin MEASUREMENT FTCMCTC_I0dqTgt3[0] "FTCMCTC_I0dqTgt3" FLOAT32_IEEE F_1_p0_46 1 2 -3.402823466E+038 3.402823466E+038 ECU_ADDRESS 0x700040E0 /end MEASUREMENT
/begin MEASUREMENT FTCMCTC_I0dqTgt3[1] "FTCMCTC_I0dqTgt3" FLOAT32_IEEE F_1_p0_46 1 2 -3.402823466E+038 3.402823466E+038 ECU_ADDRESS 0x700040E4 /end MEASUREMENT
/begin MEASUREMENT FTCMCTC_I0dqTgt3[2] "FTCMCTC_I0dqTgt3" FLOAT32_IEEE F_1_p0_46 1 2 -3.402823466E+038 3.402823466E+038 ECU_ADDRESS 0x700040E8 /end MEASUREMENT
/begin MEASUREMENT FTCMCTC_Sin3NextThetaElec "FTCMCTC_Sin3NextThetaElec" FLOAT32_IEEE F_1_p0_4 1 2 -3.402823466E+038 3.402823466E+038 ECU_ADDRESS 0x700040DC /end MEASUREMENT
/begin MEASUREMENT FTCMCTC_Sin6NextThetaElec "FTCMCTC_Sin6NextThetaElec" FLOAT32_IEEE F_1_p0_4 1 2 -3.402823466E+038 3.402823466E+038 ECU_ADDRESS 0x700040D8 /end MEASUREMENT
/begin MEASUREMENT FTCMCTC_SpyEvent "FTCMCTC_SpyEvent" UBYTE Bool_ON_OFF 1 2 0 1 BIT_MASK 0x01 ECU_ADDRESS 0x700040D4 /end MEASUREMENT
/begin MEASUREMENT FTCMCTC_iM0Tgt "FTCMCTC_iM0Tgt" FLOAT32_IEEE F_1_p0_4 1 2 -3.402823466E+038 3.402823466E+038 ECU_ADDRESS 0x700040D0 /end MEASUREMENT
/begin MEASUREMENT FTCMCTC_iM1dTgtZ "FTCMCTC_iM1dTgtZ" FLOAT32_IEEE F_1_p0_4 1 2 -3.402823466E+038 3.402823466E+038 ECU_ADDRESS 0x700040CC /end MEASUREMENT
/begin MEASUREMENT FTCMCTC_iM1qTgtZ "FTCMCTC_iM1qTgtZ" FLOAT32_IEEE F_1_p0_4 1 2 -3.402823466E+038 3.402823466E+038 ECU_ADDRESS 0x700040C8 /end MEASUREMENT
/begin MEASUREMENT FTCMCTC_iMdTgt "FTCMCTC_iMdTgt" FLOAT32_IEEE F_1_p0_4 1 2 -3.402823466E+038 3.402823466E+038 ECU_ADDRESS 0x700040C4 /end MEASUREMENT
/begin MEASUREMENT FTCMCTC_iMqTgt "FTCMCTC_iMqTgt" FLOAT32_IEEE F_1_p0_4 1 2 -3.402823466E+038 3.402823466E+038 ECU_ADDRESS 0x700040C0 /end MEASUREMENT
/begin MEASUREMENT FTCMHIJ_24thIdComp "value of the motor phase current in park frame" FLOAT32_IEEE F_1_p0_63 1 2 -3.402823466E+038 3.402823466E+038 ECU_ADDRESS 0x70004174 /end MEASUREMENT
/begin MEASUREMENT FTCMHIJ_24thIqComp "value of the motor phase current in park frame" FLOAT32_IEEE F_1_p0_63 1 2 -3.402823466E+038 3.402823466E+038 ECU_ADDRESS 0x70004170 /end MEASUREMENT
/begin MEASUREMENT FTCMHIJ_ElecAngle "value of the motor phase current in park frame" FLOAT32_IEEE F_1_p0_64 1 2 -3.402823466E+038 3.402823466E+038 ECU_ADDRESS 0x7000416C /end MEASUREMENT
/begin MEASUREMENT FTCMHIJ_I0dq3Comp[0] "value of the motor phase current in park frame" FLOAT32_IEEE F_1_p0_64 1 2 -3.402823466E+038 3.402823466E+038 ECU_ADDRESS 0x70004160 /end MEASUREMENT
/begin MEASUREMENT FTCMHIJ_I0dq3Comp[1] "value of the motor phase current in park frame" FLOAT32_IEEE F_1_p0_64 1 2 -3.402823466E+038 3.402823466E+038 ECU_ADDRESS 0x70004164 /end MEASUREMENT
/begin MEASUREMENT FTCMHIJ_I0dq3Comp[2] "value of the motor phase current in park frame" FLOAT32_IEEE F_1_p0_64 1 2 -3.402823466E+038 3.402823466E+038 ECU_ADDRESS 0x70004168 /end MEASUREMENT
/begin MEASUREMENT FTCMHIJ_IdComp "value of the motor phase current in park frame" FLOAT32_IEEE F_1_p0_63 1 2 -3.402823466E+038 3.402823466E+038 ECU_ADDRESS 0x7000415C /end MEASUREMENT
/begin MEASUREMENT FTCMHIJ_IdLut6[0] "value of the motor phase current in park frame" FLOAT32_IEEE F_1_p0_63 1 2 -3.402823466E+038 3.402823466E+038 ECU_ADDRESS 0x70004144 /end MEASUREMENT
/begin MEASUREMENT FTCMHIJ_IdLut6[1] "value of the motor phase current in park frame" FLOAT32_IEEE F_1_p0_63 1 2 -3.402823466E+038 3.402823466E+038 ECU_ADDRESS 0x70004148 /end MEASUREMENT
/begin MEASUREMENT FTCMHIJ_IdLut6[2] "value of the motor phase current in park frame" FLOAT32_IEEE F_1_p0_63 1 2 -3.402823466E+038 3.402823466E+038 ECU_ADDRESS 0x7000414C /end MEASUREMENT
/begin MEASUREMENT FTCMHIJ_IdLut6[3] "value of the motor phase current in park frame" FLOAT32_IEEE F_1_p0_63 1 2 -3.402823466E+038 3.402823466E+038 ECU_ADDRESS 0x70004150 /end MEASUREMENT
/begin MEASUREMENT FTCMHIJ_IdLut6[4] "value of the motor phase current in park frame" FLOAT32_IEEE F_1_p0_63 1 2 -3.402823466E+038 3.402823466E+038 ECU_ADDRESS 0x70004154 /end MEASUREMENT
/begin MEASUREMENT FTCMHIJ_IdLut6[5] "value of the motor phase current in park frame" FLOAT32_IEEE F_1_p0_63 1 2 -3.402823466E+038 3.402823466E+038 ECU_ADDRESS 0x70004158 /end MEASUREMENT
/begin MEASUREMENT FTCMHIJ_IqComp "value of the motor phase current in park frame" FLOAT32_IEEE F_1_p0_63 1 2 -3.402823466E+038 3.402823466E+038 ECU_ADDRESS 0x70004140 /end MEASUREMENT
/begin MEASUREMENT FTCMHIJ_IqLut6[0] "value of the motor phase current in park frame" FLOAT32_IEEE F_1_p0_63 1 2 -3.402823466E+038 3.402823466E+038 ECU_ADDRESS 0x70004128 /end MEASUREMENT
/begin MEASUREMENT FTCMHIJ_IqLut6[1] "value of the motor phase current in park frame" FLOAT32_IEEE F_1_p0_63 1 2 -3.402823466E+038 3.402823466E+038 ECU_ADDRESS 0x7000412C /end MEASUREMENT
/begin MEASUREMENT FTCMHIJ_IqLut6[2] "value of the motor phase current in park frame" FLOAT32_IEEE F_1_p0_63 1 2 -3.402823466E+038 3.402823466E+038 ECU_ADDRESS 0x70004130 /end MEASUREMENT
/begin MEASUREMENT FTCMHIJ_IqLut6[3] "value of the motor phase current in park frame" FLOAT32_IEEE F_1_p0_63 1 2 -3.402823466E+038 3.402823466E+038 ECU_ADDRESS 0x70004134 /end MEASUREMENT
/begin MEASUREMENT FTCMHIJ_IqLut6[4] "value of the motor phase current in park frame" FLOAT32_IEEE F_1_p0_63 1 2 -3.402823466E+038 3.402823466E+038 ECU_ADDRESS 0x70004138 /end MEASUREMENT
/begin MEASUREMENT FTCMHIJ_IqLut6[5] "value of the motor phase current in park frame" FLOAT32_IEEE F_1_p0_63 1 2 -3.402823466E+038 3.402823466E+038 ECU_ADDRESS 0x7000413C /end MEASUREMENT
/begin MEASUREMENT FTCMHIJ_LutBaseMagnitude12Id "value of the motor phase current in park frame" FLOAT32_IEEE F_1_p0_63 1 2 -3.402823466E+038 3.402823466E+038 ECU_ADDRESS 0x70004124 /end MEASUREMENT
/begin MEASUREMENT FTCMHIJ_LutBaseMagnitude12Iq "value of the motor phase current in park frame" FLOAT32_IEEE F_1_p0_63 1 2 -3.402823466E+038 3.402823466E+038 ECU_ADDRESS 0x70004120 /end MEASUREMENT
/begin MEASUREMENT FTCMHIJ_LutBaseMagnitude24thId "value of the motor phase current in park frame" FLOAT32_IEEE F_1_p0_63 1 2 -3.402823466E+038 3.402823466E+038 ECU_ADDRESS 0x7000411C /end MEASUREMENT
/begin MEASUREMENT FTCMHIJ_LutBaseMagnitude24thIq "value of the motor phase current in park frame" FLOAT32_IEEE F_1_p0_63 1 2 -3.402823466E+038 3.402823466E+038 ECU_ADDRESS 0x70004118 /end MEASUREMENT
/begin MEASUREMENT FTCMHIJ_LutBaseMagnitude6Id "value of the motor phase current in park frame" FLOAT32_IEEE F_1_p0_63 1 2 -3.402823466E+038 3.402823466E+038 ECU_ADDRESS 0x70004114 /end MEASUREMENT
/begin MEASUREMENT FTCMHIJ_LutBaseMagnitude6Iq "value of the motor phase current in park frame" FLOAT32_IEEE F_1_p0_63 1 2 -3.402823466E+038 3.402823466E+038 ECU_ADDRESS 0x70004110 /end MEASUREMENT
/begin MEASUREMENT FTCMHIJ_LutPhase12Iq "value of the motor phase current in park frame" FLOAT32_IEEE F_1_p0_63 1 2 -3.402823466E+038 3.402823466E+038 ECU_ADDRESS 0x7000410C /end MEASUREMENT
/begin MEASUREMENT FTCMHIJ_LutPhase24thIq "value of the motor phase current in park frame" FLOAT32_IEEE F_1_p0_63 1 2 -3.402823466E+038 3.402823466E+038 ECU_ADDRESS 0x70004108 /end MEASUREMENT
/begin MEASUREMENT FTCMHIJ_MotGenFlag "value of the motor phase current in park frame" UBYTE Bool_ON_OFF 1 2 0 1 BIT_MASK 0x01 ECU_ADDRESS 0x70004104 /end MEASUREMENT
/begin MEASUREMENT FTCMHIJ_SixthIdComp "value of the motor phase current in park frame" FLOAT32_IEEE F_1_p0_63 1 2 -3.402823466E+038 3.402823466E+038 ECU_ADDRESS 0x70004100 /end MEASUREMENT
/begin MEASUREMENT FTCMHIJ_SixthIqComp "value of the motor phase current in park frame" FLOAT32_IEEE F_1_p0_63 1 2 -3.402823466E+038 3.402823466E+038 ECU_ADDRESS 0x700040FC /end MEASUREMENT
/begin MEASUREMENT FTCMHIJ_TwelfthIdComp "value of the motor phase current in park frame" FLOAT32_IEEE F_1_p0_65 1 2 -3.402823466E+038 3.402823466E+038 ECU_ADDRESS 0x700040F8 /end MEASUREMENT
/begin MEASUREMENT FTCMHIJ_TwelfthIqComp "value of the motor phase current in park frame" FLOAT32_IEEE F_1_p0_65 1 2 -3.402823466E+038 3.402823466E+038 ECU_ADDRESS 0x700040F4 /end MEASUREMENT
/begin MEASUREMENT FTCMRPC_I0AlphaBeta[0] "FTCMRPC_I0AlphaBeta" FLOAT32_IEEE F_1_p0_46 1 2 -3.402823466E+038 3.402823466E+038 ECU_ADDRESS 0x70004184 /end MEASUREMENT
/begin MEASUREMENT FTCMRPC_I0AlphaBeta[1] "FTCMRPC_I0AlphaBeta" FLOAT32_IEEE F_1_p0_46 1 2 -3.402823466E+038 3.402823466E+038 ECU_ADDRESS 0x70004188 /end MEASUREMENT
/begin MEASUREMENT FTCMRPC_I0AlphaBeta[2] "FTCMRPC_I0AlphaBeta" FLOAT32_IEEE F_1_p0_46 1 2 -3.402823466E+038 3.402823466E+038 ECU_ADDRESS 0x7000418C /end MEASUREMENT
/begin MEASUREMENT FTCMRPC_I0dq3[0] "value of the motor phase current in park frame" FLOAT32_IEEE F_1_p0_64 1 2 -3.402823466E+038 3.402823466E+038 ECU_ADDRESS 0x70004178 /end MEASUREMENT
/begin MEASUREMENT FTCMRPC_I0dq3[1] "value of the motor phase current in park frame" FLOAT32_IEEE F_1_p0_64 1 2 -3.402823466E+038 3.402823466E+038 ECU_ADDRESS 0x7000417C /end MEASUREMENT
/begin MEASUREMENT FTCMRPC_I0dq3[2] "value of the motor phase current in park frame" FLOAT32_IEEE F_1_p0_64 1 2 -3.402823466E+038 3.402823466E+038 ECU_ADDRESS 0x70004180 /end MEASUREMENT
/begin MEASUREMENT FTCMSCS_CtrlIntegratorZ "FTCMSCS_CtrlIntegratorZ" FLOAT32_IEEE F_1_p0_4 1 2 -3.402823466E+038 3.402823466E+038 ECU_ADDRESS 0x700041C8 /end MEASUREMENT
/begin MEASUREMENT FTCMSCS_CtrlKi "FTCMSCS_CtrlKi" FLOAT32_IEEE F_1_p0_4 1 2 -3.402823466E+038 3.402823466E+038 ECU_ADDRESS 0x700041C4 /end MEASUREMENT
/begin MEASUREMENT FTCMSCS_CtrlKp "FTCMSCS_CtrlKp" FLOAT32_IEEE F_1_p0_4 1 2 -3.402823466E+038 3.402823466E+038 ECU_ADDRESS 0x700041C0 /end MEASUREMENT
/begin MEASUREMENT FTCMSCS_CtrlSatCntZ "FTCMSCS_CtrlSatCntZ" FLOAT32_IEEE F_1_p0_4 1 2 -3.402823466E+038 3.402823466E+038 ECU_ADDRESS 0x700041BC /end MEASUREMENT
/begin MEASUREMENT FTCMSCS_CtrlSatTimoutDetn "FTCMSCS_CtrlSatTimoutDetn" UBYTE Bool_ON_OFF 1 2 0 1 BIT_MASK 0x01 ECU_ADDRESS 0x700041B8 /end MEASUREMENT
/begin MEASUREMENT FTCMSCS_CtrlTgt "FTCMSCS_CtrlTgt" FLOAT32_IEEE F_1_p0_4 1 2 -3.402823466E+038 3.402823466E+038 ECU_ADDRESS 0x700041B4 /end MEASUREMENT
/begin MEASUREMENT FTCMSCS_DeltaSpeedRpmZ "FTCMSCS_DeltaSpeedRpmZ" FLOAT32_IEEE F_1_p0_52 1 2 -3.402823466E+038 3.402823466E+038 ECU_ADDRESS 0x700041B0 /end MEASUREMENT
/begin MEASUREMENT FTCMSCS_EpsilonCtrl "FTCMSCS_EpsilonCtrl" FLOAT32_IEEE F_1_p0_4 1 2 -3.402823466E+038 3.402823466E+038 ECU_ADDRESS 0x700041AC /end MEASUREMENT
/begin MEASUREMENT FTCMSCS_ObsIntegratorZ "FTCMSCS_ObsIntegratorZ" FLOAT32_IEEE F_1_p0_4 1 2 -3.402823466E+038 3.402823466E+038 ECU_ADDRESS 0x700041A8 /end MEASUREMENT
/begin MEASUREMENT FTCMSCS_SpdOverShootCntZ "FTCMSCS_SpdOverShootCntZ" FLOAT32_IEEE F_1_p0_4 1 2 -3.402823466E+038 3.402823466E+038 ECU_ADDRESS 0x700041A4 /end MEASUREMENT
/begin MEASUREMENT FTCMSCS_SpeedModelTrqSatZ "FTCMSCS_SpeedModelTrqSatZ" UBYTE Bool_ON_OFF 1 2 0 1 BIT_MASK 0x01 ECU_ADDRESS 0x700041A0 /end MEASUREMENT
/begin MEASUREMENT FTCMSCS_TorqueTestCountZ "FTCMSCS_TorqueTestCountZ" FLOAT32_IEEE F_1_p0_45 1 2 -3.402823466E+038 3.402823466E+038 ECU_ADDRESS 0x7000419C /end MEASUREMENT
/begin MEASUREMENT FTCMSCS_TorqueTgt "FTCMSCS_TorqueTgt" FLOAT32_IEEE F_1_p0_4 1 2 -3.402823466E+038 3.402823466E+038 ECU_ADDRESS 0x70004198 /end MEASUREMENT
/begin MEASUREMENT FTCMSCS_ZeroSpeedCntZ "FTCMSCS_ZeroSpeedCntZ" FLOAT32_IEEE F_1_p0_4 1 2 -3.402823466E+038 3.402823466E+038 ECU_ADDRESS 0x70004194 /end MEASUREMENT
/begin MEASUREMENT FTCMSCS_fOmegaEstZ "FTCMSCS_fOmegaEstZ" FLOAT32_IEEE F_1_p0_4 1 2 -3.402823466E+038 3.402823466E+038 ECU_ADDRESS 0x70004190 /end MEASUREMENT
/begin MEASUREMENT FTCMSTC_RateLimiterOutZ "FTCMSTC_RateLimiterOutZ" FLOAT32_IEEE F_1_p0_52 1 2 -3.402823466E+038 3.402823466E+038 ECU_ADDRESS 0x700041D0 /end MEASUREMENT
/begin MEASUREMENT FTCMSTC_SpeedRpmTgtFiltered "FTCMSTC_SpeedRpmTgtFiltered" FLOAT32_IEEE F_1_p0_68 1 2 -20000 20000 ECU_ADDRESS 0x700041CC /end MEASUREMENT
/begin MEASUREMENT FTCMTCS_AntiSlideEnaCountOutZ "FTCMTCS_AntiSlideEnaCountOutZ" SLONG F_1_p0_4 1 2 -2147483648 2147483647 ECU_ADDRESS 0x70004270 /end MEASUREMENT
/begin MEASUREMENT FTCMTCS_AntiSlideInhibOutZ "FTCMTCS_AntiSlideInhibOutZ" UBYTE Bool_ON_OFF 1 2 0 1 BIT_MASK 0x01 ECU_ADDRESS 0x7000426D /end MEASUREMENT
/begin MEASUREMENT FTCMTCS_CurrentControllerSat "FTCMTCS_CurrentControllerSat" UBYTE Bool_ON_OFF 1 2 0 1 BIT_MASK 0x01 ECU_ADDRESS 0x7000426C /end MEASUREMENT
/begin MEASUREMENT FTCMTCS_DelVol "FTCMTCS_DelVol" FLOAT32_IEEE F_1_p0_4 1 2 -3.402823466E+038 3.402823466E+038 ECU_ADDRESS 0x70004268 /end MEASUREMENT
/begin MEASUREMENT FTCMTCS_ElecTorqueMaxMin[0] "FTCMTCS_ElecTorqueMaxMin" FLOAT32_IEEE F_1_p0_56 1 2 -3.402823466E+038 3.402823466E+038 ECU_ADDRESS 0x70004260 /end MEASUREMENT
/begin MEASUREMENT FTCMTCS_ElecTorqueMaxMin[1] "FTCMTCS_ElecTorqueMaxMin" FLOAT32_IEEE F_1_p0_56 1 2 -3.402823466E+038 3.402823466E+038 ECU_ADDRESS 0x70004264 /end MEASUREMENT
/begin MEASUREMENT FTCMTCS_ElecTorqueTgt "FTCMTCS_ElecTorqueTgt" FLOAT32_IEEE F_1_p0_56 1 2 -3.402823466E+038 3.402823466E+038 ECU_ADDRESS 0x7000425C /end MEASUREMENT
/begin MEASUREMENT FTCMTCS_EntrySlideCountOutZ "FTCMTCS_EntrySlideCountOutZ" SLONG F_1_p0_4 1 2 -2147483648 2147483647 ECU_ADDRESS 0x70004258 /end MEASUREMENT
/begin MEASUREMENT FTCMTCS_EntrySlideFlag "FTCMTCS_EntrySlideFlag" UBYTE Bool_ON_OFF 1 2 0 1 BIT_MASK 0x01 ECU_ADDRESS 0x70004254 /end MEASUREMENT
/begin MEASUREMENT FTCMTCS_FluxControllerTgt "FTCMTCS_FluxControllerTgt" FLOAT32_IEEE F_1_p0_4 1 2 -3.402823466E+038 3.402823466E+038 ECU_ADDRESS 0x70004250 /end MEASUREMENT
/begin MEASUREMENT FTCMTCS_FluxControllerTgtZ "FTCMTCS_FluxControllerTgtZ" FLOAT32_IEEE F_1_p0_4 1 2 -3.402823466E+038 3.402823466E+038 ECU_ADDRESS 0x7000424C /end MEASUREMENT
/begin MEASUREMENT FTCMTCS_IdTgtAdd "FTCMTCS_IdTgtAdd" FLOAT32_IEEE F_1_p0_46 1 2 -3.402823466E+038 3.402823466E+038 ECU_ADDRESS 0x70004248 /end MEASUREMENT
/begin MEASUREMENT FTCMTCS_IdTgtAdd0 "FTCMTCS_IdTgtAdd0" FLOAT32_IEEE F_1_p0_46 1 2 -3.402823466E+038 3.402823466E+038 ECU_ADDRESS 0x70004244 /end MEASUREMENT
/begin MEASUREMENT FTCMTCS_IdqTgtAddRatio "FTCMTCS_IdqTgtAddRatio" FLOAT32_IEEE F_1_p0_4 1 2 0 1 ECU_ADDRESS 0x70004240 /end MEASUREMENT
/begin MEASUREMENT FTCMTCS_IqTgtAdd "FTCMTCS_IqTgtAdd" FLOAT32_IEEE F_1_p0_4 1 2 -3.402823466E+038 3.402823466E+038 ECU_ADDRESS 0x7000423C /end MEASUREMENT
/begin MEASUREMENT FTCMTCS_KiOut "FTCMTCS_KiOut" FLOAT32_IEEE F_1_p0_4 1 2 -3.402823466E+038 3.402823466E+038 ECU_ADDRESS 0x70004238 /end MEASUREMENT
/begin MEASUREMENT FTCMTCS_KpOut "FTCMTCS_KpOut" FLOAT32_IEEE F_1_p0_4 1 2 -3.402823466E+038 3.402823466E+038 ECU_ADDRESS 0x70004234 /end MEASUREMENT
/begin MEASUREMENT FTCMTCS_MecaSpeedDiff "FTCMTCS_MecaSpeedDiff" FLOAT32_IEEE F_1_p0_4 1 2 -3.402823466E+038 3.402823466E+038 ECU_ADDRESS 0x70004230 /end MEASUREMENT
/begin MEASUREMENT FTCMTCS_MecaSpeedOutZ "FTCMTCS_MecaSpeedOutZ" FLOAT32_IEEE F_1_p0_4 1 2 -3.402823466E+038 3.402823466E+038 ECU_ADDRESS 0x7000422C /end MEASUREMENT
/begin MEASUREMENT FTCMTCS_ParkVoltageTgt "FTCMTCS_ParkVoltageTgt" FLOAT32_IEEE F_1_p0_38 1 2 -3.402823466E+038 3.402823466E+038 ECU_ADDRESS 0x70004228 /end MEASUREMENT
/begin MEASUREMENT FTCMTCS_PhaseVoltagePeakTgt "FTCMTCS_PhaseVoltagePeakTgt" FLOAT32_IEEE F_1_p0_38 1 2 -3.402823466E+038 3.402823466E+038 ECU_ADDRESS 0x70004224 /end MEASUREMENT
/begin MEASUREMENT FTCMTCS_SlideDelayFildZ "FTCMTCS_SlideDelayFildZ" FLOAT32_IEEE F_1_p0_4 1 2 -3.402823466E+038 3.402823466E+038 ECU_ADDRESS 0x70004220 /end MEASUREMENT
/begin MEASUREMENT FTCMTCS_SpdRpmDelayFildZ "FTCMTCS_SpdRpmDelayFildZ" FLOAT32_IEEE F_1_p0_4 1 2 -3.402823466E+038 3.402823466E+038 ECU_ADDRESS 0x7000421C /end MEASUREMENT
/begin MEASUREMENT FTCMTCS_TorqueGain "FTCMTCS_TorqueGain" FLOAT32_IEEE F_1_p0_4 1 2 -3.402823466E+038 3.402823466E+038 ECU_ADDRESS 0x70004218 /end MEASUREMENT
/begin MEASUREMENT FTCMTCS_TorqueGainFild "FTCMTCS_TorqueGainFild" FLOAT32_IEEE F_1_p0_4 1 2 -3.402823466E+038 3.402823466E+038 ECU_ADDRESS 0x70004214 /end MEASUREMENT
/begin MEASUREMENT FTCMTCS_TorqueGainOutZ "FTCMTCS_TorqueGainOutZ" FLOAT32_IEEE F_1_p0_4 1 2 -3.402823466E+038 3.402823466E+038 ECU_ADDRESS 0x70004210 /end MEASUREMENT
/begin MEASUREMENT FTCMTCS_TorqueLimActivation "FTCMTCS_TorqueLimActivation" UBYTE Bool_ON_OFF 1 2 0 1 BIT_MASK 0x01 ECU_ADDRESS 0x7000420C /end MEASUREMENT
/begin MEASUREMENT FTCMTCS_TorqueSlideTgt "FTCMTCS_TorqueSlideTgt" FLOAT32_IEEE F_1_p0_4 1 2 -3.402823466E+038 3.402823466E+038 ECU_ADDRESS 0x70004208 /end MEASUREMENT
/begin MEASUREMENT FTCMTCS_TorqueVolim "FTCMTCS_TorqueVolim" FLOAT32_IEEE F_1_p0_56 1 2 -3.402823466E+038 3.402823466E+038 ECU_ADDRESS 0x70004204 /end MEASUREMENT
/begin MEASUREMENT FTCMTCS_VoltageMargin "FTCMTCS_VoltageMargin" FLOAT32_IEEE F_1_p0_45 1 2 -3.402823466E+038 3.402823466E+038 ECU_ADDRESS 0x70004200 /end MEASUREMENT
/begin MEASUREMENT FTCMTCS_VoltageMarginCorZ "FTCMTCS_VoltageMarginCorZ" FLOAT32_IEEE F_1_p0_4 1 2 -3.402823466E+038 3.402823466E+038 ECU_ADDRESS 0x700041FC /end MEASUREMENT
/begin MEASUREMENT FTCMTCS_i0dqTgt3[0] "FTCMTCS_i0dqTgt3" FLOAT32_IEEE F_1_p0_46 1 2 -3.402823466E+038 3.402823466E+038 ECU_ADDRESS 0x700041F0 /end MEASUREMENT
/begin MEASUREMENT FTCMTCS_i0dqTgt3[1] "FTCMTCS_i0dqTgt3" FLOAT32_IEEE F_1_p0_46 1 2 -3.402823466E+038 3.402823466E+038 ECU_ADDRESS 0x700041F4 /end MEASUREMENT
/begin MEASUREMENT FTCMTCS_i0dqTgt3[2] "FTCMTCS_i0dqTgt3" FLOAT32_IEEE F_1_p0_46 1 2 -3.402823466E+038 3.402823466E+038 ECU_ADDRESS 0x700041F8 /end MEASUREMENT
/begin MEASUREMENT FTCMTCS_idCorTgt "FTCMTCS_idCorTgt" FLOAT32_IEEE F_1_p0_46 1 2 -3.402823466E+038 3.402823466E+038 ECU_ADDRESS 0x700041EC /end MEASUREMENT
/begin MEASUREMENT FTCMTCS_idCorTgtZ "FTCMTCS_idCorTgtZ" FLOAT32_IEEE F_1_p0_46 1 2 -3.402823466E+038 3.402823466E+038 ECU_ADDRESS 0x700041E8 /end MEASUREMENT
/begin MEASUREMENT FTCMTCS_idLutAddTgt "FTCMTCS_idLutAddTgt" FLOAT32_IEEE F_1_p0_46 1 2 -3.402823466E+038 3.402823466E+038 ECU_ADDRESS 0x700041E4 /end MEASUREMENT
/begin MEASUREMENT FTCMTCS_idLutTgt "FTCMTCS_idLutTgt" FLOAT32_IEEE F_1_p0_46 1 2 -3.402823466E+038 3.402823466E+038 ECU_ADDRESS 0x700041E0 /end MEASUREMENT
/begin MEASUREMENT FTCMTCS_idLutTgtZ "FTCMTCS_idLutTgtZ" FLOAT32_IEEE F_1_p0_46 1 2 -3.402823466E+038 3.402823466E+038 ECU_ADDRESS 0x700041DC /end MEASUREMENT
/begin MEASUREMENT FTCMTCS_iqLutAddTgt "FTCMTCS_iqLutAddTgt" FLOAT32_IEEE F_1_p0_46 1 2 -3.402823466E+038 3.402823466E+038 ECU_ADDRESS 0x700041D8 /end MEASUREMENT
/begin MEASUREMENT FTCMTCS_iqLutTgt "FTCMTCS_iqLutTgt" FLOAT32_IEEE F_1_p0_46 1 2 -3.402823466E+038 3.402823466E+038 ECU_ADDRESS 0x700041D4 /end MEASUREMENT
/begin MEASUREMENT FTCMTTC_AfterPreTorqueTgt "After pretorque model torque target" FLOAT32_IEEE F_1_p0_56 1 2 -3.402823466E+038 3.402823466E+038 ECU_ADDRESS 0x700042FC /end MEASUREMENT
/begin MEASUREMENT FTCMTTC_AntiJerkBaseGain "FTCMTTC_AntiJerkBaseGain" FLOAT32_IEEE F_1_p0_45 1 2 -3.402823466E+038 3.402823466E+038 ECU_ADDRESS 0x700042F8 /end MEASUREMENT
/begin MEASUREMENT FTCMTTC_AntiJerkMecaTorqueTgt "FTCMTTC_AntiJerkMecaTorqueTgt" FLOAT32_IEEE F_1_p0_4 1 2 -3.402823466E+038 3.402823466E+038 ECU_ADDRESS 0x700042F4 /end MEASUREMENT
/begin MEASUREMENT FTCMTTC_AntiJerkTrqTgt "FTCMTTC_AntiJerkTrqTgt" FLOAT32_IEEE F_1_p0_4 1 2 -3.402823466E+038 3.402823466E+038 ECU_ADDRESS 0x700042F0 /end MEASUREMENT
/begin MEASUREMENT FTCMTTC_AntiJerkTrqTgtHpZ "FTCMTTC_AntiJerkTrqTgtHpZ" FLOAT32_IEEE F_1_p0_4 1 2 -3.402823466E+038 3.402823466E+038 ECU_ADDRESS 0x700042EC /end MEASUREMENT
/begin MEASUREMENT FTCMTTC_AntiJerkTrqTgtZ "FTCMTTC_AntiJerkTrqTgtZ" FLOAT32_IEEE F_1_p0_4 1 2 -3.402823466E+038 3.402823466E+038 ECU_ADDRESS 0x700042E8 /end MEASUREMENT
/begin MEASUREMENT FTCMTTC_AtjkBpAccTorqueTgt "FTCMTTC_AtjkBpAccTorqueTgt" FLOAT32_IEEE F_1_p0_4 1 2 -3.402823466E+038 3.402823466E+038 ECU_ADDRESS 0x700042E4 /end MEASUREMENT
/begin MEASUREMENT FTCMTTC_AtjkDeltaTorqueTgt "FTCMTTC_AtjkDeltaTorqueTgt" FLOAT32_IEEE F_1_p0_49 1 2 -3.402823466E+038 3.402823466E+038 ECU_ADDRESS 0x700042E0 /end MEASUREMENT
/begin MEASUREMENT FTCMTTC_BpLowCutOffFrequency "FTCMTTC_BpLowCutOffFrequency" FLOAT32_IEEE F_1_p0_35 1 2 -3.402823466E+038 3.402823466E+038 ECU_ADDRESS 0x700042DC /end MEASUREMENT
/begin MEASUREMENT FTCMTTC_DampTorqueCompTgt "FTCMTTC_DampTorqueCompTgt" FLOAT32_IEEE F_1_p0_4 1 2 -3.402823466E+038 3.402823466E+038 ECU_ADDRESS 0x700042D8 /end MEASUREMENT
/begin MEASUREMENT FTCMTTC_DampingActive "FTCMTTC_DampingActive" UBYTE Bool_ON_OFF 1 2 0 1 BIT_MASK 0x01 ECU_ADDRESS 0x700042D5 /end MEASUREMENT
/begin MEASUREMENT FTCMTTC_DampingSpdHighDetnZ "FTCMTTC_DampingSpdHighDetnZ" UBYTE Bool_ON_OFF 1 2 0 1 BIT_MASK 0x01 ECU_ADDRESS 0x700042D4 /end MEASUREMENT
/begin MEASUREMENT FTCMTTC_DeltaSpeedRpm "FTCMTTC_DeltaSpeedRpm" FLOAT32_IEEE F_1_p0_52 1 2 -3.402823466E+038 3.402823466E+038 ECU_ADDRESS 0x700042D0 /end MEASUREMENT
/begin MEASUREMENT FTCMTTC_ElecTorqueTgt "FTCMTTC_ElecTorqueTgt" FLOAT32_IEEE F_1_p0_4 1 2 -3.402823466E+038 3.402823466E+038 ECU_ADDRESS 0x700042CC /end MEASUREMENT
/begin MEASUREMENT FTCMTTC_ElecTorqueTgtCor "FTCMTTC_ElecTorqueTgtCor" FLOAT32_IEEE F_1_p0_4 1 2 -3.402823466E+038 3.402823466E+038 ECU_ADDRESS 0x700042C8 /end MEASUREMENT
/begin MEASUREMENT FTCMTTC_ElecTorqueTgtFild "Electromagnetic torque target" FLOAT32_IEEE F_1_p0_56 1 2 -3.402823466E+038 3.402823466E+038 ECU_ADDRESS 0x700042C4 /end MEASUREMENT
/begin MEASUREMENT FTCMTTC_ElecTorqueTgtFildZ "FTCMTTC_ElecTorqueTgtFildZ" FLOAT32_IEEE F_1_p0_4 1 2 -3.402823466E+038 3.402823466E+038 ECU_ADDRESS 0x700042C0 /end MEASUREMENT
/begin MEASUREMENT FTCMTTC_ElecTorqueTgtTotal "FTCMTTC_ElecTorqueTgtTotal" FLOAT32_IEEE F_1_p0_49 1 2 -3.402823466E+038 3.402823466E+038 ECU_ADDRESS 0x700042BC /end MEASUREMENT
/begin MEASUREMENT FTCMTTC_ElecTorqueTgtZ "FTCMTTC_ElecTorqueTgtZ" FLOAT32_IEEE F_1_p0_4 1 2 -3.402823466E+038 3.402823466E+038 ECU_ADDRESS 0x700042B8 /end MEASUREMENT
/begin MEASUREMENT FTCMTTC_MecaPowerMaxMin[0] "FTCMTTC_MecaPowerMaxMin" FLOAT32_IEEE F_1_p0_4 1 2 -3.402823466E+038 3.402823466E+038 ECU_ADDRESS 0x700042B0 /end MEASUREMENT
/begin MEASUREMENT FTCMTTC_MecaPowerMaxMin[1] "FTCMTTC_MecaPowerMaxMin" FLOAT32_IEEE F_1_p0_4 1 2 -3.402823466E+038 3.402823466E+038 ECU_ADDRESS 0x700042B4 /end MEASUREMENT
/begin MEASUREMENT FTCMTTC_MecaSpeedAccSlewRate "FTCMTTC_MecaSpeedAccSlewRate" FLOAT32_IEEE F_1_p0_4 1 2 -3.402823466E+038 3.402823466E+038 ECU_ADDRESS 0x700042AC /end MEASUREMENT
/begin MEASUREMENT FTCMTTC_MecaSpeedRpmFildZ "FTCMTTC_MecaSpeedRpmFildZ" FLOAT32_IEEE F_1_p0_4 1 2 -3.402823466E+038 3.402823466E+038 ECU_ADDRESS 0x700042A8 /end MEASUREMENT
/begin MEASUREMENT FTCMTTC_MecaSpeedRpmLpZ "FTCMTTC_MecaSpeedRpmLpZ" FLOAT32_IEEE F_1_p0_4 1 2 -3.402823466E+038 3.402823466E+038 ECU_ADDRESS 0x700042A4 /end MEASUREMENT
/begin MEASUREMENT FTCMTTC_MecaTorMax2CAN "FTCMTTC_MecaTorMax2CAN" FLOAT32_IEEE F_1_p0_4 1 2 -3.402823466E+038 3.402823466E+038 ECU_ADDRESS 0x700042A0 /end MEASUREMENT
/begin MEASUREMENT FTCMTTC_MecaTorMin2CAN "FTCMTTC_MecaTorMin2CAN" FLOAT32_IEEE F_1_p0_4 1 2 -3.402823466E+038 3.402823466E+038 ECU_ADDRESS 0x7000429C /end MEASUREMENT
/begin MEASUREMENT FTCMTTC_MecaTorqueMax "FTCMTTC_MecaTorqueMax" FLOAT32_IEEE F_1_p0_4 1 2 -3.402823466E+038 3.402823466E+038 ECU_ADDRESS 0x70004298 /end MEASUREMENT
/begin MEASUREMENT FTCMTTC_MecaTorqueMaxMin[0] "FTCMTTC_MecaTorqueMaxMin" FLOAT32_IEEE F_1_p0_56 1 2 -3.402823466E+038 3.402823466E+038 ECU_ADDRESS 0x70004290 /end MEASUREMENT
/begin MEASUREMENT FTCMTTC_MecaTorqueMaxMin[1] "FTCMTTC_MecaTorqueMaxMin" FLOAT32_IEEE F_1_p0_56 1 2 -3.402823466E+038 3.402823466E+038 ECU_ADDRESS 0x70004294 /end MEASUREMENT
/begin MEASUREMENT FTCMTTC_MecaTorqueMin "FTCMTTC_MecaTorqueMin" FLOAT32_IEEE F_1_p0_4 1 2 -3.402823466E+038 3.402823466E+038 ECU_ADDRESS 0x7000428C /end MEASUREMENT
/begin MEASUREMENT FTCMTTC_MecaTorqueTgt "Limited mechanical torque target" FLOAT32_IEEE F_1_p0_56 1 2 -3.402823466E+038 3.402823466E+038 ECU_ADDRESS 0x70004288 /end MEASUREMENT
/begin MEASUREMENT FTCMTTC_PowLmtTorqureRaw "FTCMTTC_PowLmtTorqureRaw" FLOAT32_IEEE F_1_p0_4 1 2 -3.402823466E+038 3.402823466E+038 ECU_ADDRESS 0x70004284 /end MEASUREMENT
/begin MEASUREMENT FTCMTTC_PreTorqueFlg "FTCMTTC_PreTorqueFlg" UBYTE Bool_ON_OFF 1 2 0 1 BIT_MASK 0x01 ECU_ADDRESS 0x70004280 /end MEASUREMENT
/begin MEASUREMENT FTCMTTC_RealMecaTorqueTgt "FTCMTTC_RealMecaTorqueTgt" FLOAT32_IEEE F_1_p0_4 1 2 -3.402823466E+038 3.402823466E+038 ECU_ADDRESS 0x7000427C /end MEASUREMENT
/begin MEASUREMENT FTCMTTC_TempPreTorqTrasStep "FTCMTTC_TempPreTorqTrasStep" FLOAT32_IEEE F_1_p0_4 1 2 -3.402823466E+038 3.402823466E+038 ECU_ADDRESS 0x70004278 /end MEASUREMENT
/begin MEASUREMENT FTCMTTC_TorqueHpFilterEnable "FTCMTTC_TorqueHpFilterEnable" UBYTE Bool_ON_OFF 1 2 0 1 BIT_MASK 0x01 ECU_ADDRESS 0x70004277 /end MEASUREMENT
/begin MEASUREMENT FTCMTTC_TorqueHpFilterEnableZ "FTCMTTC_TorqueHpFilterEnableZ" UBYTE Bool_ON_OFF 1 2 0 1 BIT_MASK 0x01 ECU_ADDRESS 0x70004276 /end MEASUREMENT
/begin MEASUREMENT FTCMTTC_TrqTrasitionFlg "FTCMTTC_TrqTrasitionFlg" UBYTE Bool_ON_OFF 1 2 0 1 BIT_MASK 0x01 ECU_ADDRESS 0x70004275 /end MEASUREMENT
/begin MEASUREMENT FTCMTTC_TsatActv "FTCMTTC_TsatActv" UBYTE Bool_ON_OFF 1 2 0 1 BIT_MASK 0x01 ECU_ADDRESS 0x70004274 /end MEASUREMENT
/begin MEASUREMENT FTDDLMP_MaxMinI0dqLimitVect "The maximum&amp;minimum current of I0,Id,Iq limit value in limp control mode." FLOAT32_IEEE F_1_p0_46 1 2 -1200 1200 MATRIX_DIM 1 6 1 ECU_ADDRESS 0x70004310 /end MEASUREMENT
/begin MEASUREMENT FTDDLMP_MaxMinI0dqLimitVect[0] "FTDDLMP_MaxMinI0dqLimitVect[0]" FLOAT32_IEEE F_1_p0_46 1 2 -1200 1200 ECU_ADDRESS 0x70004310 /end MEASUREMENT
/begin MEASUREMENT FTDDLMP_MaxMinI0dqLimitVect[1] "FTDDLMP_MaxMinI0dqLimitVect[1]" FLOAT32_IEEE F_1_p0_46 1 2 -1200 1200 ECU_ADDRESS 0x70004314 /end MEASUREMENT
/begin MEASUREMENT FTDDLMP_MaxMinI0dqLimitVect[2] "FTDDLMP_MaxMinI0dqLimitVect[2]" FLOAT32_IEEE F_1_p0_46 1 2 -1200 1200 ECU_ADDRESS 0x70004318 /end MEASUREMENT
/begin MEASUREMENT FTDDLMP_MaxMinI0dqLimitVect[3] "FTDDLMP_MaxMinI0dqLimitVect[3]" FLOAT32_IEEE F_1_p0_46 1 2 -1200 1200 ECU_ADDRESS 0x7000431C /end MEASUREMENT
/begin MEASUREMENT FTDDLMP_MaxMinI0dqLimitVect[4] "FTDDLMP_MaxMinI0dqLimitVect[4]" FLOAT32_IEEE F_1_p0_46 1 2 -1200 1200 ECU_ADDRESS 0x70004320 /end MEASUREMENT
/begin MEASUREMENT FTDDLMP_MaxMinI0dqLimitVect[5] "FTDDLMP_MaxMinI0dqLimitVect[5]" FLOAT32_IEEE F_1_p0_46 1 2 -1200 1200 ECU_ADDRESS 0x70004324 /end MEASUREMENT
/begin MEASUREMENT FTDDLMP_MaxMinSpdLimitVect "The maximum&amp;minimum speed limit value in limp control mode." FLOAT32_IEEE F_1_p0_52 1 2 -25000 25000 MATRIX_DIM 1 2 1 ECU_ADDRESS 0x70004308 /end MEASUREMENT
/begin MEASUREMENT FTDDLMP_MaxMinSpdLimitVect[0] "FTDDLMP_MaxMinSpdLimitVect[0]" FLOAT32_IEEE F_1_p0_52 1 2 -25000 25000 ECU_ADDRESS 0x70004308 /end MEASUREMENT
/begin MEASUREMENT FTDDLMP_MaxMinSpdLimitVect[1] "FTDDLMP_MaxMinSpdLimitVect[1]" FLOAT32_IEEE F_1_p0_52 1 2 -25000 25000 ECU_ADDRESS 0x7000430C /end MEASUREMENT
/begin MEASUREMENT FTDDLMP_MaxMinTorqueLimitVect "Maximum or Minimum Torque Limit Value." FLOAT32_IEEE F_1_p0_56 1 2 -500 500 MATRIX_DIM 1 2 1 ECU_ADDRESS 0x70004300 /end MEASUREMENT
/begin MEASUREMENT FTDDLMP_MaxMinTorqueLimitVect[0] "FTDDLMP_MaxMinTorqueLimitVect[0]" FLOAT32_IEEE F_1_p0_56 1 2 -500 500 ECU_ADDRESS 0x70004300 /end MEASUREMENT
/begin MEASUREMENT FTDDLMP_MaxMinTorqueLimitVect[1] "FTDDLMP_MaxMinTorqueLimitVect[1]" FLOAT32_IEEE F_1_p0_56 1 2 -500 500 ECU_ADDRESS 0x70004304 /end MEASUREMENT
/begin MEASUREMENT FTEVEIT_CommutGain "gain of commutation losses for different pwm frequence" FLOAT32_IEEE F_1_p0_4 1 2 0.125 1 ECU_ADDRESS 0x7000471C /end MEASUREMENT
/begin MEASUREMENT FTEVEIT_CommutLossesDH_UL "Estimation of commutation losses of DH leg_UL." FLOAT32_IEEE F_1_p0_69 1 2 0 1000000 ECU_ADDRESS 0x70004718 /end MEASUREMENT
/begin MEASUREMENT FTEVEIT_CommutLossesDH_VL "Estimation of commutation losses of DH leg_VL." FLOAT32_IEEE F_1_p0_69 1 2 0 1000000 ECU_ADDRESS 0x70004714 /end MEASUREMENT
/begin MEASUREMENT FTEVEIT_CommutLossesDH_WL "Estimation of commutation losses of DH leg_WL." FLOAT32_IEEE F_1_p0_69 1 2 0 1000000 ECU_ADDRESS 0x70004710 /end MEASUREMENT
/begin MEASUREMENT FTEVEIT_CommutLossesDL_UL "Estimation of commutation losses of DL leg_UL." FLOAT32_IEEE F_1_p0_69 1 2 0 1000000 ECU_ADDRESS 0x7000470C /end MEASUREMENT
/begin MEASUREMENT FTEVEIT_CommutLossesDL_VL "Estimation of commutation losses of DL leg_VL." FLOAT32_IEEE F_1_p0_69 1 2 0 1000000 ECU_ADDRESS 0x70004708 /end MEASUREMENT
/begin MEASUREMENT FTEVEIT_CommutLossesDL_WL "Estimation of commutation losses of DL leg_WL." FLOAT32_IEEE F_1_p0_69 1 2 0 1000000 ECU_ADDRESS 0x70004704 /end MEASUREMENT
/begin MEASUREMENT FTEVEIT_CommutLossesTH_UL "Estimation of commutation losses of TH leg_UL." FLOAT32_IEEE F_1_p0_69 1 2 0 1000000 ECU_ADDRESS 0x70004700 /end MEASUREMENT
/begin MEASUREMENT FTEVEIT_CommutLossesTH_VL "Estimation of commutation losses of TH leg_VL." FLOAT32_IEEE F_1_p0_69 1 2 0 1000000 ECU_ADDRESS 0x700046FC /end MEASUREMENT
/begin MEASUREMENT FTEVEIT_CommutLossesTH_WL "Estimation of commutation losses of TH leg_WL." FLOAT32_IEEE F_1_p0_69 1 2 0 1000000 ECU_ADDRESS 0x700046F8 /end MEASUREMENT
/begin MEASUREMENT FTEVEIT_CommutLossesTL_UL "Estimation of commutation losses of TL leg_UL." FLOAT32_IEEE F_1_p0_69 1 2 0 1000000 ECU_ADDRESS 0x700046F4 /end MEASUREMENT
/begin MEASUREMENT FTEVEIT_CommutLossesTL_VL "Estimation of commutation losses of TL leg_VL." FLOAT32_IEEE F_1_p0_69 1 2 0 1000000 ECU_ADDRESS 0x700046F0 /end MEASUREMENT
/begin MEASUREMENT FTEVEIT_CommutLossesTL_WL "Estimation of commutation losses of TL leg_WL." FLOAT32_IEEE F_1_p0_69 1 2 0 1000000 ECU_ADDRESS 0x700046EC /end MEASUREMENT
/begin MEASUREMENT FTEVEIT_CondLossesDH_UL "Estimation of conduction losses of DH leg_UL." FLOAT32_IEEE F_1_p0_69 1 2 0 1000000 ECU_ADDRESS 0x700046E8 /end MEASUREMENT
/begin MEASUREMENT FTEVEIT_CondLossesDH_VL "Estimation of conduction losses of DH leg_VL." FLOAT32_IEEE F_1_p0_69 1 2 0 1000000 ECU_ADDRESS 0x700046E4 /end MEASUREMENT
/begin MEASUREMENT FTEVEIT_CondLossesDH_WL "Estimation of conduction losses of DH leg_WL." FLOAT32_IEEE F_1_p0_69 1 2 0 1000000 ECU_ADDRESS 0x700046E0 /end MEASUREMENT
/begin MEASUREMENT FTEVEIT_CondLossesDL_UL "Estimation of conduction losses of DL leg_UL." FLOAT32_IEEE F_1_p0_69 1 2 0 1000000 ECU_ADDRESS 0x700046DC /end MEASUREMENT
/begin MEASUREMENT FTEVEIT_CondLossesDL_VL "Estimation of conduction losses of DL leg_VL." FLOAT32_IEEE F_1_p0_69 1 2 0 1000000 ECU_ADDRESS 0x700046D8 /end MEASUREMENT
/begin MEASUREMENT FTEVEIT_CondLossesDL_WL "Estimation of conduction losses of DL leg_WL." FLOAT32_IEEE F_1_p0_69 1 2 0 1000000 ECU_ADDRESS 0x700046D4 /end MEASUREMENT
/begin MEASUREMENT FTEVEIT_CondLossesTH_UL "Estimation of conduction losses of TH leg_UL." FLOAT32_IEEE F_1_p0_69 1 2 0 1000000 ECU_ADDRESS 0x700046D0 /end MEASUREMENT
/begin MEASUREMENT FTEVEIT_CondLossesTH_VL "Estimation of conduction losses of TH leg_VL." FLOAT32_IEEE F_1_p0_69 1 2 0 1000000 ECU_ADDRESS 0x700046CC /end MEASUREMENT
/begin MEASUREMENT FTEVEIT_CondLossesTH_WL "Estimation of conduction losses of TH leg_WL." FLOAT32_IEEE F_1_p0_69 1 2 0 1000000 ECU_ADDRESS 0x700046C8 /end MEASUREMENT
/begin MEASUREMENT FTEVEIT_CondLossesTL_UL "Estimation of conduction losses of TL leg_UL." FLOAT32_IEEE F_1_p0_69 1 2 0 1000000 ECU_ADDRESS 0x700046C4 /end MEASUREMENT
/begin MEASUREMENT FTEVEIT_CondLossesTL_VL "Estimation of conduction losses of TL leg_VL." FLOAT32_IEEE F_1_p0_69 1 2 0 1000000 ECU_ADDRESS 0x700046C0 /end MEASUREMENT
/begin MEASUREMENT FTEVEIT_CondLossesTL_WL "Estimation of conduction losses of TL leg_WL." FLOAT32_IEEE F_1_p0_69 1 2 0 1000000 ECU_ADDRESS 0x700046BC /end MEASUREMENT
/begin MEASUREMENT FTEVEIT_CurrDH_UL "Estimation of current crossing DH leg_UL." FLOAT32_IEEE F_1_p0_46 1 2 0 1000 ECU_ADDRESS 0x700046B8 /end MEASUREMENT
/begin MEASUREMENT FTEVEIT_CurrDH_VL "Estimation of current crossing DH leg_VL." FLOAT32_IEEE F_1_p0_46 1 2 0 1000 ECU_ADDRESS 0x700046B4 /end MEASUREMENT
/begin MEASUREMENT FTEVEIT_CurrDH_WL "Estimation of current crossing DH leg_WL." FLOAT32_IEEE F_1_p0_46 1 2 0 1000 ECU_ADDRESS 0x700046B0 /end MEASUREMENT
/begin MEASUREMENT FTEVEIT_CurrDL_UL "Estimation of current crossing DL leg_UL." FLOAT32_IEEE F_1_p0_46 1 2 0 1000 ECU_ADDRESS 0x700046AC /end MEASUREMENT
/begin MEASUREMENT FTEVEIT_CurrDL_VL "Estimation of current crossing DL leg_VL." FLOAT32_IEEE F_1_p0_46 1 2 0 1000 ECU_ADDRESS 0x700046A8 /end MEASUREMENT
/begin MEASUREMENT FTEVEIT_CurrDL_WL "Estimation of current crossing DL leg_WL." FLOAT32_IEEE F_1_p0_46 1 2 0 1000 ECU_ADDRESS 0x700046A4 /end MEASUREMENT
/begin MEASUREMENT FTEVEIT_CurrTH_UL "Estimation of current crossing TH leg_UL." FLOAT32_IEEE F_1_p0_46 1 2 0 1000 ECU_ADDRESS 0x700046A0 /end MEASUREMENT
/begin MEASUREMENT FTEVEIT_CurrTH_VL "Estimation of current crossing TH leg_VL." FLOAT32_IEEE F_1_p0_46 1 2 0 1000 ECU_ADDRESS 0x7000469C /end MEASUREMENT
/begin MEASUREMENT FTEVEIT_CurrTH_WL "Estimation of current crossing TH leg_WL." FLOAT32_IEEE F_1_p0_46 1 2 0 1000 ECU_ADDRESS 0x70004698 /end MEASUREMENT
/begin MEASUREMENT FTEVEIT_CurrTL_UL "Estimation of current crossing TL leg_UL." FLOAT32_IEEE F_1_p0_46 1 2 0 1000 ECU_ADDRESS 0x70004694 /end MEASUREMENT
/begin MEASUREMENT FTEVEIT_CurrTL_VL "Estimation of current crossing TL leg_VL." FLOAT32_IEEE F_1_p0_46 1 2 0 1000 ECU_ADDRESS 0x70004690 /end MEASUREMENT
/begin MEASUREMENT FTEVEIT_CurrTL_WL "Estimation of current crossing TL leg_WL." FLOAT32_IEEE F_1_p0_46 1 2 0 1000 ECU_ADDRESS 0x7000468C /end MEASUREMENT
/begin MEASUREMENT FTEVEIT_EnableInit "Initialization part is enable." UBYTE Bool_ON_OFF 1 2 0 1 BIT_MASK 0x01 ECU_ADDRESS 0x7000468A /end MEASUREMENT
/begin MEASUREMENT FTEVEIT_EnableKO "Estimation part is disable." UBYTE Bool_ON_OFF 1 2 0 1 BIT_MASK 0x01 ECU_ADDRESS 0x70004689 /end MEASUREMENT
/begin MEASUREMENT FTEVEIT_EnableOK "Estimation part is enable." UBYTE Bool_ON_OFF 1 2 0 1 BIT_MASK 0x01 ECU_ADDRESS 0x70004688 /end MEASUREMENT
/begin MEASUREMENT FTEVEIT_EstimTempDHVect[0] "Estimation of DH junction temperature for all legs." FLOAT32_IEEE F_1_p0_72 1 2 -200 400 ECU_ADDRESS 0x7000467C /end MEASUREMENT
/begin MEASUREMENT FTEVEIT_EstimTempDHVect[1] "Estimation of DH junction temperature for all legs." FLOAT32_IEEE F_1_p0_72 1 2 -200 400 ECU_ADDRESS 0x70004680 /end MEASUREMENT
/begin MEASUREMENT FTEVEIT_EstimTempDHVect[2] "Estimation of DH junction temperature for all legs." FLOAT32_IEEE F_1_p0_72 1 2 -200 400 ECU_ADDRESS 0x70004684 /end MEASUREMENT
/begin MEASUREMENT FTEVEIT_EstimTempDH_UL "Estimation of DH junction temperature leg_UL." FLOAT32_IEEE F_1_p0_72 1 2 -200 400 ECU_ADDRESS 0x70004678 /end MEASUREMENT
/begin MEASUREMENT FTEVEIT_EstimTempDH_VL "Estimation of DH junction temperature leg_VL." FLOAT32_IEEE F_1_p0_72 1 2 -200 400 ECU_ADDRESS 0x70004674 /end MEASUREMENT
/begin MEASUREMENT FTEVEIT_EstimTempDH_WL "Estimation of DH junction temperature leg_WL." FLOAT32_IEEE F_1_p0_72 1 2 -200 400 ECU_ADDRESS 0x70004670 /end MEASUREMENT
/begin MEASUREMENT FTEVEIT_EstimTempDLVect[0] "Estimation of DL junction temperature for all legs." FLOAT32_IEEE F_1_p0_72 1 2 -200 400 ECU_ADDRESS 0x70004664 /end MEASUREMENT
/begin MEASUREMENT FTEVEIT_EstimTempDLVect[1] "Estimation of DL junction temperature for all legs." FLOAT32_IEEE F_1_p0_72 1 2 -200 400 ECU_ADDRESS 0x70004668 /end MEASUREMENT
/begin MEASUREMENT FTEVEIT_EstimTempDLVect[2] "Estimation of DL junction temperature for all legs." FLOAT32_IEEE F_1_p0_72 1 2 -200 400 ECU_ADDRESS 0x7000466C /end MEASUREMENT
/begin MEASUREMENT FTEVEIT_EstimTempDL_UL "Estimation of DL junction temperature leg_UL." FLOAT32_IEEE F_1_p0_72 1 2 -200 400 ECU_ADDRESS 0x70004660 /end MEASUREMENT
/begin MEASUREMENT FTEVEIT_EstimTempDL_VL "Estimation of DL junction temperature leg_VL." FLOAT32_IEEE F_1_p0_72 1 2 -200 400 ECU_ADDRESS 0x7000465C /end MEASUREMENT
/begin MEASUREMENT FTEVEIT_EstimTempDL_WL "Estimation of DL junction temperature leg_WL." FLOAT32_IEEE F_1_p0_72 1 2 -200 400 ECU_ADDRESS 0x70004658 /end MEASUREMENT
/begin MEASUREMENT FTEVEIT_EstimTempFirstFild "Current value of the maximal estimated temperature after the first filter." FLOAT32_IEEE F_1_p0_72 1 2 -40 200 ECU_ADDRESS 0x70004654 /end MEASUREMENT
/begin MEASUREMENT FTEVEIT_EstimTempFirstFildZ "Previous value of the maximal estimated temperature after the first filter." FLOAT32_IEEE F_1_p0_72 1 2 -40 200 ECU_ADDRESS 0x70004650 /end MEASUREMENT
/begin MEASUREMENT FTEVEIT_EstimTempSecFild "Current value of the maximal estimated temperature after the second filter." FLOAT32_IEEE F_1_p0_72 1 2 -40 200 ECU_ADDRESS 0x7000464C /end MEASUREMENT
/begin MEASUREMENT FTEVEIT_EstimTempSecFildZ "Previous value of the maximal estimated temperature after the second filter." FLOAT32_IEEE F_1_p0_72 1 2 -40 200 ECU_ADDRESS 0x70004648 /end MEASUREMENT
/begin MEASUREMENT FTEVEIT_EstimTempTHVect[0] "Estimation of TH junction temperature for all legs." FLOAT32_IEEE F_1_p0_72 1 2 -200 400 ECU_ADDRESS 0x7000463C /end MEASUREMENT
/begin MEASUREMENT FTEVEIT_EstimTempTHVect[1] "Estimation of TH junction temperature for all legs." FLOAT32_IEEE F_1_p0_72 1 2 -200 400 ECU_ADDRESS 0x70004640 /end MEASUREMENT
/begin MEASUREMENT FTEVEIT_EstimTempTHVect[2] "Estimation of TH junction temperature for all legs." FLOAT32_IEEE F_1_p0_72 1 2 -200 400 ECU_ADDRESS 0x70004644 /end MEASUREMENT
/begin MEASUREMENT FTEVEIT_EstimTempTH_UL "Estimation of TH junction temperature leg_UL." FLOAT32_IEEE F_1_p0_72 1 2 -200 400 ECU_ADDRESS 0x70004638 /end MEASUREMENT
/begin MEASUREMENT FTEVEIT_EstimTempTH_VL "Estimation of TH junction temperature leg_VL." FLOAT32_IEEE F_1_p0_72 1 2 -200 400 ECU_ADDRESS 0x70004634 /end MEASUREMENT
/begin MEASUREMENT FTEVEIT_EstimTempTH_WL "Estimation of TH junction temperature leg_WL." FLOAT32_IEEE F_1_p0_72 1 2 -200 400 ECU_ADDRESS 0x70004630 /end MEASUREMENT
/begin MEASUREMENT FTEVEIT_EstimTempTLVect[0] "Estimation of TL junction temperature for all legs." FLOAT32_IEEE F_1_p0_72 1 2 -200 400 ECU_ADDRESS 0x70004624 /end MEASUREMENT
/begin MEASUREMENT FTEVEIT_EstimTempTLVect[1] "Estimation of TL junction temperature for all legs." FLOAT32_IEEE F_1_p0_72 1 2 -200 400 ECU_ADDRESS 0x70004628 /end MEASUREMENT
/begin MEASUREMENT FTEVEIT_EstimTempTLVect[2] "Estimation of TL junction temperature for all legs." FLOAT32_IEEE F_1_p0_72 1 2 -200 400 ECU_ADDRESS 0x7000462C /end MEASUREMENT
/begin MEASUREMENT FTEVEIT_EstimTempTL_UL "Estimation of TL junction temperature leg_UL." FLOAT32_IEEE F_1_p0_72 1 2 -200 400 ECU_ADDRESS 0x70004620 /end MEASUREMENT
/begin MEASUREMENT FTEVEIT_EstimTempTL_VL "Estimation of TL junction temperature leg_VL." FLOAT32_IEEE F_1_p0_72 1 2 -200 400 ECU_ADDRESS 0x7000461C /end MEASUREMENT
/begin MEASUREMENT FTEVEIT_EstimTempTL_WL "Estimation of TL junction temperature leg_WL." FLOAT32_IEEE F_1_p0_72 1 2 -200 400 ECU_ADDRESS 0x70004618 /end MEASUREMENT
/begin MEASUREMENT FTEVEIT_HysteresisZ "Hysteresis previous value." UBYTE Bool_ON_OFF 1 2 0 1 BIT_MASK 0x01 ECU_ADDRESS 0x70004614 /end MEASUREMENT
/begin MEASUREMENT FTEVEIT_PdhTdhS1_UL "DH junction temperature estimation from DH power losses leg_UL subsytem 1." FLOAT32_IEEE F_1_p0_72 1 2 -200 400 ECU_ADDRESS 0x70004610 /end MEASUREMENT
/begin MEASUREMENT FTEVEIT_PdhTdhS1_VL "DH junction temperature estimation from DH power losses leg_VL subsytem 1." FLOAT32_IEEE F_1_p0_72 1 2 -200 400 ECU_ADDRESS 0x7000460C /end MEASUREMENT
/begin MEASUREMENT FTEVEIT_PdhTdhS1_WL "DH junction temperature estimation from DH power losses leg_WL subsytem 1." FLOAT32_IEEE F_1_p0_72 1 2 -200 400 ECU_ADDRESS 0x70004608 /end MEASUREMENT
/begin MEASUREMENT FTEVEIT_PdhTdhS2_UL "DH junction temperature estimation from DH power losses leg_UL subsytem 2." FLOAT32_IEEE F_1_p0_72 1 2 -200 400 ECU_ADDRESS 0x70004604 /end MEASUREMENT
/begin MEASUREMENT FTEVEIT_PdhTdhS2_VL "DH junction temperature estimation from DH power losses leg_VL subsytem 2." FLOAT32_IEEE F_1_p0_72 1 2 -200 400 ECU_ADDRESS 0x70004600 /end MEASUREMENT
/begin MEASUREMENT FTEVEIT_PdhTdhS2_WL "DH junction temperature estimation from DH power losses leg_WL subsytem 2." FLOAT32_IEEE F_1_p0_72 1 2 -200 400 ECU_ADDRESS 0x700045FC /end MEASUREMENT
/begin MEASUREMENT FTEVEIT_PdhTdhS3_UL "DH junction temperature estimation from DH power losses leg_UL subsytem 3." FLOAT32_IEEE F_1_p0_72 1 2 -200 400 ECU_ADDRESS 0x700045F8 /end MEASUREMENT
/begin MEASUREMENT FTEVEIT_PdhTdhS3_VL "DH junction temperature estimation from DH power losses leg_VL subsytem 3." FLOAT32_IEEE F_1_p0_72 1 2 -200 400 ECU_ADDRESS 0x700045F4 /end MEASUREMENT
/begin MEASUREMENT FTEVEIT_PdhTdhS3_WL "DH junction temperature estimation from DH power losses leg_WL subsytem 3." FLOAT32_IEEE F_1_p0_72 1 2 -200 400 ECU_ADDRESS 0x700045F0 /end MEASUREMENT
/begin MEASUREMENT FTEVEIT_PdhTdhS4_UL "DH junction temperature estimation from DH power losses leg_UL subsytem 4." FLOAT32_IEEE F_1_p0_72 1 2 -200 400 ECU_ADDRESS 0x700045EC /end MEASUREMENT
/begin MEASUREMENT FTEVEIT_PdhTdhS4_VL "DH junction temperature estimation from DH power losses leg_VL subsytem 4." FLOAT32_IEEE F_1_p0_72 1 2 -200 400 ECU_ADDRESS 0x700045E8 /end MEASUREMENT
/begin MEASUREMENT FTEVEIT_PdhTdhS4_WL "DH junction temperature estimation from DH power losses leg_WL subsytem 4." FLOAT32_IEEE F_1_p0_72 1 2 -200 400 ECU_ADDRESS 0x700045E4 /end MEASUREMENT
/begin MEASUREMENT FTEVEIT_PdhTdhS5_UL "DH junction temperature estimation from DH power losses leg_UL subsytem 5." FLOAT32_IEEE F_1_p0_72 1 2 -200 400 ECU_ADDRESS 0x700045E0 /end MEASUREMENT
/begin MEASUREMENT FTEVEIT_PdhTdhS5_VL "DH junction temperature estimation from DH power losses leg_VL subsytem 5." FLOAT32_IEEE F_1_p0_72 1 2 -200 400 ECU_ADDRESS 0x700045DC /end MEASUREMENT
/begin MEASUREMENT FTEVEIT_PdhTdhS5_WL "DH junction temperature estimation from DH power losses leg_WL subsytem 5." FLOAT32_IEEE F_1_p0_72 1 2 -200 400 ECU_ADDRESS 0x700045D8 /end MEASUREMENT
/begin MEASUREMENT FTEVEIT_PdhTdh_UL "DH junction temperature estimation from DH power losses leg_UL." FLOAT32_IEEE F_1_p0_72 1 2 -200 400 ECU_ADDRESS 0x700045D4 /end MEASUREMENT
/begin MEASUREMENT FTEVEIT_PdhTdh_VL "DH junction temperature estimation from DH power losses leg_VL." FLOAT32_IEEE F_1_p0_72 1 2 -200 400 ECU_ADDRESS 0x700045D0 /end MEASUREMENT
/begin MEASUREMENT FTEVEIT_PdhTdh_WL "DH junction temperature estimation from DH power losses leg_WL." FLOAT32_IEEE F_1_p0_72 1 2 -200 400 ECU_ADDRESS 0x700045CC /end MEASUREMENT
/begin MEASUREMENT FTEVEIT_PdhTth_UL "TH junction temperature estimation from DH power losses leg_UL." FLOAT32_IEEE F_1_p0_72 1 2 -200 400 ECU_ADDRESS 0x700045C8 /end MEASUREMENT
/begin MEASUREMENT FTEVEIT_PdhTth_VL "TH junction temperature estimation from DH power losses leg_VL." FLOAT32_IEEE F_1_p0_72 1 2 -200 400 ECU_ADDRESS 0x700045C4 /end MEASUREMENT
/begin MEASUREMENT FTEVEIT_PdhTth_WL "TH junction temperature estimation from DH power losses leg_WL." FLOAT32_IEEE F_1_p0_72 1 2 -200 400 ECU_ADDRESS 0x700045C0 /end MEASUREMENT
/begin MEASUREMENT FTEVEIT_PdlTdlS1_UL "DL junction temperature estimation from DL power losses leg_UL subsytem 1." FLOAT32_IEEE F_1_p0_72 1 2 -200 400 ECU_ADDRESS 0x700045BC /end MEASUREMENT
/begin MEASUREMENT FTEVEIT_PdlTdlS1_VL "DL junction temperature estimation from DL power losses leg_VL subsytem 1." FLOAT32_IEEE F_1_p0_72 1 2 -200 400 ECU_ADDRESS 0x700045B8 /end MEASUREMENT
/begin MEASUREMENT FTEVEIT_PdlTdlS1_WL "DL junction temperature estimation from DL power losses leg_WL subsytem 1." FLOAT32_IEEE F_1_p0_72 1 2 -200 400 ECU_ADDRESS 0x700045B4 /end MEASUREMENT
/begin MEASUREMENT FTEVEIT_PdlTdlS2_UL "DL junction temperature estimation from DL power losses leg_UL subsytem 2." FLOAT32_IEEE F_1_p0_72 1 2 -200 400 ECU_ADDRESS 0x700045B0 /end MEASUREMENT
/begin MEASUREMENT FTEVEIT_PdlTdlS2_VL "DL junction temperature estimation from DL power losses leg_VL subsytem 2." FLOAT32_IEEE F_1_p0_72 1 2 -200 400 ECU_ADDRESS 0x700045AC /end MEASUREMENT
/begin MEASUREMENT FTEVEIT_PdlTdlS2_WL "DL junction temperature estimation from DL power losses leg_WL subsytem 2." FLOAT32_IEEE F_1_p0_72 1 2 -200 400 ECU_ADDRESS 0x700045A8 /end MEASUREMENT
/begin MEASUREMENT FTEVEIT_PdlTdlS3_UL "DL junction temperature estimation from DL power losses leg_UL subsytem 3." FLOAT32_IEEE F_1_p0_72 1 2 -200 400 ECU_ADDRESS 0x700045A4 /end MEASUREMENT
/begin MEASUREMENT FTEVEIT_PdlTdlS3_VL "DL junction temperature estimation from DL power losses leg_VL subsytem 3." FLOAT32_IEEE F_1_p0_72 1 2 -200 400 ECU_ADDRESS 0x700045A0 /end MEASUREMENT
/begin MEASUREMENT FTEVEIT_PdlTdlS3_WL "DL junction temperature estimation from DL power losses leg_WL subsytem 3." FLOAT32_IEEE F_1_p0_72 1 2 -200 400 ECU_ADDRESS 0x7000459C /end MEASUREMENT
/begin MEASUREMENT FTEVEIT_PdlTdlS4_UL "DL junction temperature estimation from DL power losses leg_UL subsytem 4." FLOAT32_IEEE F_1_p0_72 1 2 -200 400 ECU_ADDRESS 0x70004598 /end MEASUREMENT
/begin MEASUREMENT FTEVEIT_PdlTdlS4_VL "DL junction temperature estimation from DL power losses leg_VL subsytem 4." FLOAT32_IEEE F_1_p0_72 1 2 -200 400 ECU_ADDRESS 0x70004594 /end MEASUREMENT
/begin MEASUREMENT FTEVEIT_PdlTdlS4_WL "DL junction temperature estimation from DL power losses leg_WL subsytem 4." FLOAT32_IEEE F_1_p0_72 1 2 -200 400 ECU_ADDRESS 0x70004590 /end MEASUREMENT
/begin MEASUREMENT FTEVEIT_PdlTdlS5_UL "DL junction temperature estimation from DL power losses leg_UL subsytem 5." FLOAT32_IEEE F_1_p0_72 1 2 -200 400 ECU_ADDRESS 0x7000458C /end MEASUREMENT
/begin MEASUREMENT FTEVEIT_PdlTdlS5_VL "DL junction temperature estimation from DL power losses leg_VL subsytem 5." FLOAT32_IEEE F_1_p0_72 1 2 -200 400 ECU_ADDRESS 0x70004588 /end MEASUREMENT
/begin MEASUREMENT FTEVEIT_PdlTdlS5_WL "DL junction temperature estimation from DL power losses leg_WL subsytem 5." FLOAT32_IEEE F_1_p0_72 1 2 -200 400 ECU_ADDRESS 0x70004584 /end MEASUREMENT
/begin MEASUREMENT FTEVEIT_PdlTdl_UL "DL junction temperature estimation from DL power losses leg_UL." FLOAT32_IEEE F_1_p0_72 1 2 -200 400 ECU_ADDRESS 0x70004580 /end MEASUREMENT
/begin MEASUREMENT FTEVEIT_PdlTdl_VL "DL junction temperature estimation from DL power losses leg_VL." FLOAT32_IEEE F_1_p0_72 1 2 -200 400 ECU_ADDRESS 0x7000457C /end MEASUREMENT
/begin MEASUREMENT FTEVEIT_PdlTdl_WL "DL junction temperature estimation from DL power losses leg_WL." FLOAT32_IEEE F_1_p0_72 1 2 -200 400 ECU_ADDRESS 0x70004578 /end MEASUREMENT
/begin MEASUREMENT FTEVEIT_PdlTtl_UL "TL junction temperature estimation from DL power losses leg_UL." FLOAT32_IEEE F_1_p0_72 1 2 -200 400 ECU_ADDRESS 0x70004574 /end MEASUREMENT
/begin MEASUREMENT FTEVEIT_PdlTtl_VL "TL junction temperature estimation from DL power losses leg_VL." FLOAT32_IEEE F_1_p0_72 1 2 -200 400 ECU_ADDRESS 0x70004570 /end MEASUREMENT
/begin MEASUREMENT FTEVEIT_PdlTtl_WL "TL junction temperature estimation from DL power losses leg_WL." FLOAT32_IEEE F_1_p0_72 1 2 -200 400 ECU_ADDRESS 0x7000456C /end MEASUREMENT
/begin MEASUREMENT FTEVEIT_PlossesVect[0] "Power losses estimation for all legs." FLOAT32_IEEE F_1_p0_69 1 2 0 1000000 ECU_ADDRESS 0x70004560 /end MEASUREMENT
/begin MEASUREMENT FTEVEIT_PlossesVect[1] "Power losses estimation for all legs." FLOAT32_IEEE F_1_p0_69 1 2 0 1000000 ECU_ADDRESS 0x70004564 /end MEASUREMENT
/begin MEASUREMENT FTEVEIT_PlossesVect[2] "Power losses estimation for all legs." FLOAT32_IEEE F_1_p0_69 1 2 0 1000000 ECU_ADDRESS 0x70004568 /end MEASUREMENT
/begin MEASUREMENT FTEVEIT_Plosses_UL "Power losses estimation of the leg_UL." FLOAT32_IEEE F_1_p0_69 1 2 0 1000000 ECU_ADDRESS 0x7000455C /end MEASUREMENT
/begin MEASUREMENT FTEVEIT_Plosses_VL "Power losses estimation of the leg_VL." FLOAT32_IEEE F_1_p0_69 1 2 0 1000000 ECU_ADDRESS 0x70004558 /end MEASUREMENT
/begin MEASUREMENT FTEVEIT_Plosses_WL "Power losses estimation of the leg_WL." FLOAT32_IEEE F_1_p0_69 1 2 0 1000000 ECU_ADDRESS 0x70004554 /end MEASUREMENT
/begin MEASUREMENT FTEVEIT_PowerModuleEstTemp "Maximal value of each temperatures estimations." FLOAT32_IEEE F_1_p0_72 1 2 -200 200 ECU_ADDRESS 0x70004550 /end MEASUREMENT
/begin MEASUREMENT FTEVEIT_PthTdh_UL "DH junction temperature estimation from TH power losses leg_UL." FLOAT32_IEEE F_1_p0_72 1 2 -200 400 ECU_ADDRESS 0x7000454C /end MEASUREMENT
/begin MEASUREMENT FTEVEIT_PthTdh_VL "DH junction temperature estimation from TH power losses leg_VL." FLOAT32_IEEE F_1_p0_72 1 2 -200 400 ECU_ADDRESS 0x70004548 /end MEASUREMENT
/begin MEASUREMENT FTEVEIT_PthTdh_WL "DH junction temperature estimation from TH power losses leg_WL." FLOAT32_IEEE F_1_p0_72 1 2 -200 400 ECU_ADDRESS 0x70004544 /end MEASUREMENT
/begin MEASUREMENT FTEVEIT_PthTthS1_UL "TH junction temperature estimation from TH power losses leg_UL subsystem 1." FLOAT32_IEEE F_1_p0_72 1 2 -200 400 ECU_ADDRESS 0x70004540 /end MEASUREMENT
/begin MEASUREMENT FTEVEIT_PthTthS1_VL "TH junction temperature estimation from TH power losses leg_VL subsystem 1." FLOAT32_IEEE F_1_p0_72 1 2 -200 400 ECU_ADDRESS 0x7000453C /end MEASUREMENT
/begin MEASUREMENT FTEVEIT_PthTthS1_WL "TH junction temperature estimation from TH power losses leg_WL subsystem 1." FLOAT32_IEEE F_1_p0_72 1 2 -200 400 ECU_ADDRESS 0x70004538 /end MEASUREMENT
/begin MEASUREMENT FTEVEIT_PthTthS2_UL "TH junction temperature estimation from TH power losses leg_UL subsystem 2." FLOAT32_IEEE F_1_p0_72 1 2 -200 400 ECU_ADDRESS 0x70004534 /end MEASUREMENT
/begin MEASUREMENT FTEVEIT_PthTthS2_VL "TH junction temperature estimation from TH power losses leg_VL subsystem 2." FLOAT32_IEEE F_1_p0_72 1 2 -200 400 ECU_ADDRESS 0x70004530 /end MEASUREMENT
/begin MEASUREMENT FTEVEIT_PthTthS2_WL "TH junction temperature estimation from TH power losses leg_WL subsystem 2." FLOAT32_IEEE F_1_p0_72 1 2 -200 400 ECU_ADDRESS 0x7000452C /end MEASUREMENT
/begin MEASUREMENT FTEVEIT_PthTthS3_UL "TH junction temperature estimation from TH power losses leg_UL subsystem 3." FLOAT32_IEEE F_1_p0_72 1 2 -200 400 ECU_ADDRESS 0x70004528 /end MEASUREMENT
/begin MEASUREMENT FTEVEIT_PthTthS3_VL "TH junction temperature estimation from TH power losses leg_VL subsystem 3." FLOAT32_IEEE F_1_p0_72 1 2 -200 400 ECU_ADDRESS 0x70004524 /end MEASUREMENT
/begin MEASUREMENT FTEVEIT_PthTthS3_WL "TH junction temperature estimation from TH power losses leg_WL subsystem 3." FLOAT32_IEEE F_1_p0_72 1 2 -200 400 ECU_ADDRESS 0x70004520 /end MEASUREMENT
/begin MEASUREMENT FTEVEIT_PthTthS4_UL "TH junction temperature estimation from TH power losses leg_UL subsystem 4." FLOAT32_IEEE F_1_p0_72 1 2 -200 400 ECU_ADDRESS 0x7000451C /end MEASUREMENT
/begin MEASUREMENT FTEVEIT_PthTthS4_VL "TH junction temperature estimation from TH power losses leg_VL subsystem 4." FLOAT32_IEEE F_1_p0_72 1 2 -200 400 ECU_ADDRESS 0x70004518 /end MEASUREMENT
/begin MEASUREMENT FTEVEIT_PthTthS4_WL "TH junction temperature estimation from TH power losses leg_WL subsystem 4." FLOAT32_IEEE F_1_p0_72 1 2 -200 400 ECU_ADDRESS 0x70004514 /end MEASUREMENT
/begin MEASUREMENT FTEVEIT_PthTthS5_UL "TH junction temperature estimation from TH power losses leg_UL subsystem 5." FLOAT32_IEEE F_1_p0_72 1 2 -200 400 ECU_ADDRESS 0x70004510 /end MEASUREMENT
/begin MEASUREMENT FTEVEIT_PthTthS5_VL "TH junction temperature estimation from TH power losses leg_VL subsystem 5." FLOAT32_IEEE F_1_p0_72 1 2 -200 400 ECU_ADDRESS 0x7000450C /end MEASUREMENT
/begin MEASUREMENT FTEVEIT_PthTthS5_WL "TH junction temperature estimation from TH power losses leg_WL subsystem 5." FLOAT32_IEEE F_1_p0_72 1 2 -200 400 ECU_ADDRESS 0x70004508 /end MEASUREMENT
/begin MEASUREMENT FTEVEIT_PthTth_UL "TH junction temperature estimation from TH power losses leg_UL." FLOAT32_IEEE F_1_p0_72 1 2 -200 400 ECU_ADDRESS 0x70004504 /end MEASUREMENT
/begin MEASUREMENT FTEVEIT_PthTth_VL "TH junction temperature estimation from TH power losses leg_VL." FLOAT32_IEEE F_1_p0_72 1 2 -200 400 ECU_ADDRESS 0x70004500 /end MEASUREMENT
/begin MEASUREMENT FTEVEIT_PthTth_WL "TH junction temperature estimation from TH power losses leg_WL." FLOAT32_IEEE F_1_p0_72 1 2 -200 400 ECU_ADDRESS 0x700044FC /end MEASUREMENT
/begin MEASUREMENT FTEVEIT_PtlTdl_UL "DL junction temperature estimation from TL power losses leg_UL." FLOAT32_IEEE F_1_p0_72 1 2 -200 400 ECU_ADDRESS 0x700044F8 /end MEASUREMENT
/begin MEASUREMENT FTEVEIT_PtlTdl_VL "DL junction temperature estimation from TL power losses leg_VL." FLOAT32_IEEE F_1_p0_72 1 2 -200 400 ECU_ADDRESS 0x700044F4 /end MEASUREMENT
/begin MEASUREMENT FTEVEIT_PtlTdl_WL "DL junction temperature estimation from TL power losses leg_WL." FLOAT32_IEEE F_1_p0_72 1 2 -200 400 ECU_ADDRESS 0x700044F0 /end MEASUREMENT
/begin MEASUREMENT FTEVEIT_PtlTtlS1_UL "TL junction temperature estimation from TL power losses leg_UL subsystem 1." FLOAT32_IEEE F_1_p0_72 1 2 -200 400 ECU_ADDRESS 0x700044EC /end MEASUREMENT
/begin MEASUREMENT FTEVEIT_PtlTtlS1_VL "TL junction temperature estimation from TL power losses leg_VL subsystem 1." FLOAT32_IEEE F_1_p0_72 1 2 -200 400 ECU_ADDRESS 0x700044E8 /end MEASUREMENT
/begin MEASUREMENT FTEVEIT_PtlTtlS1_WL "TL junction temperature estimation from TL power losses leg_WL subsystem 1." FLOAT32_IEEE F_1_p0_72 1 2 -200 400 ECU_ADDRESS 0x700044E4 /end MEASUREMENT
/begin MEASUREMENT FTEVEIT_PtlTtlS2_UL "TL junction temperature estimation from TL power losses leg_UL subsystem 2." FLOAT32_IEEE F_1_p0_72 1 2 -200 400 ECU_ADDRESS 0x700044E0 /end MEASUREMENT
/begin MEASUREMENT FTEVEIT_PtlTtlS2_VL "TL junction temperature estimation from TL power losses leg_VL subsystem 2." FLOAT32_IEEE F_1_p0_72 1 2 -200 400 ECU_ADDRESS 0x700044DC /end MEASUREMENT
/begin MEASUREMENT FTEVEIT_PtlTtlS2_WL "TL junction temperature estimation from TL power losses leg_WL subsystem 2." FLOAT32_IEEE F_1_p0_72 1 2 -200 400 ECU_ADDRESS 0x700044D8 /end MEASUREMENT
/begin MEASUREMENT FTEVEIT_PtlTtlS3_UL "TL junction temperature estimation from TL power losses leg_UL subsystem 3." FLOAT32_IEEE F_1_p0_72 1 2 -200 400 ECU_ADDRESS 0x700044D4 /end MEASUREMENT
/begin MEASUREMENT FTEVEIT_PtlTtlS3_VL "TL junction temperature estimation from TL power losses leg_VL subsystem 3." FLOAT32_IEEE F_1_p0_72 1 2 -200 400 ECU_ADDRESS 0x700044D0 /end MEASUREMENT
/begin MEASUREMENT FTEVEIT_PtlTtlS3_WL "TL junction temperature estimation from TL power losses leg_WL subsystem 3." FLOAT32_IEEE F_1_p0_72 1 2 -200 400 ECU_ADDRESS 0x700044CC /end MEASUREMENT
/begin MEASUREMENT FTEVEIT_PtlTtlS4_UL "TL junction temperature estimation from TL power losses leg_UL subsystem 4." FLOAT32_IEEE F_1_p0_72 1 2 -200 400 ECU_ADDRESS 0x700044C8 /end MEASUREMENT
/begin MEASUREMENT FTEVEIT_PtlTtlS4_VL "TL junction temperature estimation from TL power losses leg_VL subsystem 4." FLOAT32_IEEE F_1_p0_72 1 2 -200 400 ECU_ADDRESS 0x700044C4 /end MEASUREMENT
/begin MEASUREMENT FTEVEIT_PtlTtlS4_WL "TL junction temperature estimation from TL power losses leg_WL subsystem 4." FLOAT32_IEEE F_1_p0_72 1 2 -200 400 ECU_ADDRESS 0x700044C0 /end MEASUREMENT
/begin MEASUREMENT FTEVEIT_PtlTtlS5_UL "TL junction temperature estimation from TL power losses leg_UL subsystem 5." FLOAT32_IEEE F_1_p0_72 1 2 -200 400 ECU_ADDRESS 0x700044BC /end MEASUREMENT
/begin MEASUREMENT FTEVEIT_PtlTtlS5_VL "TL junction temperature estimation from TL power losses leg_VL subsystem 5." FLOAT32_IEEE F_1_p0_72 1 2 -200 400 ECU_ADDRESS 0x700044B8 /end MEASUREMENT
/begin MEASUREMENT FTEVEIT_PtlTtlS5_WL "TL junction temperature estimation from TL power losses leg_WL subsystem 5." FLOAT32_IEEE F_1_p0_72 1 2 -200 400 ECU_ADDRESS 0x700044B4 /end MEASUREMENT
/begin MEASUREMENT FTEVEIT_PtlTtl_UL "TL junction temperature estimation from TL power losses leg_UL." FLOAT32_IEEE F_1_p0_72 1 2 -200 400 ECU_ADDRESS 0x700044B0 /end MEASUREMENT
/begin MEASUREMENT FTEVEIT_PtlTtl_VL "TL junction temperature estimation from TL power losses leg_VL." FLOAT32_IEEE F_1_p0_72 1 2 -200 400 ECU_ADDRESS 0x700044AC /end MEASUREMENT
/begin MEASUREMENT FTEVEIT_PtlTtl_WL "TL junction temperature estimation from TL power losses leg_WL." FLOAT32_IEEE F_1_p0_72 1 2 -200 400 ECU_ADDRESS 0x700044A8 /end MEASUREMENT
/begin MEASUREMENT FTEVEIT_TcoolingEstimation "Estimated cooling temperature." FLOAT32_IEEE F_1_p0_72 1 2 -200 200 ECU_ADDRESS 0x700044A4 /end MEASUREMENT
/begin MEASUREMENT FTEVEIT_VectEstimTempFild10Z "Previous value of the vector temperature 10th element after filtering." FLOAT32_IEEE F_1_p0_73 1 2 -40 200 ECU_ADDRESS 0x70004470 /end MEASUREMENT
/begin MEASUREMENT FTEVEIT_VectEstimTempFild11Z "Previous value of the vector temperature 11th element after filtering." FLOAT32_IEEE F_1_p0_73 1 2 -40 200 ECU_ADDRESS 0x7000446C /end MEASUREMENT
/begin MEASUREMENT FTEVEIT_VectEstimTempFild12Z "Previous value of the vector temperature 12th element after filtering." FLOAT32_IEEE F_1_p0_73 1 2 -40 200 ECU_ADDRESS 0x70004468 /end MEASUREMENT
/begin MEASUREMENT FTEVEIT_VectEstimTempFild1Z "Previous value of the vector temperature 1st element after filtering." FLOAT32_IEEE F_1_p0_73 1 2 -40 200 ECU_ADDRESS 0x70004464 /end MEASUREMENT
/begin MEASUREMENT FTEVEIT_VectEstimTempFild2Z "Previous value of the vector temperature 2nd element after filtering." FLOAT32_IEEE F_1_p0_73 1 2 -40 200 ECU_ADDRESS 0x70004460 /end MEASUREMENT
/begin MEASUREMENT FTEVEIT_VectEstimTempFild3Z "Previous value of the vector temperature 3rd element after filtering." FLOAT32_IEEE F_1_p0_73 1 2 -40 200 ECU_ADDRESS 0x7000445C /end MEASUREMENT
/begin MEASUREMENT FTEVEIT_VectEstimTempFild4Z "Previous value of the vector temperature 4th element after filtering." FLOAT32_IEEE F_1_p0_73 1 2 -40 200 ECU_ADDRESS 0x70004458 /end MEASUREMENT
/begin MEASUREMENT FTEVEIT_VectEstimTempFild5Z "Previous value of the vector temperature 5th element after filtering." FLOAT32_IEEE F_1_p0_73 1 2 -40 200 ECU_ADDRESS 0x70004454 /end MEASUREMENT
/begin MEASUREMENT FTEVEIT_VectEstimTempFild6Z "Previous value of the vector temperature 6th element after filtering." FLOAT32_IEEE F_1_p0_73 1 2 -40 200 ECU_ADDRESS 0x70004450 /end MEASUREMENT
/begin MEASUREMENT FTEVEIT_VectEstimTempFild7Z "Previous value of the vector temperature 7th element after filtering." FLOAT32_IEEE F_1_p0_73 1 2 -40 200 ECU_ADDRESS 0x7000444C /end MEASUREMENT
/begin MEASUREMENT FTEVEIT_VectEstimTempFild8Z "Previous value of the vector temperature 8th element after filtering." FLOAT32_IEEE F_1_p0_73 1 2 -40 200 ECU_ADDRESS 0x70004448 /end MEASUREMENT
/begin MEASUREMENT FTEVEIT_VectEstimTempFild9Z "Previous value of the vector temperature 9th element after filtering." FLOAT32_IEEE F_1_p0_73 1 2 -40 200 ECU_ADDRESS 0x70004444 /end MEASUREMENT
/begin MEASUREMENT FTEVEIT_VectEstimTempFild[0] "Current value of the vector temperature after filtering." FLOAT32_IEEE F_1_p0_73 1 2 -40 200 ECU_ADDRESS 0x70004474 /end MEASUREMENT
/begin MEASUREMENT FTEVEIT_VectEstimTempFild[10] "Current value of the vector temperature after filtering." FLOAT32_IEEE F_1_p0_73 1 2 -40 200 ECU_ADDRESS 0x7000449C /end MEASUREMENT
/begin MEASUREMENT FTEVEIT_VectEstimTempFild[11] "Current value of the vector temperature after filtering." FLOAT32_IEEE F_1_p0_73 1 2 -40 200 ECU_ADDRESS 0x700044A0 /end MEASUREMENT
/begin MEASUREMENT FTEVEIT_VectEstimTempFild[1] "Current value of the vector temperature after filtering." FLOAT32_IEEE F_1_p0_73 1 2 -40 200 ECU_ADDRESS 0x70004478 /end MEASUREMENT
/begin MEASUREMENT FTEVEIT_VectEstimTempFild[2] "Current value of the vector temperature after filtering." FLOAT32_IEEE F_1_p0_73 1 2 -40 200 ECU_ADDRESS 0x7000447C /end MEASUREMENT
/begin MEASUREMENT FTEVEIT_VectEstimTempFild[3] "Current value of the vector temperature after filtering." FLOAT32_IEEE F_1_p0_73 1 2 -40 200 ECU_ADDRESS 0x70004480 /end MEASUREMENT
/begin MEASUREMENT FTEVEIT_VectEstimTempFild[4] "Current value of the vector temperature after filtering." FLOAT32_IEEE F_1_p0_73 1 2 -40 200 ECU_ADDRESS 0x70004484 /end MEASUREMENT
/begin MEASUREMENT FTEVEIT_VectEstimTempFild[5] "Current value of the vector temperature after filtering." FLOAT32_IEEE F_1_p0_73 1 2 -40 200 ECU_ADDRESS 0x70004488 /end MEASUREMENT
/begin MEASUREMENT FTEVEIT_VectEstimTempFild[6] "Current value of the vector temperature after filtering." FLOAT32_IEEE F_1_p0_73 1 2 -40 200 ECU_ADDRESS 0x7000448C /end MEASUREMENT
/begin MEASUREMENT FTEVEIT_VectEstimTempFild[7] "Current value of the vector temperature after filtering." FLOAT32_IEEE F_1_p0_73 1 2 -40 200 ECU_ADDRESS 0x70004490 /end MEASUREMENT
/begin MEASUREMENT FTEVEIT_VectEstimTempFild[8] "Current value of the vector temperature after filtering." FLOAT32_IEEE F_1_p0_73 1 2 -40 200 ECU_ADDRESS 0x70004494 /end MEASUREMENT
/begin MEASUREMENT FTEVEIT_VectEstimTempFild[9] "Current value of the vector temperature after filtering." FLOAT32_IEEE F_1_p0_73 1 2 -40 200 ECU_ADDRESS 0x70004498 /end MEASUREMENT
/begin MEASUREMENT FTMTLCS_1ByAccumulator "FTMTLCS_1ByAccumulator" FLOAT32_IEEE F_1_p0_4 1 2 -3.402823466E+038 3.402823466E+038 ECU_ADDRESS 0x70004788 /end MEASUREMENT
/begin MEASUREMENT FTMTLCS_A2DOffsetIsuL "parameter used to correct the sensor offset error" FLOAT32_IEEE F_1_p0_74 1 2 -3.402823466E+038 3.402823466E+038 ECU_ADDRESS 0x70004784 /end MEASUREMENT
/begin MEASUREMENT FTMTLCS_A2DOffsetIsvL "parameter used to correct the sensor offset error" FLOAT32_IEEE F_1_p0_74 1 2 -3.402823466E+038 3.402823466E+038 ECU_ADDRESS 0x70004780 /end MEASUREMENT
/begin MEASUREMENT FTMTLCS_A2DOffsetIswL "parameter used to correct the sensor offset error" FLOAT32_IEEE F_1_p0_74 1 2 -3.402823466E+038 3.402823466E+038 ECU_ADDRESS 0x7000477C /end MEASUREMENT
/begin MEASUREMENT FTMTLCS_A2DOffsetSumIsuLZ "sum of the current sample durring initialization" FLOAT32_IEEE F_1_p0_74 1 2 -3.402823466E+038 3.402823466E+038 ECU_ADDRESS 0x70004778 /end MEASUREMENT
/begin MEASUREMENT FTMTLCS_A2DOffsetSumIsvLZ "sum of the current sample durring initialization" FLOAT32_IEEE F_1_p0_74 1 2 -3.402823466E+038 3.402823466E+038 ECU_ADDRESS 0x70004774 /end MEASUREMENT
/begin MEASUREMENT FTMTLCS_A2DOffsetSumIswLZ "sum of the current sample durring initialization" FLOAT32_IEEE F_1_p0_74 1 2 -3.402823466E+038 3.402823466E+038 ECU_ADDRESS 0x70004770 /end MEASUREMENT
/begin MEASUREMENT FTMTLCS_A2DResCorrd_IsuL "corrected ADC value of the current sensor" FLOAT32_IEEE F_1_p0_74 1 2 0 4095 ECU_ADDRESS 0x7000476C /end MEASUREMENT
/begin MEASUREMENT FTMTLCS_A2DResCorrd_IsvL "corrected ADC value of the current sensor" FLOAT32_IEEE F_1_p0_74 1 2 0 4095 ECU_ADDRESS 0x70004768 /end MEASUREMENT
/begin MEASUREMENT FTMTLCS_A2DResCorrd_IswL "corrected ADC value of the current sensor" FLOAT32_IEEE F_1_p0_74 1 2 0 4095 ECU_ADDRESS 0x70004764 /end MEASUREMENT
/begin MEASUREMENT FTMTLCS_CurSenrPhaU_OutRngHDetn "FTMTLCS_CurSenrPhaU_OutRngHDetn" UBYTE Bool_ON_OFF 1 2 0 1 BIT_MASK 0x01 ECU_ADDRESS 0x70004762 /end MEASUREMENT
/begin MEASUREMENT FTMTLCS_CurSenrPhaU_OutRngLDetn "FTMTLCS_CurSenrPhaU_OutRngLDetn" UBYTE Bool_ON_OFF 1 2 0 1 BIT_MASK 0x01 ECU_ADDRESS 0x70004761 /end MEASUREMENT
/begin MEASUREMENT FTMTLCS_CurSenrPhaV_OutRngHDetn "FTMTLCS_CurSenrPhaV_OutRngHDetn" UBYTE Bool_ON_OFF 1 2 0 1 BIT_MASK 0x01 ECU_ADDRESS 0x70004760 /end MEASUREMENT
/begin MEASUREMENT FTMTLCS_CurSenrPhaV_OutRngLDetn "FTMTLCS_CurSenrPhaV_OutRngLDetn" UBYTE Bool_ON_OFF 1 2 0 1 BIT_MASK 0x01 ECU_ADDRESS 0x7000475F /end MEASUREMENT
/begin MEASUREMENT FTMTLCS_CurSenrPhaW_OutRngHDetn "FTMTLCS_CurSenrPhaW_OutRngHDetn" UBYTE Bool_ON_OFF 1 2 0 1 BIT_MASK 0x01 ECU_ADDRESS 0x7000475E /end MEASUREMENT
/begin MEASUREMENT FTMTLCS_CurSenrPhaW_OutRngLDetn "FTMTLCS_CurSenrPhaW_OutRngLDetn" UBYTE Bool_ON_OFF 1 2 0 1 BIT_MASK 0x01 ECU_ADDRESS 0x7000475D /end MEASUREMENT
/begin MEASUREMENT FTMTLCS_CurrentSumError "FTMTLCS_CurrentSumError" UBYTE Bool_ON_OFF 1 2 0 1 BIT_MASK 0x01 ECU_ADDRESS 0x7000475C /end MEASUREMENT
/begin MEASUREMENT FTMTLCS_ElecSpeedRdsFildZ "FTMTLCS_ElecSpeedRdsFildZ" FLOAT32_IEEE F_1_p0_4 1 2 -3.402823466E+038 3.402823466E+038 ECU_ADDRESS 0x70004758 /end MEASUREMENT
/begin MEASUREMENT FTMTLCS_Iu "FTMTLCS_Iu" FLOAT32_IEEE F_1_p0_46 1 2 -1000 1000 ECU_ADDRESS 0x70004754 /end MEASUREMENT
/begin MEASUREMENT FTMTLCS_Iuvw3[0] "FTMTLCS_Iuvw3" FLOAT32_IEEE F_1_p0_4 1 2 -3.402823466E+038 3.402823466E+038 ECU_ADDRESS 0x70004748 /end MEASUREMENT
/begin MEASUREMENT FTMTLCS_Iuvw3[1] "FTMTLCS_Iuvw3" FLOAT32_IEEE F_1_p0_4 1 2 -3.402823466E+038 3.402823466E+038 ECU_ADDRESS 0x7000474C /end MEASUREMENT
/begin MEASUREMENT FTMTLCS_Iuvw3[2] "FTMTLCS_Iuvw3" FLOAT32_IEEE F_1_p0_4 1 2 -3.402823466E+038 3.402823466E+038 ECU_ADDRESS 0x70004750 /end MEASUREMENT
/begin MEASUREMENT FTMTLCS_Iv "FTMTLCS_Iv" FLOAT32_IEEE F_1_p0_46 1 2 -1000 1000 ECU_ADDRESS 0x70004744 /end MEASUREMENT
/begin MEASUREMENT FTMTLCS_Iw "FTMTLCS_Iw" FLOAT32_IEEE F_1_p0_46 1 2 -1000 1000 ECU_ADDRESS 0x70004740 /end MEASUREMENT
/begin MEASUREMENT FTMTLCS_LostPhaseError "FTMTLCS_LostPhaseError" UBYTE Bool_ON_OFF 1 2 0 1 BIT_MASK 0x01 ECU_ADDRESS 0x7000473D /end MEASUREMENT
/begin MEASUREMENT FTMTLCS_OffsetCompOK "FTMTLCS_OffsetCompOK" UBYTE Bool_ON_OFF 1 2 0 1 BIT_MASK 0x01 ECU_ADDRESS 0x7000473C /end MEASUREMENT
/begin MEASUREMENT FTMTLCS_SampleNumberZ "number of sample since the beginning of the initialization" ULONG F_1_p0_55 1 2 0 4294967295 ECU_ADDRESS 0x70004738 /end MEASUREMENT
/begin MEASUREMENT FTMTLCS_Scaled_Isu "FTMTLCS_Scaled_Isu" FLOAT32_IEEE F_1_p0_4 1 2 -3.402823466E+038 3.402823466E+038 ECU_ADDRESS 0x70004734 /end MEASUREMENT
/begin MEASUREMENT FTMTLCS_Scaled_Isv "FTMTLCS_Scaled_Isv" FLOAT32_IEEE F_1_p0_4 1 2 -3.402823466E+038 3.402823466E+038 ECU_ADDRESS 0x70004730 /end MEASUREMENT
/begin MEASUREMENT FTMTLCS_Scaled_Isw "FTMTLCS_Scaled_Isw" FLOAT32_IEEE F_1_p0_4 1 2 -3.402823466E+038 3.402823466E+038 ECU_ADDRESS 0x7000472C /end MEASUREMENT
/begin MEASUREMENT FTMTLCS_TrimIsuvw[0] "FTMTLCS_TrimIsuvw" FLOAT32_IEEE F_1_p0_4 1 2 -3.402823466E+038 3.402823466E+038 ECU_ADDRESS 0x70004720 /end MEASUREMENT
/begin MEASUREMENT FTMTLCS_TrimIsuvw[1] "FTMTLCS_TrimIsuvw" FLOAT32_IEEE F_1_p0_4 1 2 -3.402823466E+038 3.402823466E+038 ECU_ADDRESS 0x70004724 /end MEASUREMENT
/begin MEASUREMENT FTMTLCS_TrimIsuvw[2] "FTMTLCS_TrimIsuvw" FLOAT32_IEEE F_1_p0_4 1 2 -3.402823466E+038 3.402823466E+038 ECU_ADDRESS 0x70004728 /end MEASUREMENT
/begin MEASUREMENT FTMTSEP_DelayTheta "next time step cosinus value of the electrical angle" FLOAT32_IEEE F_1_p0_55 1 2 -3.402823466E+038 3.402823466E+038 ECU_ADDRESS 0x700047A8 /end MEASUREMENT
/begin MEASUREMENT FTMTSEP_ErrThetaComp "FTMTSEP_ErrThetaComp" FLOAT32_IEEE F_1_p0_75 1 2 -3.402823466E+038 3.402823466E+038 ECU_ADDRESS 0x700047A4 /end MEASUREMENT
/begin MEASUREMENT FTMTSEP_NextThetaElecRdSurPi "next time step value of the electrical angle" FLOAT32_IEEE F_1_p0_76 1 2 -3.402823466E+038 3.402823466E+038 ECU_ADDRESS 0x700047A0 /end MEASUREMENT
/begin MEASUREMENT FTMTSEP_SinCosNextThetaElec[0] "next time step cosinus  and sinus values of the electrical angle" FLOAT32_IEEE F_1_p0_55 1 2 -3.402823466E+038 3.402823466E+038 ECU_ADDRESS 0x70004798 /end MEASUREMENT
/begin MEASUREMENT FTMTSEP_SinCosNextThetaElec[1] "next time step cosinus  and sinus values of the electrical angle" FLOAT32_IEEE F_1_p0_55 1 2 -3.402823466E+038 3.402823466E+038 ECU_ADDRESS 0x7000479C /end MEASUREMENT
/begin MEASUREMENT FTMTSEP_SinCosThetaElec[0] "cosinus  and sinus values of the electrical angle" FLOAT32_IEEE F_1_p0_55 1 2 -3.402823466E+038 3.402823466E+038 ECU_ADDRESS 0x70004790 /end MEASUREMENT
/begin MEASUREMENT FTMTSEP_SinCosThetaElec[1] "cosinus  and sinus values of the electrical angle" FLOAT32_IEEE F_1_p0_55 1 2 -3.402823466E+038 3.402823466E+038 ECU_ADDRESS 0x70004794 /end MEASUREMENT
/begin MEASUREMENT FTMTSEP_ThetaElecRdSurPi "value of the electrical angle" FLOAT32_IEEE F_1_p0_76 1 2 -3.402823466E+038 3.402823466E+038 ECU_ADDRESS 0x7000478C /end MEASUREMENT
/begin MEASUREMENT FTSMACS_AclPreviousState "FTSMACS_AclPreviousState" UWORD F_1_p0_4 1 2 0 65535 ECU_ADDRESS 0x70004334 /end MEASUREMENT
/begin MEASUREMENT FTSMACS_AclState "FTSMACS_AclState" UWORD F_1_p0_4 1 2 0 65535 ECU_ADDRESS 0x70004332 /end MEASUREMENT
/begin MEASUREMENT FTSMACS_CmdFtShutDownRes "FTSMACS_CmdFtShutDownRes" UBYTE Bool_ON_OFF 1 2 0 1 BIT_MASK 0x01 ECU_ADDRESS 0x70004331 /end MEASUREMENT
/begin MEASUREMENT FTSMACS_CmdFtStartRes "FTSMACS_CmdFtStartRes" UBYTE Bool_ON_OFF 1 2 0 1 BIT_MASK 0x01 ECU_ADDRESS 0x70004330 /end MEASUREMENT
/begin MEASUREMENT FTSMACS_CmdPwmDirectReq "FTSMACS_CmdPwmDirectReq" UBYTE Bool_ON_OFF 1 2 0 1 BIT_MASK 0x01 ECU_ADDRESS 0x7000432F /end MEASUREMENT
/begin MEASUREMENT FTSMACS_CmdPwmOffReq "FTSMACS_CmdPwmOffReq" UBYTE Bool_ON_OFF 1 2 0 1 BIT_MASK 0x01 ECU_ADDRESS 0x7000432E /end MEASUREMENT
/begin MEASUREMENT FTSMACS_ReinitFault "Boolean for fault reinitialization." UBYTE Bool_ON_OFF 1 2 0 1 BIT_MASK 0x01 ECU_ADDRESS 0x7000432D /end MEASUREMENT
/begin MEASUREMENT FTSMACS_TestFault "Boolean for fault reinitialization." UBYTE Bool_ON_OFF 1 2 0 1 BIT_MASK 0x01 ECU_ADDRESS 0x7000432C /end MEASUREMENT
/begin MEASUREMENT FTSMACS_VsiTimerFreqRatioRef "Timer frequency ratio reference." FLOAT32_IEEE F_1_p0_4 1 2 0 65535 ECU_ADDRESS 0x70004328 /end MEASUREMENT
/begin MEASUREMENT FTSMMAM_AclState "FTSMMAM_AclState" UWORD F_1_p0_55 1 2 0 65535 ECU_ADDRESS 0x70004348 /end MEASUREMENT
/begin MEASUREMENT FTSMMAM_CMCCS_M0ConOnoff "FTSMMAM_CMCCS_M0ConOnoff" UBYTE Bool_ON_OFF 1 2 0 1 BIT_MASK 0x01 ECU_ADDRESS 0x70004347 /end MEASUREMENT
/begin MEASUREMENT FTSMMAM_EVEIT_MainEnable "FTSMMAM_EVEIT_MainEnable" UBYTE Bool_ON_OFF 1 2 0 1 BIT_MASK 0x01 ECU_ADDRESS 0x70004346 /end MEASUREMENT
/begin MEASUREMENT FTSMMAM_FTCIVDC_State "FTSMMAM_FTCIVDC_State" UWORD F_1_p0_43 1 2 0 65535 ECU_ADDRESS 0x70004344 /end MEASUREMENT
/begin MEASUREMENT FTSMMAM_FTCMCCS_State "FTSMMAM_FTCMCCS_State" UWORD F_1_p0_43 1 2 0 65535 ECU_ADDRESS 0x70004342 /end MEASUREMENT
/begin MEASUREMENT FTSMMAM_FTCMSCS_State "FTSMMAM_FTCMSCS_State" UWORD F_1_p0_43 1 2 0 65535 ECU_ADDRESS 0x70004340 /end MEASUREMENT
/begin MEASUREMENT FTSMMAM_FTCMTCS_State "FTSMMAM_FTCMTCS_State" UWORD F_1_p0_43 1 2 0 65535 ECU_ADDRESS 0x7000433E /end MEASUREMENT
/begin MEASUREMENT FTSMMAM_FtModeReq "FTSMMAM_FtModeReq" UWORD F_1_p0_55 1 2 0 65535 ECU_ADDRESS 0x7000433C /end MEASUREMENT
/begin MEASUREMENT FTSMMAM_MTLCS_State "FTSMMAM_MTLCS_State" UWORD F_1_p0_43 1 2 0 65535 ECU_ADDRESS 0x7000433A /end MEASUREMENT
/begin MEASUREMENT FTSMMAM_MTMEP_State "FTSMMAM_MTMEP_State" UWORD F_1_p0_4 1 2 0 65535 ECU_ADDRESS 0x70004338 /end MEASUREMENT
/begin MEASUREMENT FTSMMAM_SMREF_MainEnable "FTSMMAM_SMREF_MainEnable" UBYTE Bool_ON_OFF 1 2 0 1 BIT_MASK 0x01 ECU_ADDRESS 0x70004336 /end MEASUREMENT
/begin MEASUREMENT FTSMREF_AngleTable "FTSMREF_AngleTable" FLOAT32_IEEE F_1_p0_77 1 2 -3.402823466E+038 3.402823466E+038 ECU_ADDRESS 0x70004380 /end MEASUREMENT
/begin MEASUREMENT FTSMREF_AutoPhaseCalLock "FTSMREF_AutoPhaseCalLock" FLOAT32_IEEE F_1_p0_4 1 2 -3.402823466E+038 3.402823466E+038 ECU_ADDRESS 0x7000437C /end MEASUREMENT
/begin MEASUREMENT FTSMREF_AutoPhasingCal "FTSMREF_AutoPhasingCal" FLOAT32_IEEE F_1_p0_4 1 2 -3.402823466E+038 3.402823466E+038 ECU_ADDRESS 0x70004378 /end MEASUREMENT
/begin MEASUREMENT FTSMREF_AutoPhasingCalRaw "FTSMREF_AutoPhasingCalRaw" FLOAT32_IEEE F_1_p0_4 1 2 -3.402823466E+038 3.402823466E+038 ECU_ADDRESS 0x70004374 /end MEASUREMENT
/begin MEASUREMENT FTSMREF_AutoPhasingCalRawZ "FTSMREF_AutoPhasingCalRawZ" FLOAT32_IEEE F_1_p0_4 1 2 -3.402823466E+038 3.402823466E+038 ECU_ADDRESS 0x70004370 /end MEASUREMENT
/begin MEASUREMENT FTSMREF_AutophasingSumZ "FTSMREF_AutophasingSumZ" FLOAT32_IEEE F_1_p0_4 1 2 -3.402823466E+038 3.402823466E+038 ECU_ADDRESS 0x7000436C /end MEASUREMENT
/begin MEASUREMENT FTSMREF_CycNum "FTSMREF_CycNum" FLOAT32_IEEE F_1_p0_4 1 2 -3.402823466E+038 3.402823466E+038 ECU_ADDRESS 0x70004368 /end MEASUREMENT
/begin MEASUREMENT FTSMREF_Cyclefinish "FTSMREF_Cyclefinish" UBYTE Bool_ON_OFF 1 2 0 1 BIT_MASK 0x01 ECU_ADDRESS 0x70004364 /end MEASUREMENT
/begin MEASUREMENT FTSMREF_I0dqRef[0] "FTSMREF_I0dqRef" FLOAT32_IEEE F_1_p0_46 1 2 -3.402823466E+038 3.402823466E+038 ECU_ADDRESS 0x70004358 /end MEASUREMENT
/begin MEASUREMENT FTSMREF_I0dqRef[1] "FTSMREF_I0dqRef" FLOAT32_IEEE F_1_p0_46 1 2 -3.402823466E+038 3.402823466E+038 ECU_ADDRESS 0x7000435C /end MEASUREMENT
/begin MEASUREMENT FTSMREF_I0dqRef[2] "FTSMREF_I0dqRef" FLOAT32_IEEE F_1_p0_46 1 2 -3.402823466E+038 3.402823466E+038 ECU_ADDRESS 0x70004360 /end MEASUREMENT
/begin MEASUREMENT FTSMREF_IdrefTable "FTSMREF_IdrefTable" FLOAT32_IEEE F_1_p0_77 1 2 -3.402823466E+038 3.402823466E+038 ECU_ADDRESS 0x70004354 /end MEASUREMENT
/begin MEASUREMENT FTSMREF_ImposedThetaRdSurPi "FTSMREF_ImposedThetaRdSurPi" FLOAT32_IEEE F_1_p0_77 1 2 -3.402823466E+038 3.402823466E+038 ECU_ADDRESS 0x70004350 /end MEASUREMENT
/begin MEASUREMENT FTSMREF_RotoringCalEnable "FTSMREF_RotoringCalEnable" UBYTE Bool_ON_OFF 1 2 0 1 BIT_MASK 0x01 ECU_ADDRESS 0x7000434E /end MEASUREMENT
/begin MEASUREMENT FTSMREF_RotoringCalFinish "FTSMREF_RotoringCalFinish" UBYTE Bool_ON_OFF 1 2 0 1 BIT_MASK 0x01 ECU_ADDRESS 0x7000434D /end MEASUREMENT
/begin MEASUREMENT FTSMREF_RotoringCalStart "FTSMREF_RotoringCalStart" UBYTE Bool_ON_OFF 1 2 0 1 BIT_MASK 0x01 ECU_ADDRESS 0x7000434C /end MEASUREMENT
/begin MEASUREMENT FTSMREF_Timer1Z "FTSMREF_Timer1Z" UWORD F_1_p0_4 1 2 0 65535 ECU_ADDRESS 0x7000434A /end MEASUREMENT
/begin MEASUREMENT SDMTLCS_CurrentRmsIuFild "SDMTLCS_CurrentRmsIuFild" FLOAT32_IEEE F_1_p0_4 1 2 -3.402823466E+038 3.402823466E+038 ECU_ADDRESS 0x70004824 /end MEASUREMENT
/begin MEASUREMENT SDMTLCS_CurrentRmsIuFildZ "SDMTLCS_CurrentRmsIuFildZ" FLOAT32_IEEE F_1_p0_4 1 2 -3.402823466E+038 3.402823466E+038 ECU_ADDRESS 0x70004820 /end MEASUREMENT
/begin MEASUREMENT SDMTLCS_CurrentRmsIvFild "SDMTLCS_CurrentRmsIvFild" FLOAT32_IEEE F_1_p0_4 1 2 -3.402823466E+038 3.402823466E+038 ECU_ADDRESS 0x7000481C /end MEASUREMENT
/begin MEASUREMENT SDMTLCS_CurrentRmsIvFildZ "SDMTLCS_CurrentRmsIvFildZ" FLOAT32_IEEE F_1_p0_4 1 2 -3.402823466E+038 3.402823466E+038 ECU_ADDRESS 0x70004818 /end MEASUREMENT
/begin MEASUREMENT SDMTLCS_CurrentRmsIwFild "SDMTLCS_CurrentRmsIwFild" FLOAT32_IEEE F_1_p0_4 1 2 -3.402823466E+038 3.402823466E+038 ECU_ADDRESS 0x70004814 /end MEASUREMENT
/begin MEASUREMENT SDMTLCS_CurrentRmsIwFildZ "SDMTLCS_CurrentRmsIwFildZ" FLOAT32_IEEE F_1_p0_4 1 2 -3.402823466E+038 3.402823466E+038 ECU_ADDRESS 0x70004810 /end MEASUREMENT
/begin MEASUREMENT SDMTLCS_IuInput "SDMTLCS_IuInput" FLOAT32_IEEE F_1_p0_4 1 2 -3.402823466E+038 3.402823466E+038 ECU_ADDRESS 0x7000480C /end MEASUREMENT
/begin MEASUREMENT SDMTLCS_Iuvw3_Rms[0] "SDMTLCS_Iuvw3_Rms" FLOAT32_IEEE F_1_p0_4 1 2 -3.402823466E+038 3.402823466E+038 ECU_ADDRESS 0x70004800 /end MEASUREMENT
/begin MEASUREMENT SDMTLCS_Iuvw3_Rms[1] "SDMTLCS_Iuvw3_Rms" FLOAT32_IEEE F_1_p0_4 1 2 -3.402823466E+038 3.402823466E+038 ECU_ADDRESS 0x70004804 /end MEASUREMENT
/begin MEASUREMENT SDMTLCS_Iuvw3_Rms[2] "SDMTLCS_Iuvw3_Rms" FLOAT32_IEEE F_1_p0_4 1 2 -3.402823466E+038 3.402823466E+038 ECU_ADDRESS 0x70004808 /end MEASUREMENT
/begin MEASUREMENT SDMTLCS_IvInput "SDMTLCS_IvInput" FLOAT32_IEEE F_1_p0_4 1 2 -3.402823466E+038 3.402823466E+038 ECU_ADDRESS 0x700047FC /end MEASUREMENT
/begin MEASUREMENT SDMTLCS_IwInput "SDMTLCS_IwInput" FLOAT32_IEEE F_1_p0_4 1 2 -3.402823466E+038 3.402823466E+038 ECU_ADDRESS 0x700047F8 /end MEASUREMENT
/begin MEASUREMENT SDMTLCS_RmsNumberZ "SDMTLCS_RmsNumberZ" ULONG F_1_p0_4 1 2 0 4294967295 ECU_ADDRESS 0x700047F4 /end MEASUREMENT
/begin MEASUREMENT SDMTLCS_RmsSumIuZ "SDMTLCS_RmsSumIuZ" FLOAT32_IEEE F_1_p0_4 1 2 -3.402823466E+038 3.402823466E+038 ECU_ADDRESS 0x700047F0 /end MEASUREMENT
/begin MEASUREMENT SDMTLCS_RmsSumIvZ "SDMTLCS_RmsSumIvZ" FLOAT32_IEEE F_1_p0_4 1 2 -3.402823466E+038 3.402823466E+038 ECU_ADDRESS 0x700047EC /end MEASUREMENT
/begin MEASUREMENT SDMTLCS_RmsSumIwZ "SDMTLCS_RmsSumIwZ" FLOAT32_IEEE F_1_p0_4 1 2 -3.402823466E+038 3.402823466E+038 ECU_ADDRESS 0x700047E8 /end MEASUREMENT
/begin MEASUREMENT SDMTMEP_AutoPhase "SDMTMEP_AutoPhase" FLOAT32_IEEE F_1_p0_47 1 2 -1 1 ECU_ADDRESS 0x70004944 /end MEASUREMENT
/begin MEASUREMENT SDMTMEP_BenchModeValueZ "Bench Mode value with 1 time delay" UBYTE Bool_ON_OFF 1 2 0 1 BIT_MASK 0x01 ECU_ADDRESS 0x70004942 /end MEASUREMENT
/begin MEASUREMENT SDMTMEP_CosOutRangeHighDetn "SDMTMEP_CosOutRangeHighDetn" UBYTE Bool_ON_OFF 1 2 0 1 BIT_MASK 0x01 ECU_ADDRESS 0x70004941 /end MEASUREMENT
/begin MEASUREMENT SDMTMEP_CosOutRangeLowDetn "SDMTMEP_CosOutRangeLowDetn" UBYTE Bool_ON_OFF 1 2 0 1 BIT_MASK 0x01 ECU_ADDRESS 0x70004940 /end MEASUREMENT
/begin MEASUREMENT SDMTMEP_CosResultAvgMax "SDMTMEP_CosResultAvgMax" FLOAT32_IEEE F_1_p0_4 1 2 -3.402823466E+038 3.402823466E+038 ECU_ADDRESS 0x7000493C /end MEASUREMENT
/begin MEASUREMENT SDMTMEP_CosResultAvgMin "SDMTMEP_CosResultAvgMin" FLOAT32_IEEE F_1_p0_4 1 2 -3.402823466E+038 3.402823466E+038 ECU_ADDRESS 0x70004938 /end MEASUREMENT
/begin MEASUREMENT SDMTMEP_CosResultMax "SDMTMEP_CosResultMax" FLOAT32_IEEE F_1_p0_4 1 2 -3.402823466E+038 3.402823466E+038 ECU_ADDRESS 0x70004934 /end MEASUREMENT
/begin MEASUREMENT SDMTMEP_CosResultMaxSumZ "SDMTMEP_CosResultMaxSumZ" FLOAT32_IEEE F_1_p0_4 1 2 -3.402823466E+038 3.402823466E+038 ECU_ADDRESS 0x70004930 /end MEASUREMENT
/begin MEASUREMENT SDMTMEP_CosResultMaxZ "SDMTMEP_CosResultMaxZ" FLOAT32_IEEE F_1_p0_4 1 2 -3.402823466E+038 3.402823466E+038 ECU_ADDRESS 0x7000492C /end MEASUREMENT
/begin MEASUREMENT SDMTMEP_CosResultMin "SDMTMEP_CosResultMin" FLOAT32_IEEE F_1_p0_4 1 2 -3.402823466E+038 3.402823466E+038 ECU_ADDRESS 0x70004928 /end MEASUREMENT
/begin MEASUREMENT SDMTMEP_CosResultMinSumZ "SDMTMEP_CosResultMinSumZ" FLOAT32_IEEE F_1_p0_4 1 2 -3.402823466E+038 3.402823466E+038 ECU_ADDRESS 0x70004924 /end MEASUREMENT
/begin MEASUREMENT SDMTMEP_CosResultMinZ "SDMTMEP_CosResultMinZ" FLOAT32_IEEE F_1_p0_4 1 2 -3.402823466E+038 3.402823466E+038 ECU_ADDRESS 0x70004920 /end MEASUREMENT
/begin MEASUREMENT SDMTMEP_CosScaled "scaled value of the resolver cosinus measure" FLOAT32_IEEE F_1_p0_55 1 2 -3.402823466E+038 3.402823466E+038 ECU_ADDRESS 0x7000491C /end MEASUREMENT
/begin MEASUREMENT SDMTMEP_CosSignSumZ "SDMTMEP_CosSignSumZ" FLOAT32_IEEE F_1_p0_4 1 2 -3.402823466E+038 3.402823466E+038 ECU_ADDRESS 0x70004918 /end MEASUREMENT
/begin MEASUREMENT SDMTMEP_DeltaTheta "difference between resolver angle and estimated angle" FLOAT32_IEEE F_1_p0_62 1 2 -3.402823466E+038 3.402823466E+038 ECU_ADDRESS 0x70004914 /end MEASUREMENT
/begin MEASUREMENT SDMTMEP_ElecSpeedRds "electrical speed" FLOAT32_IEEE F_1_p0_112 1 2 -3.402823466E+038 3.402823466E+038 ECU_ADDRESS 0x70004910 /end MEASUREMENT
/begin MEASUREMENT SDMTMEP_ErrorThetaElecRdSurPi "SDMTMEP_ErrorThetaElecRdSurPi" FLOAT32_IEEE F_1_p0_4 1 2 -3.402823466E+038 3.402823466E+038 ECU_ADDRESS 0x7000490C /end MEASUREMENT
/begin MEASUREMENT SDMTMEP_EstimatedCos "cosinus of the resolver angle estimation" FLOAT32_IEEE F_1_p0_55 1 2 -3.402823466E+038 3.402823466E+038 ECU_ADDRESS 0x70004908 /end MEASUREMENT
/begin MEASUREMENT SDMTMEP_EstimatedSin "sinus of the resolver angle estimation" FLOAT32_IEEE F_1_p0_55 1 2 -3.402823466E+038 3.402823466E+038 ECU_ADDRESS 0x70004904 /end MEASUREMENT
/begin MEASUREMENT SDMTMEP_ForwardDirect "SDMTMEP_ForwardDirect" SBYTE F_1_p0_4 1 2 -128 127 ECU_ADDRESS 0x70004900 /end MEASUREMENT
/begin MEASUREMENT SDMTMEP_GainCosSignFit "SDMTMEP_GainCosSignFit" FLOAT32_IEEE F_1_p0_4 1 2 -3.402823466E+038 3.402823466E+038 ECU_ADDRESS 0x700048FC /end MEASUREMENT
/begin MEASUREMENT SDMTMEP_GainCosTrim "SDMTMEP_GainCosTrim" FLOAT32_IEEE F_1_p0_4 1 2 -3.402823466E+038 3.402823466E+038 ECU_ADDRESS 0x700048F8 /end MEASUREMENT
/begin MEASUREMENT SDMTMEP_GainCosTrimCal "SDMTMEP_GainCosTrimCal" FLOAT32_IEEE F_1_p0_4 1 2 -3.402823466E+038 3.402823466E+038 ECU_ADDRESS 0x700048F4 /end MEASUREMENT
/begin MEASUREMENT SDMTMEP_GainSinTrim "SDMTMEP_GainSinTrim" FLOAT32_IEEE F_1_p0_4 1 2 -3.402823466E+038 3.402823466E+038 ECU_ADDRESS 0x700048F0 /end MEASUREMENT
/begin MEASUREMENT SDMTMEP_GainSinTrimCal "SDMTMEP_GainSinTrimCal" FLOAT32_IEEE F_1_p0_4 1 2 -3.402823466E+038 3.402823466E+038 ECU_ADDRESS 0x700048EC /end MEASUREMENT
/begin MEASUREMENT SDMTMEP_HalfRdSurPiCadran2or4 "signal equal to 0.5rd/pi when the angle is in the 2 or 4 quadrant of the unit circle" UWORD F_0v0000152588_p0_113 1 2 0 0.9999847412 ECU_ADDRESS 0x700048E8 /end MEASUREMENT
/begin MEASUREMENT SDMTMEP_IllegalResParDetn "SDMTMEP_IllegalResParDetn" UBYTE Bool_ON_OFF 1 2 0 1 BIT_MASK 0x01 ECU_ADDRESS 0x700048E6 /end MEASUREMENT
/begin MEASUREMENT SDMTMEP_IllegalResParFlt "SDMTMEP_IllegalResParFlt" UBYTE Bool_ON_OFF 1 2 0 1 BIT_MASK 0x01 ECU_ADDRESS 0x700048E5 /end MEASUREMENT
/begin MEASUREMENT SDMTMEP_IllegalResParFltLock "SDMTMEP_IllegalResParFltLock" UBYTE Bool_ON_OFF 1 2 0 1 BIT_MASK 0x01 ECU_ADDRESS 0x700048E4 /end MEASUREMENT
/begin MEASUREMENT SDMTMEP_ImposedThetaZ "SDMTMEP_ImposedThetaZ" FLOAT32_IEEE F_1_p0_4 1 2 -3.402823466E+038 3.402823466E+038 ECU_ADDRESS 0x700048E0 /end MEASUREMENT
/begin MEASUREMENT SDMTMEP_MecaSpeedRds "value of the motor mechanical speed" FLOAT32_IEEE F_1_p0_112 1 2 -3.402823466E+038 3.402823466E+038 ECU_ADDRESS 0x700048DC /end MEASUREMENT
/begin MEASUREMENT SDMTMEP_MecaSpeedRpm "value of the motor mechanical speed" FLOAT32_IEEE F_1_p0_52 1 2 -3.402823466E+038 3.402823466E+038 ECU_ADDRESS 0x700048D8 /end MEASUREMENT
/begin MEASUREMENT SDMTMEP_MecaSpeedRpmOc "SDMTMEP_MecaSpeedRpmOc" FLOAT32_IEEE F_1_p0_4 1 2 -3.402823466E+038 3.402823466E+038 ECU_ADDRESS 0x700048D4 /end MEASUREMENT
/begin MEASUREMENT SDMTMEP_OcCosAdcFildZ "SDMTMEP_OcCosAdcFildZ" FLOAT32_IEEE F_1_p0_4 1 2 -3.402823466E+038 3.402823466E+038 ECU_ADDRESS 0x700048D0 /end MEASUREMENT
/begin MEASUREMENT SDMTMEP_OcRotoringFailFlg "SDMTMEP_OcRotoringFailFlg" UBYTE Bool_ON_OFF 1 2 0 1 BIT_MASK 0x01 ECU_ADDRESS 0x700048CD /end MEASUREMENT
/begin MEASUREMENT SDMTMEP_OcRotoringNormal "SDMTMEP_OcRotoringNormal" UBYTE Bool_ON_OFF 1 2 0 1 BIT_MASK 0x01 ECU_ADDRESS 0x700048CC /end MEASUREMENT
/begin MEASUREMENT SDMTMEP_OcSinAdcFildZ "SDMTMEP_OcSinAdcFildZ" FLOAT32_IEEE F_1_p0_4 1 2 -3.402823466E+038 3.402823466E+038 ECU_ADDRESS 0x700048C8 /end MEASUREMENT
/begin MEASUREMENT SDMTMEP_OffsetCosTrim "SDMTMEP_OffsetCosTrim" FLOAT32_IEEE F_1_p0_4 1 2 -3.402823466E+038 3.402823466E+038 ECU_ADDRESS 0x700048C4 /end MEASUREMENT
/begin MEASUREMENT SDMTMEP_OffsetCosTrimCal "SDMTMEP_OffsetCosTrimCal" FLOAT32_IEEE F_1_p0_4 1 2 -3.402823466E+038 3.402823466E+038 ECU_ADDRESS 0x700048C0 /end MEASUREMENT
/begin MEASUREMENT SDMTMEP_OffsetSinTrim "SDMTMEP_OffsetSinTrim" FLOAT32_IEEE F_1_p0_4 1 2 -3.402823466E+038 3.402823466E+038 ECU_ADDRESS 0x700048BC /end MEASUREMENT
/begin MEASUREMENT SDMTMEP_OffsetSinTrimCal "SDMTMEP_OffsetSinTrimCal" FLOAT32_IEEE F_1_p0_4 1 2 -3.402823466E+038 3.402823466E+038 ECU_ADDRESS 0x700048B8 /end MEASUREMENT
/begin MEASUREMENT SDMTMEP_PerdTimerZ "SDMTMEP_PerdTimerZ" UWORD F_1_p0_4 1 2 0 65535 ECU_ADDRESS 0x700048B4 /end MEASUREMENT
/begin MEASUREMENT SDMTMEP_PosCompError "SDMTMEP_PosCompError" FLOAT32_IEEE F_1_p0_4 1 2 -3.402823466E+038 3.402823466E+038 ECU_ADDRESS 0x700048B0 /end MEASUREMENT
/begin MEASUREMENT SDMTMEP_PrevElecSpeedRds "SDMTMEP_PrevElecSpeedRds" FLOAT32_IEEE F_1_p0_4 1 2 -3.402823466E+038 3.402823466E+038 ECU_ADDRESS 0x700048AC /end MEASUREMENT
/begin MEASUREMENT SDMTMEP_PrevThetaElecRdSurPi "SDMTMEP_PrevThetaElecRdSurPi" FLOAT32_IEEE F_1_p0_4 1 2 -3.402823466E+038 3.402823466E+038 ECU_ADDRESS 0x700048A8 /end MEASUREMENT
/begin MEASUREMENT SDMTMEP_ResThetaRdSurPiOcZ "SDMTMEP_ResThetaRdSurPiOcZ" FLOAT32_IEEE F_1_p0_4 1 2 -3.402823466E+038 3.402823466E+038 ECU_ADDRESS 0x700048A4 /end MEASUREMENT
/begin MEASUREMENT SDMTMEP_ResolNextThetaRdByPi "next time step value of the resolver angle" FLOAT32_IEEE F_1_p0_76 1 2 -3.402823466E+038 3.402823466E+038 ECU_ADDRESS 0x700048A0 /end MEASUREMENT
/begin MEASUREMENT SDMTMEP_ResolverAcceleration "resolver acceleration" FLOAT32_IEEE F_1_p0_114 1 2 -3.402823466E+038 3.402823466E+038 ECU_ADDRESS 0x7000489C /end MEASUREMENT
/begin MEASUREMENT SDMTMEP_ResolverPositionFailFlg "SDMTMEP_ResolverPositionFailFlg" UBYTE Bool_ON_OFF 1 2 0 1 BIT_MASK 0x01 ECU_ADDRESS 0x70004898 /end MEASUREMENT
/begin MEASUREMENT SDMTMEP_ResolverSpeedRds "resolver speed" FLOAT32_IEEE F_1_p0_112 1 2 -1000000 1000000 ECU_ADDRESS 0x70004894 /end MEASUREMENT
/begin MEASUREMENT SDMTMEP_ResolverSpeedRdsFild "resolver speed" FLOAT32_IEEE F_1_p0_112 1 2 -1000000 1000000 ECU_ADDRESS 0x70004890 /end MEASUREMENT
/begin MEASUREMENT SDMTMEP_ResolverSpeedRdsFildOc "resolver speed" FLOAT32_IEEE F_1_p0_112 1 2 -1000000 1000000 ECU_ADDRESS 0x7000488C /end MEASUREMENT
/begin MEASUREMENT SDMTMEP_ResolverSpeedRdsFildZ "resolver speed filtered with 1 time delay" FLOAT32_IEEE F_1_p0_112 1 2 -3.402823466E+038 3.402823466E+038 ECU_ADDRESS 0x70004888 /end MEASUREMENT
/begin MEASUREMENT SDMTMEP_ResolverSpeedRdsOcZ "resolver speed with 1 time delay" FLOAT32_IEEE F_1_p0_112 1 2 -1000000 1000000 ECU_ADDRESS 0x70004884 /end MEASUREMENT
/begin MEASUREMENT SDMTMEP_ResolverSpeedRdsZ "resolver speed with 1 time delay" FLOAT32_IEEE F_1_p0_112 1 2 -1000000 1000000 ECU_ADDRESS 0x70004880 /end MEASUREMENT
/begin MEASUREMENT SDMTMEP_ResolverThetaRdSurPi "value of the resolver angle" FLOAT32_IEEE F_1_p0_76 1 2 -3.402823466E+038 3.402823466E+038 ECU_ADDRESS 0x7000487C /end MEASUREMENT
/begin MEASUREMENT SDMTMEP_ResolverThetaRdSurPiOc "value of the resolver angle" FLOAT32_IEEE F_1_p0_76 1 2 -3.402823466E+038 3.402823466E+038 ECU_ADDRESS 0x70004878 /end MEASUREMENT
/begin MEASUREMENT SDMTMEP_ResolverThetaRdSurPiOcZ "value of the resolver angle with 1 time delay" FLOAT32_IEEE F_1_p0_76 1 2 -3.402823466E+038 3.402823466E+038 ECU_ADDRESS 0x70004874 /end MEASUREMENT
/begin MEASUREMENT SDMTMEP_ResolverThetaRdSurPiZ "value of the resolver angle with 1 time delay" FLOAT32_IEEE F_1_p0_76 1 2 -3.402823466E+038 3.402823466E+038 ECU_ADDRESS 0x70004870 /end MEASUREMENT
/begin MEASUREMENT SDMTMEP_SinOutRangeHighDetn "SDMTMEP_SinOutRangeHighDetn" UBYTE Bool_ON_OFF 1 2 0 1 BIT_MASK 0x01 ECU_ADDRESS 0x7000486D /end MEASUREMENT
/begin MEASUREMENT SDMTMEP_SinOutRangeLowDetn "SDMTMEP_SinOutRangeLowDetn" UBYTE Bool_ON_OFF 1 2 0 1 BIT_MASK 0x01 ECU_ADDRESS 0x7000486C /end MEASUREMENT
/begin MEASUREMENT SDMTMEP_SinResultAvgMax "SDMTMEP_SinResultAvgMax" FLOAT32_IEEE F_1_p0_4 1 2 -3.402823466E+038 3.402823466E+038 ECU_ADDRESS 0x70004868 /end MEASUREMENT
/begin MEASUREMENT SDMTMEP_SinResultAvgMin "SDMTMEP_SinResultAvgMin" FLOAT32_IEEE F_1_p0_4 1 2 -3.402823466E+038 3.402823466E+038 ECU_ADDRESS 0x70004864 /end MEASUREMENT
/begin MEASUREMENT SDMTMEP_SinResultMax "SDMTMEP_SinResultMax" FLOAT32_IEEE F_1_p0_4 1 2 -3.402823466E+038 3.402823466E+038 ECU_ADDRESS 0x70004860 /end MEASUREMENT
/begin MEASUREMENT SDMTMEP_SinResultMaxSumZ "SDMTMEP_SinResultMaxSumZ" FLOAT32_IEEE F_1_p0_4 1 2 -3.402823466E+038 3.402823466E+038 ECU_ADDRESS 0x7000485C /end MEASUREMENT
/begin MEASUREMENT SDMTMEP_SinResultMaxZ "SDMTMEP_SinResultMaxZ" FLOAT32_IEEE F_1_p0_4 1 2 -3.402823466E+038 3.402823466E+038 ECU_ADDRESS 0x70004858 /end MEASUREMENT
/begin MEASUREMENT SDMTMEP_SinResultMin "SDMTMEP_SinResultMin" FLOAT32_IEEE F_1_p0_4 1 2 -3.402823466E+038 3.402823466E+038 ECU_ADDRESS 0x70004854 /end MEASUREMENT
/begin MEASUREMENT SDMTMEP_SinResultMinSumZ "SDMTMEP_SinResultMinSumZ" FLOAT32_IEEE F_1_p0_4 1 2 -3.402823466E+038 3.402823466E+038 ECU_ADDRESS 0x70004850 /end MEASUREMENT
/begin MEASUREMENT SDMTMEP_SinResultMinZ "SDMTMEP_SinResultMinZ" FLOAT32_IEEE F_1_p0_4 1 2 -3.402823466E+038 3.402823466E+038 ECU_ADDRESS 0x7000484C /end MEASUREMENT
/begin MEASUREMENT SDMTMEP_SinScaled "scaled value of the resolver sinus measure" FLOAT32_IEEE F_1_p0_55 1 2 -3.402823466E+038 3.402823466E+038 ECU_ADDRESS 0x70004848 /end MEASUREMENT
/begin MEASUREMENT SDMTMEP_SingleConversion "Single conversion of SDMTMEP_HalfRdSurPiCadran2or4" FLOAT32_IEEE F_1_p0_76 1 2 -3.402823466E+038 3.402823466E+038 ECU_ADDRESS 0x70004844 /end MEASUREMENT
/begin MEASUREMENT SDMTMEP_SpeedCmpFailFlg "SDMTMEP_SpeedCmpFailFlg" UBYTE Bool_ON_OFF 1 2 0 1 BIT_MASK 0x01 ECU_ADDRESS 0x70004840 /end MEASUREMENT
/begin MEASUREMENT SDMTMEP_ThetaElecRdSurPi "value of the electrical angle" FLOAT32_IEEE F_1_p0_76 1 2 -3.402823466E+038 3.402823466E+038 ECU_ADDRESS 0x7000483C /end MEASUREMENT
/begin MEASUREMENT SDMTMEP_ThetaInitRdSurPi "initial value of the resolver angle" FLOAT32_IEEE F_1_p0_76 1 2 -3.402823466E+038 3.402823466E+038 ECU_ADDRESS 0x70004838 /end MEASUREMENT
/begin MEASUREMENT SDMTMEP_ThetaTempRdSurPi "intermediate angle" FLOAT32_IEEE F_1_p0_76 1 2 -3.402823466E+038 3.402823466E+038 ECU_ADDRESS 0x70004834 /end MEASUREMENT
/begin MEASUREMENT SDMTMEP_ThetaTempRdSurPiOc "intermediate angle" FLOAT32_IEEE F_1_p0_76 1 2 -3.402823466E+038 3.402823466E+038 ECU_ADDRESS 0x70004830 /end MEASUREMENT
/begin MEASUREMENT SDMTMEP_ThetaTempRdSurPiOcZ "intermediate angle with 1 time delay" FLOAT32_IEEE F_1_p0_76 1 2 -3.402823466E+038 3.402823466E+038 ECU_ADDRESS 0x7000482C /end MEASUREMENT
/begin MEASUREMENT SDMTMEP_ThetaTempRdSurPiZ "intermediate angle with 1 time delay" FLOAT32_IEEE F_1_p0_76 1 2 -3.402823466E+038 3.402823466E+038 ECU_ADDRESS 0x70004828 /end MEASUREMENT
/begin MEASUREMENT SD_AutoPhasingAngle_F32 "SD_AutoPhasingAngle_F32" FLOAT32_IEEE F_1_p0_4 1 2 -3.402823466E+038 3.402823466E+038 ECU_ADDRESS 0x700047E4 /end MEASUREMENT
/begin MEASUREMENT SD_AutophasingCal_F32 "SD_AutophasingCal_F32" FLOAT32_IEEE F_1_p0_4 1 2 -3.402823466E+038 3.402823466E+038 ECU_ADDRESS 0x700047E0 /end MEASUREMENT
/begin MEASUREMENT SD_FtModeReq_U16 "SD_FtModeReq_U16" UWORD F_1_p0_4 1 2 0 65535 ECU_ADDRESS 0x700047DC /end MEASUREMENT
/begin MEASUREMENT SD_GainCosTrim_F32 "SD_GainCosTrim_F32" FLOAT32_IEEE F_1_p0_4 1 2 -3.402823466E+038 3.402823466E+038 ECU_ADDRESS 0x700047D8 /end MEASUREMENT
/begin MEASUREMENT SD_GainSinTrim_F32 "SD_GainSinTrim_F32" FLOAT32_IEEE F_1_p0_4 1 2 -3.402823466E+038 3.402823466E+038 ECU_ADDRESS 0x700047D4 /end MEASUREMENT
/begin MEASUREMENT SD_ImposedThetaRdSurPi_F32 "SD_ImposedThetaRdSurPi_F32" FLOAT32_IEEE F_1_p0_4 1 2 -3.402823466E+038 3.402823466E+038 ECU_ADDRESS 0x700047D0 /end MEASUREMENT
/begin MEASUREMENT SD_Iuvw3_F32[0] "SD_Iuvw3_F32" FLOAT32_IEEE F_1_p0_4 1 2 -3.402823466E+038 3.402823466E+038 ECU_ADDRESS 0x700047C4 /end MEASUREMENT
/begin MEASUREMENT SD_Iuvw3_F32[1] "SD_Iuvw3_F32" FLOAT32_IEEE F_1_p0_4 1 2 -3.402823466E+038 3.402823466E+038 ECU_ADDRESS 0x700047C8 /end MEASUREMENT
/begin MEASUREMENT SD_Iuvw3_F32[2] "SD_Iuvw3_F32" FLOAT32_IEEE F_1_p0_4 1 2 -3.402823466E+038 3.402823466E+038 ECU_ADDRESS 0x700047CC /end MEASUREMENT
/begin MEASUREMENT SD_MTMEPState_U16 "SD_MTMEPState_U16" UWORD F_1_p0_4 1 2 0 65535 ECU_ADDRESS 0x700047C2 /end MEASUREMENT
/begin MEASUREMENT SD_OccycleFinish_B "SD_OccycleFinish_B" UBYTE Bool_ON_OFF 1 2 0 1 BIT_MASK 0x01 ECU_ADDRESS 0x700047C0 /end MEASUREMENT
/begin MEASUREMENT SD_OffsetCosTrim_F32 "SD_OffsetCosTrim_F32" FLOAT32_IEEE F_1_p0_4 1 2 -3.402823466E+038 3.402823466E+038 ECU_ADDRESS 0x700047BC /end MEASUREMENT
/begin MEASUREMENT SD_OffsetSinTrim_F32 "SD_OffsetSinTrim_F32" FLOAT32_IEEE F_1_p0_4 1 2 -3.402823466E+038 3.402823466E+038 ECU_ADDRESS 0x700047B8 /end MEASUREMENT
/begin MEASUREMENT SD_ResolverSinCos2_U16[0] "SD_ResolverSinCos2_U16" UWORD F_1_p0_4 1 2 0 65535 ECU_ADDRESS 0x700047B4 /end MEASUREMENT
/begin MEASUREMENT SD_ResolverSinCos2_U16[1] "SD_ResolverSinCos2_U16" UWORD F_1_p0_4 1 2 0 65535 ECU_ADDRESS 0x700047B6 /end MEASUREMENT
/begin MEASUREMENT SD_RotoringCalEnable_B "SD_RotoringCalEnable_B" UBYTE Bool_ON_OFF 1 2 0 1 BIT_MASK 0x01 ECU_ADDRESS 0x700047B2 /end MEASUREMENT
/begin MEASUREMENT SD_RotoringCalFinish_B "SD_RotoringCalFinish_B" UBYTE Bool_ON_OFF 1 2 0 1 BIT_MASK 0x01 ECU_ADDRESS 0x700047B1 /end MEASUREMENT
/begin MEASUREMENT SD_RotoringCalStart_B "SD_RotoringCalStart_B" UBYTE Bool_ON_OFF 1 2 0 1 BIT_MASK 0x01 ECU_ADDRESS 0x700047B0 /end MEASUREMENT
/begin MEASUREMENT SD_UbatHV_F32 "SD_UbatHV_F32" FLOAT32_IEEE F_1_p0_4 1 2 -3.402823466E+038 3.402823466E+038 ECU_ADDRESS 0x700047AC /end MEASUREMENT
/begin COMPU_METHOD F_1_p0_4 "" RAT_FUNC "%9.2" "-" COEFFS 0 1 0 0 0 1 /end COMPU_METHOD
/begin COMPU_METHOD F_1_p0_35 "" RAT_FUNC "%9.2" "Hz" COEFFS 0 1 0 0 0 1 /end COMPU_METHOD
/begin COMPU_METHOD F_1_p0_38 "" RAT_FUNC "%9.2" "V" COEFFS 0 1 0 0 0 1 /end COMPU_METHOD
/begin COMPU_METHOD F_1_p0_40 "" RAT_FUNC "%9.2" "[]" COEFFS 0 1 0 0 0 1 /end COMPU_METHOD
/begin COMPU_METHOD F_1_p0_43 "" RAT_FUNC "%9.2" "Nan." COEFFS 0 1 0 0 0 1 /end COMPU_METHOD
/begin COMPU_METHOD F_1_p0_45 "" RAT_FUNC "%9.2" "Nan" COEFFS 0 1 0 0 0 1 /end COMPU_METHOD
/begin COMPU_METHOD F_1_p0_46 "" RAT_FUNC "%9.2" "A" COEFFS 0 1 0 0 0 1 /end COMPU_METHOD
/begin COMPU_METHOD F_1_p0_47 "" RAT_FUNC "%9.2" "None" COEFFS 0 1 0 0 0 1 /end COMPU_METHOD
/begin COMPU_METHOD F_1_p0_49 "" RAT_FUNC "%9.2" "Nm" COEFFS 0 1 0 0 0 1 /end COMPU_METHOD
/begin COMPU_METHOD F_1_p0_50 "" RAT_FUNC "%9.2" "Rpm" COEFFS 0 1 0 0 0 1 /end COMPU_METHOD
/begin COMPU_METHOD F_1_p0_52 "" RAT_FUNC "%9.2" "rpm" COEFFS 0 1 0 0 0 1 /end COMPU_METHOD
/begin COMPU_METHOD F_1_p0_53 "" RAT_FUNC "%9.2" "s" COEFFS 0 1 0 0 0 1 /end COMPU_METHOD
/begin COMPU_METHOD F_1_p0_55 "" RAT_FUNC "%9.2" "none" COEFFS 0 1 0 0 0 1 /end COMPU_METHOD
/begin COMPU_METHOD F_1_p0_56 "" RAT_FUNC "%9.2" "N.m" COEFFS 0 1 0 0 0 1 /end COMPU_METHOD
/begin COMPU_METHOD F_1_p0_57 "" RAT_FUNC "%9.2" "1/degC" COEFFS 0 1 0 0 0 1 /end COMPU_METHOD
/begin COMPU_METHOD F_1_p0_58 "" RAT_FUNC "%9.2" "degC" COEFFS 0 1 0 0 0 1 /end COMPU_METHOD
/begin COMPU_METHOD F_1_p0_59 "" RAT_FUNC "%9.2" "1/V" COEFFS 0 1 0 0 0 1 /end COMPU_METHOD
/begin COMPU_METHOD F_1_p0_60 "" RAT_FUNC "%9.2" "us" COEFFS 0 1 0 0 0 1 /end COMPU_METHOD
/begin COMPU_METHOD F_1_p0_61 "" RAT_FUNC "%9.2" "Ohms" COEFFS 0 1 0 0 0 1 /end COMPU_METHOD
/begin COMPU_METHOD F_1_p0_62 "" RAT_FUNC "%9.2" "rd" COEFFS 0 1 0 0 0 1 /end COMPU_METHOD
/begin COMPU_METHOD F_1_p0_63 "" RAT_FUNC "%9.2" "Volts" COEFFS 0 1 0 0 0 1 /end COMPU_METHOD
/begin COMPU_METHOD F_1_p0_64 "" RAT_FUNC "%9.2" "Amps" COEFFS 0 1 0 0 0 1 /end COMPU_METHOD
/begin COMPU_METHOD F_1_p0_65 "" RAT_FUNC "%9.2" "Volt" COEFFS 0 1 0 0 0 1 /end COMPU_METHOD
/begin COMPU_METHOD F_1_p0_66 "" RAT_FUNC "%9.2" "ms" COEFFS 0 1 0 0 0 1 /end COMPU_METHOD
/begin COMPU_METHOD F_1_p0_67 "" RAT_FUNC "%9.2" "rpm/s" COEFFS 0 1 0 0 0 1 /end COMPU_METHOD
/begin COMPU_METHOD F_1_p0_68 "" RAT_FUNC "%9.2" "rds" COEFFS 0 1 0 0 0 1 /end COMPU_METHOD
/begin COMPU_METHOD F_1_p0_69 "" RAT_FUNC "%9.2" "W" COEFFS 0 1 0 0 0 1 /end COMPU_METHOD
/begin COMPU_METHOD F_1_p0_72 "" RAT_FUNC "%9.2" "Deg Celsius" COEFFS 0 1 0 0 0 1 /end COMPU_METHOD
/begin COMPU_METHOD F_1_p0_73 "" RAT_FUNC "%9.2" "Deg_Celsius" COEFFS 0 1 0 0 0 1 /end COMPU_METHOD
/begin COMPU_METHOD F_1_p0_74 "" RAT_FUNC "%9.2" "dec" COEFFS 0 1 0 0 0 1 /end COMPU_METHOD
/begin COMPU_METHOD F_1_p0_75 "" RAT_FUNC "%9.2" "rad" COEFFS 0 1 0 0 0 1 /end COMPU_METHOD
/begin COMPU_METHOD F_1_p0_76 "" RAT_FUNC "%9.2" "rd/pi" COEFFS 0 1 0 0 0 1 /end COMPU_METHOD
/begin COMPU_METHOD F_1_p0_77 "" RAT_FUNC "%9.2" "deta" COEFFS 0 1 0 0 0 1 /end COMPU_METHOD
/begin COMPU_METHOD F_1_p0_112 "" RAT_FUNC "%9.2" "rd/s" COEFFS 0 1 0 0 0 1 /end COMPU_METHOD
/begin COMPU_METHOD F_0v0000152588_p0_113 "" RAT_FUNC "%9.5" "rd/pi" COEFFS 0 1 0 0 0 1.52588e-005 /end COMPU_METHOD
/begin COMPU_METHOD F_1_p0_114 "" RAT_FUNC "%9.2" "rd/s?" COEFFS 0 1 0 0 0 1 /end COMPU_METHOD
/begin COMPU_METHOD Id_0x00 "" RAT_FUNC "%9.2" "." COEFFS 0 1 0 0 0 1 /end COMPU_METHOD
/begin COMPU_METHOD Bool_ON_OFF "" TAB_VERB "%8.4" "." COMPU_TAB_REF Bool_ON_OFF_table /end COMPU_METHOD
/begin COMPU_VTAB Bool_ON_OFF_table "" TAB_VERB 2 0 "OFF" 1 "ON" /end COMPU_VTAB
/begin FUNCTION SWC_FT ""
 /begin DEF_CHARACTERISTIC FTASBDS_BatVoltDrtEnableC FTASBDS_LutBatteryDeratingGainC FTASBDS_LutBatteryVoltageC FTASBDS_LutInMecaSpeedRpmC FTASBDS_LutOutDeratingGainC FTASBDS_ManualDeratingGainC FTASBDS_MaxDeratingGainC FTASBDS_MinDeratingGainC FTASBDS_UbatHVNominalC FTASBDS_ZeroSpdC FTASDPM_I0DeratingMaxC FTASDPM_I0DeratingMinC FTASDPM_IdDeratingMaxC FTASDPM_IdDeratingMinC FTASDPM_IqDeratingMaxC FTASDPM_IqDeratingMinC FTASDPM_SpeedDrtMaxRpmC FTASDPM_SpeedDrtMinRpmC FTASETP_ControllerEstPmKiC FTASETP_ControllerEstPmKpC FTASETP_ControllerPmKiC FTASETP_ControllerPmKpC FTASETP_EstPmDrtEnableC FTASETP_EstPmKiMaxC FTASETP_EstPmMaximalTempC FTASETP_LutInMecaSpeedRpmC FTASETP_MaxDeratingGainC FTASETP_MinDeratingGainC FTASETP_OpenLoopEstPmDrtGainC FTASETP_PmDrtEnableC FTASETP_PmKiMaxC FTASETP_PmMaximalTempC FTASMTP_ControllerWndgKiC FTASMTP_ControllerWndgKpC FTASMTP_MaxDeratingGainC FTASMTP_MinDeratingGainC FTASMTP_WndgDrtEnableC FTASMTP_WndgKiMaxC FTASMTP_WndgMaximalTempC FTASOSP_LutMotDeratingGainC FTASOSP_LutMotorSpeedC FTASOSP_ManualDeratingGainC FTASOSP_MaxDeratingGainC FTASOSP_MinDeratingGainC FTASOSP_MotorSpdDrtEnableC FTCIVDC_Concordia33C FTCIVDC_DeadComDisableIsC FTCIVDC_DeadComEnableIsC FTCIVDC_DeadCompCurFildNumC FTCIVDC_DeadCompDutyFildNumC FTCIVDC_DeadCurrentSwitchC FTCIVDC_DeadZnCompEnaC FTCIVDC_DeadZnCompSpeedHighC FTCIVDC_DeadZnCompSpeedLowC FTCIVDC_DeadZoneTimeUsC FTCIVDC_DefaultPwmFrequencyC FTCIVDC_DutyCycleMaxC FTCIVDC_DutyCycleMinC FTCIVDC_ExtPwmOnOff3C FTCIVDC_FpgaDutyCycleMinMaxC FTCIVDC_FreqRangC FTCIVDC_InitDutyCycle3C FTCIVDC_InitPwmOnOff3C FTCIVDC_LutInSpeedC FTCIVDC_LutInTorqueC FTCIVDC_LutMecaspeedRpmC FTCIVDC_LutOutFreqLmtC FTCIVDC_LutPwmFrequenceC FTCIVDC_MecaSpdCutOffFrequencyC FTCIVDC_OperationnalPwmOnOff3C FTCIVDC_PwmFrequenceMaxC FTCIVDC_PwmFrequenceMinC FTCIVDC_PwmZeroMatchEnC FTCIVDC_PwmZeroMatchRevC FTCIVDC_RandFreqEnC FTCIVDC_RdFreqTimeC FTCIVDC_SpdMaxC FTCIVDC_SpdMinC FTCIVDC_UbatHVLowSatC FTCIVDC_VFreqEnableC FTCMCCS_CurrentLoopOrgEnC FTCMCCS_EM1dOpenLoopGainC FTCMCCS_EM1qOpenLoopGainC FTCMCCS_GenTableTorqueThrdC FTCMCCS_IdCurrLoopParOnOffC FTCMCCS_iM1dTgtFildTrC FTCMCCS_iM1qTgtFildTrC FTCMCCS_InitU0dqTgt3C FTCMCCS_IqCurrLoopParOnOffC FTCMCCS_Lm0C FTCMCCS_Lm1dC FTCMCCS_Lm1qC FTCMCCS_LutElecSpeedRds3C FTCMCCS_LutInSpeedRpmC FTCMCCS_LutInUbatC FTCMCCS_LutM0CtrlTrC FTCMCCS_LutOutM1dCtrlTrGC FTCMCCS_LutOutM1dCtrlTrMC FTCMCCS_LutOutM1qCtrlTrGC FTCMCCS_LutOutM1qCtrlTrMC FTCMCCS_M1dCtrlTrC FTCMCCS_M1qCtrlTrC FTCMCCS_PhimC FTCMCCS_RsC FTCMCCS_SampleTimeFactC FTCMCCS_TransEmfM1dGainC FTCMCCS_TransEmfM1qGainC FTCMCCS_VariableLm1dOnOffC FTCMCCS_VariableLm1qOnOffC FTCMCCS_VariablePhimOnOffC FTCMCTC_CoggingCompGainC FTCMCTC_CoggingCompOnOffC FTCMCTC_CoggingPhaseRdC FTCMCTC_H3CurrentOnOffC FTCMCTC_H3CurrentRatioC FTCMCTC_LutCoggingCompGainC FTCMCTC_LutElecSpeedRds2C FTCMCTC_LutElecSpeedRdsC FTCMCTC_LutH3CompGainC FTCMCTC_SpyThresholdC FTCMHIJ_24IdEnableC FTCMHIJ_24IqEnableC FTCMHIJ_24thTimesIdC FTCMHIJ_24thTimesIqC FTCMHIJ_HijCurrentOnOffC FTCMHIJ_HijMecaSpdRpmMaxC FTCMHIJ_IdqMaxLmtC FTCMHIJ_IdqMinLmtC FTCMHIJ_LutInSpeed24C FTCMHIJ_LutInSpeed6dC FTCMHIJ_LutInSpeedC FTCMHIJ_LutInSpeedPhaseIdC FTCMHIJ_LutInSpeedPhaseIqC FTCMHIJ_LutInTorque24C FTCMHIJ_LutInTorqueC FTCMHIJ_LutInTorqueGen24C FTCMHIJ_LutInTorqueGenC FTCMHIJ_LutOut24thPhaseIdC FTCMHIJ_LutOut24thPhaseIdGenC FTCMHIJ_LutOut24thPhaseIqC FTCMHIJ_LutOut24thPhaseIqGenC FTCMHIJ_LutOutBaseMagnitude12IdC FTCMHIJ_LutOutBaseMagnitude12IqC FTCMHIJ_LutOutBaseMagnitude12IqGenC FTCMHIJ_LutOutBaseMagnitude24IdC FTCMHIJ_LutOutBaseMagnitude24IdGenC FTCMHIJ_LutOutBaseMagnitude24IqC FTCMHIJ_LutOutBaseMagnitude24IqGenC FTCMHIJ_LutOutBaseMagnitude6IdC FTCMHIJ_LutOutBaseMagnitude6IdGenC FTCMHIJ_LutOutBaseMagnitude6IqC FTCMHIJ_LutOutSixthPhaseIdC FTCMHIJ_LutOutSixthPhaseIdGenC FTCMHIJ_LutOutSixthPhaseIqC FTCMHIJ_LutOutTwelfthPhaseIdC FTCMHIJ_LutOutTwelfthPhaseIqC FTCMHIJ_LutOutTwelfthPhaseIqGenC FTCMHIJ_SixIdEnableC FTCMHIJ_SixIqEnableC FTCMHIJ_SixTimesIdC FTCMHIJ_SixTimesIqC FTCMHIJ_TwelveIdEnableC FTCMHIJ_TwelveIqEnableC FTCMHIJ_TwelveTimesIdC FTCMHIJ_TwelveTimesIqC FTCMRPC_ConcordiaTrans33C FTCMSCS_CtrlSatToC FTCMSCS_CtrlTrC FTCMSCS_fC FTCMSCS_InitalValueEnC FTCMSCS_jC FTCMSCS_SpdAccPerMsThrC FTCMSCS_SpdOvershootFaultC FTCMSCS_ZeroSpdThrC FTCMSCS_ZeroSpdTimoutC FTCMSTC_AccelNegRpmBySecondC FTCMSTC_AccelPosRpmBySecondC FTCMTCS_AccelPosRpmBySecondC FTCMTCS_AntiSlideEnableC FTCMTCS_AntiSlideEnaCountMaxC FTCMTCS_AntiSlideTorqueThrC FTCMTCS_BenchElecPowerMaxC FTCMTCS_BenchElecTorqueMaxC FTCMTCS_CutOffFrequencySpdRpmC FTCMTCS_deg2radC FTCMTCS_DivideTorqMinC FTCMTCS_EntrySlideCountMaxC FTCMTCS_ExtTorqueMaxMinC FTCMTCS_FluxControllerGainC FTCMTCS_FluxControllerGainKiC FTCMTCS_FluxControllerGainKpC FTCMTCS_FluxCtrPiEnableC FTCMTCS_GainPhaseVoltagePeakC FTCMTCS_GenTableTorqueThrdC FTCMTCS_IdentificationAngleDegC FTCMTCS_IdentificationIsTgtC FTCMTCS_IdModeOnOffC FTCMTCS_Initi0dqTgt3C FTCMTCS_InitTorqueMaxMinC FTCMTCS_iqCorEnaC FTCMTCS_KilLmtC FTCMTCS_LutCutOffFreqSlideC FTCMTCS_LutInAddSpeedRpmC FTCMTCS_LutInAddUbatC FTCMTCS_LutInMecaSpeedRpmC FTCMTCS_LutInSpeedRpmC FTCMTCS_LutInTorqueTgtC FTCMTCS_LutInUbatC FTCMTCS_LutInUbatHVC FTCMTCS_LutOutAddElecTorqPoitC FTCMTCS_LutOutIdAdd0C FTCMTCS_LutOutIdAdd0MotC FTCMTCS_LutOutIdAddGenC FTCMTCS_LutOutIdAddMotC FTCMTCS_LutOutIqAddGenC FTCMTCS_LutOutIqAddMotC FTCMTCS_LutOutTorqueMaxC FTCMTCS_LutOutTorqueMinC /end DEF_CHARACTERISTIC
 /begin OUT_MEASUREMENT FTASDPM_DrtGainMin FTASDPM_MaxMinI0dqDrtVect FTASDPM_MaxMinI0dqDrtVect[0] FTASDPM_MaxMinI0dqDrtVect[1] FTASDPM_MaxMinI0dqDrtVect[2] FTASDPM_MaxMinI0dqDrtVect[3] FTASDPM_MaxMinI0dqDrtVect[4] FTASDPM_MaxMinI0dqDrtVect[5] FTASDPM_MaxMinSpdDrtVect FTASDPM_MaxMinSpdDrtVect[0] FTASDPM_MaxMinSpdDrtVect[1] FTASDPM_MaxMinTorqueDrtVect FTASDPM_MaxMinTorqueDrtVect[0] FTASDPM_MaxMinTorqueDrtVect[1] FTASDPM_MaxTorqueDerating FTASDPM_MinTorqueDerating FTASETP_EstPmDeratingAct FTASETP_EstPmDrtGain FTASETP_EstPmMaxTemp FTASETP_EstPmResetZ FTASETP_IntegralEstPmDrtGainZ FTASETP_IntegralPmDrtGainZ FTASETP_OpenLoopEstPmDrtGain FTASETP_PmDeratingAct FTASETP_PmDrtGain FTASETP_PmMaxTemp FTASETP_PmResetZ FTASMTP_IntegralWndg1DrtGainZ FTASMTP_IntegralWndg2DrtGainZ FTASMTP_Wndg1ResetZ FTASMTP_Wndg1Temp FTASMTP_Wndg2DeratingActDetn FTASMTP_Wndg2ResetZ FTASMTP_Wndg2Temp FTASMTP_WndgDrtGain FTASOSP_MotorSpeedDrtGainMax FTASOSP_MotorSpeedDrtGainMin FTCIVDC_1ByUbatHV FTCIVDC_CntTimeZ FTCIVDC_CompDutyUZ FTCIVDC_CompDutyVZ FTCIVDC_CompDutyWZ FTCIVDC_CurrDeltaThetaRd FTCIVDC_DeadCompEnRelayZ FTCIVDC_DeadCompNumberZ FTCIVDC_DeadZnCompSpdEnZ FTCIVDC_DeadZnEnaFlg FTCIVDC_DutyCycle3[0] FTCIVDC_DutyCycle3[1] FTCIVDC_DutyCycle3[2] FTCIVDC_DutyCycleMinMax[0] FTCIVDC_DutyCycleMinMax[1] FTCIVDC_DutyCycleOrg3[0] FTCIVDC_DutyCycleOrg3[1] FTCIVDC_DutyCycleOrg3[2] FTCIVDC_DutyCycleTemp3[0] FTCIVDC_DutyCycleTemp3[1] FTCIVDC_DutyCycleTemp3[2] FTCIVDC_IdFildZ FTCIVDC_IqFildZ FTCIVDC_Iuvw3Z[0] FTCIVDC_Iuvw3Z[1] FTCIVDC_Iuvw3Z[2] FTCIVDC_LutOutFreq FTCIVDC_MecaSpeedRpmFild FTCIVDC_MecaSpeedRpmZ FTCIVDC_PwmFrequence FTCIVDC_PwmFrequenceZ FTCIVDC_PwmOnOff3[0] FTCIVDC_PwmOnOff3[1] FTCIVDC_PwmOnOff3[2] FTCIVDC_RandFreq FTCIVDC_RandNumScal FTCIVDC_RandomNum FTCIVDC_SimpleUVW3[0] FTCIVDC_SimpleUVW3[1] FTCIVDC_SimpleUVW3[2] FTCIVDC_TimeEnableZ FTCIVDC_UbatHV FTCIVDC_UM0zeroTgt FTCIVDC_UM1AlphaTgt FTCIVDC_UM1BetaTgt FTCMCCS_AAfilterVar1Z FTCMCCS_AAfilterVar2Z FTCMCCS_AAfilterVar3Z FTCMCCS_AAfilterVar4Z FTCMCCS_AAfilterVar5Z FTCMCCS_EM1dOpenLoopEst FTCMCCS_EM1qOpenLoopEst FTCMCCS_EpsilonM0Ctrl FTCMCCS_EpsilonM1dCtrl FTCMCCS_EpsilonM1qCtrl FTCMCCS_iM1dTgtFild FTCMCCS_iM1dTgtFildTr FTCMCCS_iM1dTgtFildZ FTCMCCS_iM1qTgtFild FTCMCCS_iM1qTgtFildTr FTCMCCS_iM1qTgtFildZ FTCMCCS_Lm1d FTCMCCS_Lm1q FTCMCCS_LutOutiM1dTgtFildTr FTCMCCS_LutOutiM1qTgtFildTr FTCMCCS_LutOutM1dCtrlTr FTCMCCS_LutOutM1qCtrlTr FTCMCCS_M0CtrlIntegratorZ FTCMCCS_M0CtrlKi FTCMCCS_M0CtrlKp FTCMCCS_M0CtrlTgt FTCMCCS_M1dCtrlIntegratorZ FTCMCCS_M1dCtrlKi FTCMCCS_M1dCtrlKp FTCMCCS_M1dCtrlTgt FTCMCCS_M1dCtrlTr FTCMCCS_M1dObsIntegratorZ FTCMCCS_M1qCtrlIntegratorZ FTCMCCS_M1qCtrlKi FTCMCCS_M1qCtrlKp FTCMCCS_M1qCtrlTgt FTCMCCS_M1qCtrlTr FTCMCCS_M1qObsIntegratorZ FTCMCCS_Phim FTCMCCS_Rs FTCMCCS_RsiM1dEstZ FTCMCCS_RsiM1qEstZ FTCMCCS_SampleTime3ST FTCMCCS_SampleTimeF32 FTCMCCS_TotalI0dqTgt3[0] FTCMCCS_TotalI0dqTgt3[1] FTCMCCS_TotalI0dqTgt3[2] FTCMCCS_TransEmfM1d FTCMCCS_TransEmfM1q FTCMCCS_TransUd FTCMCCS_TransUq FTCMCCS_U0dqTgt3[0] FTCMCCS_U0dqTgt3[1] FTCMCCS_U0dqTgt3[2] FTCMCCS_UdqNorm FTCMCCS_UM1dTgt FTCMCCS_UM1qTgt FTCMCTC_CoggingComp FTCMCTC_H3CurrentTgt FTCMCTC_I0dqTgt3[0] FTCMCTC_I0dqTgt3[1] FTCMCTC_I0dqTgt3[2] FTCMCTC_iM0Tgt FTCMCTC_iM1dTgtZ FTCMCTC_iM1qTgtZ FTCMCTC_iMdTgt FTCMCTC_iMqTgt FTCMCTC_Sin3NextThetaElec FTCMCTC_Sin6NextThetaElec FTCMCTC_SpyEvent FTCMHIJ_24thIdComp FTCMHIJ_24thIqComp FTCMHIJ_ElecAngle FTCMHIJ_I0dq3Comp[0] FTCMHIJ_I0dq3Comp[1] FTCMHIJ_I0dq3Comp[2] FTCMHIJ_IdComp FTCMHIJ_IdLut6[0] FTCMHIJ_IdLut6[1] FTCMHIJ_IdLut6[2] FTCMHIJ_IdLut6[3] FTCMHIJ_IdLut6[4] FTCMHIJ_IdLut6[5] FTCMHIJ_IqComp FTCMHIJ_IqLut6[0] FTCMHIJ_IqLut6[1] FTCMHIJ_IqLut6[2] FTCMHIJ_IqLut6[3] FTCMHIJ_IqLut6[4] FTCMHIJ_IqLut6[5] FTCMHIJ_LutBaseMagnitude12Id FTCMHIJ_LutBaseMagnitude12Iq FTCMHIJ_LutBaseMagnitude24thId FTCMHIJ_LutBaseMagnitude24thIq FTCMHIJ_LutBaseMagnitude6Id FTCMHIJ_LutBaseMagnitude6Iq FTCMHIJ_LutPhase12Iq FTCMHIJ_LutPhase24thIq FTCMHIJ_MotGenFlag FTCMHIJ_SixthIdComp FTCMHIJ_SixthIqComp FTCMHIJ_TwelfthIdComp FTCMHIJ_TwelfthIqComp FTCMRPC_I0AlphaBeta[0] FTCMRPC_I0AlphaBeta[1] FTCMRPC_I0AlphaBeta[2] FTCMRPC_I0dq3[0] FTCMRPC_I0dq3[1] FTCMRPC_I0dq3[2] FTCMSCS_CtrlIntegratorZ FTCMSCS_CtrlKi FTCMSCS_CtrlKp FTCMSCS_CtrlSatCntZ FTCMSCS_CtrlSatTimoutDetn FTCMSCS_CtrlTgt FTCMSCS_DeltaSpeedRpmZ FTCMSCS_EpsilonCtrl FTCMSCS_fOmegaEstZ FTCMSCS_ObsIntegratorZ FTCMSCS_SpdOverShootCntZ FTCMSCS_SpeedModelTrqSatZ FTCMSCS_TorqueTestCountZ FTCMSCS_TorqueTgt FTCMSCS_ZeroSpeedCntZ FTCMSTC_RateLimiterOutZ FTCMSTC_SpeedRpmTgtFiltered FTCMTCS_AntiSlideEnaCountOutZ FTCMTCS_AntiSlideInhibOutZ FTCMTCS_CurrentControllerSat FTCMTCS_DelVol FTCMTCS_ElecTorqueMaxMin[0] FTCMTCS_ElecTorqueMaxMin[1] FTCMTCS_ElecTorqueTgt FTCMTCS_EntrySlideCountOutZ FTCMTCS_EntrySlideFlag FTCMTCS_FluxControllerTgt FTCMTCS_FluxControllerTgtZ FTCMTCS_i0dqTgt3[0] FTCMTCS_i0dqTgt3[1] FTCMTCS_i0dqTgt3[2] FTCMTCS_idCorTgt FTCMTCS_idCorTgtZ FTCMTCS_idLutAddTgt FTCMTCS_idLutTgt FTCMTCS_idLutTgtZ FTCMTCS_IdqTgtAddRatio FTCMTCS_IdTgtAdd FTCMTCS_IdTgtAdd0 FTCMTCS_iqLutAddTgt FTCMTCS_iqLutTgt FTCMTCS_IqTgtAdd FTCMTCS_KiOut FTCMTCS_KpOut FTCMTCS_MecaSpeedDiff FTCMTCS_MecaSpeedOutZ FTCMTCS_ParkVoltageTgt FTCMTCS_PhaseVoltagePeakTgt FTCMTCS_SlideDelayFildZ FTCMTCS_SpdRpmDelayFildZ FTCMTCS_TorqueGain FTCMTCS_TorqueGainFild FTCMTCS_TorqueGainOutZ FTCMTCS_TorqueLimActivation FTCMTCS_TorqueSlideTgt FTCMTCS_TorqueVolim FTCMTCS_VoltageMargin FTCMTCS_VoltageMarginCorZ FTCMTTC_AfterPreTorqueTgt FTCMTTC_AntiJerkBaseGain FTCMTTC_AntiJerkMecaTorqueTgt FTCMTTC_AntiJerkTrqTgt FTCMTTC_AntiJerkTrqTgtHpZ FTCMTTC_AntiJerkTrqTgtZ FTCMTTC_AtjkBpAccTorqueTgt FTCMTTC_AtjkDeltaTorqueTgt FTCMTTC_BpLowCutOffFrequency FTCMTTC_DampingActive FTCMTTC_DampingSpdHighDetnZ FTCMTTC_DampTorqueCompTgt FTCMTTC_DeltaSpeedRpm FTCMTTC_ElecTorqueTgt FTCMTTC_ElecTorqueTgtCor FTCMTTC_ElecTorqueTgtFild FTCMTTC_ElecTorqueTgtFildZ FTCMTTC_ElecTorqueTgtTotal FTCMTTC_ElecTorqueTgtZ FTCMTTC_MecaPowerMaxMin[0] FTCMTTC_MecaPowerMaxMin[1] FTCMTTC_MecaSpeedAccSlewRate FTCMTTC_MecaSpeedRpmFildZ FTCMTTC_MecaSpeedRpmLpZ FTCMTTC_MecaTorMax2CAN FTCMTTC_MecaTorMin2CAN FTCMTTC_MecaTorqueMax FTCMTTC_MecaTorqueMaxMin[0] FTCMTTC_MecaTorqueMaxMin[1] FTCMTTC_MecaTorqueMin FTCMTTC_MecaTorqueTgt FTCMTTC_PowLmtTorqureRaw FTCMTTC_PreTorqueFlg FTCMTTC_RealMecaTorqueTgt FTCMTTC_TempPreTorqTrasStep FTCMTTC_TorqueHpFilterEnable FTCMTTC_TorqueHpFilterEnableZ FTCMTTC_TrqTrasitionFlg FTCMTTC_TsatActv FTDDLMP_MaxMinI0dqLimitVect FTDDLMP_MaxMinI0dqLimitVect[0] FTDDLMP_MaxMinI0dqLimitVect[1] FTDDLMP_MaxMinI0dqLimitVect[2] FTDDLMP_MaxMinI0dqLimitVect[3] FTDDLMP_MaxMinI0dqLimitVect[4] FTDDLMP_MaxMinI0dqLimitVect[5] FTDDLMP_MaxMinSpdLimitVect FTDDLMP_MaxMinSpdLimitVect[0] FTDDLMP_MaxMinSpdLimitVect[1] FTDDLMP_MaxMinTorqueLimitVect FTDDLMP_MaxMinTorqueLimitVect[0] FTDDLMP_MaxMinTorqueLimitVect[1] FTEVEIT_CommutGain FTEVEIT_CommutLossesDH_UL FTEVEIT_CommutLossesDH_VL FTEVEIT_CommutLossesDH_WL FTEVEIT_CommutLossesDL_UL FTEVEIT_CommutLossesDL_VL FTEVEIT_CommutLossesDL_WL FTEVEIT_CommutLossesTH_UL FTEVEIT_CommutLossesTH_VL FTEVEIT_CommutLossesTH_WL FTEVEIT_CommutLossesTL_UL FTEVEIT_CommutLossesTL_VL FTEVEIT_CommutLossesTL_WL FTEVEIT_CondLossesDH_UL FTEVEIT_CondLossesDH_VL FTEVEIT_CondLossesDH_WL FTEVEIT_CondLossesDL_UL FTEVEIT_CondLossesDL_VL FTEVEIT_CondLossesDL_WL FTEVEIT_CondLossesTH_UL FTEVEIT_CondLossesTH_VL FTEVEIT_CondLossesTH_WL FTEVEIT_CondLossesTL_UL FTEVEIT_CondLossesTL_VL FTEVEIT_CondLossesTL_WL FTEVEIT_CurrDH_UL FTEVEIT_CurrDH_VL FTEVEIT_CurrDH_WL FTEVEIT_CurrDL_UL FTEVEIT_CurrDL_VL FTEVEIT_CurrDL_WL FTEVEIT_CurrTH_UL FTEVEIT_CurrTH_VL FTEVEIT_CurrTH_WL FTEVEIT_CurrTL_UL FTEVEIT_CurrTL_VL FTEVEIT_CurrTL_WL FTEVEIT_EnableInit FTEVEIT_EnableKO FTEVEIT_EnableOK FTEVEIT_EstimTempDH_UL FTEVEIT_EstimTempDH_VL FTEVEIT_EstimTempDH_WL FTEVEIT_EstimTempDHVect[0] FTEVEIT_EstimTempDHVect[1] FTEVEIT_EstimTempDHVect[2] FTEVEIT_EstimTempDL_UL FTEVEIT_EstimTempDL_VL FTEVEIT_EstimTempDL_WL FTEVEIT_EstimTempDLVect[0] FTEVEIT_EstimTempDLVect[1] FTEVEIT_EstimTempDLVect[2] FTEVEIT_EstimTempFirstFild FTEVEIT_EstimTempFirstFildZ FTEVEIT_EstimTempSecFild FTEVEIT_EstimTempSecFildZ FTEVEIT_EstimTempTH_UL FTEVEIT_EstimTempTH_VL FTEVEIT_EstimTempTH_WL FTEVEIT_EstimTempTHVect[0] FTEVEIT_EstimTempTHVect[1] FTEVEIT_EstimTempTHVect[2] FTEVEIT_EstimTempTL_UL FTEVEIT_EstimTempTL_VL FTEVEIT_EstimTempTL_WL FTEVEIT_EstimTempTLVect[0] FTEVEIT_EstimTempTLVect[1] FTEVEIT_EstimTempTLVect[2] FTEVEIT_HysteresisZ FTEVEIT_PdhTdh_UL FTEVEIT_PdhTdh_VL FTEVEIT_PdhTdh_WL FTEVEIT_PdhTdhS1_UL FTEVEIT_PdhTdhS1_VL FTEVEIT_PdhTdhS1_WL FTEVEIT_PdhTdhS2_UL FTEVEIT_PdhTdhS2_VL FTEVEIT_PdhTdhS2_WL FTEVEIT_PdhTdhS3_UL FTEVEIT_PdhTdhS3_VL FTEVEIT_PdhTdhS3_WL FTEVEIT_PdhTdhS4_UL FTEVEIT_PdhTdhS4_VL FTEVEIT_PdhTdhS4_WL FTEVEIT_PdhTdhS5_UL FTEVEIT_PdhTdhS5_VL FTEVEIT_PdhTdhS5_WL FTEVEIT_PdhTth_UL FTEVEIT_PdhTth_VL FTEVEIT_PdhTth_WL FTEVEIT_PdlTdl_UL FTEVEIT_PdlTdl_VL FTEVEIT_PdlTdl_WL FTEVEIT_PdlTdlS1_UL FTEVEIT_PdlTdlS1_VL FTEVEIT_PdlTdlS1_WL FTEVEIT_PdlTdlS2_UL FTEVEIT_PdlTdlS2_VL FTEVEIT_PdlTdlS2_WL FTEVEIT_PdlTdlS3_UL FTEVEIT_PdlTdlS3_VL FTEVEIT_PdlTdlS3_WL FTEVEIT_PdlTdlS4_UL FTEVEIT_PdlTdlS4_VL FTEVEIT_PdlTdlS4_WL FTEVEIT_PdlTdlS5_UL FTEVEIT_PdlTdlS5_VL FTEVEIT_PdlTdlS5_WL FTEVEIT_PdlTtl_UL FTEVEIT_PdlTtl_VL FTEVEIT_PdlTtl_WL FTEVEIT_Plosses_UL FTEVEIT_Plosses_VL FTEVEIT_Plosses_WL FTEVEIT_PlossesVect[0] FTEVEIT_PlossesVect[1] FTEVEIT_PlossesVect[2] FTEVEIT_PowerModuleEstTemp FTEVEIT_PthTdh_UL FTEVEIT_PthTdh_VL FTEVEIT_PthTdh_WL FTEVEIT_PthTth_UL FTEVEIT_PthTth_VL FTEVEIT_PthTth_WL FTEVEIT_PthTthS1_UL FTEVEIT_PthTthS1_VL FTEVEIT_PthTthS1_WL FTEVEIT_PthTthS2_UL FTEVEIT_PthTthS2_VL FTEVEIT_PthTthS2_WL FTEVEIT_PthTthS3_UL FTEVEIT_PthTthS3_VL FTEVEIT_PthTthS3_WL FTEVEIT_PthTthS4_UL FTEVEIT_PthTthS4_VL FTEVEIT_PthTthS4_WL FTEVEIT_PthTthS5_UL FTEVEIT_PthTthS5_VL FTEVEIT_PthTthS5_WL FTEVEIT_PtlTdl_UL FTEVEIT_PtlTdl_VL FTEVEIT_PtlTdl_WL FTEVEIT_PtlTtl_UL FTEVEIT_PtlTtl_VL FTEVEIT_PtlTtl_WL FTEVEIT_PtlTtlS1_UL FTEVEIT_PtlTtlS1_VL FTEVEIT_PtlTtlS1_WL FTEVEIT_PtlTtlS2_UL FTEVEIT_PtlTtlS2_VL FTEVEIT_PtlTtlS2_WL FTEVEIT_PtlTtlS3_UL FTEVEIT_PtlTtlS3_VL FTEVEIT_PtlTtlS3_WL FTEVEIT_PtlTtlS4_UL FTEVEIT_PtlTtlS4_VL FTEVEIT_PtlTtlS4_WL FTEVEIT_PtlTtlS5_UL FTEVEIT_PtlTtlS5_VL FTEVEIT_PtlTtlS5_WL FTEVEIT_TcoolingEstimation FTEVEIT_VectEstimTempFild10Z FTEVEIT_VectEstimTempFild11Z FTEVEIT_VectEstimTempFild12Z FTEVEIT_VectEstimTempFild1Z FTEVEIT_VectEstimTempFild2Z FTEVEIT_VectEstimTempFild3Z FTEVEIT_VectEstimTempFild4Z FTEVEIT_VectEstimTempFild5Z FTEVEIT_VectEstimTempFild6Z FTEVEIT_VectEstimTempFild7Z FTEVEIT_VectEstimTempFild8Z FTEVEIT_VectEstimTempFild9Z FTEVEIT_VectEstimTempFild[0] FTEVEIT_VectEstimTempFild[10] FTEVEIT_VectEstimTempFild[11] FTEVEIT_VectEstimTempFild[1] FTEVEIT_VectEstimTempFild[2] FTEVEIT_VectEstimTempFild[3] FTEVEIT_VectEstimTempFild[4] FTEVEIT_VectEstimTempFild[5] FTEVEIT_VectEstimTempFild[6] FTEVEIT_VectEstimTempFild[7] FTEVEIT_VectEstimTempFild[8] FTEVEIT_VectEstimTempFild[9] FTMTLCS_1ByAccumulator FTMTLCS_A2DOffsetIsuL FTMTLCS_A2DOffsetIsvL FTMTLCS_A2DOffsetIswL FTMTLCS_A2DOffsetSumIsuLZ FTMTLCS_A2DOffsetSumIsvLZ FTMTLCS_A2DOffsetSumIswLZ FTMTLCS_A2DResCorrd_IsuL FTMTLCS_A2DResCorrd_IsvL FTMTLCS_A2DResCorrd_IswL FTMTLCS_CurrentSumError FTMTLCS_CurSenrPhaU_OutRngHDetn FTMTLCS_CurSenrPhaU_OutRngLDetn FTMTLCS_CurSenrPhaV_OutRngHDetn FTMTLCS_CurSenrPhaV_OutRngLDetn FTMTLCS_CurSenrPhaW_OutRngHDetn FTMTLCS_CurSenrPhaW_OutRngLDetn FTMTLCS_ElecSpeedRdsFildZ FTMTLCS_Iu FTMTLCS_Iuvw3[0] FTMTLCS_Iuvw3[1] FTMTLCS_Iuvw3[2] FTMTLCS_Iv FTMTLCS_Iw FTMTLCS_LostPhaseError FTMTLCS_OffsetCompOK FTMTLCS_SampleNumberZ FTMTLCS_Scaled_Isu FTMTLCS_Scaled_Isv FTMTLCS_Scaled_Isw FTMTLCS_TrimIsuvw[0] FTMTLCS_TrimIsuvw[1] FTMTLCS_TrimIsuvw[2] FTMTSEP_DelayTheta FTMTSEP_ErrThetaComp FTMTSEP_NextThetaElecRdSurPi FTMTSEP_SinCosNextThetaElec[0] FTMTSEP_SinCosNextThetaElec[1] FTMTSEP_SinCosThetaElec[0] FTMTSEP_SinCosThetaElec[1] FTMTSEP_ThetaElecRdSurPi FTSMACS_AclPreviousState FTSMACS_AclState FTSMACS_CmdFtShutDownRes FTSMACS_CmdFtStartRes FTSMACS_CmdPwmDirectReq FTSMACS_CmdPwmOffReq FTSMACS_ReinitFault FTSMACS_TestFault FTSMACS_VsiTimerFreqRatioRef FTSMMAM_AclState FTSMMAM_CMCCS_M0ConOnoff FTSMMAM_EVEIT_MainEnable FTSMMAM_FTCIVDC_State FTSMMAM_FTCMCCS_State FTSMMAM_FTCMSCS_State FTSMMAM_FTCMTCS_State FTSMMAM_FtModeReq FTSMMAM_MTLCS_State FTSMMAM_MTMEP_State FTSMMAM_SMREF_MainEnable FTSMREF_AngleTable FTSMREF_AutoPhaseCalLock FTSMREF_AutoPhasingCal FTSMREF_AutoPhasingCalRaw FTSMREF_AutoPhasingCalRawZ FTSMREF_AutophasingSumZ FTSMREF_Cyclefinish FTSMREF_CycNum FTSMREF_I0dqRef[0] FTSMREF_I0dqRef[1] FTSMREF_I0dqRef[2] FTSMREF_IdrefTable FTSMREF_ImposedThetaRdSurPi FTSMREF_RotoringCalEnable FTSMREF_RotoringCalFinish FTSMREF_RotoringCalStart FTSMREF_Timer1Z SD_AutoPhasingAngle_F32 SD_AutophasingCal_F32 SD_FtModeReq_U16 SD_GainCosTrim_F32 SD_GainSinTrim_F32 SD_ImposedThetaRdSurPi_F32 SD_Iuvw3_F32[0] SD_Iuvw3_F32[1] SD_Iuvw3_F32[2] SD_MTMEPState_U16 SD_OccycleFinish_B SD_OffsetCosTrim_F32 SD_OffsetSinTrim_F32 SD_ResolverSinCos2_U16[0] SD_ResolverSinCos2_U16[1] SD_RotoringCalEnable_B SD_RotoringCalFinish_B SD_RotoringCalStart_B SD_UbatHV_F32 SDMTLCS_CurrentRmsIuFild SDMTLCS_CurrentRmsIuFildZ SDMTLCS_CurrentRmsIvFild SDMTLCS_CurrentRmsIvFildZ SDMTLCS_CurrentRmsIwFild SDMTLCS_CurrentRmsIwFildZ SDMTLCS_IuInput SDMTLCS_Iuvw3_Rms[0] SDMTLCS_Iuvw3_Rms[1] SDMTLCS_Iuvw3_Rms[2] SDMTLCS_IvInput SDMTLCS_IwInput SDMTLCS_RmsNumberZ SDMTLCS_RmsSumIuZ SDMTLCS_RmsSumIvZ SDMTLCS_RmsSumIwZ SDMTMEP_AutoPhase SDMTMEP_BenchModeValueZ SDMTMEP_CosOutRangeHighDetn SDMTMEP_CosOutRangeLowDetn SDMTMEP_CosResultAvgMax SDMTMEP_CosResultAvgMin SDMTMEP_CosResultMax SDMTMEP_CosResultMaxSumZ SDMTMEP_CosResultMaxZ SDMTMEP_CosResultMin SDMTMEP_CosResultMinSumZ SDMTMEP_CosResultMinZ SDMTMEP_CosScaled SDMTMEP_CosSignSumZ SDMTMEP_DeltaTheta SDMTMEP_ElecSpeedRds SDMTMEP_ErrorThetaElecRdSurPi SDMTMEP_EstimatedCos SDMTMEP_EstimatedSin SDMTMEP_ForwardDirect SDMTMEP_GainCosSignFit SDMTMEP_GainCosTrim SDMTMEP_GainCosTrimCal SDMTMEP_GainSinTrim SDMTMEP_GainSinTrimCal SDMTMEP_HalfRdSurPiCadran2or4 SDMTMEP_IllegalResParDetn SDMTMEP_IllegalResParFlt SDMTMEP_IllegalResParFltLock SDMTMEP_ImposedThetaZ SDMTMEP_MecaSpeedRds SDMTMEP_MecaSpeedRpm SDMTMEP_MecaSpeedRpmOc SDMTMEP_OcCosAdcFildZ SDMTMEP_OcRotoringFailFlg SDMTMEP_OcRotoringNormal SDMTMEP_OcSinAdcFildZ SDMTMEP_OffsetCosTrim SDMTMEP_OffsetCosTrimCal SDMTMEP_OffsetSinTrim SDMTMEP_OffsetSinTrimCal SDMTMEP_PerdTimerZ SDMTMEP_PosCompError SDMTMEP_PrevElecSpeedRds SDMTMEP_PrevThetaElecRdSurPi SDMTMEP_ResolNextThetaRdByPi SDMTMEP_ResolverAcceleration SDMTMEP_ResolverPositionFailFlg SDMTMEP_ResolverSpeedRds SDMTMEP_ResolverSpeedRdsFild SDMTMEP_ResolverSpeedRdsFildOc SDMTMEP_ResolverSpeedRdsFildZ SDMTMEP_ResolverSpeedRdsOcZ SDMTMEP_ResolverSpeedRdsZ SDMTMEP_ResolverThetaRdSurPi SDMTMEP_ResolverThetaRdSurPiOc SDMTMEP_ResolverThetaRdSurPiOcZ SDMTMEP_ResolverThetaRdSurPiZ SDMTMEP_ResThetaRdSurPiOcZ SDMTMEP_SingleConversion SDMTMEP_SinOutRangeHighDetn SDMTMEP_SinOutRangeLowDetn SDMTMEP_SinResultAvgMax SDMTMEP_SinResultAvgMin SDMTMEP_SinResultMax SDMTMEP_SinResultMaxSumZ SDMTMEP_SinResultMaxZ SDMTMEP_SinResultMin SDMTMEP_SinResultMinSumZ SDMTMEP_SinResultMinZ SDMTMEP_SinScaled SDMTMEP_SpeedCmpFailFlg SDMTMEP_ThetaElecRdSurPi SDMTMEP_ThetaInitRdSurPi SDMTMEP_ThetaTempRdSurPi SDMTMEP_ThetaTempRdSurPiOc SDMTMEP_ThetaTempRdSurPiOcZ SDMTMEP_ThetaTempRdSurPiZ /end OUT_MEASUREMENT
/end FUNCTION
/end MODULE
/end PROJECT
