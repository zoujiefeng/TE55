ASAP2_VERSION 1 31
/begin PROJECT ProjectName "Project Comment Goes Here"
/begin HEADER "Header Comments go here" /end HEADER
/begin MODULE ModuleName "Module Comment Goes Here"
/begin MOD_COMMON "Mod Common Comment Here" BYTE_ORDER MSB_FIRST /end MOD_COMMON
/begin RECORD_LAYOUT Scalar_BOOLEAN FNC_VALUES 1 UBYTE COLUMN_DIR DIRECT /end RECORD_LAYOUT
/begin RECORD_LAYOUT Scalar_UBYTE FNC_VALUES 1 UBYTE COLUMN_DIR DIRECT /end RECORD_LAYOUT
/begin RECORD_LAYOUT Scalar_UWORD FNC_VALUES 1 UWORD COLUMN_DIR DIRECT /end RECORD_LAYOUT
/begin RECORD_LAYOUT Scalar_SWORD FNC_VALUES 1 SWORD COLUMN_DIR DIRECT /end RECORD_LAYOUT
/begin RECORD_LAYOUT Scalar_FLOAT32_IEEE FNC_VALUES 1 FLOAT32_IEEE COLUMN_DIR DIRECT /end RECORD_LAYOUT
/begin RECORD_LAYOUT Lookup1D_UWORD FNC_VALUES 1 UWORD COLUMN_DIR DIRECT /end RECORD_LAYOUT
/begin RECORD_LAYOUT Lookup1D_X_UWORD AXIS_PTS_X 1 UWORD INDEX_INCR DIRECT /end RECORD_LAYOUT
/begin RECORD_LAYOUT Lookup1D_WORD FNC_VALUES 1 SWORD COLUMN_DIR DIRECT /end RECORD_LAYOUT
/begin RECORD_LAYOUT Lookup1D_X_WORD AXIS_PTS_X 1 SWORD INDEX_INCR DIRECT /end RECORD_LAYOUT
/begin RECORD_LAYOUT Lookup2D_UWORD FNC_VALUES 1 UWORD COLUMN_DIR DIRECT /end RECORD_LAYOUT
/begin RECORD_LAYOUT Lookup2D_X_UWORD AXIS_PTS_X 1 UWORD INDEX_INCR DIRECT /end RECORD_LAYOUT
/begin RECORD_LAYOUT Lookup2D_WORD FNC_VALUES 1 SWORD COLUMN_DIR DIRECT /end RECORD_LAYOUT
/begin RECORD_LAYOUT Lookup2D_X_WORD AXIS_PTS_X 1 SWORD INDEX_INCR DIRECT /end RECORD_LAYOUT
/begin COMPU_METHOD CM_T_Cnt_Num_1_1_u16 "Q = V" RAT_FUNC "%5.0" "Num (counts)" COEFFS 0 1 0 0 0 1 /end COMPU_METHOD
/begin COMPU_METHOD CM_T_Cnt_Num_1_1_u8 "Q = V" RAT_FUNC "%3.0" "Num (counts)" COEFFS 0 1 0 0 0 1 /end COMPU_METHOD
/begin COMPU_METHOD CM_T_BOOLEAN "Q = V" RAT_FUNC "%1.0" "Bool" COEFFS 0 1 0 0 0 1 /end COMPU_METHOD
/* (add any file trailer comments here) */ /* EOF CAND.a2l */
/begin RECORD_LAYOUT Scalar_BOOLEAN FNC_VALUES 1 UBYTE COLUMN_DIR DIRECT /end RECORD_LAYOUT
/begin RECORD_LAYOUT Scalar_UBYTE FNC_VALUES 1 UBYTE COLUMN_DIR DIRECT /end RECORD_LAYOUT
/begin RECORD_LAYOUT Scalar_UWORD FNC_VALUES 1 UWORD COLUMN_DIR DIRECT /end RECORD_LAYOUT
/begin RECORD_LAYOUT Scalar_SWORD FNC_VALUES 1 SWORD COLUMN_DIR DIRECT /end RECORD_LAYOUT
/begin RECORD_LAYOUT Scalar_FLOAT32_IEEE FNC_VALUES 1 FLOAT32_IEEE COLUMN_DIR DIRECT /end RECORD_LAYOUT
/begin RECORD_LAYOUT Lookup1D_UWORD FNC_VALUES 1 UWORD COLUMN_DIR DIRECT /end RECORD_LAYOUT
/begin RECORD_LAYOUT Lookup1D_X_UWORD AXIS_PTS_X 1 UWORD INDEX_INCR DIRECT /end RECORD_LAYOUT
/begin RECORD_LAYOUT Lookup1D_WORD FNC_VALUES 1 SWORD COLUMN_DIR DIRECT /end RECORD_LAYOUT
/begin RECORD_LAYOUT Lookup1D_X_WORD AXIS_PTS_X 1 SWORD INDEX_INCR DIRECT /end RECORD_LAYOUT
/begin RECORD_LAYOUT Lookup2D_UWORD FNC_VALUES 1 UWORD COLUMN_DIR DIRECT /end RECORD_LAYOUT
/begin RECORD_LAYOUT Lookup2D_X_UWORD AXIS_PTS_X 1 UWORD INDEX_INCR DIRECT /end RECORD_LAYOUT
/begin RECORD_LAYOUT Lookup2D_WORD FNC_VALUES 1 SWORD COLUMN_DIR DIRECT /end RECORD_LAYOUT
/begin RECORD_LAYOUT Lookup2D_X_WORD AXIS_PTS_X 1 SWORD INDEX_INCR DIRECT /end RECORD_LAYOUT
/begin COMPU_METHOD CM_T_p_kPa_1_1_s16 "Q = V" RAT_FUNC "%5.0" "kPa (kiloPascals  (kPa))" COEFFS 0 1 0 0 0 1 /end COMPU_METHOD
/begin COMPU_METHOD CM_T_n_rpm_1_1_s16 "Q = V" RAT_FUNC "%5.0" "rpm (revolutions / minute  (rpm))" COEFFS 0 1 0 0 0 1 /end COMPU_METHOD
/begin COMPU_METHOD CM_T_Cnt_Num_1_1_u16 "Q = V" RAT_FUNC "%5.0" "Num (counts)" COEFFS 0 1 0 0 0 1 /end COMPU_METHOD
/begin COMPU_METHOD CM_T_M_Nm_32_1_s16 "Q = V*32.000000" RAT_FUNC "%9.5" "Nm (newton-meters  (Nm))" COEFFS 0 32 0 0 0 1 /end COMPU_METHOD
/begin COMPU_METHOD CM_T_r_NA_1024_1_s16 "Q = V*1024.000000" RAT_FUNC "%12.10" "NA (none)" COEFFS 0 1024 0 0 0 1 /end COMPU_METHOD
/begin COMPU_METHOD CM_T_T_degC_16_1_s16 "Q = V*16.000000" RAT_FUNC "%8.4" "degC (degrees Celsius  (deg C))" COEFFS 0 16 0 0 0 1 /end COMPU_METHOD
/begin COMPU_METHOD CM_T_K_NA_1024_1_u16 "Q = V*1024.000000" RAT_FUNC "%12.10" "NA (dependent upon the gain)" COEFFS 0 1024 0 0 0 1 /end COMPU_METHOD
/begin COMPU_METHOD CM_T_t_s_1000_1_s16 "Q = V*1000.000000" RAT_FUNC "%0.6" "s (seconds  (s))" COEFFS 0 1000 0 0 0 1 /end COMPU_METHOD
/begin COMPU_METHOD CM_T_BOOLEAN "Q = V" RAT_FUNC "%1.0" "Bool" COEFFS 0 1 0 0 0 1 /end COMPU_METHOD
/* EOF CCAP.a2l */
/begin RECORD_LAYOUT Scalar_BOOLEAN FNC_VALUES 1 UBYTE COLUMN_DIR DIRECT /end RECORD_LAYOUT
/begin RECORD_LAYOUT Scalar_UBYTE FNC_VALUES 1 UBYTE COLUMN_DIR DIRECT /end RECORD_LAYOUT
/begin RECORD_LAYOUT Scalar_UWORD FNC_VALUES 1 UWORD COLUMN_DIR DIRECT /end RECORD_LAYOUT
/begin RECORD_LAYOUT Scalar_SWORD FNC_VALUES 1 SWORD COLUMN_DIR DIRECT /end RECORD_LAYOUT
/begin RECORD_LAYOUT Scalar_FLOAT32_IEEE FNC_VALUES 1 FLOAT32_IEEE COLUMN_DIR DIRECT /end RECORD_LAYOUT
/begin RECORD_LAYOUT Lookup1D_UWORD FNC_VALUES 1 UWORD COLUMN_DIR DIRECT /end RECORD_LAYOUT
/begin RECORD_LAYOUT Lookup1D_X_UWORD AXIS_PTS_X 1 UWORD INDEX_INCR DIRECT /end RECORD_LAYOUT
/begin RECORD_LAYOUT Lookup1D_WORD FNC_VALUES 1 SWORD COLUMN_DIR DIRECT /end RECORD_LAYOUT
/begin RECORD_LAYOUT Lookup1D_X_WORD AXIS_PTS_X 1 SWORD INDEX_INCR DIRECT /end RECORD_LAYOUT
/begin RECORD_LAYOUT Lookup2D_UWORD FNC_VALUES 1 UWORD COLUMN_DIR DIRECT /end RECORD_LAYOUT
/begin RECORD_LAYOUT Lookup2D_X_UWORD AXIS_PTS_X 1 UWORD INDEX_INCR DIRECT /end RECORD_LAYOUT
/begin RECORD_LAYOUT Lookup2D_WORD FNC_VALUES 1 SWORD COLUMN_DIR DIRECT /end RECORD_LAYOUT
/begin RECORD_LAYOUT Lookup2D_X_WORD AXIS_PTS_X 1 SWORD INDEX_INCR DIRECT /end RECORD_LAYOUT
/begin MEASUREMENT CLCOve_M_EvenITorque "Even clutch I-part torque." SWORD CM_T_M_Nm_32_1_s16 0 0 -1024.0 1023.96875 ECU_ADDRESS 0x0000 /* @ECU_Address@CLCOve_M_EvenITorque@ */ /end MEASUREMENT
/begin MEASUREMENT CLCOve_M_EvenDTorque "Even clutch D-part torque." SWORD CM_T_M_Nm_32_1_s16 0 0 -1000.0 1000.0 ECU_ADDRESS 0x0000 /* @ECU_Address@CLCOve_M_EvenDTorque@ */ /end MEASUREMENT
/begin MEASUREMENT CLCOve_M_EvenPIDTorque "Even clutch PID torque." SWORD CM_T_M_Nm_32_1_s16 0 0 -1024.0 1023.96875 ECU_ADDRESS 0x0000 /* @ECU_Address@CLCOve_M_EvenPIDTorque@ */ /end MEASUREMENT
/begin MEASUREMENT CLCOve_M_EvenPIDTorqueLim "Even clutch PID torque limited." SWORD CM_T_M_Nm_32_1_s16 0 0 -1024.0 1023.96875 ECU_ADDRESS 0x0000 /* @ECU_Address@CLCOve_M_EvenPIDTorqueLim@ */ /end MEASUREMENT
/begin MEASUREMENT CLCOve_M_EvenInGearTrq "The unfiltered torque request in \"InGear\"" SWORD CM_T_M_Nm_32_1_s16 0 0 -1024.0 1023.96875 ECU_ADDRESS 0x0000 /* @ECU_Address@CLCOve_M_EvenInGearTrq@ */ /end MEASUREMENT
/begin MEASUREMENT CLCOve_M_FFMinusOddCltchTrq "FF minus odd clutch torque." SWORD CM_T_M_Nm_32_1_s16 0 0 -1024.0 1023.96875 ECU_ADDRESS 0x0000 /* @ECU_Address@CLCOve_M_FFMinusOddCltchTrq@ */ /end MEASUREMENT
/begin MEASUREMENT CLCOve_M_EvenTrqModeTrq "The unfiltered torque when in torque mode." SWORD CM_T_M_Nm_32_1_s16 0 0 -1024.0 1023.96875 ECU_ADDRESS 0x0000 /* @ECU_Address@CLCOve_M_EvenTrqModeTrq@ */ /end MEASUREMENT
/begin MEASUREMENT CLCOve_M_EvenUnfilteredTrq "The unfiiltered torque" SWORD CM_T_M_Nm_32_1_s16 0 0 -1024.0 1023.96875 ECU_ADDRESS 0x0000 /* @ECU_Address@CLCOve_M_EvenUnfilteredTrq@ */ /end MEASUREMENT
/begin MEASUREMENT CLCOve_M_A1 "A1" SWORD CM_T_M_Nm_32_1_s16 0 0 -1024.0 1023.96875 ECU_ADDRESS 0x0000 /* @ECU_Address@CLCOve_M_A1@ */ /end MEASUREMENT
/begin MEASUREMENT CLCOve_M_A6 "A6" SWORD CM_T_M_Nm_32_1_s16 0 0 -1024.0 1023.96875 ECU_ADDRESS 0x0000 /* @ECU_Address@CLCOve_M_A6@ */ /end MEASUREMENT
/begin MEASUREMENT CLCOve_M_A2 "A2" SWORD CM_T_M_Nm_32_1_s16 0 0 -1024.0 1023.96875 ECU_ADDRESS 0x0000 /* @ECU_Address@CLCOve_M_A2@ */ /end MEASUREMENT
/begin MEASUREMENT CLCOve_M_A3 "A3" SWORD CM_T_M_Nm_32_1_s16 0 0 -1024.0 1023.96875 ECU_ADDRESS 0x0000 /* @ECU_Address@CLCOve_M_A3@ */ /end MEASUREMENT
/begin MEASUREMENT CLCOve_M_OddPTorque "Odd clutch P-part torque." SWORD CM_T_M_Nm_32_1_s16 0 0 -1024.0 1023.96875 ECU_ADDRESS 0x0000 /* @ECU_Address@CLCOve_M_OddPTorque@ */ /end MEASUREMENT
/begin MEASUREMENT CLCOve_M_OddITorque "Odd clutch I-part torque." SWORD CM_T_M_Nm_32_1_s16 0 0 -1024.0 1023.96875 ECU_ADDRESS 0x0000 /* @ECU_Address@CLCOve_M_OddITorque@ */ /end MEASUREMENT
/begin MEASUREMENT CLCOve_M_OddDTorque "Odd clutch D-part torque." SWORD CM_T_M_Nm_32_1_s16 0 0 -1024.0 1023.96875 ECU_ADDRESS 0x0000 /* @ECU_Address@CLCOve_M_OddDTorque@ */ /end MEASUREMENT
/begin MEASUREMENT CLCOve_M_OddPIDTorque "Odd clutch PID torque." SWORD CM_T_M_Nm_32_1_s16 0 0 -1024.0 1023.96875 ECU_ADDRESS 0x0000 /* @ECU_Address@CLCOve_M_OddPIDTorque@ */ /end MEASUREMENT
/begin MEASUREMENT CLCOve_M_OddPIDTorqueLim "Limited Odd clutch PID torque." SWORD CM_T_M_Nm_32_1_s16 0 0 -1024.0 1023.96875 ECU_ADDRESS 0x0000 /* @ECU_Address@CLCOve_M_OddPIDTorqueLim@ */ /end MEASUREMENT
/begin MEASUREMENT CLCOve_M_OddInGearTrq "Odd clutch in gear torque." SWORD CM_T_M_Nm_32_1_s16 0 0 -1024.0 1023.96875 ECU_ADDRESS 0x0000 /* @ECU_Address@CLCOve_M_OddInGearTrq@ */ /end MEASUREMENT
/begin MEASUREMENT CLCOve_M_FFMinusEvenCltchTrq "FF minus even clutch torque." SWORD CM_T_M_Nm_32_1_s16 0 0 -1024.0 1023.96875 ECU_ADDRESS 0x0000 /* @ECU_Address@CLCOve_M_FFMinusEvenCltchTrq@ */ /end MEASUREMENT
/begin MEASUREMENT CLCOve_M_OddTrqModeTrq "odd clutch torque in torque mode." SWORD CM_T_M_Nm_32_1_s16 0 0 -1024.0 1023.96875 ECU_ADDRESS 0x0000 /* @ECU_Address@CLCOve_M_OddTrqModeTrq@ */ /end MEASUREMENT
/begin MEASUREMENT CLCOve_M_OddUnfilteredTrq "Odd clutch unfiltered torque." SWORD CM_T_M_Nm_32_1_s16 0 0 -1024.0 1023.96875 ECU_ADDRESS 0x0000 /* @ECU_Address@CLCOve_M_OddUnfilteredTrq@ */ /end MEASUREMENT
/begin MEASUREMENT CLCOve_M_A5 "A5" SWORD CM_T_M_Nm_32_1_s16 0 0 -1024.0 1023.96875 ECU_ADDRESS 0x0000 /* @ECU_Address@CLCOve_M_A5@ */ /end MEASUREMENT
/begin MEASUREMENT CLCOve_M_A4 "A5" SWORD CM_T_M_Nm_32_1_s16 0 0 -1024.0 1023.96875 ECU_ADDRESS 0x0000 /* @ECU_Address@CLCOve_M_A4@ */ /end MEASUREMENT
/begin MEASUREMENT CLCOve_M_A7 "A7" SWORD CM_T_M_Nm_32_1_s16 0 0 -1024.0 1023.96875 ECU_ADDRESS 0x0000 /* @ECU_Address@CLCOve_M_A7@ */ /end MEASUREMENT
/begin MEASUREMENT CLCOve_b_OddClutchSlipError "Indication for ClutchError, to much slipping has been detected while InGear" UBYTE CM_T_BOOLEAN 0 0 0.0 1.0 ECU_ADDRESS 0x0000 /* @ECU_Address@CLCOve_b_OddClutchSlipError@ */ /end MEASUREMENT
/begin MEASUREMENT CLCOve_b_FromInGearToOpen "This parameter indicates the state before entering open.
      1: Ingear
      0: Prepare
      
      " UBYTE CM_T_BOOLEAN 0 0 0.0 1.0 ECU_ADDRESS 0x0000 /* @ECU_Address@CLCOve_b_FromInGearToOpen@ */ /end MEASUREMENT
/begin MEASUREMENT CLCOve_b_EvenHaltIntegration "Halt integration for even clutch" UBYTE CM_T_BOOLEAN 0 0 0 1 ECU_ADDRESS 0x0000 /* @ECU_Address@CLCOve_b_EvenHaltIntegration@ */ /end MEASUREMENT
/begin MEASUREMENT CLCOve_b_EvenPIDSaturated "True if even clutch PID is saturated." UBYTE CM_T_BOOLEAN 0 0 0.0 1.0 ECU_ADDRESS 0x0000 /* @ECU_Address@CLCOve_b_EvenPIDSaturated@ */ /end MEASUREMENT
/begin MEASUREMENT CLCOve_b_A16 "A16" UBYTE CM_T_BOOLEAN 0 0 0 1 ECU_ADDRESS 0x0000 /* @ECU_Address@CLCOve_b_A16@ */ /end MEASUREMENT
/begin MEASUREMENT CLCOve_b_A15 "A15" UBYTE CM_T_BOOLEAN 0 0 0 1 ECU_ADDRESS 0x0000 /* @ECU_Address@CLCOve_b_A15@ */ /end MEASUREMENT
/begin MEASUREMENT CLCOve_b_A9 "A9" UBYTE CM_T_BOOLEAN 0 0 0 1 ECU_ADDRESS 0x0000 /* @ECU_Address@CLCOve_b_A9@ */ /end MEASUREMENT
/begin MEASUREMENT CLCOve_b_A12 "A12" UBYTE CM_T_BOOLEAN 0 0 0 1 ECU_ADDRESS 0x0000 /* @ECU_Address@CLCOve_b_A12@ */ /end MEASUREMENT
/begin MEASUREMENT CLCOve_b_OddHaltIntegration "Halt integration for Odd clutch." UBYTE CM_T_BOOLEAN 0 0 0 1 ECU_ADDRESS 0x0000 /* @ECU_Address@CLCOve_b_OddHaltIntegration@ */ /end MEASUREMENT
/begin MEASUREMENT CLCOve_b_A8 "A8" UBYTE CM_T_BOOLEAN 0 0 0 1 ECU_ADDRESS 0x0000 /* @ECU_Address@CLCOve_b_A8@ */ /end MEASUREMENT
/begin MEASUREMENT CLCOve_b_A14 "A14" UBYTE CM_T_BOOLEAN 0 0 0 1 ECU_ADDRESS 0x0000 /* @ECU_Address@CLCOve_b_A14@ */ /end MEASUREMENT
/begin MEASUREMENT CLCOve_b_A11 "A11" UBYTE CM_T_BOOLEAN 0 0 0 1 ECU_ADDRESS 0x0000 /* @ECU_Address@CLCOve_b_A11@ */ /end MEASUREMENT
/begin MEASUREMENT CLCOve_b_A13 "A13" UBYTE CM_T_BOOLEAN 0 0 0 1 ECU_ADDRESS 0x0000 /* @ECU_Address@CLCOve_b_A13@ */ /end MEASUREMENT
/begin MEASUREMENT CLCOve_b_OddPIDSaturated "True if odd clutch PID is saturated." UBYTE CM_T_BOOLEAN 0 0 0.0 1.0 ECU_ADDRESS 0x0000 /* @ECU_Address@CLCOve_b_OddPIDSaturated@ */ /end MEASUREMENT
/begin MEASUREMENT CLCOve_b_DisengageCompleteDelay "Delay for CLPCve_b_DisengageCompleteDelay" UBYTE CM_T_BOOLEAN 0 0 0.0 1.0 ECU_ADDRESS 0x0000 /* @ECU_Address@CLCOve_b_DisengageCompleteDelay@ */ /end MEASUREMENT
/begin COMPU_METHOD CM_T_M_Nm_32_1_s16 "Q = V*32.000000" RAT_FUNC "%9.5" "Nm (newton-meters  (Nm))" COEFFS 0 32 0 0 0 1 /end COMPU_METHOD
/begin COMPU_METHOD CM_T_n_rpm_1_1_s16 "Q = V" RAT_FUNC "%5.0" "rpm (revolutions / minute  (rpm))" COEFFS 0 1 0 0 0 1 /end COMPU_METHOD
/begin COMPU_METHOD CM_T_Cnt_Num_1_1_s16 "Q = V" RAT_FUNC "%5.0" "Num (counts)" COEFFS 0 1 0 0 0 1 /end COMPU_METHOD
/begin COMPU_METHOD CM_T_Cnt_Num_1_1_u16 "Q = V" RAT_FUNC "%5.0" "Num (counts)" COEFFS 0 1 0 0 0 1 /end COMPU_METHOD
/begin COMPU_METHOD CM_T_BOOLEAN "Q = V" RAT_FUNC "%1.0" "Bool" COEFFS 0 1 0 0 0 1 /end COMPU_METHOD
/begin COMPU_METHOD CM_uint16 "Q = V" RAT_FUNC "%5.0" "Num (counts)" COEFFS 0 1 0 0 0 1 /end COMPU_METHOD
/* EOF CLCO.a2l */
/begin RECORD_LAYOUT Scalar_BOOLEAN FNC_VALUES 1 UBYTE COLUMN_DIR DIRECT /end RECORD_LAYOUT
/begin RECORD_LAYOUT Scalar_UBYTE FNC_VALUES 1 UBYTE COLUMN_DIR DIRECT /end RECORD_LAYOUT
/begin RECORD_LAYOUT Scalar_UWORD FNC_VALUES 1 UWORD COLUMN_DIR DIRECT /end RECORD_LAYOUT
/begin RECORD_LAYOUT Scalar_SWORD FNC_VALUES 1 SWORD COLUMN_DIR DIRECT /end RECORD_LAYOUT
/begin RECORD_LAYOUT Scalar_FLOAT32_IEEE FNC_VALUES 1 FLOAT32_IEEE COLUMN_DIR DIRECT /end RECORD_LAYOUT
/begin RECORD_LAYOUT Lookup1D_BYTE FNC_VALUES 1 SBYTE COLUMN_DIR DIRECT /end RECORD_LAYOUT
/begin RECORD_LAYOUT Lookup1D_X_BYTE AXIS_PTS_X 1 SBYTE INDEX_INCR DIRECT /end RECORD_LAYOUT
/begin RECORD_LAYOUT Lookup1D_X_UBYTE AXIS_PTS_X 1 UBYTE INDEX_INCR DIRECT /end RECORD_LAYOUT
/begin RECORD_LAYOUT Lookup1D_UWORD FNC_VALUES 1 UWORD COLUMN_DIR DIRECT /end RECORD_LAYOUT
/begin RECORD_LAYOUT Lookup1D_X_UWORD AXIS_PTS_X 1 UWORD INDEX_INCR DIRECT /end RECORD_LAYOUT
/begin RECORD_LAYOUT Lookup1D_WORD FNC_VALUES 1 SWORD COLUMN_DIR DIRECT /end RECORD_LAYOUT
/begin RECORD_LAYOUT Lookup1D_X_WORD AXIS_PTS_X 1 SWORD INDEX_INCR DIRECT /end RECORD_LAYOUT
/begin RECORD_LAYOUT Lookup1D_ULONG FNC_VALUES 1 ULONG COLUMN_DIR DIRECT /end RECORD_LAYOUT
/begin RECORD_LAYOUT Lookup1D_X_ULONG AXIS_PTS_X 1 ULONG INDEX_INCR DIRECT /end RECORD_LAYOUT
/begin RECORD_LAYOUT Lookup1D_SLONG FNC_VALUES 1 SLONG COLUMN_DIR DIRECT /end RECORD_LAYOUT
/begin RECORD_LAYOUT Lookup1D_X_LONG AXIS_PTS_X 1 SLONG INDEX_INCR DIRECT /end RECORD_LAYOUT
/begin RECORD_LAYOUT Lookup1D_FLOAT32_IEEE FNC_VALUES 1 FLOAT32_IEEE COLUMN_DIR DIRECT /end RECORD_LAYOUT
/begin RECORD_LAYOUT Lookup1D_X_FLOAT32_IEEE AXIS_PTS_X 1 FLOAT32_IEEE INDEX_INCR DIRECT /end RECORD_LAYOUT
/begin RECORD_LAYOUT Lookup1D_FLOAT64_IEEE FNC_VALUES 1 FLOAT64_IEEE COLUMN_DIR DIRECT /end RECORD_LAYOUT
/begin RECORD_LAYOUT Lookup1D_X_FLOAT64_IEEE AXIS_PTS_X 1 FLOAT64_IEEE INDEX_INCR DIRECT /end RECORD_LAYOUT
/begin RECORD_LAYOUT Lookup2D_UBYTE FNC_VALUES 1 UBYTE COLUMN_DIR DIRECT /end RECORD_LAYOUT
/begin RECORD_LAYOUT Lookup2D_X_UBYTE AXIS_PTS_X 1 UBYTE INDEX_INCR DIRECT /end RECORD_LAYOUT
/begin RECORD_LAYOUT Lookup2D_BYTE FNC_VALUES 1 SBYTE COLUMN_DIR DIRECT /end RECORD_LAYOUT
/begin RECORD_LAYOUT Lookup2D_X_BYTE AXIS_PTS_X 1 SBYTE INDEX_INCR DIRECT /end RECORD_LAYOUT
/begin RECORD_LAYOUT Lookup2D_UWORD FNC_VALUES 1 UWORD COLUMN_DIR DIRECT /end RECORD_LAYOUT
/begin RECORD_LAYOUT Lookup2D_X_UWORD AXIS_PTS_X 1 UWORD INDEX_INCR DIRECT /end RECORD_LAYOUT
/begin RECORD_LAYOUT Lookup2D_WORD FNC_VALUES 1 SWORD COLUMN_DIR DIRECT /end RECORD_LAYOUT
/begin RECORD_LAYOUT Lookup2D_X_WORD AXIS_PTS_X 1 SWORD INDEX_INCR DIRECT /end RECORD_LAYOUT
/begin RECORD_LAYOUT Lookup2D_ULONG FNC_VALUES 1 ULONG COLUMN_DIR DIRECT /end RECORD_LAYOUT
/begin RECORD_LAYOUT Lookup2D_X_ULONG AXIS_PTS_X 1 ULONG INDEX_INCR DIRECT /end RECORD_LAYOUT
/begin RECORD_LAYOUT Lookup2D_LONG FNC_VALUES 1 SLONG COLUMN_DIR DIRECT /end RECORD_LAYOUT
/begin RECORD_LAYOUT Lookup2D_X_LONG AXIS_PTS_X 1 SLONG INDEX_INCR DIRECT /end RECORD_LAYOUT
/begin RECORD_LAYOUT Lookup2D_FLOAT32_IEEE FNC_VALUES 1 FLOAT32_IEEE COLUMN_DIR DIRECT /end RECORD_LAYOUT
/begin RECORD_LAYOUT Lookup2D_X_FLOAT32_IEEE AXIS_PTS_X 1 FLOAT32_IEEE INDEX_INCR DIRECT /end RECORD_LAYOUT
/begin RECORD_LAYOUT Lookup2D_FLOAT64_IEEE FNC_VALUES 1 FLOAT64_IEEE COLUMN_DIR DIRECT /end RECORD_LAYOUT
/begin RECORD_LAYOUT Lookup2D_X_FLOAT64_IEEE AXIS_PTS_X 1 FLOAT64_IEEE INDEX_INCR DIRECT /end RECORD_LAYOUT
/begin CHARACTERISTIC CLPCkt_Pct_CAPM_DutyCompensation "### Description
      This is the DC compensation for CAPM needed to maintain a certain speed
      ### Usage
      Set to measured DC needed to maintain each speed in the support point axis
      ### Calibration Note
      Support point axis are calibrated with CLPCkn_n_CAPM_Target
      It may not be possible to achieve all speeds without creating to high pressure
      This feed-forward is highly dependent on supply voltage to BLDC power stage, this calibration is against the supply-voltage in CLPCke_U_CAPM_NominalVoltage
      Typically, for no load the comensation would be linear, matching a kV for the motor, if the load (due to pressure) is handled by the other feed-forward.
      " CURVE 0x0000 /* @ECU_Address@CLPCkt_Pct_CAPM_DutyCompensation@ */ Lookup1D_WORD 0 CM_T_Pct_pct_256_1_s16 -128.0 127.99609375
 /begin AXIS_DESCR COM_AXIS NO_INPUT_QUANTITY CM_T_n_rpm_1_1_s16 16 -32768.0 32767.0 AXIS_PTS_REF CLPCkn_n_CAPM_Target /end AXIS_DESCR
/end CHARACTERISTIC
/begin AXIS_PTS CLPCkn_n_CAPM_Target "### Description
      This is the support point axis for DC compensation for CAPM needed to maintain a certain speed
      ### Usage
      Set to desired support points
      ### Calibration Note
      
      " 0x0000 /* @ECU_Address@CLPCkn_n_CAPM_Target@ */ NO_INPUT_QUANTITY Lookup1D_X_WORD 0 CM_T_n_rpm_1_1_s16 16 -32768.0 32767.0 /end AXIS_PTS
/begin CHARACTERISTIC CLPCkt_n_CAPM_Fill "iption
      This is the extra speed part for fill compensation, to reach the target fill pressure (or kisspoint if target is above kisspoint).
      ### Usage
      Set to desired extra fill speed depending on \"fill pressure diff\" and oil temperature.
      ### Calibration Note
      To have any effect, this compensation needs to be enabled through CLPCke_b_EnableFillCompensation
      Support points axis are calibrated with CLPCkn_T_OilTemp_CAPM_Fill and CLPCkn_p_FillDiff_CAPM_Fill" MAP 0x0000 /* @ECU_Address@CLPCkt_n_CAPM_Fill@ */ Lookup2D_WORD 0 CM_T_n_rpm_1_1_s16 0.0 32767 EXTENDED_LIMITS -32768.0 32767.0
 /begin AXIS_DESCR COM_AXIS CLPCve_p_FillDiff CM_T_p_kPa_32_1_u16 7 0.0 2047.96875 AXIS_PTS_REF CLPCkn_p_FillDiff_CAPM_Fill /end AXIS_DESCR
 /begin AXIS_DESCR COM_AXIS CLPCve_T_TransOilSump CM_T_T_degC_16_1_s16 11 -2048.0 2047.9375 AXIS_PTS_REF CLPCkn_T_OilTemp_CAPM_Fill /end AXIS_DESCR
/end CHARACTERISTIC
/begin AXIS_PTS CLPCkn_T_OilTemp_CAPM_Fill "iption
      Support point axis relative to oil-temperature for extra speed part for fill compensation, to reach the target fill pressure (or kisspoint if target is above kisspoint).
      ### Usage
      Set to desired oil temperature support points
      ### Calibration Note
      This is used in table CLPCkt_n_CAPM_Fill" 0x0000 /* @ECU_Address@CLPCkn_T_OilTemp_CAPM_Fill@ */ CLPCve_T_TransOilSump Lookup2D_X_WORD 0 CM_T_T_degC_16_1_s16 11 -2048.0 2047.9375 /end AXIS_PTS
/begin AXIS_PTS CLPCkn_p_FillDiff_CAPM_Fill "iption
      Support point axis relative to \"fill pressure diff\" (CLPCve_p_FillDiff = min(target, kisspoint) - actual) for extra speed part for fill compensation, to reach the target fill pressure (or kisspoint if target is above kisspoint).
      ### Usage
      Set to desired \"fill pressure diff\" support points
      ### Calibration Note
      This is used in table CLPCkt_n_CAPM_Fill" 0x0000 /* @ECU_Address@CLPCkn_p_FillDiff_CAPM_Fill@ */ CLPCve_p_FillDiff Lookup2D_X_UWORD 0 CM_T_p_kPa_32_1_u16 7 0.0 2047.96875 /end AXIS_PTS
/begin CHARACTERISTIC CLPCkt_n_CAPM_MaxFill "This sets the maximum CAPM speed for fill, as a function of oil temperature
      If the fill is attempted to be mad to quickly, an increase in oil-pressure above kiss-point can be measured despite fill isn't complete
      This is due to the pressure sensor is located close to the pump, and then the oil needs to flow to the clutch and move the cylinder, if oil is pumped to quickly the pressure at the pump increases without oil has flowed to the clutch
      The fill speed needs to be set significantly lower when the oil is cold" CURVE 0x0000 /* @ECU_Address@CLPCkt_n_CAPM_MaxFill@ */ Lookup1D_WORD 0 CM_T_n_rpm_1_1_s16 0.0 32767 EXTENDED_LIMITS -32768.0 32767.0
 /begin AXIS_DESCR COM_AXIS CLPCve_T_TransOilSump CM_T_T_degC_16_1_s16 11 -2048.0 2047.9375 AXIS_PTS_REF CLPCkn_T_OilTemp_MaxFill /end AXIS_DESCR
/end CHARACTERISTIC
/begin AXIS_PTS CLPCkn_T_OilTemp_MaxFill "This is the support-point axis, relative to oil-temp, for the maximum CAPM speed for fill" 0x0000 /* @ECU_Address@CLPCkn_T_OilTemp_MaxFill@ */ CLPCve_T_TransOilSump Lookup1D_X_WORD 0 CM_T_T_degC_16_1_s16 11 -2048.0 2047.9375 /end AXIS_PTS
/begin CHARACTERISTIC CLPCkt_n_FillPressureControlRelativeMaxSpeed "### Description
      This is the maximum target speed for fill pressure controller relative to feed-forward target rpm based on how close to kiss point the pressure is
      ### Usage
      Set to desired maximum speed, relative to feed-forward, when in filling state
      ### Calibration Note
      The purpose here is to limit the CAPM speed when approaching kisspoint, since the pressure buildup increase rapidly when going above kisspoint.
      Thus to avoid a uncontrollable pressure spike, the target speed could be limited when close to kiss-point
      " CURVE 0x0000 /* @ECU_Address@CLPCkt_n_FillPressureControlRelativeMaxSpeed@ */ Lookup1D_WORD 0 CM_T_n_rpm_1_1_s16 0.0 32767.0 EXTENDED_LIMITS -32768.0 32767.0
 /begin AXIS_DESCR COM_AXIS NO_INPUT_QUANTITY CM_T_p_kPa_32_1_u16 2 0.0 2047.96875 AXIS_PTS_REF CLPCkn_p_FillPressureControlRelativeMaxSpeed /end AXIS_DESCR
/end CHARACTERISTIC
/begin AXIS_PTS CLPCkn_p_FillPressureControlRelativeMaxSpeed "### Description
      This is the support point axis for maximum target speed for fill pressure controller relative to feed-forward target rpm
      ### Usage
      Set to pressure support points, in difference between (p_Kisspoint - p_Actual)
      ### Calibration Note
      " 0x0000 /* @ECU_Address@CLPCkn_p_FillPressureControlRelativeMaxSpeed@ */ NO_INPUT_QUANTITY Lookup1D_X_UWORD 0 CM_T_p_kPa_32_1_u16 2 0.0 2047.96875 /end AXIS_PTS
/begin CHARACTERISTIC CLPCkt_r_CAPM_PressureControl_forP "" MAP 0x0000 /* @ECU_Address@CLPCkt_r_CAPM_PressureControl_forP@ */ Lookup2D_UWORD 0 CM_T_K_NA_128_1_u16 0 511.9921875
 /begin AXIS_DESCR COM_AXIS CLPCve_p_Clutch CM_T_p_kPa_32_1_u16 12 0 2047.96875 AXIS_PTS_REF CLPCkn_p_Clutch_forP /end AXIS_DESCR
 /begin AXIS_DESCR COM_AXIS CLPCve_p_CAPM_Target CM_T_p_kPa_32_1_u16 12 0 2047.96875 AXIS_PTS_REF CLPCkn_p_CAPM_Target_forP /end AXIS_DESCR
/end CHARACTERISTIC
/begin AXIS_PTS CLPCkn_p_CAPM_Target_forP "" 0x0000 /* @ECU_Address@CLPCkn_p_CAPM_Target_forP@ */ CLPCve_p_CAPM_Target Lookup2D_X_UWORD 0 CM_T_p_kPa_32_1_u16 12 0 2047.96875 /end AXIS_PTS
/begin AXIS_PTS CLPCkn_p_Clutch_forP "" 0x0000 /* @ECU_Address@CLPCkn_p_Clutch_forP@ */ CLPCve_p_Clutch Lookup2D_X_UWORD 0 CM_T_p_kPa_32_1_u16 12 0 2047.96875 /end AXIS_PTS
/begin CHARACTERISTIC CLPCkt_r_CAPM_PressureControlP "" MAP 0x0000 /* @ECU_Address@CLPCkt_r_CAPM_PressureControlP@ */ Lookup2D_UWORD 0 CM_T_K_NA_128_1_u16 0 511.9921875
 /begin AXIS_DESCR COM_AXIS CLPCve_p_PressureDiff CM_T_p_kPa_1_1_s16 12 -32768 32767 AXIS_PTS_REF CLPCkn_p_ClutchPresDiff /end AXIS_DESCR
 /begin AXIS_DESCR COM_AXIS CLPCve_T_TransOilSump CM_T_T_degC_16_1_s16 11 -2048.0 2047.9375 AXIS_PTS_REF CLPCkn_T_TransOilSump /end AXIS_DESCR
/end CHARACTERISTIC
/begin AXIS_PTS CLPCkn_T_TransOilSump "" 0x0000 /* @ECU_Address@CLPCkn_T_TransOilSump@ */ CLPCve_T_TransOilSump Lookup2D_X_WORD 0 CM_T_T_degC_16_1_s16 11 -2048.0 2047.9375 /end AXIS_PTS
/begin AXIS_PTS CLPCkn_p_ClutchPresDiff "" 0x0000 /* @ECU_Address@CLPCkn_p_ClutchPresDiff@ */ CLPCve_p_PressureDiff Lookup2D_X_WORD 0 CM_T_p_kPa_1_1_s16 12 -32768 32767 /end AXIS_PTS
/begin CHARACTERISTIC CLPCkt_r_CAPM_PressureControlI "" MAP 0x0000 /* @ECU_Address@CLPCkt_r_CAPM_PressureControlI@ */ Lookup2D_UWORD 0 CM_T_K_NA_1024_1_u16 0 63.9990234375
 /begin AXIS_DESCR COM_AXIS CLPCve_p_PressureDiff CM_T_p_kPa_1_1_s16 12 -32768 32767 AXIS_PTS_REF CLPCkn_p_ClutchPresDiff /end AXIS_DESCR
 /begin AXIS_DESCR COM_AXIS CLPCve_T_TransOilSump CM_T_T_degC_16_1_s16 11 -2048.0 2047.9375 AXIS_PTS_REF CLPCkn_T_TransOilSump /end AXIS_DESCR
/end CHARACTERISTIC
/begin CHARACTERISTIC CLPCkt_n_PressureControllerMaxDueToTemp "### Description
      This is pressure controller max speed limitation due to oil temperature
      ### Usage
      Set to desired maximum speed as function of temperature
      ### Calibration Note" CURVE 0x0000 /* @ECU_Address@CLPCkt_n_PressureControllerMaxDueToTemp@ */ Lookup1D_WORD 0 CM_T_n_rpm_1_1_s16 0.0 32767.0 EXTENDED_LIMITS -32768.0 32767.0
 /begin AXIS_DESCR COM_AXIS CLPCve_T_TransOilSump CM_T_T_degC_16_1_s16 9 -50.0 150.0 AXIS_PTS_REF CLPCkn_T_OilTemp /end AXIS_DESCR
/end CHARACTERISTIC
/begin AXIS_PTS CLPCkn_T_OilTemp "### Description
      This is the oil temperature support point axis for pressure controller min/max speed limitation due to oil temperature
      ### Usage
      Set to desired oil temperature support points
      ### Calibration Note
      Note that this is used in multiple tables
      " 0x0000 /* @ECU_Address@CLPCkn_T_OilTemp@ */ CLPCve_T_TransOilSump Lookup1D_X_WORD 0 CM_T_T_degC_16_1_s16 9 -50.0 150.0 EXTENDED_LIMITS -2048.0 2047.9375 /end AXIS_PTS
/begin CHARACTERISTIC CLPCkt_n_PressureControllerMinDueToTemp "### Description
      This is pressure controller min speed limitation due to oil temperature
      ### Usage
      Set to desired minimum speed as function of temperature
      ### Calibration Note" CURVE 0x0000 /* @ECU_Address@CLPCkt_n_PressureControllerMinDueToTemp@ */ Lookup1D_WORD 0 CM_T_n_rpm_1_1_s16 -32768.0 0.0 EXTENDED_LIMITS -32768.0 32767.0
 /begin AXIS_DESCR COM_AXIS CLPCve_T_TransOilSump CM_T_T_degC_16_1_s16 9 -50.0 150.0 AXIS_PTS_REF CLPCkn_T_OilTemp /end AXIS_DESCR
/end CHARACTERISTIC
/begin CHARACTERISTIC CLPCkt_I_CAP_ReducedMaxCurrent "### Description
      This is a CAPM BLDC current limitation when the CAPM is close to overcurrent
      ### Usage
      Set to max current as a function of ratio of normalized filtered current (vs limit)
      ### Calibration Note
      This support points axis is calibrated with CLPCkn_r_CAP_ReducedMaxCurrent, wich correlates to input CLPCve_r_CAP_Y
      
      
      
      
      
      " CURVE 0x0000 /* @ECU_Address@CLPCkt_I_CAP_ReducedMaxCurrent@ */ Lookup1D_WORD 0 CM_T_I_A_32_1_s16 -1024.0 1023.96875
 /begin AXIS_DESCR COM_AXIS CLPCve_r_CAP_Y CM_T_r_NA_32768_1_u16 7 0 1.999969482421875 AXIS_PTS_REF CLPCkn_r_CAP_ReducedMaxCurrent /end AXIS_DESCR
/end CHARACTERISTIC
/begin AXIS_PTS CLPCkn_r_CAP_ReducedMaxCurrent "### Description
      This is the support point axis for CAPM BLDC current limitation when the CAPM is close to overcurrent
      ### Usage
      Set to desired support points, relative to CLPCve_r_CAP_Y
      ### Calibration Note
      The table data is calibrated with CLPCkt_I_CAP_ReducedMaxCurrent
      " 0x0000 /* @ECU_Address@CLPCkn_r_CAP_ReducedMaxCurrent@ */ CLPCve_r_CAP_Y Lookup1D_X_UWORD 0 CM_T_r_NA_32768_1_u16 7 0 1.999969482421875 /end AXIS_PTS
/begin CHARACTERISTIC CLPCkt_n_CAPM_TargetSpeedCompensation "### Description
      This is the target speed compensation for CCPM needed to maintain a pressure
      ### Usage
      Set to measured CAPM speed needed to maintain each pressure in the support point axis
      ### Calibration Note
      Support point axis are calibrated with CLPCkn_p_CAPM_Target
      It may not be possible to achieve all pressures" CURVE 0x0000 /* @ECU_Address@CLPCkt_n_CAPM_TargetSpeedCompensation@ */ Lookup1D_WORD 0 CM_T_n_rpm_1_1_s16 -32768.0 32767.0
 /begin AXIS_DESCR COM_AXIS CLPCve_p_CAPM_Target CM_T_p_kPa_32_1_u16 12 0.0 2047.96875 AXIS_PTS_REF CLPCkn_p_CAPM_Target /end AXIS_DESCR
/end CHARACTERISTIC
/begin AXIS_PTS CLPCkn_p_CAPM_Target "### Description
      This is the support point axis for speed compensation for CAPM needed to maintain a certain pressure
      ### Usage
      Set to desired support points
      ### Calibration Note" 0x0000 /* @ECU_Address@CLPCkn_p_CAPM_Target@ */ CLPCve_p_CAPM_Target Lookup1D_X_UWORD 0 CM_T_p_kPa_32_1_u16 12 0.0 2047.96875 /end AXIS_PTS
/begin CHARACTERISTIC CLPCkt_n_FlowComp "This is the fill speed compensation (extra fill) as a function of pressure diff (relative to target pressure and actual pressure) and oil temperature" MAP 0x0000 /* @ECU_Address@CLPCkt_n_FlowComp@ */ Lookup2D_WORD 0 CM_T_n_rpm_1_1_s16 -32768 32767
 /begin AXIS_DESCR COM_AXIS CLPCve_T_TransOilSump CM_T_T_degC_16_1_s16 11 -40.0 150.0 AXIS_PTS_REF CLPCkn_T_FlowComp /end AXIS_DESCR
 /begin AXIS_DESCR COM_AXIS CLPCve_p_CAPM_Target CM_T_p_kPa_32_1_u16 12 0.0 2047.0 AXIS_PTS_REF CLPCkn_p_FlowComp /end AXIS_DESCR
/end CHARACTERISTIC
/begin AXIS_PTS CLPCkn_p_FlowComp "Support-point axis for fill speed compensation, pressure diff (relative to target pressure and actual pressure)" 0x0000 /* @ECU_Address@CLPCkn_p_FlowComp@ */ CLPCve_p_CAPM_Target Lookup2D_X_UWORD 0 CM_T_p_kPa_32_1_u16 12 0.0 2047.0 EXTENDED_LIMITS 0.0 2047.96875 /end AXIS_PTS
/begin AXIS_PTS CLPCkn_T_FlowComp "Support-point axis for fill speed compensation, oil temperature" 0x0000 /* @ECU_Address@CLPCkn_T_FlowComp@ */ CLPCve_T_TransOilSump Lookup2D_X_WORD 0 CM_T_T_degC_16_1_s16 11 -40.0 150.0 EXTENDED_LIMITS -2048.0 2047.9375 /end AXIS_PTS
/begin CHARACTERISTIC CLPCkt_Cnt_CAPM_Fill_IPartDelay "This is the maximum time (in counts of 5ms sample time) to disable the normal I-part of the PID-controller during fill" CURVE 0x0000 /* @ECU_Address@CLPCkt_Cnt_CAPM_Fill_IPartDelay@ */ Lookup1D_UWORD 0 CM_T_Cnt_Num_1_1_u16 0 65535
 /begin AXIS_DESCR COM_AXIS CLPCve_T_TransOilSump CM_T_T_degC_16_1_s16 11 -2048.0 2047.9375 AXIS_PTS_REF CLPCkn_T_CAPM_Fill_IPartDelay /end AXIS_DESCR
/end CHARACTERISTIC
/begin AXIS_PTS CLPCkn_T_CAPM_Fill_IPartDelay "This is the support-point axis, relative to oil-temp, for the maximum time to disable normal I-part of the PID-controller during fill" 0x0000 /* @ECU_Address@CLPCkn_T_CAPM_Fill_IPartDelay@ */ CLPCve_T_TransOilSump Lookup1D_X_WORD 0 CM_T_T_degC_16_1_s16 11 -2048.0 2047.9375 /end AXIS_PTS
/begin CHARACTERISTIC CLPCkt_Cnt_MaxFill "This sets the maximum time to limit the maximum CAPM speed during fill, as a function of oil temperature
      This is set in amount of samples in 5ms sample time" CURVE 0x0000 /* @ECU_Address@CLPCkt_Cnt_MaxFill@ */ Lookup1D_UWORD 0 CM_T_Cnt_Num_1_1_u16 0 65535
 /begin AXIS_DESCR COM_AXIS CLPCve_T_TransOilSump CM_T_T_degC_16_1_s16 11 -2048.0 2047.9375 AXIS_PTS_REF CLPCkn_T_OilTempMaxFill /end AXIS_DESCR
/end CHARACTERISTIC
/begin AXIS_PTS CLPCkn_T_OilTempMaxFill "This is the support-point axis, relative to oil-temp, for maximum time to limit the maximum CAPM speed during fill" 0x0000 /* @ECU_Address@CLPCkn_T_OilTempMaxFill@ */ CLPCve_T_TransOilSump Lookup1D_X_WORD 0 CM_T_T_degC_16_1_s16 11 -2048.0 2047.9375 /end AXIS_PTS
/begin CHARACTERISTIC CLPCkt_Cnt_FillCompensation "This is the maximum time (in counts of 5ms sample time) to have extra fill-compensation during fill" CURVE 0x0000 /* @ECU_Address@CLPCkt_Cnt_FillCompensation@ */ Lookup1D_UWORD 0 CM_T_Cnt_Num_1_1_u16 0 65535
 /begin AXIS_DESCR COM_AXIS CLPCve_T_TransOilSump CM_T_T_degC_16_1_s16 11 -2048.0 2047.9375 AXIS_PTS_REF CLPCkn_T_OilTemp_FillCompensation /end AXIS_DESCR
/end CHARACTERISTIC
/begin AXIS_PTS CLPCkn_T_OilTemp_FillCompensation "This is the support-point axis, relative to oil-temp, for having extra fill-compensation for fill" 0x0000 /* @ECU_Address@CLPCkn_T_OilTemp_FillCompensation@ */ CLPCve_T_TransOilSump Lookup1D_X_WORD 0 CM_T_T_degC_16_1_s16 11 -2048.0 2047.9375 /end AXIS_PTS
/begin CHARACTERISTIC CLPCkt_n_PressureControllerMinSpeed "### Description
      This is the pressure controller minimum target speed as a function of actual pressure
      ### Usage
      Set to desired minimum speed limit as a function of actual pressure
      ### Calibration Note
      This works both as an overall minimum speed limit and also as a way to prevent pressure controller to not request negative speed when the pressure is low (actual pressure might not go to zero)
      " CURVE 0x0000 /* @ECU_Address@CLPCkt_n_PressureControllerMinSpeed@ */ Lookup1D_WORD 0 CM_T_n_rpm_1_1_s16 -32767.0 0.0 EXTENDED_LIMITS -32768.0 32767.0
 /begin AXIS_DESCR COM_AXIS CLPCve_p_Clutch CM_T_p_kPa_32_1_u16 5 0.0 2047.96875 AXIS_PTS_REF CLPCkn_p_PressureControllerMinSpeed /end AXIS_DESCR
/end CHARACTERISTIC
/begin AXIS_PTS CLPCkn_p_PressureControllerMinSpeed "### Description
      This is actual pressure support point axis for the pressure controller minimum target speed
      ### Usage
      Set to desired support point axis for actual pressure
      ### Calibration Note
      " 0x0000 /* @ECU_Address@CLPCkn_p_PressureControllerMinSpeed@ */ CLPCve_p_Clutch Lookup1D_X_UWORD 0 CM_T_p_kPa_32_1_u16 5 0.0 2047.96875 /end AXIS_PTS
/begin CHARACTERISTIC CLPCkt_dp_AdaptionFillMaxExpected "Adaptionfill, maximum expected pressure increase, if actual pressure increases faster then adaptionfill" CURVE 0x0000 /* @ECU_Address@CLPCkt_dp_AdaptionFillMaxExpected@ */ Lookup1D_WORD 0 CM_T_dp_kPaps_8_1_s16 0.0 4095.875 EXTENDED_LIMITS -4096.0 4095.875
 /begin AXIS_DESCR COM_AXIS CLPCve_n_AdaptionFill CM_T_n_rpm_1_1_s16 5 0.0 32767 AXIS_PTS_REF CLPCkn_n_AdaptionFillMaxExpected /end AXIS_DESCR
/end CHARACTERISTIC
/begin AXIS_PTS CLPCkn_n_AdaptionFillMaxExpected "Adaptionfill, target speed support-point axis for maximum expected pressure increase" 0x0000 /* @ECU_Address@CLPCkn_n_AdaptionFillMaxExpected@ */ CLPCve_n_AdaptionFill Lookup1D_X_WORD 0 CM_T_n_rpm_1_1_s16 5 0.0 32767 EXTENDED_LIMITS -32768.0 32767.0 /end AXIS_PTS
/begin CHARACTERISTIC CLPCkt_p_PreparePressureRelativeToKisspointOdd "### Description
      This sets the target prepare pressure relative to kisspoint for Odd clutch, used when torque request is zero.
      ### Usage
      Set to desired offset for target prepare pressure relative to kisspoint for Odd clutch
      ### Calibration Note
      Negative value
      " CURVE 0x0000 /* @ECU_Address@CLPCkt_p_PreparePressureRelativeToKisspointOdd@ */ Lookup1D_WORD 0 CM_T_p_kPa_1_1_s16 -32768 0.0 EXTENDED_LIMITS -32768.0 32767.0
 /begin AXIS_DESCR COM_AXIS CLPCve_n_OddClutchAbsDiff CM_T_n_rpm_1_1_s16 8 0.0 32767 AXIS_PTS_REF CLPCkn_n_DiffSpeedPreparePressure /end AXIS_DESCR
/end CHARACTERISTIC
/begin AXIS_PTS CLPCkn_n_DiffSpeedPreparePressure "Support-point axis for CLPCkt_p_PreparePressureRelativeToKisspointOdd relative to DiffSpeed over clutch (CLPCve_n_OddClutchAbsDiff)" 0x0000 /* @ECU_Address@CLPCkn_n_DiffSpeedPreparePressure@ */ CLPCve_n_OddClutchAbsDiff Lookup1D_X_WORD 0 CM_T_n_rpm_1_1_s16 8 0.0 32767 EXTENDED_LIMITS -32768.0 32767.0 /end AXIS_PTS
/begin CHARACTERISTIC CLPCkt_p_OddClutchTempCompensation "Clutch kisspoint change due to oil temperature.
      Set to 0 for the temp where kisspoint kalibrated/adapted at.
      " CURVE 0x0000 /* @ECU_Address@CLPCkt_p_OddClutchTempCompensation@ */ Lookup1D_WORD 0 CM_T_p_kPa_64_1_s16 -512.0 511.984375
 /begin AXIS_DESCR COM_AXIS NO_INPUT_QUANTITY CM_T_T_degC_16_1_s16 5 -2048.0 2047.9375 AXIS_PTS_REF CLPCkn_T_OddClutchTempCompensation /end AXIS_DESCR
/end CHARACTERISTIC
/begin AXIS_PTS CLPCkn_T_OddClutchTempCompensation "Support point axis for kisspoint change die to oil temperature, relative to transmission oil temp." 0x0000 /* @ECU_Address@CLPCkn_T_OddClutchTempCompensation@ */ NO_INPUT_QUANTITY Lookup1D_X_WORD 0 CM_T_T_degC_16_1_s16 5 -2048.0 2047.9375 /end AXIS_PTS
/begin CHARACTERISTIC CLPCkt_p_OddClutchSecondarySideBalancing "Clutch balancing due to rotational speed (absolute) of clutch secondary side (outgoing).
      Used for kisspoint compensation due to rotational speed.
      Needs to be negative to lower the kisspoint
      " CURVE 0x0000 /* @ECU_Address@CLPCkt_p_OddClutchSecondarySideBalancing@ */ Lookup1D_WORD 0 CM_T_p_kPa_64_1_s16 -512.0 511.984375
 /begin AXIS_DESCR COM_AXIS CLPCve_n_OddClthAbsSpeed CM_T_n_rpm_1_1_s16 18 -32768 32767 AXIS_PTS_REF CLPCkn_n_OddClutchSecondarySideBalancing /end AXIS_DESCR
/end CHARACTERISTIC
/begin AXIS_PTS CLPCkn_n_OddClutchSecondarySideBalancing "Support point axis for clutch balancing due to rotational speed (absolute)
      This corresponds to the absolute rotational speed of secondary side of clutch
      " 0x0000 /* @ECU_Address@CLPCkn_n_OddClutchSecondarySideBalancing@ */ CLPCve_n_OddClthAbsSpeed Lookup1D_X_WORD 0 CM_T_n_rpm_1_1_s16 18 -32768 32767 /end AXIS_PTS
/begin CHARACTERISTIC CLPCkt_p_ClutchPressureRequestOdd "Clutch torque to clutch pressure conversion curve." CURVE 0x0000 /* @ECU_Address@CLPCkt_p_ClutchPressureRequestOdd@ */ Lookup1D_WORD 0 CM_T_p_kPa_1_1_s16 0.0 10000.0 EXTENDED_LIMITS -32768.0 32767.0
 /begin AXIS_DESCR COM_AXIS NO_INPUT_QUANTITY CM_T_M_Nm_32_1_s16 5 -1000.0 1000.0 AXIS_PTS_REF CLPCkn_M_TrqToPrsConversionAxis /end AXIS_DESCR
/end CHARACTERISTIC
/begin AXIS_PTS CLPCkn_M_TrqToPrsConversionAxis "Torque breakpoint axis" 0x0000 /* @ECU_Address@CLPCkn_M_TrqToPrsConversionAxis@ */ NO_INPUT_QUANTITY Lookup1D_X_WORD 0 CM_T_M_Nm_32_1_s16 5 -1000.0 1000.0 EXTENDED_LIMITS -1024.0 1023.96875 /end AXIS_PTS
/begin CHARACTERISTIC CLPCkt_p_ClutchPressureRequestEven "Clutch torque to clutch pressure conversion curve." CURVE 0x0000 /* @ECU_Address@CLPCkt_p_ClutchPressureRequestEven@ */ Lookup1D_WORD 0 CM_T_p_kPa_1_1_s16 0.0 10000.0 EXTENDED_LIMITS -32768.0 32767.0
 /begin AXIS_DESCR COM_AXIS NO_INPUT_QUANTITY CM_T_M_Nm_32_1_s16 5 -1000.0 1000.0 AXIS_PTS_REF CLPCkn_M_TrqToPrsConversionAxis /end AXIS_DESCR
/end CHARACTERISTIC
/begin CHARACTERISTIC CLPCkt_K_ClutchFrictionDecline "Friction decline due to high temperature." CURVE 0x0000 /* @ECU_Address@CLPCkt_K_ClutchFrictionDecline@ */ Lookup1D_UWORD 0 CM_T_r_NA_1024_1_u16 0.0 1.0 EXTENDED_LIMITS 0.0 63.9990234375
 /begin AXIS_DESCR COM_AXIS NO_INPUT_QUANTITY CM_T_T_degC_16_1_s16 8 -50.0 1000.0 AXIS_PTS_REF CLPCkn_T_ClutchDiscTemp /end AXIS_DESCR
/end CHARACTERISTIC
/begin AXIS_PTS CLPCkn_T_ClutchDiscTemp "Average clutch disc lining temperature." 0x0000 /* @ECU_Address@CLPCkn_T_ClutchDiscTemp@ */ NO_INPUT_QUANTITY Lookup1D_X_WORD 0 CM_T_T_degC_16_1_s16 8 -50.0 1000.0 EXTENDED_LIMITS -2048.0 2047.9375 /end AXIS_PTS
/begin CHARACTERISTIC CLPCkt_r_FrictionCoefficientOdd "Coefficient of friction for clutch surface material." CURVE 0x0000 /* @ECU_Address@CLPCkt_r_FrictionCoefficientOdd@ */ Lookup1D_UWORD 0 CM_T_r_NA_1024_1_u16 0.0 1.0 EXTENDED_LIMITS 0.0 63.9990234375
 /begin AXIS_DESCR COM_AXIS CLPCve_n_OddClutchAbsDiff CM_T_n_rpm_1_1_s16 8 0.0 10000.0 AXIS_PTS_REF CLPCkn_n_ClutchDiffSpeed /end AXIS_DESCR
/end CHARACTERISTIC
/begin AXIS_PTS CLPCkn_n_ClutchDiffSpeed "Clutch differential speed breakpoint axis." 0x0000 /* @ECU_Address@CLPCkn_n_ClutchDiffSpeed@ */ CLPCve_n_OddClutchAbsDiff Lookup1D_X_WORD 0 CM_T_n_rpm_1_1_s16 8 0.0 10000.0 EXTENDED_LIMITS -32768.0 32767.0 /end AXIS_PTS
/begin CHARACTERISTIC CLPCkt_r_FrictionCoefficientEven "Coefficient of friction for clutch surface material." CURVE 0x0000 /* @ECU_Address@CLPCkt_r_FrictionCoefficientEven@ */ Lookup1D_UWORD 0 CM_T_r_NA_1024_1_u16 0.0 1.0 EXTENDED_LIMITS 0.0 63.9990234375
 /begin AXIS_DESCR COM_AXIS NO_INPUT_QUANTITY CM_T_n_rpm_1_1_s16 8 0.0 10000.0 AXIS_PTS_REF CLPCkn_n_ClutchDiffSpeed /end AXIS_DESCR
/end CHARACTERISTIC
/begin CHARACTERISTIC CLPCkt_p_AntiTieUpSlaveMaxLimitation "Hard limitation value for preventing transmission tie up. Transmission tie up is the case of both clutches engaging a certain level of torque simultanously. This behaviour could lead to hardware damage." CURVE 0x0000 /* @ECU_Address@CLPCkt_p_AntiTieUpSlaveMaxLimitation@ */ Lookup1D_WORD 0 CM_T_p_kPa_1_1_s16 -32000.0 32000.0 EXTENDED_LIMITS -32768.0 32767.0
 /begin AXIS_DESCR COM_AXIS NO_INPUT_QUANTITY CM_T_p_kPa_1_1_s16 5 -32000.0 32000.0 AXIS_PTS_REF CLPCkn_p_AntiTieUpMasterAxis /end AXIS_DESCR
/end CHARACTERISTIC
/begin AXIS_PTS CLPCkn_p_AntiTieUpMasterAxis "Breakpoint axis for transmission anti tie up limitation of clutch actuator pressures." 0x0000 /* @ECU_Address@CLPCkn_p_AntiTieUpMasterAxis@ */ NO_INPUT_QUANTITY Lookup1D_X_WORD 0 CM_T_p_kPa_1_1_s16 5 -32000.0 32000.0 EXTENDED_LIMITS -32768.0 32767.0 /end AXIS_PTS
/begin CHARACTERISTIC CLPCke_I_CAP_BSW_CurrentLimit "### Description
      This is the BSW current limit for CAP BLDC Phase Current
      ### Usage
      Set to the same value as used in BSW
      ### Calibration Note
      " VALUE 0x0000 /* @ECU_Address@CLPCke_I_CAP_BSW_CurrentLimit@ */ Scalar_FLOAT32_IEEE 0 CM_T_I_A_Float32 0.1 3.4E+38 EXTENDED_LIMITS -3.4E+38 3.4E+38 /end CHARACTERISTIC
/begin CHARACTERISTIC CLPCke_K_CAP_BSW_CurrentLimit "Low pass filter koefficient =  deltaT/T
      Where deltaT is periodicity for the filter, here 1 sec.
      And T is timeconstant for filter.
      " VALUE 0x0000 /* @ECU_Address@CLPCke_K_CAP_BSW_CurrentLimit@ */ Scalar_FLOAT32_IEEE 0 CM_T_K_NA_Float32 0.0 1.0 EXTENDED_LIMITS -3.4E+38 3.4E+38 /end CHARACTERISTIC
/begin CHARACTERISTIC CLPCke_K_CurrentToPressureDecrease "Filter co-efficient for decreasing estimated current to pressure ratio" VALUE 0x0000 /* @ECU_Address@CLPCke_K_CurrentToPressureDecrease@ */ Scalar_FLOAT32_IEEE 0 CM_T_K_NA_Float32 0.0 1.0 EXTENDED_LIMITS -3.4E+38 3.4E+38 /end CHARACTERISTIC
/begin CHARACTERISTIC CLPCke_K_CurrentToPressureIncrease "Filter co-efficient for increasing estimated current to pressure ratio" VALUE 0x0000 /* @ECU_Address@CLPCke_K_CurrentToPressureIncrease@ */ Scalar_FLOAT32_IEEE 0 CM_T_K_NA_Float32 0.0 1.0 EXTENDED_LIMITS -3.4E+38 3.4E+38 /end CHARACTERISTIC
/begin CHARACTERISTIC CLPCke_K_PowerToPressureDecrease "Filter co-efficient for decreasing estimated power to pressure ratio" VALUE 0x0000 /* @ECU_Address@CLPCke_K_PowerToPressureDecrease@ */ Scalar_FLOAT32_IEEE 0 CM_T_K_NA_Float32 0.0 1.0 EXTENDED_LIMITS -3.4E+38 3.4E+38 /end CHARACTERISTIC
/begin CHARACTERISTIC CLPCke_K_PowerToPressureIncrease "Filter co-efficient for increasing estimated power to pressure ratio" VALUE 0x0000 /* @ECU_Address@CLPCke_K_PowerToPressureIncrease@ */ Scalar_FLOAT32_IEEE 0 CM_T_K_NA_Float32 0.0 1.0 EXTENDED_LIMITS -3.4E+38 3.4E+38 /end CHARACTERISTIC
/begin CHARACTERISTIC CLPCke_e_CAPM_Status "### Description
      This sets the CAPM BLDC Command Status, this needs to be set/enabled manually
      ### Usage
      Set to desired CAPM BLDC Command Status
      ### Calibration Note
      This needs to be enabled to be able to run CAPM BLDC motor" VALUE 0x0000 /* @ECU_Address@CLPCke_e_CAPM_Status@ */ Scalar_UBYTE 0 CM_CLPCte_e_St_ElM 15 255 EXTENDED_LIMITS 0 0 /end CHARACTERISTIC
/begin CHARACTERISTIC CLPCie_e_CAPM_PressureControl "### Description
      Override for target for CAPM pressure controller
      ### Usage
      Set to desired override mode when needed, if test sequence generator or manual target is needed.
      ### Calibration Note
      Shall be set CLPCce_e_CAPM_Source_No_Override in production intended SW." VALUE 0x0000 /* @ECU_Address@CLPCie_e_CAPM_PressureControl@ */ Scalar_UBYTE 0 CM_CLPCte_e_CAPM_Override 0 5 EXTENDED_LIMITS 0 0 /end CHARACTERISTIC
/begin CHARACTERISTIC CLPCie_e_CAPM_SpeedControl "### Description
      Override for target for CAPM speed controller
      ### Usage
      Set to desired override mode when needed, if test sequence generator or manual target is needed.
      ### Calibration Note
      Shall be set CLPCce_e_CAPM_Source_No_Override in production intended SW." VALUE 0x0000 /* @ECU_Address@CLPCie_e_CAPM_SpeedControl@ */ Scalar_UBYTE 0 CM_CLPCte_e_CAPM_Override 0 5 EXTENDED_LIMITS 0 0 /end CHARACTERISTIC
/begin CHARACTERISTIC CLPCie_n_CAPM_TargetSpeed "### Description
      This is the manual target speed for CAPM speed controller
      ### Usage
      Set to target speed for CAPM speed controller
      ### Calibration Note
      This value will only be acknowledged when CAPM speed control is enabled and manual speed target selected with override
      " VALUE 0x0000 /* @ECU_Address@CLPCie_n_CAPM_TargetSpeed@ */ Scalar_SWORD 0 CM_T_n_rpm_1_1_s16 -14000.0 14000.0 EXTENDED_LIMITS -32768.0 32767.0 /end CHARACTERISTIC
/begin CHARACTERISTIC CLPCie_p_EvenClutchPresReqInternal_Offset "Offset for throughput of nominal functionality.
      Shall be set to 0 for production intent SW
      " VALUE 0x0000 /* @ECU_Address@CLPCie_p_EvenClutchPresReqInternal_Offset@ */ Scalar_SWORD 0 CM_T_p_kPa_1_1_s16 -32768.0 32767.0 /end CHARACTERISTIC
/begin CHARACTERISTIC CLPCie_p_EvenClutchPresReq_OV "Override value." VALUE 0x0000 /* @ECU_Address@CLPCie_p_EvenClutchPresReq_OV@ */ Scalar_SWORD 0 CM_T_p_kPa_1_1_s16 0.0 1500.0 EXTENDED_LIMITS -32768.0 32767.0 /end CHARACTERISTIC
/begin CHARACTERISTIC CLPCie_p_OddClutchPresReqInternal_Offset "Offset for throughput of nominal functionality.
      Shall be set to 0 for production intent SW
      
      " VALUE 0x0000 /* @ECU_Address@CLPCie_p_OddClutchPresReqInternal_Offset@ */ Scalar_SWORD 0 CM_T_p_kPa_1_1_s16 -32768.0 32767.0 /end CHARACTERISTIC
/begin CHARACTERISTIC CLPCie_p_OddClutchPresReq_OV "Override value." VALUE 0x0000 /* @ECU_Address@CLPCie_p_OddClutchPresReq_OV@ */ Scalar_SWORD 0 CM_T_p_kPa_1_1_s16 0.0 1500.0 EXTENDED_LIMITS -32768.0 32767.0 /end CHARACTERISTIC
/begin CHARACTERISTIC CLPCka_n_CAPM_SpeedTestSequencePhaseTarget "### Description
      This is the target speed for each phase (up to 10 phases usable) for target speed sequence generator for Clutch Actuator Pump Motor
      ### Usage
      Set to desired target speed for each phase in rpm, the output during the phase will be interpolated between last phase output and the current phase target.
      ### Calibration Note
      
      " VAL_BLK 0x0000 /* @ECU_Address@CLPCka_n_CAPM_SpeedTestSequencePhaseTarget@ */ Scalar_SWORD 0 CM_T_n_rpm_1_1_s16 -14000.0 14000.0 EXTENDED_LIMITS -32768.0 32767.0 NUMBER 100 /end CHARACTERISTIC
/begin CHARACTERISTIC CLPCka_p_CAPM_PressureTestSequencePhaseTarget "### Description
      This is the target pressure for each phase (up to 10 phases usable) for target pressure sequence generator for Clutch Actuator Pump Motor
      ### Usage
      Set to desired target pressure for each phase in kPa, the output during the phase will be interpolated between last phase output and the current phase target.
      ### Calibration Note
      
      
      " VAL_BLK 0x0000 /* @ECU_Address@CLPCka_p_CAPM_PressureTestSequencePhaseTarget@ */ Scalar_SWORD 0 CM_T_p_kPa_1_1_s16 0.0 2000.0 EXTENDED_LIMITS -32768.0 32767.0 NUMBER 100 /end CHARACTERISTIC
/begin CHARACTERISTIC CLPCke_n_AdaptionFillMaxError "Condition for adaptionfill (finding kisspoint), when in in active adaptionfill state the for CAP-speed error relative the target speed is allowed to be max this value, there is also a time delay during the speed condition needs to be fulfilled before trying to find kisspoint" VALUE 0x0000 /* @ECU_Address@CLPCke_n_AdaptionFillMaxError@ */ Scalar_SWORD 0 CM_T_n_rpm_1_1_s16 0.0 32767.0 EXTENDED_LIMITS -32768.0 32767.0 /end CHARACTERISTIC
/begin CHARACTERISTIC CLPCke_n_AdaptionFillMaxTarget "Maximum speed for adaptionfill target" VALUE 0x0000 /* @ECU_Address@CLPCke_n_AdaptionFillMaxTarget@ */ Scalar_SWORD 0 CM_T_n_rpm_1_1_s16 0.0 6000.0 EXTENDED_LIMITS -32768.0 32767.0 /end CHARACTERISTIC
/begin CHARACTERISTIC CLPCke_n_AdaptionFillMinTarget "Minimum speed for adaptionfill target" VALUE 0x0000 /* @ECU_Address@CLPCke_n_AdaptionFillMinTarget@ */ Scalar_SWORD 0 CM_T_n_rpm_1_1_s16 0.0 6000.0 EXTENDED_LIMITS -32768.0 32767.0 /end CHARACTERISTIC
/begin CHARACTERISTIC CLPCke_n_CAPM_AdaptionFillTarget "Target (minimum at initialization) for adaptionfill, target will increase if feed-forward compensation exceeds the current target" VALUE 0x0000 /* @ECU_Address@CLPCke_n_CAPM_AdaptionFillTarget@ */ Scalar_SWORD 0 CM_T_n_rpm_1_1_s16 0.0 32767.0 EXTENDED_LIMITS -32768.0 32767.0 /end CHARACTERISTIC
/begin CHARACTERISTIC CLPCke_n_CAPM_FillPressureControllerDecreaseRateLim "### Description
      This enables sets the target speed decrease rate-limit for CAPM pressure control when in filling state
      ### Usage
      Set to maximum decrease rate of target speed for pressure controller when in filling state, in rpm per sample (at 5ms)
      ### Calibration Note
      The speed limits have precedence over rate, thus the output can always be limited (towards zero) faster than any rate limit." VALUE 0x0000 /* @ECU_Address@CLPCke_n_CAPM_FillPressureControllerDecreaseRateLim@ */ Scalar_SWORD 0 CM_T_n_rpm_1_1_s16 -32768.0 -1.0 EXTENDED_LIMITS -32768.0 32767.0 /end CHARACTERISTIC
/begin CHARACTERISTIC CLPCke_n_CAPM_FillPressureControllerIncreaseRateLim "### Description
      This enables sets the target speed increase rate-limit for CAPM pressure control when in filling state
      ### Usage
      Set to maximum increase rate of target speed for pressure controller when in filling state, in rpm per sample (at 5ms)
      ### Calibration Note
      The speed limits have precedence over rate, thus the output can always be limited (towards zero) faster than any rate limit." VALUE 0x0000 /* @ECU_Address@CLPCke_n_CAPM_FillPressureControllerIncreaseRateLim@ */ Scalar_SWORD 0 CM_T_n_rpm_1_1_s16 1.0 32767.0 EXTENDED_LIMITS -32768.0 32767.0 /end CHARACTERISTIC
/begin CHARACTERISTIC CLPCke_n_CAPM_MinSpeedToEnableController "This is the delay for disabling CAPM speed controller, if below CLPCke_Cnt_DelayToDisableSpeedController for more time than specified with with this parameter (in counts of 2.5ms sample time) then the controller will be disabled and output duty-cycle set to 0" VALUE 0x0000 /* @ECU_Address@CLPCke_n_CAPM_MinSpeedToEnableController@ */ Scalar_SWORD 0 CM_T_n_rpm_1_1_s16 0.0 32767 EXTENDED_LIMITS -32768.0 32767.0 /end CHARACTERISTIC
/begin CHARACTERISTIC CLPCke_n_CAPM_PressureControllerDecreaseRateLim "### Description
      This enables sets the target speed decrease rate-limit for CAPM pressure control
      ### Usage
      Set to maximum decrease rate of target speed for pressure controller, in rpm per sample (at 5ms)
      ### Calibration Note
      The speed limits have precedence over rate, thus the output can always be limited (towards zero) faster than any rate limit." VALUE 0x0000 /* @ECU_Address@CLPCke_n_CAPM_PressureControllerDecreaseRateLim@ */ Scalar_SWORD 0 CM_T_n_rpm_1_1_s16 -32768.0 -1.0 EXTENDED_LIMITS -32768.0 32767.0 /end CHARACTERISTIC
/begin CHARACTERISTIC CLPCke_n_CAPM_PressureControllerIncreaseRateLim "### Description
      This enables sets the target speed increase rate-limit for CAPM pressure control
      ### Usage
      Set to maximum increase rate of target speed for pressure controller, in rpm per sample (at 5ms)
      ### Calibration Note
      The speed limits have precedence over rate, thus the output can always be limited (towards zero) faster than any rate limit." VALUE 0x0000 /* @ECU_Address@CLPCke_n_CAPM_PressureControllerIncreaseRateLim@ */ Scalar_SWORD 0 CM_T_n_rpm_1_1_s16 1.0 32767.0 EXTENDED_LIMITS -32768.0 32767.0 /end CHARACTERISTIC
/begin CHARACTERISTIC CLPCke_n_CAPM_PressureControllerMaxSpeed "### Description
      This is the maximum CAPM speed to be used by CAPM pressure controller
      ### Usage
      Set to desired maximum CAPM speed for pressure controller
      ### Calibration Note
      " VALUE 0x0000 /* @ECU_Address@CLPCke_n_CAPM_PressureControllerMaxSpeed@ */ Scalar_SWORD 0 CM_T_n_rpm_1_1_s16 0.0 32767.0 EXTENDED_LIMITS -32768.0 32767.0 /end CHARACTERISTIC
/begin CHARACTERISTIC CLPCke_n_MaxTransInputSpeedForClutchIOCs "### Description
      This sets the maximum transmission input speed (absolute value) for which it's allowed to activate (and keep active) CAP DID IOCs.
      ### Usage
      Set to maximum transmission input speed to allow CAP IOCs.
      ### Calibration Note" VALUE 0x0000 /* @ECU_Address@CLPCke_n_MaxTransInputSpeedForClutchIOCs@ */ Scalar_SWORD 0 CM_T_n_rpm_1_1_s16 0.0 32767.0 EXTENDED_LIMITS -32768.0 32767.0 /end CHARACTERISTIC
/begin CHARACTERISTIC CLPCke_n_PressureControlMinSpeedAboveKisspoint "### Description
      This is a separate mininum speed for CAPM pressure controller when above fill phase and target is above kisspoint
      ### Usage
      Set to desired minimum CAPM pressure controller limit when both actual and target pressure is above kisspoint
      ### Calibration Note
      To limit usage of negative speed to lower pressure when no intention to open clutch
      There is a general minimum speed limit as well, maximum value will be used for limitation" VALUE 0x0000 /* @ECU_Address@CLPCke_n_PressureControlMinSpeedAboveKisspoint@ */ Scalar_SWORD 0 CM_T_n_rpm_1_1_s16 -32768.0 0.0 EXTENDED_LIMITS -32768.0 32767.0 /end CHARACTERISTIC
/begin CHARACTERISTIC CLPCke_n_PressureControlRelativeMaxSpeed "Relative to feed-forward limit
      I.e. the maximum limit for the actual PID-controller
      " VALUE 0x0000 /* @ECU_Address@CLPCke_n_PressureControlRelativeMaxSpeed@ */ Scalar_SWORD 0 CM_T_n_rpm_1_1_s16 0.0 32767.0 EXTENDED_LIMITS -32768.0 32767.0 /end CHARACTERISTIC
/begin CHARACTERISTIC CLPCke_p_ClutchOpenPressureRequest "Pressure request when clutch is requested open, but engine is running (ie pressure is possible). This cal helps pressure controller to settle for temperature dependence etc." VALUE 0x0000 /* @ECU_Address@CLPCke_p_ClutchOpenPressureRequest@ */ Scalar_SWORD 0 CM_T_p_kPa_1_1_s16 -32768.0 200.0 EXTENDED_LIMITS -32768.0 32767.0 /end CHARACTERISTIC
/begin CHARACTERISTIC CLPCke_p_EvenMaxAllowedClutchOilPress "This cal is to protect clutch from being exposed to excessive oil pressures." VALUE 0x0000 /* @ECU_Address@CLPCke_p_EvenMaxAllowedClutchOilPress@ */ Scalar_SWORD 0 CM_T_p_kPa_1_1_s16 0.0 10000.0 EXTENDED_LIMITS -32768.0 32767.0 /end CHARACTERISTIC
/begin CHARACTERISTIC CLPCke_p_KisspointAdaptionTolerance "Adaptionfill, this sets the tolerance for finding kiss-point, when the actual pressure increases above the expected linear pressure buildup by this amount it's assumed that the pressure increase is due to being at kisspoint" VALUE 0x0000 /* @ECU_Address@CLPCke_p_KisspointAdaptionTolerance@ */ Scalar_SWORD 0 CM_T_p_kPa_1_1_s16 0.0 32767 EXTENDED_LIMITS -32768.0 32767.0 /end CHARACTERISTIC
/begin CHARACTERISTIC CLPCke_p_MinPreparePressure "Minimum possible prepare pressure" VALUE 0x0000 /* @ECU_Address@CLPCke_p_MinPreparePressure@ */ Scalar_SWORD 0 CM_T_p_kPa_1_1_s16 0.0 32767 EXTENDED_LIMITS -32768.0 32767.0 /end CHARACTERISTIC
/begin CHARACTERISTIC CLPCke_p_OddMaxAllowedClutchOilPress "This cal is to protect clutch from being exposed to excessive oil pressures." VALUE 0x0000 /* @ECU_Address@CLPCke_p_OddMaxAllowedClutchOilPress@ */ Scalar_SWORD 0 CM_T_p_kPa_1_1_s16 0.0 10000.0 EXTENDED_LIMITS -32768.0 32767.0 /end CHARACTERISTIC
/begin CHARACTERISTIC CLPCke_p_OddMaxAllowedClutchOilPressForIOC "This cal is to protect clutch from being exposed to excessive oil pressures.
      This calibration allows for higher pressure than normal max limit for using CAP IOCs
      " VALUE 0x0000 /* @ECU_Address@CLPCke_p_OddMaxAllowedClutchOilPressForIOC@ */ Scalar_SWORD 0 CM_T_p_kPa_1_1_s16 0.0 10000.0 EXTENDED_LIMITS -32768.0 32767.0 /end CHARACTERISTIC
/begin CHARACTERISTIC CLPCke_p_PreparePressureRelativeToKisspointEven "### Description
      This sets the target prepare pressure relative to kisspoint for Odd clutch, used when torque request is zero.
      ### Usage
      Set to desired offset for target prepare pressure relative to kisspoint for Odd clutch
      ### Calibration Note
      Negative value" VALUE 0x0000 /* @ECU_Address@CLPCke_p_PreparePressureRelativeToKisspointEven@ */ Scalar_SWORD 0 CM_T_p_kPa_1_1_s16 -32768.0 0.0 EXTENDED_LIMITS -32768.0 32767.0 /end CHARACTERISTIC
/begin CHARACTERISTIC CLPCke_p_ToleranceForBeingAtPrepare "This is the tolerance for being at pressure prepare target (i.e. deviation between prepare target and actual not greater than this value), this is used to indicate that the prepare state request is complete" VALUE 0x0000 /* @ECU_Address@CLPCke_p_ToleranceForBeingAtPrepare@ */ Scalar_SWORD 0 CM_T_p_kPa_1_1_s16 0.0 32767 EXTENDED_LIMITS -32768.0 32767.0 /end CHARACTERISTIC
/begin CHARACTERISTIC CLPCke_p_ToleranceForBeingAtTarget "This is the tolerance for being at pressure target (i.e. deviation between target and actual not greater than this value), this is used to indicate that the ingear state request is complete and also if it's possible to estimate current and power to pressure ratio" VALUE 0x0000 /* @ECU_Address@CLPCke_p_ToleranceForBeingAtTarget@ */ Scalar_SWORD 0 CM_T_p_kPa_1_1_s16 0.0 32767 EXTENDED_LIMITS -32768.0 32767.0 /end CHARACTERISTIC
/begin CHARACTERISTIC CLPCka_Cnt_CAPM_PressureTestSequencePhaseDuration "### Description
      This is the duration for each phase (up to 10 phases usable) for target pressure sequence generator for Clutch Actuator Pump Motor
      ### Usage
      Set to desired duration for each phase in counts of periodic sample time (running at 0.005ms, so 200 counts => 1 second)
      ### Calibration Note
      For steps, use 0 or 1 counts.
      
      " VAL_BLK 0x0000 /* @ECU_Address@CLPCka_Cnt_CAPM_PressureTestSequencePhaseDuration@ */ Scalar_UWORD 0 CM_T_Cnt_Num_1_1_u16 0.0 65535.0 NUMBER 100 /end CHARACTERISTIC
/begin CHARACTERISTIC CLPCka_Cnt_CAPM_SpeedTestSequencePhaseDuration "### Description
      This is the duration for each phase (up to 10 phases usable) for target speed sequence generator for Clutch Actuator Pump Motor
      ### Usage
      Set to desired duration for each phase in counts of periodic sample time (running at 0.005ms, so 200 counts => 1 second)
      ### Calibration Note
      For steps, use 0 or 1 counts.
      
      " VAL_BLK 0x0000 /* @ECU_Address@CLPCka_Cnt_CAPM_SpeedTestSequencePhaseDuration@ */ Scalar_UWORD 0 CM_T_Cnt_Num_1_1_u16 0.0 65535.0 NUMBER 100 /end CHARACTERISTIC
/begin CHARACTERISTIC CLPCke_Cnt_AdaptionFillSpeedCond "Condition for adaptionfill (finding kisspoint), when in in active adaptionfill state the for CAP-speed has been close enough of target speed for this amount of samples (@5ms) before starting to find the kisspoint" VALUE 0x0000 /* @ECU_Address@CLPCke_Cnt_AdaptionFillSpeedCond@ */ Scalar_UWORD 0 CM_T_Cnt_Num_1_1_u16 0.0 65535.0 /end CHARACTERISTIC
/begin CHARACTERISTIC CLPCke_Cnt_AtPressureTargetDelayForLoadDetermination "This is the stabilization delay for current and power estimation, the actual pressure needs to have been close enough to target pressure for this amount of time (count of 5ms sample time)" VALUE 0x0000 /* @ECU_Address@CLPCke_Cnt_AtPressureTargetDelayForLoadDetermination@ */ Scalar_UWORD 0 CM_T_Cnt_Num_1_1_u16 0 65535 /end CHARACTERISTIC
/begin CHARACTERISTIC CLPCke_Cnt_CAPM_MaxEnableTimeAfterPressRequest "This specifies the maximum time the pressure controller is allowed to continue to request speed after the requested pressure isn't high enough to enable controller, in counts of sample time (@5ms)" VALUE 0x0000 /* @ECU_Address@CLPCke_Cnt_CAPM_MaxEnableTimeAfterPressRequest@ */ Scalar_UWORD 0 CM_T_Cnt_Num_1_1_u16 0 65535 /end CHARACTERISTIC
/begin CHARACTERISTIC CLPCke_Cnt_DebounceTieUpOccured "This cal states the number of SWU executions for debouncing the tie-up occured this key on decision." VALUE 0x0000 /* @ECU_Address@CLPCke_Cnt_DebounceTieUpOccured@ */ Scalar_UWORD 0 CM_T_Cnt_Num_1_1_u16 0.0 1000.0 EXTENDED_LIMITS 0.0 65535.0 /end CHARACTERISTIC
/begin CHARACTERISTIC CLPCke_Cnt_DelayToDisableSpeedController "This is the minimum target speed to enable the CAPM speed controller, if below this limit, for more time than specified with CLPCke_n_CAPM_MinSpeedToEnableController then the controller will be disabled and output duty-cycle set to 0" VALUE 0x0000 /* @ECU_Address@CLPCke_Cnt_DelayToDisableSpeedController@ */ Scalar_UWORD 0 CM_T_Cnt_Num_1_1_u16 0 65535 /end CHARACTERISTIC
/begin CHARACTERISTIC CLPCke_Cnt_DisableCAP_ClutchOpenReq "This specifies the maximum time that the CAP actuator is enabled after ClutchOpenReq is set, in counts of periodic sample time (@10ms)" VALUE 0x0000 /* @ECU_Address@CLPCke_Cnt_DisableCAP_ClutchOpenReq@ */ Scalar_UWORD 0 CM_T_Cnt_Num_1_1_u16 0 65535 /end CHARACTERISTIC
/begin CHARACTERISTIC CLPCke_Cnt_DisableCAP_ForceClutchOpen "### Description
      This sets the delay after ForceClutchOpen function action is set that the CAP actuator will be disabled.
      The disabling of CAP will be turned off if the delay is set to maximum value (65535)
      ### Usage
      Set to desired delay (in counts of periodic sample time, 10ms) before disabling CAP actuator
      ### Calibration Note
      " VALUE 0x0000 /* @ECU_Address@CLPCke_Cnt_DisableCAP_ForceClutchOpen@ */ Scalar_UWORD 0 CM_T_Cnt_Num_1_1_u16 0 65535 /end CHARACTERISTIC
/begin CHARACTERISTIC CLPCke_Cnt_FillCompensationAfterFill "This specifies the maximum time to allow fill compensation after pressure controller state has switched from Fill" VALUE 0x0000 /* @ECU_Address@CLPCke_Cnt_FillCompensationAfterFill@ */ Scalar_UWORD 0 CM_T_Cnt_Num_1_1_u16 0 65535 /end CHARACTERISTIC
/begin CHARACTERISTIC CLPCke_Cnt_FrictionSurfacesEven "Number of friction surfaces for clutch (not discs/linings!)." VALUE 0x0000 /* @ECU_Address@CLPCke_Cnt_FrictionSurfacesEven@ */ Scalar_UWORD 0 CM_T_Cnt_Num_1_1_u16 1.0 50.0 EXTENDED_LIMITS 0.0 65535.0 /end CHARACTERISTIC
/begin CHARACTERISTIC CLPCke_Cnt_FrictionSurfacesOdd "Number of friction surfaces for clutch (not discs/linings!)." VALUE 0x0000 /* @ECU_Address@CLPCke_Cnt_FrictionSurfacesOdd@ */ Scalar_UWORD 0 CM_T_Cnt_Num_1_1_u16 1.0 50.0 EXTENDED_LIMITS 0.0 65535.0 /end CHARACTERISTIC
/begin CHARACTERISTIC CLPCke_Cnt_KisspointAdaptionSamplesBetweenPoints "Adaptionfill, this sets how often the algorithm shall set points used for linear approximation of pressure buildup" VALUE 0x0000 /* @ECU_Address@CLPCke_Cnt_KisspointAdaptionSamplesBetweenPoints@ */ Scalar_UWORD 0 CM_T_Cnt_Num_1_1_u16 1.0 65535 EXTENDED_LIMITS 0.0 65535.0 /end CHARACTERISTIC
/begin CHARACTERISTIC CLPCke_Cnt_MaxKissPointAdaptionFill "Maximum time allowed to be in kisspoint adaption state, when timeout it will fall back to normal fill" VALUE 0x0000 /* @ECU_Address@CLPCke_Cnt_MaxKissPointAdaptionFill@ */ Scalar_UWORD 0 CM_T_Cnt_Num_1_1_u16 0.0 65535.0 /end CHARACTERISTIC
/begin CHARACTERISTIC CLPCke_Cnt_MinDiff_FillPartCompensation "This is a delay for disabling the fill-compensation due to the difference for fill target
      Set to desired delay, in counts of 5ms sample time
      
      Difference is calibrated with CLPCke_p_MinDiff_FillPartCompensation
      " VALUE 0x0000 /* @ECU_Address@CLPCke_Cnt_MinDiff_FillPartCompensation@ */ Scalar_UWORD 0 CM_T_Cnt_Num_1_1_u16 0 65535 /end CHARACTERISTIC
/begin CHARACTERISTIC CLPCke_Cnt_NoOfAdaptionsEstimationsUntilFirstDone "Adaptionfill, number of sucessfully found kisspoint until storing adaptionvalue the first time" VALUE 0x0000 /* @ECU_Address@CLPCke_Cnt_NoOfAdaptionsEstimationsUntilFirstDone@ */ Scalar_UWORD 0 CM_T_Cnt_Num_1_1_u16 0 65535 /end CHARACTERISTIC
/begin CHARACTERISTIC CLPCke_Cnt_StablePressureDelay "This is the stabilization delay for stable pressure for current and power estimation, the actual pressure needs to be kept steady (not deviate more than CLPCke_p_StablePressureTolerance) for this amount of time (count of 5ms sample time)" VALUE 0x0000 /* @ECU_Address@CLPCke_Cnt_StablePressureDelay@ */ Scalar_UWORD 0 CM_T_Cnt_Num_1_1_u16 0 65535 /end CHARACTERISTIC
/begin CHARACTERISTIC CLPCie_p_CAPM_TargetPressure "### Description
      This is the target pressure for CAPM pressure controller when using manual override
      ### Usage
      Set to target pressure for CAPM pressure controller
      ### Calibration Note
      This value will only be acknowledged when CAPM pressure control is enabled and CAPM pressure test-sequence is not enabled
      " VALUE 0x0000 /* @ECU_Address@CLPCie_p_CAPM_TargetPressure@ */ Scalar_UWORD 0 CM_T_p_kPa_32_1_u16 0.0 2000.0 EXTENDED_LIMITS 0.0 2047.96875 /end CHARACTERISTIC
/begin CHARACTERISTIC CLPCke_p_CAPM_ActualPressureToEnableController "### Description
      This is the actual pressure to toggle pressure controller on/off
      ### Usage
      Set to desired actual pressure limit for keeping pressure controller active, if higher than pressure controller is enabled.
      ### Calibration Note
      Pressure controller will be enabled if target pressure or actual is above their respective limit" VALUE 0x0000 /* @ECU_Address@CLPCke_p_CAPM_ActualPressureToEnableController@ */ Scalar_UWORD 0 CM_T_p_kPa_32_1_u16 0.0 2047.96875 /end CHARACTERISTIC
/begin CHARACTERISTIC CLPCke_p_CAPM_TargetPressureToEnableController "### Description
      This is the target pressure to toggle pressure controller on/off
      ### Usage
      Set to desired target pressure limit for keeping pressure controller active, if higher than pressure controller is enabled.
      ### Calibration Note
      Pressure controller will be enabled if target pressure or actual is above their respective limit" VALUE 0x0000 /* @ECU_Address@CLPCke_p_CAPM_TargetPressureToEnableController@ */ Scalar_UWORD 0 CM_T_p_kPa_32_1_u16 0.0 2047.96875 /end CHARACTERISTIC
/begin CHARACTERISTIC CLPCke_p_FillTargetAbovePressureKneePoint "This calibration allowes the fillcompensation to use a higher target than the pressure knee point pressure.
      Note: The fill target will still be limited by the pressure target
      
      " VALUE 0x0000 /* @ECU_Address@CLPCke_p_FillTargetAbovePressureKneePoint@ */ Scalar_UWORD 0 CM_T_p_kPa_32_1_u16 0.0 2047.96875 /end CHARACTERISTIC
/begin CHARACTERISTIC CLPCke_p_KisspointLowerAdaptionLimit "Minimum adaption limit for kisspoint" VALUE 0x0000 /* @ECU_Address@CLPCke_p_KisspointLowerAdaptionLimit@ */ Scalar_UWORD 0 CM_T_p_kPa_32_1_u16 50.0 170.0 EXTENDED_LIMITS 0.0 2047.96875 /end CHARACTERISTIC
/begin CHARACTERISTIC CLPCke_p_KisspointUpperAdaptionLimit "Maximum adaption limit for kisspoint" VALUE 0x0000 /* @ECU_Address@CLPCke_p_KisspointUpperAdaptionLimit@ */ Scalar_UWORD 0 CM_T_p_kPa_32_1_u16 170.0 320.0 EXTENDED_LIMITS 0.0 2047.96875 /end CHARACTERISTIC
/begin CHARACTERISTIC CLPCke_p_MinDiff_FillIPartEnable "This is the difference to fill target for reactivation of the normal I-part of the fill PID_controller can enabled
      When the difference is below this limit, the I-part can be enabled" VALUE 0x0000 /* @ECU_Address@CLPCke_p_MinDiff_FillIPartEnable@ */ Scalar_UWORD 0 CM_T_p_kPa_32_1_u16 0 2047.96875 /end CHARACTERISTIC
/begin CHARACTERISTIC CLPCke_p_MinDiff_FillPartCompensation "This is the difference to fill target for disabling the fill-compensation
      When the difference is below this limit, the fill-compensation will be disabled" VALUE 0x0000 /* @ECU_Address@CLPCke_p_MinDiff_FillPartCompensation@ */ Scalar_UWORD 0 CM_T_p_kPa_32_1_u16 0.0 2047.96875 /end CHARACTERISTIC
/begin CHARACTERISTIC CLPCke_p_MinPressureForLoadEstimation "This is the minimum clutch pressure to enable current and power to pressure estimations" VALUE 0x0000 /* @ECU_Address@CLPCke_p_MinPressureForLoadEstimation@ */ Scalar_UWORD 0 CM_T_p_kPa_32_1_u16 0 2047.96875 /end CHARACTERISTIC
/begin CHARACTERISTIC CLPCke_p_PressureKneePointAdaptionMargin "### Description
      This is the minimum margin needed for triggering adaption of pressure kneepoint (difference between last kneepoint and actual pressure), if the difference is less than this the adaption of pressure kneepoint won't be activated
      ### Usage
      Set to desired minimum margin for triggering adaption of pressure knee-point
      ### Calibration Note
      " VALUE 0x0000 /* @ECU_Address@CLPCke_p_PressureKneePointAdaptionMargin@ */ Scalar_UWORD 0 CM_T_p_kPa_32_1_u16 0 2047.96875 /end CHARACTERISTIC
/begin CHARACTERISTIC CLPCke_p_StablePressureTolerance "This is the stabilization tolearance for stable pressure for current and power estimation, the actual pressure needs to be kept steady (not deviate more than this tolerance) for the time specified with CLPCke_Cnt_StablePressureDelay" VALUE 0x0000 /* @ECU_Address@CLPCke_p_StablePressureTolerance@ */ Scalar_UWORD 0 CM_T_p_kPa_32_1_u16 0 2047.96875 /end CHARACTERISTIC
/begin CHARACTERISTIC CLPCke_T_MaxOilTempForKisspointAdaption "Maximum oil pressure for kisspoint adaption using adpationfill" VALUE 0x0000 /* @ECU_Address@CLPCke_T_MaxOilTempForKisspointAdaption@ */ Scalar_SWORD 0 CM_T_T_degC_16_1_s16 -2048.0 2047.0 EXTENDED_LIMITS -2048.0 2047.9375 /end CHARACTERISTIC
/begin CHARACTERISTIC CLPCke_T_MinOilTempForKisspointAdaption "Minimum oil pressure for kisspoint adaption using adpationfill" VALUE 0x0000 /* @ECU_Address@CLPCke_T_MinOilTempForKisspointAdaption@ */ Scalar_SWORD 0 CM_T_T_degC_16_1_s16 -2048.0 2047.0 EXTENDED_LIMITS -2048.0 2047.9375 /end CHARACTERISTIC
/begin CHARACTERISTIC CLPCke_I_CAPM_MaxCurrent "This is the maximum current for CAPM, phase current PWM On-part
      This is used to estimate the maximum pressure and maximum/available torque, no other limitation of current is made other than lowering the available estimated torque capacity" VALUE 0x0000 /* @ECU_Address@CLPCke_I_CAPM_MaxCurrent@ */ Scalar_SWORD 0 CM_T_I_A_32_1_s16 0.0 1023.96875 EXTENDED_LIMITS -1024.0 1023.96875 /end CHARACTERISTIC
/begin CHARACTERISTIC CLPCke_M_MinReqForAdaptionFill "Adaptionfill, minimum torque target to enable adaptionfill (i.e. this torque needs to be requested from an unfilled state)" VALUE 0x0000 /* @ECU_Address@CLPCke_M_MinReqForAdaptionFill@ */ Scalar_SWORD 0 CM_T_M_Nm_32_1_s16 0.0 1023.96875 EXTENDED_LIMITS -1024.0 1023.96875 /end CHARACTERISTIC
/begin CHARACTERISTIC CLPCke_U_CAPM_NominalVoltage "### Description
      This is the nominal voltage for CAPM BLDC
      ### Usage
      Set to estimated voltage for CAPM BLDC
      ### Calibration Note
      Untestet!
      This is used for the CAPM speed control, to feed-forward the estimated power needed to maintain target speed
      To calculate the feed-forward DC, the CAPM BLDC voltage is used to estimate the nominal max power" VALUE 0x0000 /* @ECU_Address@CLPCke_U_CAPM_NominalVoltage@ */ Scalar_SWORD 0 CM_T_U_V_512_1_s16 0.0 60.0 EXTENDED_LIMITS -64.0 63.998046875 /end CHARACTERISTIC
/begin CHARACTERISTIC CLPCke_U_MinMotorSupplyVoltage "Minimum power stage supply voltage to be used for BLDC voltage compensation
      If measured voltage is below this value the voltage compensation saturates at this value" VALUE 0x0000 /* @ECU_Address@CLPCke_U_MinMotorSupplyVoltage@ */ Scalar_SWORD 0 CM_T_U_V_512_1_s16 5.0 63.998046875 EXTENDED_LIMITS -64.0 63.998046875 /end CHARACTERISTIC
/begin CHARACTERISTIC CLPCke_p_KisspointMaxNegAdjustmentLimit "Maximum adjustment of kisspoint for lowering pressure" VALUE 0x0000 /* @ECU_Address@CLPCke_p_KisspointMaxNegAdjustmentLimit@ */ Scalar_SWORD 0 CM_T_p_kPa_64_1_s16 -512.0 -0.015625 EXTENDED_LIMITS -512.0 511.984375 /end CHARACTERISTIC
/begin CHARACTERISTIC CLPCke_p_KisspointMaxPosAdjustmentLimit "Maximum adjustment of kisspoint for increasing pressure" VALUE 0x0000 /* @ECU_Address@CLPCke_p_KisspointMaxPosAdjustmentLimit@ */ Scalar_SWORD 0 CM_T_p_kPa_64_1_s16 0.015625 511.984375 EXTENDED_LIMITS -512.0 511.984375 /end CHARACTERISTIC
/begin CHARACTERISTIC CLPCke_p_KneePointOffsetFromKisspoint "### Description
      If not using \"found\" pressure knee point, then this is the offset from \"static\" (not compensated for clutch balancing) kisspoint
      ### Usage
      Set to desired offset between kisspoint and pressure kneepoint
      ### Calibration Note" VALUE 0x0000 /* @ECU_Address@CLPCke_p_KneePointOffsetFromKisspoint@ */ Scalar_SWORD 0 CM_T_p_kPa_64_1_s16 -512.0 511.984375 /end CHARACTERISTIC
/begin CHARACTERISTIC CLPCke_v_MaxVehicleSpeedForClutchIOCs "### Description
      This sets the maximum vehicle speed (absolute value) for which it's allowed to activate (and keep active) CAP DID IOCs.
      ### Usage
      Set to maximum vehicle speed to allow CAP IOCs.
      ### Calibration Note" VALUE 0x0000 /* @ECU_Address@CLPCke_v_MaxVehicleSpeedForClutchIOCs@ */ Scalar_SWORD 0 CM_T_v_kph_64_1_s16 0.0 511.984375 EXTENDED_LIMITS -512.0 511.984375 /end CHARACTERISTIC
/begin CHARACTERISTIC CLPCke_Pct_CAPM_DC "### Description
      This is the set value for output DC for CAPM BLDC
      ### Usage
      Set to desired DC command for CAPM BLDC
      ### Calibration Note
      This needs CAPM speed controller to be turned off to be used" VALUE 0x0000 /* @ECU_Address@CLPCke_Pct_CAPM_DC@ */ Scalar_SWORD 0 CM_T_Pct_pct_10_1_s16 -100.0 100.0 EXTENDED_LIMITS -3276.8 3276.7000000000003 /end CHARACTERISTIC
/begin CHARACTERISTIC CLPCke_Pct_CAPM_RateLimitDecrease "### Description
      This is the Decrease rate-limit for output duty-cycle for CAPM BLDC
      ### Usage
      Set to desired DC rate-limitation in Pct duty-cycle Decrease per sample (running at 2.5ms)
      ### Calibration Note
      Set as fast as possible, since speed controller doesn't expect/considers this rate limitation
      Negative Value!
      " VALUE 0x0000 /* @ECU_Address@CLPCke_Pct_CAPM_RateLimitDecrease@ */ Scalar_SWORD 0 CM_T_Pct_pct_10_1_s16 -3276.8 -0.1 EXTENDED_LIMITS -3276.8 3276.7000000000003 /end CHARACTERISTIC
/begin CHARACTERISTIC CLPCke_Pct_CAPM_RateLimitIncrease "### Description
      This is the Increase rate-limit for output duty-cycle for CAPM BLDC
      ### Usage
      Set to desired DC rate-limitation in Pct duty-cycle Increase per sample (running at 2.5ms)
      ### Calibration Note
      Set as fast as possible, since speed controller doesn't expect/considers this rate limitation
      
      " VALUE 0x0000 /* @ECU_Address@CLPCke_Pct_CAPM_RateLimitIncrease@ */ Scalar_SWORD 0 CM_T_Pct_pct_10_1_s16 0.1 3276.7 EXTENDED_LIMITS -3276.8 3276.7000000000003 /end CHARACTERISTIC
/begin CHARACTERISTIC CLPCke_Pct_CAPM_SpeedControl_DC_Max "### Description
      This is calibration for possibility to limit maximum output DC for CAPM BLDC Speed controller
      ### Usage
      Set to desired max duty cycle for CAPM BLDC
      ### Calibration Note
      Seems as maximum duty-cycle supprted by BLDC is 97.4
      " VALUE 0x0000 /* @ECU_Address@CLPCke_Pct_CAPM_SpeedControl_DC_Max@ */ Scalar_SWORD 0 CM_T_Pct_pct_10_1_s16 0.0 100.0 EXTENDED_LIMITS -3276.8 3276.7000000000003 /end CHARACTERISTIC
/begin CHARACTERISTIC CLPCke_Pct_CAPM_SpeedControl_DC_Min "### Description
      This is calibration for possibility to limit minimum output DC for CAPM BLDC Speed controller
      ### Usage
      Set to desired min duty cycle for CAPM BLDC
      ### Calibration Note
      Seems as maximum duty-cycle supprted by BLDC is 97.4
      Negative value
      " VALUE 0x0000 /* @ECU_Address@CLPCke_Pct_CAPM_SpeedControl_DC_Min@ */ Scalar_SWORD 0 CM_T_Pct_pct_10_1_s16 -100.0 0.0 EXTENDED_LIMITS -3276.8 3276.7000000000003 /end CHARACTERISTIC
/begin CHARACTERISTIC CLPCie_Cf_PressureToTorqueEven_OV "Override value." VALUE 0x0000 /* @ECU_Address@CLPCie_Cf_PressureToTorqueEven_OV@ */ Scalar_UWORD 0 CM_T_K_NA_32768_1_u16 0.0 1.0 EXTENDED_LIMITS 0.0 1.999969482421875 /end CHARACTERISTIC
/begin CHARACTERISTIC CLPCie_Cf_PressureToTorqueOdd_OV "Override value." VALUE 0x0000 /* @ECU_Address@CLPCie_Cf_PressureToTorqueOdd_OV@ */ Scalar_UWORD 0 CM_T_K_NA_32768_1_u16 0.0 1.0 EXTENDED_LIMITS 0.0 1.999969482421875 /end CHARACTERISTIC
/begin CHARACTERISTIC CLPCke_p_TransferGainLowerAdaptionLimit "Min slope for transfer gain, pressure (kPa) to torque (Nm) " VALUE 0x0000 /* @ECU_Address@CLPCke_p_TransferGainLowerAdaptionLimit@ */ Scalar_UWORD 0 CM_T_K_NA_32768_1_u16 3.0517578125E-5 1.999969482421875 EXTENDED_LIMITS 0.0 1.999969482421875 /end CHARACTERISTIC
/begin CHARACTERISTIC CLPCke_p_TransferGainUpperAdaptionLimit "Max slope for transfer gain, pressure (kPa) to torque (Nm) " VALUE 0x0000 /* @ECU_Address@CLPCke_p_TransferGainUpperAdaptionLimit@ */ Scalar_UWORD 0 CM_T_K_NA_32768_1_u16 0 1.999969482421875 /end CHARACTERISTIC
/begin CHARACTERISTIC CLPCke_r_CAPM_SpeedControlD_Part "### Description
      This is the CAPM speed control D-part
      ### Usage
      Set to desired CAPM speed control D-part
      ### Calibration Note" VALUE 0x0000 /* @ECU_Address@CLPCke_r_CAPM_SpeedControlD_Part@ */ Scalar_UWORD 0 CM_T_K_NA_32768_1_u16 0.0 1.99 EXTENDED_LIMITS 0.0 1.999969482421875 /end CHARACTERISTIC
/begin CHARACTERISTIC CLPCke_r_CAPM_SpeedControlI_Part "### Description
      This is the CAPM speed control I-part
      ### Usage
      Set to desired CAPM speed control I-part
      ### Calibration Note" VALUE 0x0000 /* @ECU_Address@CLPCke_r_CAPM_SpeedControlI_Part@ */ Scalar_UWORD 0 CM_T_K_NA_32768_1_u16 0.0 1.99 EXTENDED_LIMITS 0.0 1.999969482421875 /end CHARACTERISTIC
/begin CHARACTERISTIC CLPCke_r_CAPM_SpeedControlP_Part "### Description
      This is the CAPM speed control P-part
      ### Usage
      Set to desired CAPM speed control P-part
      ### Calibration Note" VALUE 0x0000 /* @ECU_Address@CLPCke_r_CAPM_SpeedControlP_Part@ */ Scalar_UWORD 0 CM_T_K_NA_32768_1_u16 0.0 1.99 EXTENDED_LIMITS 0.0 1.999969482421875 /end CHARACTERISTIC
/begin CHARACTERISTIC CLPCke_r_CAPM_SpeedControl_PowerBasedFeedForward "### Description
      This ratio of feed-forward to use of estimated power to maintain target CAPM speed
      ### Usage
      Set to estimated ratio, typically 0-1 for how much power based feed-forward to use
      ### Calibration Note
      Untestet!
      " VALUE 0x0000 /* @ECU_Address@CLPCke_r_CAPM_SpeedControl_PowerBasedFeedForward@ */ Scalar_UWORD 0 CM_T_K_NA_32768_1_u16 0.0 1.99 EXTENDED_LIMITS 0.0 1.999969482421875 /end CHARACTERISTIC
/begin CHARACTERISTIC CLPCke_r_CAP_Efficiency "### Description
      This is the estimated CAPM hydromechanical efficiency
      ### Usage
      Set to estimated CAPM hydromechanical efficiency
      ### Calibration Note
      This is used by the CAPM speed controller feed forward due to clutch pressure" VALUE 0x0000 /* @ECU_Address@CLPCke_r_CAP_Efficiency@ */ Scalar_UWORD 0 CM_T_r_NA_32768_1_u16 0.0 1.0 EXTENDED_LIMITS 0.0 1.999969482421875 /end CHARACTERISTIC
/begin CHARACTERISTIC CLPCke_r_CAP_LatchTooCloseToOverCurrent "### Description
      This is the ratio for setting and latching indication that CAPM BLDC is close to overcurrent
      ### Usage
      Set to desired ratio for indicating CAPM BLDC too close to overcurrent, will set latching when CLPCve_r_CAP_Y is greater than or equal to this value
      ### Calibration Note
      This value is compared to CLPCve_r_CAP_Y, when this exceeds 1 the CAPM powerstage will be turned off by BSW
      The indication is released when CLPCve_r_CAP_Y is equal or less than CLPCke_r_CAP_ReleaseTooCloseToOverCurrent
      The too close to overcurrent indication needs to be enabled with CLPCke_CAP_EnableTooCloseToOverCurrent" VALUE 0x0000 /* @ECU_Address@CLPCke_r_CAP_LatchTooCloseToOverCurrent@ */ Scalar_UWORD 0 CM_T_r_NA_32768_1_u16 0.0 1.0 EXTENDED_LIMITS 0.0 1.999969482421875 /end CHARACTERISTIC
/begin CHARACTERISTIC CLPCke_r_CAP_ReleaseTooCloseToOverCurrent "### Description
      This is the ratio for releasing indication that CAPM BLDC is close to overcurrent
      ### Usage
      Set to desired ratio for releasing CAPM BLDC too close to overcurrent, will release latching when CLPCve_r_CAP_Y is equal to or less than this value
      ### Calibration Note
      This value is compared to CLPCve_r_CAP_Y, when this exceeds 1 the CAPM powerstage will be turned off by BSW
      The indication is set and latched when CLPCve_r_CAP_Y is greater than or equal to CLPCke_r_CAP_LatchTooCloseToOverCurrent
      The too close to overcurrent indication needs to be enabled with CLPCke_CAP_EnableTooCloseToOverCurrent" VALUE 0x0000 /* @ECU_Address@CLPCke_r_CAP_ReleaseTooCloseToOverCurrent@ */ Scalar_UWORD 0 CM_T_r_NA_32768_1_u16 0.0 1.0 EXTENDED_LIMITS 0.0 1.999969482421875 /end CHARACTERISTIC
/begin CHARACTERISTIC CLPCke_r_CAP_Y_OverCurrentMargin "### Description
      This is the margin for CAP overcurrent filter load value Y, used to prevent CAP Phase Overcurrent.
      The speed limit will be reduced when the margin (relative to 1) is smaller than this value
      ### Usage
      Set to desired minimum margin for filtered load current before target speed is reduced
      ### Calibration Note
      " VALUE 0x0000 /* @ECU_Address@CLPCke_r_CAP_Y_OverCurrentMargin@ */ Scalar_UWORD 0 CM_T_r_NA_32768_1_u16 0.0 0.7 EXTENDED_LIMITS 0.0 1.999969482421875 /end CHARACTERISTIC
/begin CHARACTERISTIC CLPCke_r_NA_NewAdaptionAdjustementFactor "Adjustmentfactor, ratio of the difference between old stored kisspoint and newly found kisspoint that shall be used for adjustement of new kisspoint" VALUE 0x0000 /* @ECU_Address@CLPCke_r_NA_NewAdaptionAdjustementFactor@ */ Scalar_UWORD 0 CM_T_r_NA_32768_1_u16 0.0 1.0 EXTENDED_LIMITS 0.0 1.999969482421875 /end CHARACTERISTIC
/begin CHARACTERISTIC CLPCie_r_EvenClutchPresReqInternal_Scaling "Scaling for throughput of nominal functionality.
      Shall be set to 1 for production intent SW
      
      " VALUE 0x0000 /* @ECU_Address@CLPCie_r_EvenClutchPresReqInternal_Scaling@ */ Scalar_SWORD 0 CM_T_r_NA_1024_1_s16 -5.0 5.0 EXTENDED_LIMITS -32.0 31.9990234375 /end CHARACTERISTIC
/begin CHARACTERISTIC CLPCie_r_OddClutchPresReqInternal_Scaling "Scaling for throughput of nominal functionality.
      Shall be set to 1 for production intent SW
      " VALUE 0x0000 /* @ECU_Address@CLPCie_r_OddClutchPresReqInternal_Scaling@ */ Scalar_SWORD 0 CM_T_r_NA_1024_1_s16 -5.0 5.0 EXTENDED_LIMITS -32.0 31.9990234375 /end CHARACTERISTIC
/begin CHARACTERISTIC CLPCke_R_CAPM_InternalResistance "### Description
      This is the estimated internal resistance in the CAPM BLDC
      ### Usage
      Set to estimated internal resistance for CAPM BLDC
      ### Calibration Note
      This is used by the CAPM speed controller feed forward due to clutch pressure" VALUE 0x0000 /* @ECU_Address@CLPCke_R_CAPM_InternalResistance@ */ Scalar_SWORD 0 CM_T_R_ohm_1024_1_s16 0.0009765625 31.875 EXTENDED_LIMITS -32.0 31.9990234375 /end CHARACTERISTIC
/begin CHARACTERISTIC CLPCke_l_ClutchNetRadiusEven "Clutch Net Radius.
      
      NR=(R^3-r^3)/(R^2-r^2)*2/3
      
      Where:
      R = Clutch outer radius (contact surface)
      r = Clutch inner radius (contact surface)
      
      " VALUE 0x0000 /* @ECU_Address@CLPCke_l_ClutchNetRadiusEven@ */ Scalar_SWORD 0 CM_T_l_m_1024_1_s16 0.0 1.0 EXTENDED_LIMITS -32.0 31.9990234375 /end CHARACTERISTIC
/begin CHARACTERISTIC CLPCke_l_ClutchNetRadiusOdd "Clutch Net Radius.
      
      NR=(R^3-r^3)/(R^2-r^2)*2/3
      
      Where:
      R = Clutch outer radius (contact surface)
      r = Clutch inner radius (contact surface)
      
      
      " VALUE 0x0000 /* @ECU_Address@CLPCke_l_ClutchNetRadiusOdd@ */ Scalar_SWORD 0 CM_T_l_m_1024_1_s16 0.0 1.0 EXTENDED_LIMITS -32.0 31.9990234375 /end CHARACTERISTIC
/begin CHARACTERISTIC CLPCke_A_AppPistonEven "Area of Apply piston." VALUE 0x0000 /* @ECU_Address@CLPCke_A_AppPistonEven@ */ Scalar_UWORD 0 CM_T_A_m2_65536_1_u16 0.0 0.9 EXTENDED_LIMITS 0.0 0.9999847412109375 /end CHARACTERISTIC
/begin CHARACTERISTIC CLPCke_A_AppPistonOdd "Area of Apply piston." VALUE 0x0000 /* @ECU_Address@CLPCke_A_AppPistonOdd@ */ Scalar_UWORD 0 CM_T_A_m2_65536_1_u16 0.0 0.9 EXTENDED_LIMITS 0.0 0.9999847412109375 /end CHARACTERISTIC
/begin CHARACTERISTIC CLPCke_r_CAPM_FillPressureControlD_Part "### Description
      This is the CAPM fill pressure control D-part
      ### Usage
      Set to desired CAPM pressure control D-part when in filling state
      ### Calibration Note
      " VALUE 0x0000 /* @ECU_Address@CLPCke_r_CAPM_FillPressureControlD_Part@ */ Scalar_UWORD 0 CM_T_K_NA_1024_1_u16 0.0 63.9990234375 /end CHARACTERISTIC
/begin CHARACTERISTIC CLPCke_r_CAPM_FillPressureControlI_Part "### Description
      This is the CAPM fill pressure control I-part
      ### Usage
      Set to desired CAPM pressure control I-part when in filling state
      ### Calibration Note
      
      " VALUE 0x0000 /* @ECU_Address@CLPCke_r_CAPM_FillPressureControlI_Part@ */ Scalar_UWORD 0 CM_T_K_NA_1024_1_u16 0.0 63.9990234375 /end CHARACTERISTIC
/begin CHARACTERISTIC CLPCke_r_CAPM_PressureControlD_Part "### Description
      This is the CAPM pressure control D-part
      ### Usage
      Set to desired CAPM pressure control D-part
      ### Calibration Note
      " VALUE 0x0000 /* @ECU_Address@CLPCke_r_CAPM_PressureControlD_Part@ */ Scalar_UWORD 0 CM_T_K_NA_1024_1_u16 0.0 63.9990234375 /end CHARACTERISTIC
/begin CHARACTERISTIC CLPCke_r_CAPM_PressureControlI_Part "### Description
      This is the CAPM pressure control I-part
      ### Usage
      Set to desired CAPM pressure control I-part
      ### Calibration Note
      " VALUE 0x0000 /* @ECU_Address@CLPCke_r_CAPM_PressureControlI_Part@ */ Scalar_UWORD 0 CM_T_K_NA_1024_1_u16 0.0 63.9990234375 /end CHARACTERISTIC
/begin CHARACTERISTIC CLPCke_r_StaticToKineticFrictionRatio "The ratio between clutch static friction and kinetic friction (us/uk). Since static friction is normally larger than its kinetic counterpart, this cal should exceed 1." VALUE 0x0000 /* @ECU_Address@CLPCke_r_StaticToKineticFrictionRatio@ */ Scalar_UWORD 0 CM_T_r_NA_1024_1_u16 1.0 1.5 EXTENDED_LIMITS 0.0 63.9990234375 /end CHARACTERISTIC
/begin CHARACTERISTIC CLPCke_K_PressureFiltInvertedTimeConstant "The inverted time constant for low pass filtering of Clutch Pressure
      I.e. a time constant of 0.05s should be calibrated with value 20.
      
      
      " VALUE 0x0000 /* @ECU_Address@CLPCke_K_PressureFiltInvertedTimeConstant@ */ Scalar_UWORD 0 CM_T_K_NA_128_1_u16 0.0 200.0 EXTENDED_LIMITS 0.0 511.9921875 /end CHARACTERISTIC
/begin CHARACTERISTIC CLPCke_r_CAPM_FillPressureControlP_Part "### Description
      This is the CAPM fill pressure control P-part
      ### Usage
      Set to desired CAPM pressure control P-part in filling state
      ### Calibration Note
      
      
      " VALUE 0x0000 /* @ECU_Address@CLPCke_r_CAPM_FillPressureControlP_Part@ */ Scalar_UWORD 0 CM_T_K_NA_128_1_u16 0.0 511.0 EXTENDED_LIMITS 0.0 511.9921875 /end CHARACTERISTIC
/begin CHARACTERISTIC CLPCke_r_CAPM_PressureControlP_Part "### Description
      This is the CAPM pressure control P-part
      ### Usage
      Set to desired CAPM pressure control P-part
      ### Calibration Note
      
      
      " VALUE 0x0000 /* @ECU_Address@CLPCke_r_CAPM_PressureControlP_Part@ */ Scalar_UWORD 0 CM_T_K_NA_128_1_u16 0.0 511.0 EXTENDED_LIMITS 0.0 511.9921875 /end CHARACTERISTIC
/begin CHARACTERISTIC CLPCke_V_CAP_Displacement "### Description
      This is the displacement of the Clutch Actuator Pump
      ### Usage
      Set to ideal volymetric displacment in ml per revolution
      ### Calibration Note" VALUE 0x0000 /* @ECU_Address@CLPCke_V_CAP_Displacement@ */ Scalar_SWORD 0 CM_T_V_ml_128_1_s16 0.0 255.991875 EXTENDED_LIMITS -256.0 255.9921875 /end CHARACTERISTIC
/begin CHARACTERISTIC CLPCke_Cnt_CAPM_PressureTestSequenceNumberOfPhases "### Description
      This is the desired amount of phases to use for target pressure sequence generator for Clutch Actuator Pump Motor
      ### Usage
      Set to desired amount of phases to use before restarting the sequence
      ### Calibration Note
      Set to a number from 1-100
      " VALUE 0x0000 /* @ECU_Address@CLPCke_Cnt_CAPM_PressureTestSequenceNumberOfPhases@ */ Scalar_UBYTE 0 CM_T_Cnt_Num_1_1_u8 1.0 100.0 EXTENDED_LIMITS 0.0 255.0 /end CHARACTERISTIC
/begin CHARACTERISTIC CLPCke_Cnt_CAPM_SpeedTestSequenceNumberOfPhases "### Description
      This is the desired amount of phases to use for target speed sequence generator for Clutch Actuator Pump Motor
      ### Usage
      Set to desired amount of phases to use before restarting the sequence
      ### Calibration Note
      Set to a number from 1-100
      " VALUE 0x0000 /* @ECU_Address@CLPCke_Cnt_CAPM_SpeedTestSequenceNumberOfPhases@ */ Scalar_UBYTE 0 CM_T_Cnt_Num_1_1_u8 1.0 100.0 EXTENDED_LIMITS 0.0 255.0 /end CHARACTERISTIC
/begin CHARACTERISTIC CLPCie_Cf_PressureToTorqueEven_OB "Bool for activating override." VALUE 0x0000 /* @ECU_Address@CLPCie_Cf_PressureToTorqueEven_OB@ */ Scalar_BOOLEAN 0 CM_T_BOOLEAN 0.0 1.0 /end CHARACTERISTIC
/begin CHARACTERISTIC CLPCie_Cf_PressureToTorqueOdd_OB "Bool for activating override." VALUE 0x0000 /* @ECU_Address@CLPCie_Cf_PressureToTorqueOdd_OB@ */ Scalar_BOOLEAN 0 CM_T_BOOLEAN 0.0 1.0 /end CHARACTERISTIC
/begin CHARACTERISTIC CLPCie_p_EvenClutchPresReq_OB "Bool for activating override." VALUE 0x0000 /* @ECU_Address@CLPCie_p_EvenClutchPresReq_OB@ */ Scalar_BOOLEAN 0 CM_T_BOOLEAN 0.0 1.0 /end CHARACTERISTIC
/begin CHARACTERISTIC CLPCie_p_OddClutchPresReq_OB "Bool for activating override." VALUE 0x0000 /* @ECU_Address@CLPCie_p_OddClutchPresReq_OB@ */ Scalar_BOOLEAN 0 CM_T_BOOLEAN 0.0 1.0 /end CHARACTERISTIC
/begin CHARACTERISTIC CLPCke_b_CAPM_ChangeBLDC_Direction "### Description
      This enables changes which direction of CAPM BLDC is used to build up clutch pressure (by changing sign on the pressure-controller speed target)
      ### Usage
      Set to true if CAPM BLDC direction shall be changed
      ### Calibration Note
      " VALUE 0x0000 /* @ECU_Address@CLPCke_b_CAPM_ChangeBLDC_Direction@ */ Scalar_BOOLEAN 0 CM_T_BOOLEAN 0.0 1.0 /end CHARACTERISTIC
/begin CHARACTERISTIC CLPCke_b_CAPM_EnablePressureControl "### Description
      This enables CAPM pressure control
      ### Usage
      Set to true if pressure control shall be enabled
      ### Calibration Note
      For CAPM pressure control to be acknowleged, CAPM speed control also needs to be enabled" VALUE 0x0000 /* @ECU_Address@CLPCke_b_CAPM_EnablePressureControl@ */ Scalar_BOOLEAN 0 CM_T_BOOLEAN 0.0 1.0 /end CHARACTERISTIC
/begin CHARACTERISTIC CLPCke_b_CAPM_OverCurrent_UseBSW_Limit "### Description
      This enables indicating using the BSW CAPM BLDC filtered overcurrent limit for CurrentBasedMaxSpeed
      ### Usage
      Set to true to use information from BSW as well as (max of) the calculated value in CLPC
      Set to false to only use the calculated value in CLPC
      ### Calibration Note
      The BSW value can be measured with CLPCve_r_CAP_BSW_Y and the CLPC value with CLPCve_r_CAP_Y" VALUE 0x0000 /* @ECU_Address@CLPCke_b_CAPM_OverCurrent_UseBSW_Limit@ */ Scalar_BOOLEAN 0 CM_T_BOOLEAN 0.0 1.0 /end CHARACTERISTIC
/begin CHARACTERISTIC CLPCke_b_CAPM_PressureControlIPartCompOfOverReq "### Description
      This enables some anti-windup in CAPM pressure controller when speed controller is saturated
      ### Usage
      Set to true to reduce pressure controller I-part when speed controller is saturated
      ### Calibration Note" VALUE 0x0000 /* @ECU_Address@CLPCke_b_CAPM_PressureControlIPartCompOfOverReq@ */ Scalar_BOOLEAN 0 CM_T_BOOLEAN 0.0 1.0 /end CHARACTERISTIC
/begin CHARACTERISTIC CLPCke_b_CAPM_PressureControl_PIDuse "" VALUE 0x0000 /* @ECU_Address@CLPCke_b_CAPM_PressureControl_PIDuse@ */ Scalar_BOOLEAN 0 CM_T_BOOLEAN 0.0 1.0 /end CHARACTERISTIC
/begin CHARACTERISTIC CLPCke_b_CAPM_PressureTestSequenceEnable "### Description
      This enables the target pressure test sequence generator for Clutch Actuator Pump Motor
      ### Usage
      Set to TRUE to enable the sequence generator
      ### Calibration Note
      This only enables the generator, not that the output is used, the sequence generator output is CLPCve_p_CAPM_PressureTestSequenceTarget
      " VALUE 0x0000 /* @ECU_Address@CLPCke_b_CAPM_PressureTestSequenceEnable@ */ Scalar_BOOLEAN 0 CM_T_BOOLEAN 0.0 1.0 /end CHARACTERISTIC
/begin CHARACTERISTIC CLPCke_b_CAPM_SpeedControlDutyCompVoltageCompEnable "### Description
      This enables voltage compensation of MotorSupply voltage of CAPM for speed control duty-cycle compensation
      ### Usage
      Set to true if voltage compensation for feed-forward shall be enabled
      ### Calibration Note
      " VALUE 0x0000 /* @ECU_Address@CLPCke_b_CAPM_SpeedControlDutyCompVoltageCompEnable@ */ Scalar_BOOLEAN 0 CM_T_BOOLEAN 0.0 1.0 /end CHARACTERISTIC
/begin CHARACTERISTIC CLPCke_b_CAPM_SpeedControllerEnable "### Description
      This enables CAPM speed control
      ### Usage
      Set to true if speed control shall be enabled
      ### Calibration Note" VALUE 0x0000 /* @ECU_Address@CLPCke_b_CAPM_SpeedControllerEnable@ */ Scalar_BOOLEAN 0 CM_T_BOOLEAN 0.0 1.0 /end CHARACTERISTIC
/begin CHARACTERISTIC CLPCke_b_CAPM_SpeedTestSequenceEnable "### Description
      This enables the target speed test sequence generator for Clutch Actuator Pump Motor
      ### Usage
      Set to TRUE to enable the sequence generator
      ### Calibration Note
      This only enables the generator, not that the output is used, the sequence generator output is CLPCve_n_CAPM_SpeedTestSequenceTarget
      " VALUE 0x0000 /* @ECU_Address@CLPCke_b_CAPM_SpeedTestSequenceEnable@ */ Scalar_BOOLEAN 0 CM_T_BOOLEAN 0.0 1.0 /end CHARACTERISTIC
/begin CHARACTERISTIC CLPCke_b_CAP_EnableTooCloseToOverCurrent "### Description
      This enables indicating if CAPM BLDC is close to overcurrent
      ### Usage
      Set to true if close to overcurrent shall be indicated for CAPM BLDC
      ### Calibration Note
      The indication is set when CLPCve_r_CAP_Y reaches CLPCke_r_CAP_LatchTooCloseToOverCurrent
      The indication is released when CLPCve_r_CAP_Y has gone down to CLPCke_r_CAP_ReleaseTooCloseToOverCurrent
      BSW will cut CAPM BLDC for overcurrent when CLPCve_r_CAP_Y is greater than 1" VALUE 0x0000 /* @ECU_Address@CLPCke_b_CAP_EnableTooCloseToOverCurrent@ */ Scalar_BOOLEAN 0 CM_T_BOOLEAN 0.0 1.0 /end CHARACTERISTIC
/begin CHARACTERISTIC CLPCke_b_CAP_Y_EnableCurrentLoad "### Description
      This enables using current load for the CAP phase overcurrent protection, with possibility to calibrate a margin.
      If disabled, the CAP BLDC is constantly being limited relative to the current limit, regardless if the current-load value is low or not, but the current limit could be lowered due too high current load instead.
      If enabled, the allowed pressure is proportionally reduced, so that the pressure would be at the current limit when the current load is at cut-off limit (1) minus the margin (CLPCke_r_CAP_Y_OverCurrentMargin)
      ### Usage
      Set to true to enable using current load estimation value
      Set to false to always try to not exceed current limit
      ### Calibration Note
      " VALUE 0x0000 /* @ECU_Address@CLPCke_b_CAP_Y_EnableCurrentLoad@ */ Scalar_BOOLEAN 0 CM_T_BOOLEAN 0 1 /end CHARACTERISTIC
/begin CHARACTERISTIC CLPCke_b_ClutchPressureSampleSmoothingEnable "This enables using the mean of the last two values instead of just the current" VALUE 0x0000 /* @ECU_Address@CLPCke_b_ClutchPressureSampleSmoothingEnable@ */ Scalar_BOOLEAN 0 CM_T_BOOLEAN 0.0 1.0 /end CHARACTERISTIC
/begin CHARACTERISTIC CLPCke_b_EnableFillCompensation "### Description
      This enables an extra CAPM speed boost when in fill to reach fill target, unloading the Fill PID controller.
      ### Usage
      Set to TRUE to enable Fill compensation
      ### Calibration Note
      Fill compensation is calibrated with table CLPCkt_n_CAPM_Fill
      " VALUE 0x0000 /* @ECU_Address@CLPCke_b_EnableFillCompensation@ */ Scalar_BOOLEAN 0 CM_T_BOOLEAN 0.0 1.0 /end CHARACTERISTIC
/begin CHARACTERISTIC CLPCke_b_KneePointAdaptionEnable "This parameter enables the adaptionfill logic for finding pressure knee point" VALUE 0x0000 /* @ECU_Address@CLPCke_b_KneePointAdaptionEnable@ */ Scalar_BOOLEAN 0 CM_T_BOOLEAN 0.0 1.0 /end CHARACTERISTIC
/begin CHARACTERISTIC CLPCke_b_StopKneePointAdaptionOnceFound "This specifies if pressure knee-point adaption only shall be done until determined to have been found" VALUE 0x0000 /* @ECU_Address@CLPCke_b_StopKneePointAdaptionOnceFound@ */ Scalar_BOOLEAN 0 CM_T_BOOLEAN 0.0 1.0 /end CHARACTERISTIC
/begin CHARACTERISTIC CLPCke_b_UseCurveForTrqToPresEven "Enables the use of a curve for converting torque to pressure." VALUE 0x0000 /* @ECU_Address@CLPCke_b_UseCurveForTrqToPresEven@ */ Scalar_BOOLEAN 0 CM_T_BOOLEAN 0.0 1.0 /end CHARACTERISTIC
/begin CHARACTERISTIC CLPCke_b_UseCurveForTrqToPresOdd "Enables the use of a curve for converting torque to pressure." VALUE 0x0000 /* @ECU_Address@CLPCke_b_UseCurveForTrqToPresOdd@ */ Scalar_BOOLEAN 0 CM_T_BOOLEAN 0.0 1.0 /end CHARACTERISTIC
/begin CHARACTERISTIC CLPCke_b_UseEvenAsPrecautionMaster "This cal provides the oportunity to switch to making the even clutch the master of pressure precaution algorithm. The request of the master will allways be fullfilled, and the request of the secondary clutch will be limited." VALUE 0x0000 /* @ECU_Address@CLPCke_b_UseEvenAsPrecautionMaster@ */ Scalar_BOOLEAN 0 CM_T_BOOLEAN 0.0 1.0 /end CHARACTERISTIC
/begin CHARACTERISTIC CLPCke_b_UseKissPointAdaption "Sets if adaptionvalue for kisspoint shall be used (if set), otherwise calibration value for kisspoint is used" VALUE 0x0000 /* @ECU_Address@CLPCke_b_UseKissPointAdaption@ */ Scalar_BOOLEAN 0 CM_T_BOOLEAN 0.0 1.0 /end CHARACTERISTIC
/begin CHARACTERISTIC CLPCke_b_UseMaxCurrentAvailable "This enables usage of estimated current (BLDC PWM-On part phase current) available for limiting indicated available pressure" VALUE 0x0000 /* @ECU_Address@CLPCke_b_UseMaxCurrentAvailable@ */ Scalar_BOOLEAN 0 CM_T_BOOLEAN 0.0 1.0 /end CHARACTERISTIC
/begin CHARACTERISTIC CLPCke_b_UseMaxPowerAvailable "This enables usage of estimated power (to keep Busbar total current below limit) available for limiting indicated available pressure" VALUE 0x0000 /* @ECU_Address@CLPCke_b_UseMaxPowerAvailable@ */ Scalar_BOOLEAN 0 CM_T_BOOLEAN 0 1 /end CHARACTERISTIC
/begin CHARACTERISTIC CLPCke_b_UseMaxSumPhaseCurrentAvailable "This enables usage of estimated sum phase current (to keep total sum phase current below limit) available for limiting indicated available pressure" VALUE 0x0000 /* @ECU_Address@CLPCke_b_UseMaxSumPhaseCurrentAvailable@ */ Scalar_BOOLEAN 0 CM_T_BOOLEAN 0 1 /end CHARACTERISTIC
/begin CHARACTERISTIC CLPCke_b_UseOddClutchTransferGainAdaptionValue "Sets if adaptionvalue for clutch transfer gain shall be used (if set), otherwise calibrations is used for clutch transfer gain instead" VALUE 0x0000 /* @ECU_Address@CLPCke_b_UseOddClutchTransferGainAdaptionValue@ */ Scalar_BOOLEAN 0 CM_T_BOOLEAN 0.0 1.0 /end CHARACTERISTIC
/begin MEASUREMENT CLPCve_r_CurrentToPressure "Estimated \"Current To Pressure\" ratio" FLOAT32_IEEE CM_T_r_NA_Float32 0 0 -3.4E+38 3.4E+38 ECU_ADDRESS 0x0000 /* @ECU_Address@CLPCve_r_CurrentToPressure@ */ /end MEASUREMENT
/begin MEASUREMENT CLPCve_r_PowerToPressure "Estimated \"Power To Pressure\" ratio" FLOAT32_IEEE CM_T_r_NA_Float32 0 0 -3.4E+38 3.4E+38 ECU_ADDRESS 0x0000 /* @ECU_Address@CLPCve_r_PowerToPressure@ */ /end MEASUREMENT
/begin MEASUREMENT CLPCve_P_AvailableBusbarPower "Estimated available Busbar Power" FLOAT32_IEEE CM_T_P_W_Float32 0 0 0.0 3.4E+38 ECU_ADDRESS 0x0000 /* @ECU_Address@CLPCve_P_AvailableBusbarPower@ */ /end MEASUREMENT
/begin MEASUREMENT CLPCve_r_CAP_X "Normalized CAP Phase Current, when this is above 1 the CAP Phase Current is above the current limit" FLOAT32_IEEE CM_T_r_NA_Float32 0 0 -3.4E+38 3.4E+38 ECU_ADDRESS 0x0000 /* @ECU_Address@CLPCve_r_CAP_X@ */ /end MEASUREMENT
/begin MEASUREMENT CLPCve_I_CAPM_Avg "###Description
      Feedback from BLDC for CAPM, TCU_I_MotAvrgCrnt
      
      
      " FLOAT32_IEEE CM_T_I_A_Float32 0 0 -327.68 327.67 ECU_ADDRESS 0x0000 /* @ECU_Address@CLPCve_I_CAPM_Avg@ */ /end MEASUREMENT
/begin MEASUREMENT CLPCve_P_CAPM_Estimated "Estimated power of CAPM" FLOAT32_IEEE CM_T_P_W_Float32 0 0 -3.4E+38 3.4E+38 ECU_ADDRESS 0x0000 /* @ECU_Address@CLPCve_P_CAPM_Estimated@ */ /end MEASUREMENT
/begin MEASUREMENT CLPCve_I_CAPM_Max "###Description
      Feedback from BLDC for CAPM, TCU_I_MotMaxCrnt
      
      " FLOAT32_IEEE CM_T_I_A_Float32 0 0 -327.68 327.67 ECU_ADDRESS 0x0000 /* @ECU_Address@CLPCve_I_CAPM_Max@ */ /end MEASUREMENT
/begin MEASUREMENT CLPCve_e_CAPM_PressureControllerState "Current control state of CAPM pressure controller" UBYTE CM_CLPCte_e_ControllerState 0 0 0 6 ECU_ADDRESS 0x0000 /* @ECU_Address@CLPCve_e_CAPM_PressureControllerState@ */ /end MEASUREMENT
/begin MEASUREMENT CLPCve_n_OddClthAbsSpeed "Absolute speed of secondary side of clutch" SWORD CM_T_n_rpm_1_1_s16 0 0 -32768 32767 ECU_ADDRESS 0x0000 /* @ECU_Address@CLPCve_n_OddClthAbsSpeed@ */ /end MEASUREMENT
/begin MEASUREMENT CLPCve_n_OddClutchAbsDiff "Absolute speed diff over Odd Clutch" SWORD CM_T_n_rpm_1_1_s16 0 0 0.0 32767 ECU_ADDRESS 0x0000 /* @ECU_Address@CLPCve_n_OddClutchAbsDiff@ */ /end MEASUREMENT
/begin MEASUREMENT CLPCva_p_PreparePressures "Clutch prepare pressures to overcome return springs in transmission." SWORD CM_T_p_kPa_1_1_s16 0 0 0.0 1800.0 ARRAY_SIZE 2 ECU_ADDRESS 0x0000 /* @ECU_Address@CLPCva_p_PreparePressures@ */ /end MEASUREMENT
/begin MEASUREMENT CLPCve_p_OddClutchPresReqSecured "Clutch pressure controller setpoint. Before output override." SWORD CM_T_p_kPa_1_1_s16 0 0 -32000.0 32000.0 ECU_ADDRESS 0x0000 /* @ECU_Address@CLPCve_p_OddClutchPresReqSecured@ */ /end MEASUREMENT
/begin MEASUREMENT CLPCve_p_EvenClutchPresReqSecured "Clutch pressure controller setpoint. Before output override." SWORD CM_T_p_kPa_1_1_s16 0 0 -32000.0 32000.0 ECU_ADDRESS 0x0000 /* @ECU_Address@CLPCve_p_EvenClutchPresReqSecured@ */ /end MEASUREMENT
/begin MEASUREMENT CLPCve_p_OddMaxPossibleClutchOilPress "Estimated maximum possible clutch pressure" SWORD CM_T_p_kPa_1_1_s16 0 0 0.0 32767 ECU_ADDRESS 0x0000 /* @ECU_Address@CLPCve_p_OddMaxPossibleClutchOilPress@ */ /end MEASUREMENT
/begin MEASUREMENT CLPCve_p_OddMaxPossibleSumCurLimitation "Estimated maximum possible clutch pressure with regards to sum of phase limits" SWORD CM_T_p_kPa_1_1_s16 0 0 -32768 32767 ECU_ADDRESS 0x0000 /* @ECU_Address@CLPCve_p_OddMaxPossibleSumCurLimitation@ */ /end MEASUREMENT
/begin MEASUREMENT CLPCve_p_OddMaxPossibleClutchOilPressWithMargin "Possible clutch pressure after taking current load into consideration (only if enabled)" SWORD CM_T_p_kPa_1_1_s16 0 0 -32768 32767 ECU_ADDRESS 0x0000 /* @ECU_Address@CLPCve_p_OddMaxPossibleClutchOilPressWithMargin@ */ /end MEASUREMENT
/begin MEASUREMENT CLPCve_p_OddFinalPrepareTarget "This is the final prepare target, which would be the prepare target if the clutch speeds were mathced at current conditions" SWORD CM_T_p_kPa_1_1_s16 0 0 -32768 32767 ECU_ADDRESS 0x0000 /* @ECU_Address@CLPCve_p_OddFinalPrepareTarget@ */ /end MEASUREMENT
/begin MEASUREMENT CLPCve_p_KisspointAdaption "Current stored kiss-point" SWORD CM_T_p_kPa_1_1_s16 0 0 -32768 32767 ECU_ADDRESS 0x0000 /* @ECU_Address@CLPCve_p_KisspointAdaption@ */ /end MEASUREMENT
/begin MEASUREMENT CLPCve_n_CAPM_PressureControlTargetSpeedCompensation "###Description
      Feed-forward for CAPM pressure control, this is the pressure to rpm contribution" SWORD CM_T_n_rpm_1_1_s16 0 0 0.0 32767.0 ECU_ADDRESS 0x0000 /* @ECU_Address@CLPCve_n_CAPM_PressureControlTargetSpeedCompensation@ */ /end MEASUREMENT
/begin MEASUREMENT CLPCve_n_CAPM_PressureControlFlowCompensation "###Description
      Feed-forward for CAPM pressure control, this is the leak-flow estimation contribution" SWORD CM_T_n_rpm_1_1_s16 0 0 -32768.0 32767.0 ECU_ADDRESS 0x0000 /* @ECU_Address@CLPCve_n_CAPM_PressureControlFlowCompensation@ */ /end MEASUREMENT
/begin MEASUREMENT CLPCve_n_CAPM_PressureControlCompensation "###Description
      Feed-forward for CAPM pressure control, this is total feed-forward" SWORD CM_T_n_rpm_1_1_s16 0 0 -32768.0 32767.0 ECU_ADDRESS 0x0000 /* @ECU_Address@CLPCve_n_CAPM_PressureControlCompensation@ */ /end MEASUREMENT
/begin MEASUREMENT CLPCve_n_CAPM_MaxFill "Maximum fill speed" SWORD CM_T_n_rpm_1_1_s16 0 0 0.0 32767 ECU_ADDRESS 0x0000 /* @ECU_Address@CLPCve_n_CAPM_MaxFill@ */ /end MEASUREMENT
/begin MEASUREMENT CLPCve_n_CAPM_PressureControlI_Part "###Description
      CAPM pressure control I-part contribution" SWORD CM_T_n_rpm_1_1_s16 0 0 -32768.0 32767.0 ECU_ADDRESS 0x0000 /* @ECU_Address@CLPCve_n_CAPM_PressureControlI_Part@ */ /end MEASUREMENT
/begin MEASUREMENT CLPCve_n_CAPM_Fill "Extra speed part for fill compensation" SWORD CM_T_n_rpm_1_1_s16 0 0 0.0 32767 ECU_ADDRESS 0x0000 /* @ECU_Address@CLPCve_n_CAPM_Fill@ */ /end MEASUREMENT
/begin MEASUREMENT CLPCve_n_CAPM_PressureControlP_Part "###Description
      CAPM pressure control P-part contribution" SWORD CM_T_n_rpm_1_1_s16 0 0 -32768.0 32767.0 ECU_ADDRESS 0x0000 /* @ECU_Address@CLPCve_n_CAPM_PressureControlP_Part@ */ /end MEASUREMENT
/begin MEASUREMENT CLPCve_n_CAPM_PressureControlD_Part "###Description
      CAPM pressure control D-part contribution" SWORD CM_T_n_rpm_1_1_s16 0 0 -32768.0 32767.0 ECU_ADDRESS 0x0000 /* @ECU_Address@CLPCve_n_CAPM_PressureControlD_Part@ */ /end MEASUREMENT
/begin MEASUREMENT CLPCve_n_AdaptionFill "AdaptionFill target speed" SWORD CM_T_n_rpm_1_1_s16 0 0 0.0 32767.0 ECU_ADDRESS 0x0000 /* @ECU_Address@CLPCve_n_AdaptionFill@ */ /end MEASUREMENT
/begin MEASUREMENT CLPCve_n_PressureControllerMax "This is the current total maximum speed limitation for pressure controller" SWORD CM_T_n_rpm_1_1_s16 0 0 0.0 32767.0 ECU_ADDRESS 0x0000 /* @ECU_Address@CLPCve_n_PressureControllerMax@ */ /end MEASUREMENT
/begin MEASUREMENT CLPCve_n_PressureControllerMin "This is the current total minimum speed limitation for pressure controller" SWORD CM_T_n_rpm_1_1_s16 0 0 -32768.0 0.0 ECU_ADDRESS 0x0000 /* @ECU_Address@CLPCve_n_PressureControllerMin@ */ /end MEASUREMENT
/begin MEASUREMENT CLPCve_n_CAPM_PressureControllerTarget "###Description
      Speed command output from pressure controller" SWORD CM_T_n_rpm_1_1_s16 0 0 -32768.0 32676.0 ECU_ADDRESS 0x0000 /* @ECU_Address@CLPCve_n_CAPM_PressureControllerTarget@ */ /end MEASUREMENT
/begin MEASUREMENT CLPCve_n_CAPM_SpeedTestSequenceTarget "###Description
      Target speed for test sequence generator for Clutch Actuator Pump Motor
      " SWORD CM_T_n_rpm_1_1_s16 0 0 -32768.0 32767.0 ECU_ADDRESS 0x0000 /* @ECU_Address@CLPCve_n_CAPM_SpeedTestSequenceTarget@ */ /end MEASUREMENT
/begin MEASUREMENT CLPCve_n_CAPM_SpeedControllerTarget "###Description
      Actual target for speed controller" SWORD CM_T_n_rpm_1_1_s16 0 0 -32768.0 32767.0 ECU_ADDRESS 0x0000 /* @ECU_Address@CLPCve_n_CAPM_SpeedControllerTarget@ */ /end MEASUREMENT
/begin MEASUREMENT CLPCve_p_LastEstimatedKisspoint "Intermediate variable, the last found kisspoint estimation made during AdaptionFill" SWORD CM_T_p_kPa_1_1_s16 0 0 -32768 32767 ECU_ADDRESS 0x0000 /* @ECU_Address@CLPCve_p_LastEstimatedKisspoint@ */ /end MEASUREMENT
/begin MEASUREMENT CLPCve_p_EstimationCompare "AdaptionFill estimated pressure buildup, kiss-point is determined to be found when actual pressure increases above estimation (with tolerance)" SWORD CM_T_p_kPa_1_1_s16 0 0 -32768 32767 ECU_ADDRESS 0x0000 /* @ECU_Address@CLPCve_p_EstimationCompare@ */ /end MEASUREMENT
/begin MEASUREMENT CLPCve_p_PressureDiff "Pressure diff" SWORD CM_T_p_kPa_1_1_s16 0 0 -32768 32767 ECU_ADDRESS 0x0000 /* @ECU_Address@CLPCve_p_PressureDiff@ */ /end MEASUREMENT
/begin MEASUREMENT CLPCve_n_CAPM "###Description
      Feedback from BLDC for CAPM, TCU_n_MotRotSpd (actual speed)" SWORD CM_T_n_rpm_1_1_s16 0 0 -32768.0 32767.0 ECU_ADDRESS 0x0000 /* @ECU_Address@CLPCve_n_CAPM@ */ /end MEASUREMENT
/begin MEASUREMENT CLPCve_Cnt_CAPMPS_ActPosInc "###Description
      Feedback from BLDC for CAPM, TCU_Ct_PwrStgActPosInc" SWORD CM_T_Cnt_Num_1_1_s16 0 0 -32768.0 32767.0 ECU_ADDRESS 0x0000 /* @ECU_Address@CLPCve_Cnt_CAPMPS_ActPosInc@ */ /end MEASUREMENT
/begin MEASUREMENT CLPCve_n_CAPM_Overrequest "###Description
      Speed controller saturated high, this is the estimation of the unrealized speed request" SWORD CM_T_n_rpm_1_1_s16 0 0 -32768.0 32767.0 ECU_ADDRESS 0x0000 /* @ECU_Address@CLPCve_n_CAPM_Overrequest@ */ /end MEASUREMENT
/begin MEASUREMENT CLPCve_K_TransferGainAdaption "Current stored transfer gain" UWORD CM_uint16 0 0 0 65535 ECU_ADDRESS 0x0000 /* @ECU_Address@CLPCve_K_TransferGainAdaption@ */ /end MEASUREMENT
/begin MEASUREMENT CLPCve_Cnt_VolatileKisspointAdaptionTest "This is the number of times kiss-point has ben found using adaptionfill before setting FirstDone flag, when this value exceeds CLPCke_Cnt_NoOfAdaptionsEstimationsUntilFirstDone and FirstDone is set it will go to Zero at the next found adaption" UWORD CM_T_Cnt_Num_1_1_u16 0 0 0 65535 ECU_ADDRESS 0x0000 /* @ECU_Address@CLPCve_Cnt_VolatileKisspointAdaptionTest@ */ /end MEASUREMENT
/begin MEASUREMENT CLPCve_Cnt_AdaptKissPointActive "Time that adaption-fill for kiss-point adaption has been active (in counts of 10ms)" UWORD CM_T_Cnt_Num_1_1_u16 0 0 0.0 65535.0 ECU_ADDRESS 0x0000 /* @ECU_Address@CLPCve_Cnt_AdaptKissPointActive@ */ /end MEASUREMENT
/begin MEASUREMENT CLPCve_Cnt_CAPM_PressureTestSequenceCycles "###Description
      Number of sequences for pressure test sequence generator for Clutch Actuator Pump Motor, this will saturate at 65535
      " UWORD CM_T_Cnt_Num_1_1_u16 0 0 0.0 65535.0 ECU_ADDRESS 0x0000 /* @ECU_Address@CLPCve_Cnt_CAPM_PressureTestSequenceCycles@ */ /end MEASUREMENT
/begin MEASUREMENT CLPCve_Cnt_CAPM_SpeedTestSequenceCycles "###Description
      Number of sequences for speed test sequence generator for Clutch Actuator Pump Motor, this will saturate at 65535
      " UWORD CM_T_Cnt_Num_1_1_u16 0 0 0.0 65535.0 ECU_ADDRESS 0x0000 /* @ECU_Address@CLPCve_Cnt_CAPM_SpeedTestSequenceCycles@ */ /end MEASUREMENT
/begin MEASUREMENT CLPCve_p_CAPM_PressureTestSequenceTarget "###Description
      Target pressure for test sequence generator for Clutch Actuator Pump Motor
      " UWORD CM_T_p_kPa_32_1_u16 0 0 0.0 2047.96875 ECU_ADDRESS 0x0000 /* @ECU_Address@CLPCve_p_CAPM_PressureTestSequenceTarget@ */ /end MEASUREMENT
/begin MEASUREMENT CLPCve_p_CAPM_Target "###Description
      Actual target for pressure controller" UWORD CM_T_p_kPa_32_1_u16 0 0 0.0 2047.96875 ECU_ADDRESS 0x0000 /* @ECU_Address@CLPCve_p_CAPM_Target@ */ /end MEASUREMENT
/begin MEASUREMENT CLPCve_p_Clutch "###Description
      Actual clutch pressure" UWORD CM_T_p_kPa_32_1_u16 0 0 0.0 2047.96875 ECU_ADDRESS 0x0000 /* @ECU_Address@CLPCve_p_Clutch@ */ /end MEASUREMENT
/begin MEASUREMENT CLPCve_p_FillDiff "\"Fill Pressure Diff\" = min(target, kisspoint) - actual)
      Used for determination of extra speed part for fill compensation" UWORD CM_T_p_kPa_32_1_u16 0 0 0 2047.96875 ECU_ADDRESS 0x0000 /* @ECU_Address@CLPCve_p_FillDiff@ */ /end MEASUREMENT
/begin MEASUREMENT CLPCve_p_ClutchFiltered "Filtered clutch pressure" UWORD CM_T_p_kPa_32_1_u16 0 0 0 2047.96875 ECU_ADDRESS 0x0000 /* @ECU_Address@CLPCve_p_ClutchFiltered@ */ /end MEASUREMENT
/begin MEASUREMENT CLPCve_T_TransOilSump "###Description
      Transmission oil sump temperature" SWORD CM_T_T_degC_16_1_s16 0 0 -2048.0 2047.9375 ECU_ADDRESS 0x0000 /* @ECU_Address@CLPCve_T_TransOilSump@ */ /end MEASUREMENT
/begin MEASUREMENT CLPCve_T_CAPMPS "###Description
      Feedback from BLDC for CAPM, TCU_Temp_PwrStgTemp" SWORD CM_T_T_degC_16_1_s16 0 0 -2048.0 2047.9375 ECU_ADDRESS 0x0000 /* @ECU_Address@CLPCve_T_CAPMPS@ */ /end MEASUREMENT
/begin MEASUREMENT CLPCve_Pct_CAPM_SpeedControl_DC "###Description
      Actual CAPM speed controller duty-cycle" SWORD CM_T_Pct_pct_10_1_s16 0 0 0.0 100.0 ECU_ADDRESS 0x0000 /* @ECU_Address@CLPCve_Pct_CAPM_SpeedControl_DC@ */ /end MEASUREMENT
/begin MEASUREMENT CLPCva_Cf_PresToTrq "Current conversion factor from clutch pressure to clutch torque." UWORD CM_T_K_NA_32768_1_u16 0 0 0.0 1.999969482421875 ARRAY_SIZE 2 ECU_ADDRESS 0x0000 /* @ECU_Address@CLPCva_Cf_PresToTrq@ */ /end MEASUREMENT
/begin MEASUREMENT CLPCve_r_CAP_BSW_Y "Phase current load from BSW" UWORD CM_T_r_NA_32768_1_u16 0 0 0 1.999969482421875 ECU_ADDRESS 0x0000 /* @ECU_Address@CLPCve_r_CAP_BSW_Y@ */ /end MEASUREMENT
/begin MEASUREMENT CLPCve_r_CAP_ASW_Y "Phase current load estimated in ASW" UWORD CM_T_r_NA_32768_1_u16 0 0 0 1.999969482421875 ECU_ADDRESS 0x0000 /* @ECU_Address@CLPCve_r_CAP_ASW_Y@ */ /end MEASUREMENT
/begin MEASUREMENT CLPCve_r_IGainBasedOnDiff "I gain based on preesure error and temp" UWORD CM_T_K_NA_1024_1_u16 0 0 0 63.9990234375 ECU_ADDRESS 0x0000 /* @ECU_Address@CLPCve_r_IGainBasedOnDiff@ */ /end MEASUREMENT
/begin MEASUREMENT CLPCve_DC_CAPM_SpeedControllerPressureCompensation "###Description
      CAPM Speed controller pressure compensation to maintain target speed" SWORD CM_T_Pct_pct_256_1_s16 0 0 -128.0 127.99609375 ECU_ADDRESS 0x0000 /* @ECU_Address@CLPCve_DC_CAPM_SpeedControllerPressureCompensation@ */ /end MEASUREMENT
/begin MEASUREMENT CLPCve_Pct_CAPM_SpeedControlDutyCompensation "###Description
      CAPM Speedcontroller feed-forward, target speed to DC contribution" SWORD CM_T_Pct_pct_256_1_s16 0 0 -128.0 127.99609375 ECU_ADDRESS 0x0000 /* @ECU_Address@CLPCve_Pct_CAPM_SpeedControlDutyCompensation@ */ /end MEASUREMENT
/begin MEASUREMENT CLPCve_Pct_CAPM_SpeedControlP_Part "###Description
      CAPM Speedcontroller P-part contribution" SWORD CM_T_Pct_pct_256_1_s16 0 0 -128.0 127.99609375 ECU_ADDRESS 0x0000 /* @ECU_Address@CLPCve_Pct_CAPM_SpeedControlP_Part@ */ /end MEASUREMENT
/begin MEASUREMENT CLPCve_Pct_CAPM_SpeedControlI_Part "###Description
      CAPM Speedcontroller I-part contribution" SWORD CM_T_Pct_pct_256_1_s16 0 0 -128.0 127.99609375 ECU_ADDRESS 0x0000 /* @ECU_Address@CLPCve_Pct_CAPM_SpeedControlI_Part@ */ /end MEASUREMENT
/begin MEASUREMENT CLPCve_Pct_CAPM_SpeedControlD_Part "###Description
      CAPM Speedcontroller D-part contribution" SWORD CM_T_Pct_pct_256_1_s16 0 0 -128.0 127.99609375 ECU_ADDRESS 0x0000 /* @ECU_Address@CLPCve_Pct_CAPM_SpeedControlD_Part@ */ /end MEASUREMENT
/begin MEASUREMENT CLPCve_r_PGainBasedOnPres "Gain based on pressure and temp" UWORD CM_T_K_NA_128_1_u16 0 0 0 511.9921875 ECU_ADDRESS 0x0000 /* @ECU_Address@CLPCve_r_PGainBasedOnPres@ */ /end MEASUREMENT
/begin MEASUREMENT CLPCve_r_PGainBasedOnDiff "Gain based on pressure error and temp" UWORD CM_T_K_NA_128_1_u16 0 0 0 511.9921875 ECU_ADDRESS 0x0000 /* @ECU_Address@CLPCve_r_PGainBasedOnDiff@ */ /end MEASUREMENT
/begin MEASUREMENT CLPCve_dp_Clutch "Derivative of clutch pressure, used by AdaptionFill kiss-point adaption" SWORD CM_T_dp_kPaps_8_1_s16 0 0 -4096.0 4095.875 ECU_ADDRESS 0x0000 /* @ECU_Address@CLPCve_dp_Clutch@ */ /end MEASUREMENT
/begin MEASUREMENT CLPCve_Cnt_CAPM_CommandDBC_in "" UBYTE CM_T_Cnt_Num_1_1_u8 0 0 0.0 3.0 ECU_ADDRESS 0x0000 /* @ECU_Address@CLPCve_Cnt_CAPM_CommandDBC_in@ */ /end MEASUREMENT
/begin MEASUREMENT CLPCve_Cnt_CAPM_Speed_Status "170: valid
      255: not_valid
      " UBYTE CM_T_Cnt_Num_1_1_u8 0 0 0.0 255.0 ECU_ADDRESS 0x0000 /* @ECU_Address@CLPCve_Cnt_CAPM_Speed_Status@ */ /end MEASUREMENT
/begin MEASUREMENT CLPCve_Cnt_CAPMPS_Pos_Status "170: valid
      255: not_valid
      " UBYTE CM_T_Cnt_Num_1_1_u8 0 0 0.0 255.0 ECU_ADDRESS 0x0000 /* @ECU_Address@CLPCve_Cnt_CAPMPS_Pos_Status@ */ /end MEASUREMENT
/begin MEASUREMENT CLPCve_Cnt_CAPM_ActualStatus "15: not_supported
      170: valid
      195: not_precise
      240: Init
      255: not_valid
      " UBYTE CM_T_Cnt_Num_1_1_u8 0 0 0.0 255.0 ECU_ADDRESS 0x0000 /* @ECU_Address@CLPCve_Cnt_CAPM_ActualStatus@ */ /end MEASUREMENT
/begin MEASUREMENT CLPCve_Cnt_CAPMPS_Mode "15: power_stage_Hi_Z
      170: power_stage_ON
      240: power_stage_brake
      255: power_stage_OFF
      " UBYTE CM_T_Cnt_Num_1_1_u8 0 0 0.0 255.0 ECU_ADDRESS 0x0000 /* @ECU_Address@CLPCve_Cnt_CAPMPS_Mode@ */ /end MEASUREMENT
/begin MEASUREMENT CLPCve_Cnt_CAPMPS_Status "15: disconnected
      170 :no_failure
      240: short_circuit
      255: failure
      " UBYTE CM_T_Cnt_Num_1_1_u8 0 0 0.0 255.0 ECU_ADDRESS 0x0000 /* @ECU_Address@CLPCve_Cnt_CAPMPS_Status@ */ /end MEASUREMENT
/begin MEASUREMENT CLPCve_Cnt_CAPMPS_TemperatureStatus "170: valid
      255: not_valid
      " UBYTE CM_T_Cnt_Num_1_1_u8 0 0 0.0 255.0 ECU_ADDRESS 0x0000 /* @ECU_Address@CLPCve_Cnt_CAPMPS_TemperatureStatus@ */ /end MEASUREMENT
/begin MEASUREMENT CLPCve_Cnt_CAPMPS_TemperatureWarnLevel "170: normal_level
      204: warning_level
      240: off_request
      255: switch_off_forced
      " UBYTE CM_T_Cnt_Num_1_1_u8 0 0 0.0 255.0 ECU_ADDRESS 0x0000 /* @ECU_Address@CLPCve_Cnt_CAPMPS_TemperatureWarnLevel@ */ /end MEASUREMENT
/begin MEASUREMENT CLPCve_b_KissPointAdaptionWithinLimits "Indicates if stored adaption value for KissPoint (CLPCve_p_KisspointAdaption) is within limits" UBYTE CM_T_BOOLEAN 0 0 0.0 1.0 ECU_ADDRESS 0x0000 /* @ECU_Address@CLPCve_b_KissPointAdaptionWithinLimits@ */ /end MEASUREMENT
/begin MEASUREMENT CLPCve_b_KisspointAdaptionSet "Indicates if adaption value for KissPoint (CLPCve_p_KisspointAdaption) seems to have been set, i.e. Inverse value matches data value" UBYTE CM_T_BOOLEAN 0 0 0.0 1.0 ECU_ADDRESS 0x0000 /* @ECU_Address@CLPCve_b_KisspointAdaptionSet@ */ /end MEASUREMENT
/begin MEASUREMENT CLPCve_b_TransferGainAdaptionWithinLimits "Indicates if stored adaption value for TransferGain (CLPCve_K_TransferGainAdaption) is within limits" UBYTE CM_T_BOOLEAN 0 0 0.0 1.0 ECU_ADDRESS 0x0000 /* @ECU_Address@CLPCve_b_TransferGainAdaptionWithinLimits@ */ /end MEASUREMENT
/begin MEASUREMENT CLPCve_b_TransferGainAdaptionSet "Indicates if adaption value for TransferGain (CLPCve_K_TransferGainAdaption) seems to have been set, i.e. Inverse value matches data value" UBYTE CM_T_BOOLEAN 0 0 0.0 1.0 ECU_ADDRESS 0x0000 /* @ECU_Address@CLPCve_b_TransferGainAdaptionSet@ */ /end MEASUREMENT
/begin MEASUREMENT CLPCve_b_AtPressureTarget "This indicates that the pressure is at (close enough) the current pressure target" UBYTE CM_T_BOOLEAN 0 0 0 1 ECU_ADDRESS 0x0000 /* @ECU_Address@CLPCve_b_AtPressureTarget@ */ /end MEASUREMENT
/begin MEASUREMENT CLPCve_b_StablePressure "Indicates that stable pressure is achieved, used by Current and Power to Pressure estimation" UBYTE CM_T_BOOLEAN 0 0 0 1 ECU_ADDRESS 0x0000 /* @ECU_Address@CLPCve_b_StablePressure@ */ /end MEASUREMENT
/begin MEASUREMENT CLPCve_b_TieUpCondition "This flag goes true when a transmission tie-up condition is detected. Tie-up means that both clutches are being commanded too high torques simultanously." UBYTE CM_T_BOOLEAN 0 0 0.0 1.0 ECU_ADDRESS 0x0000 /* @ECU_Address@CLPCve_b_TieUpCondition@ */ /end MEASUREMENT
/begin MEASUREMENT CLPCve_b_CAPM_Press_DBC "" UBYTE CM_T_BOOLEAN 0 0 0.0 1.0 ECU_ADDRESS 0x0000 /* @ECU_Address@CLPCve_b_CAPM_Press_DBC@ */ /end MEASUREMENT
/begin MEASUREMENT CLPCve_b_CAPM_FillControllerI_PartEnable "This indicates that the Fill-controller I-part is enabled, it can be turned of for alimited time when entering fill to avoid unnecessary I-part wind-up" UBYTE CM_T_BOOLEAN 0 0 0 1 ECU_ADDRESS 0x0000 /* @ECU_Address@CLPCve_b_CAPM_FillControllerI_PartEnable@ */ /end MEASUREMENT
/begin MEASUREMENT CLPCve_b_PressureControllerActive "###Description
      Pressure Controller Active" UBYTE CM_T_BOOLEAN 0 0 0.0 1.0 ECU_ADDRESS 0x0000 /* @ECU_Address@CLPCve_b_PressureControllerActive@ */ /end MEASUREMENT
/begin MEASUREMENT CLPCve_b_CAPM_Speed_DBC "" UBYTE CM_T_BOOLEAN 0 0 0.0 1.0 ECU_ADDRESS 0x0000 /* @ECU_Address@CLPCve_b_CAPM_Speed_DBC@ */ /end MEASUREMENT
/begin MEASUREMENT CLPCve_b_CAPM_DC_DBC "" UBYTE CM_T_BOOLEAN 0 0 0.0 1.0 ECU_ADDRESS 0x0000 /* @ECU_Address@CLPCve_b_CAPM_DC_DBC@ */ /end MEASUREMENT
/begin MEASUREMENT CLPCve_b_CAPM_DC_SaturatedLow "###Description
      Speed controller output saturated low" UBYTE CM_T_BOOLEAN 0 0 0.0 1.0 ECU_ADDRESS 0x0000 /* @ECU_Address@CLPCve_b_CAPM_DC_SaturatedLow@ */ /end MEASUREMENT
/begin MEASUREMENT CLPCve_b_CAPM_DC_SaturatedHigh "###Description
      Speed controller output saturated high" UBYTE CM_T_BOOLEAN 0 0 0.0 1.0 ECU_ADDRESS 0x0000 /* @ECU_Address@CLPCve_b_CAPM_DC_SaturatedHigh@ */ /end MEASUREMENT
/begin MEASUREMENT CLPCve_b_SpeedControllerActive "###Description
      Speed controller active" UBYTE CM_T_BOOLEAN 0 0 0.0 1.0 ECU_ADDRESS 0x0000 /* @ECU_Address@CLPCve_b_SpeedControllerActive@ */ /end MEASUREMENT
/begin MEASUREMENT CLPCve_b_TieUpOccuredThisKeyOn "This signal indicates that a tie-up condition has occured since last ECU reset." UBYTE CM_T_BOOLEAN 0 0 0.0 1.0 ECU_ADDRESS 0x0000 /* @ECU_Address@CLPCve_b_TieUpOccuredThisKeyOn@ */ /end MEASUREMENT
/begin COMPU_METHOD CM_T_Pct_pct_256_1_s16 "Q = V*256.000000" RAT_FUNC "%11.8" "pct (percent  (%))" COEFFS 0 256 0 0 0 1 /end COMPU_METHOD
/begin COMPU_METHOD CM_T_n_rpm_1_1_s16 "Q = V" RAT_FUNC "%5.0" "rpm (revolutions / minute  (rpm))" COEFFS 0 1 0 0 0 1 /end COMPU_METHOD
/begin COMPU_METHOD CM_T_p_kPa_32_1_u16 "Q = V*32.000000" RAT_FUNC "%9.5" "kPa (kiloPascals  (kPa))" COEFFS 0 32 0 0 0 1 /end COMPU_METHOD
/begin COMPU_METHOD CM_T_T_degC_16_1_s16 "Q = V*16.000000" RAT_FUNC "%8.4" "degC (degrees Celsius  (deg C))" COEFFS 0 16 0 0 0 1 /end COMPU_METHOD
/begin COMPU_METHOD CM_T_K_NA_128_1_u16 "Q = V*128.000000" RAT_FUNC "%10.7" "NA (dependent upon the gain)" COEFFS 0 128 0 0 0 1 /end COMPU_METHOD
/begin COMPU_METHOD CM_T_p_kPa_1_1_s16 "Q = V" RAT_FUNC "%5.0" "kPa (kiloPascals  (kPa))" COEFFS 0 1 0 0 0 1 /end COMPU_METHOD
/begin COMPU_METHOD CM_T_K_NA_1024_1_u16 "Q = V*1024.000000" RAT_FUNC "%12.10" "NA (dependent upon the gain)" COEFFS 0 1024 0 0 0 1 /end COMPU_METHOD
/begin COMPU_METHOD CM_T_I_A_32_1_s16 "Q = V*32.000000" RAT_FUNC "%9.5" "A (amperes  (A))" COEFFS 0 32 0 0 0 1 /end COMPU_METHOD
/begin COMPU_METHOD CM_T_r_NA_32768_1_u16 "Q = V*32768.000000" RAT_FUNC "%16.15" "NA (none)" COEFFS 0 32768 0 0 0 1 /end COMPU_METHOD
/begin COMPU_METHOD CM_T_Cnt_Num_1_1_u16 "Q = V" RAT_FUNC "%5.0" "Num (counts)" COEFFS 0 1 0 0 0 1 /end COMPU_METHOD
/begin COMPU_METHOD CM_T_dp_kPaps_8_1_s16 "Q = V*8.000000" RAT_FUNC "%7.3" "kPaps (kiloPascals / second  (kPa/s))" COEFFS 0 8 0 0 0 1 /end COMPU_METHOD
/begin COMPU_METHOD CM_T_p_kPa_64_1_s16 "Q = V*64.000000" RAT_FUNC "%10.6" "kPa (kiloPascals  (kPa))" COEFFS 0 64 0 0 0 1 /end COMPU_METHOD
/begin COMPU_METHOD CM_T_M_Nm_32_1_s16 "Q = V*32.000000" RAT_FUNC "%9.5" "Nm (newton-meters  (Nm))" COEFFS 0 32 0 0 0 1 /end COMPU_METHOD
/begin COMPU_METHOD CM_T_r_NA_1024_1_u16 "Q = V*1024.000000" RAT_FUNC "%12.10" "NA (none)" COEFFS 0 1024 0 0 0 1 /end COMPU_METHOD
/begin COMPU_METHOD CM_T_I_A_Float32 "Q = V" RAT_FUNC "%8.6" "A (amperes  (A))" COEFFS 0 1 0 0 0 1 /end COMPU_METHOD
/begin COMPU_METHOD CM_T_K_NA_Float32 "Q = V" RAT_FUNC "%8.6" "NA (dependent upon the gain)" COEFFS 0 1 0 0 0 1 /end COMPU_METHOD
/begin COMPU_METHOD CM_CLPCte_e_St_ElM "Enumerated data type: CLPCte_e_St_ElM" TAB_VERB "%0.6" "" COMPU_TAB_REF VTAB_FOR_CM_CLPCte_e_St_ElM /end COMPU_METHOD
/begin COMPU_VTAB VTAB_FOR_CM_CLPCte_e_St_ElM "Enumerated data type: CLPCte_e_St_ElM" TAB_VERB 4 15 "CLPCce_e_St_ElM_power_stage_Hi_Z" 170 "CLPCce_e_St_ElM_power_stage_ON" 240 "CLPCce_e_St_ElM_power_stage_brake" 255 "CLPCce_e_St_ElM_power_stage_OFF" /end COMPU_VTAB
/begin COMPU_METHOD CM_CLPCte_e_CAPM_Override "Enumerated data type: CLPCte_e_CAPM_Override" TAB_VERB "%0.6" "" COMPU_TAB_REF VTAB_FOR_CM_CLPCte_e_CAPM_Override /end COMPU_METHOD
/begin COMPU_VTAB VTAB_FOR_CM_CLPCte_e_CAPM_Override "Enumerated data type: CLPCte_e_CAPM_Override" TAB_VERB 3 0 "CLPCce_e_CAPM_Source_No_Override" 3 "CLPCce_e_CAPM_Source_TestSequenceGenerator" 5 "CLPCce_e_CAPM_Source_ManualTarget" /end COMPU_VTAB
/begin COMPU_METHOD CM_T_U_V_512_1_s16 "Q = V*512.000000" RAT_FUNC "%12.9" "V (volts  (V))" COEFFS 0 512 0 0 0 1 /end COMPU_METHOD
/begin COMPU_METHOD CM_T_v_kph_64_1_s16 "Q = V*64.000000" RAT_FUNC "%10.6" "kph (kilometers / hour  (kph))" COEFFS 0 64 0 0 0 1 /end COMPU_METHOD
/begin COMPU_METHOD CM_T_Pct_pct_10_1_s16 "Q = V*10.000000" RAT_FUNC "%0.6" "pct (percent  (%))" COEFFS 0 10 0 0 0 1 /end COMPU_METHOD
/begin COMPU_METHOD CM_T_K_NA_32768_1_u16 "Q = V*32768.000000" RAT_FUNC "%16.15" "NA (dependent upon the gain)" COEFFS 0 32768 0 0 0 1 /end COMPU_METHOD
/begin COMPU_METHOD CM_T_r_NA_1024_1_s16 "Q = V*1024.000000" RAT_FUNC "%12.10" "NA (none)" COEFFS 0 1024 0 0 0 1 /end COMPU_METHOD
/begin COMPU_METHOD CM_T_R_ohm_1024_1_s16 "Q = V*1024.000000" RAT_FUNC "%12.10" "ohm (ohms  (ohm))" COEFFS 0 1024 0 0 0 1 /end COMPU_METHOD
/begin COMPU_METHOD CM_T_l_m_1024_1_s16 "Q = V*1024.000000" RAT_FUNC "%12.10" "m (meters  (m))" COEFFS 0 1024 0 0 0 1 /end COMPU_METHOD
/begin COMPU_METHOD CM_T_A_m2_65536_1_u16 "Q = V*65536.000000" RAT_FUNC "%21.16" "m2 (square meters  (m2))" COEFFS 0 65536 0 0 0 1 /end COMPU_METHOD
/begin COMPU_METHOD CM_T_V_ml_128_1_s16 "Q = V*128.000000" RAT_FUNC "%10.7" "ml (milliliters  (ml))" COEFFS 0 128 0 0 0 1 /end COMPU_METHOD
/begin COMPU_METHOD CM_T_Cnt_Num_1_1_u8 "Q = V" RAT_FUNC "%3.0" "Num (counts)" COEFFS 0 1 0 0 0 1 /end COMPU_METHOD
/begin COMPU_METHOD CM_T_BOOLEAN "Q = V" RAT_FUNC "%1.0" "Bool" COEFFS 0 1 0 0 0 1 /end COMPU_METHOD
/begin COMPU_METHOD CM_T_r_NA_Float32 "Q = V" RAT_FUNC "%8.6" "NA (none)" COEFFS 0 1 0 0 0 1 /end COMPU_METHOD
/begin COMPU_METHOD CM_T_P_W_Float32 "Q = V" RAT_FUNC "%8.6" "W (watts  (W))" COEFFS 0 1 0 0 0 1 /end COMPU_METHOD
/begin COMPU_METHOD CM_CLPCte_e_ControllerState "Enumerated data type: CLPCte_e_ControllerState" TAB_VERB "%0.6" "" COMPU_TAB_REF VTAB_FOR_CM_CLPCte_e_ControllerState /end COMPU_METHOD
/begin COMPU_VTAB VTAB_FOR_CM_CLPCte_e_ControllerState "Enumerated data type: CLPCte_e_ControllerState" TAB_VERB 4 0 "CLPCce_e_ControllerOff" 3 "CLPCce_e_ControllerClosedLoop" 5 "CLPCce_e_ControllerFill" 6 "CLPCce_e_ControllerAdaptationFill" /end COMPU_VTAB
/begin COMPU_METHOD CM_T_Cnt_Num_1_1_s16 "Q = V" RAT_FUNC "%5.0" "Num (counts)" COEFFS 0 1 0 0 0 1 /end COMPU_METHOD
/begin COMPU_METHOD CM_uint16 "Q = V" RAT_FUNC "%5.0" "NA (dependent upon the gain)" COEFFS 0 1 0 0 0 1 /end COMPU_METHOD
/* EOF CLPC.a2l */
/begin RECORD_LAYOUT Scalar_BOOLEAN FNC_VALUES 1 UBYTE COLUMN_DIR DIRECT /end RECORD_LAYOUT
/begin RECORD_LAYOUT Scalar_UBYTE FNC_VALUES 1 UBYTE COLUMN_DIR DIRECT /end RECORD_LAYOUT
/begin RECORD_LAYOUT Scalar_BYTE FNC_VALUES 1 SBYTE COLUMN_DIR DIRECT /end RECORD_LAYOUT
/begin RECORD_LAYOUT Scalar_UWORD FNC_VALUES 1 UWORD COLUMN_DIR DIRECT /end RECORD_LAYOUT
/begin RECORD_LAYOUT Scalar_SWORD FNC_VALUES 1 SWORD COLUMN_DIR DIRECT /end RECORD_LAYOUT
/begin RECORD_LAYOUT Scalar_LONG FNC_VALUES 1 SLONG COLUMN_DIR DIRECT /end RECORD_LAYOUT
/begin RECORD_LAYOUT Scalar_FLOAT32_IEEE FNC_VALUES 1 FLOAT32_IEEE COLUMN_DIR DIRECT /end RECORD_LAYOUT
/begin RECORD_LAYOUT Scalar_FLOAT64_IEEE FNC_VALUES 1 FLOAT64_IEEE COLUMN_DIR DIRECT /end RECORD_LAYOUT
/begin RECORD_LAYOUT Lookup1D_BYTE FNC_VALUES 1 SBYTE COLUMN_DIR DIRECT /end RECORD_LAYOUT
/begin RECORD_LAYOUT Lookup1D_X_BYTE AXIS_PTS_X 1 SBYTE INDEX_INCR DIRECT /end RECORD_LAYOUT
/begin RECORD_LAYOUT Lookup1D_X_UBYTE AXIS_PTS_X 1 UBYTE INDEX_INCR DIRECT /end RECORD_LAYOUT
/begin RECORD_LAYOUT Lookup1D_UWORD FNC_VALUES 1 UWORD COLUMN_DIR DIRECT /end RECORD_LAYOUT
/begin RECORD_LAYOUT Lookup1D_X_UWORD AXIS_PTS_X 1 UWORD INDEX_INCR DIRECT /end RECORD_LAYOUT
/begin RECORD_LAYOUT Lookup1D_WORD FNC_VALUES 1 SWORD COLUMN_DIR DIRECT /end RECORD_LAYOUT
/begin RECORD_LAYOUT Lookup1D_X_WORD AXIS_PTS_X 1 SWORD INDEX_INCR DIRECT /end RECORD_LAYOUT
/begin RECORD_LAYOUT Lookup1D_ULONG FNC_VALUES 1 ULONG COLUMN_DIR DIRECT /end RECORD_LAYOUT
/begin RECORD_LAYOUT Lookup1D_X_ULONG AXIS_PTS_X 1 ULONG INDEX_INCR DIRECT /end RECORD_LAYOUT
/begin RECORD_LAYOUT Lookup1D_SLONG FNC_VALUES 1 SLONG COLUMN_DIR DIRECT /end RECORD_LAYOUT
/begin RECORD_LAYOUT Lookup1D_X_LONG AXIS_PTS_X 1 SLONG INDEX_INCR DIRECT /end RECORD_LAYOUT
/begin RECORD_LAYOUT Lookup1D_FLOAT32_IEEE FNC_VALUES 1 FLOAT32_IEEE COLUMN_DIR DIRECT /end RECORD_LAYOUT
/begin RECORD_LAYOUT Lookup1D_X_FLOAT32_IEEE AXIS_PTS_X 1 FLOAT32_IEEE INDEX_INCR DIRECT /end RECORD_LAYOUT
/begin RECORD_LAYOUT Lookup1D_FLOAT64_IEEE FNC_VALUES 1 FLOAT64_IEEE COLUMN_DIR DIRECT /end RECORD_LAYOUT
/begin RECORD_LAYOUT Lookup1D_X_FLOAT64_IEEE AXIS_PTS_X 1 FLOAT64_IEEE INDEX_INCR DIRECT /end RECORD_LAYOUT
/begin RECORD_LAYOUT Lookup2D_UBYTE FNC_VALUES 1 UBYTE COLUMN_DIR DIRECT /end RECORD_LAYOUT
/begin RECORD_LAYOUT Lookup2D_X_UBYTE AXIS_PTS_X 1 UBYTE INDEX_INCR DIRECT /end RECORD_LAYOUT
/begin RECORD_LAYOUT Lookup2D_BYTE FNC_VALUES 1 SBYTE COLUMN_DIR DIRECT /end RECORD_LAYOUT
/begin RECORD_LAYOUT Lookup2D_X_BYTE AXIS_PTS_X 1 SBYTE INDEX_INCR DIRECT /end RECORD_LAYOUT
/begin RECORD_LAYOUT Lookup2D_UWORD FNC_VALUES 1 UWORD COLUMN_DIR DIRECT /end RECORD_LAYOUT
/begin RECORD_LAYOUT Lookup2D_X_UWORD AXIS_PTS_X 1 UWORD INDEX_INCR DIRECT /end RECORD_LAYOUT
/begin RECORD_LAYOUT Lookup2D_WORD FNC_VALUES 1 SWORD COLUMN_DIR DIRECT /end RECORD_LAYOUT
/begin RECORD_LAYOUT Lookup2D_X_WORD AXIS_PTS_X 1 SWORD INDEX_INCR DIRECT /end RECORD_LAYOUT
/begin RECORD_LAYOUT Lookup2D_ULONG FNC_VALUES 1 ULONG COLUMN_DIR DIRECT /end RECORD_LAYOUT
/begin RECORD_LAYOUT Lookup2D_X_ULONG AXIS_PTS_X 1 ULONG INDEX_INCR DIRECT /end RECORD_LAYOUT
/begin RECORD_LAYOUT Lookup2D_LONG FNC_VALUES 1 SLONG COLUMN_DIR DIRECT /end RECORD_LAYOUT
/begin RECORD_LAYOUT Lookup2D_X_LONG AXIS_PTS_X 1 SLONG INDEX_INCR DIRECT /end RECORD_LAYOUT
/begin RECORD_LAYOUT Lookup2D_FLOAT32_IEEE FNC_VALUES 1 FLOAT32_IEEE COLUMN_DIR DIRECT /end RECORD_LAYOUT
/begin RECORD_LAYOUT Lookup2D_X_FLOAT32_IEEE AXIS_PTS_X 1 FLOAT32_IEEE INDEX_INCR DIRECT /end RECORD_LAYOUT
/begin RECORD_LAYOUT Lookup2D_FLOAT64_IEEE FNC_VALUES 1 FLOAT64_IEEE COLUMN_DIR DIRECT /end RECORD_LAYOUT
/begin RECORD_LAYOUT Lookup2D_X_FLOAT64_IEEE AXIS_PTS_X 1 FLOAT64_IEEE INDEX_INCR DIRECT /end RECORD_LAYOUT
/begin CHARACTERISTIC FDMAka_e_LatchModes "Vehicle modes in which to latch function actions" VAL_BLK 0x0000 /* @ECU_Address@FDMAka_e_LatchModes@ */ Scalar_UBYTE 0 CM_DPSCte_e_VehicleModes 0 12 EXTENDED_LIMITS 0 0 NUMBER 3 /end CHARACTERISTIC
/begin CHARACTERISTIC FDMAka_e_CANDve_e_VCU_InvalidDataVldSQ "Each element of this Signal Quality (SQ) array is associated with a calibratable Function Action (FA)." VAL_BLK 0x0000 /* @ECU_Address@FDMAka_e_CANDve_e_VCU_InvalidDataVldSQ@ */ Scalar_UBYTE 0 CM_SPARte_e_Validity 0 3 EXTENDED_LIMITS 0 0 NUMBER 3 /end CHARACTERISTIC
/begin CHARACTERISTIC FDMAka_e_SWINve_e_GCU_COM_ValiditySQ "Each element of this Signal Quality (SQ) array is associated with a calibratable Function Action (FA)." VAL_BLK 0x0000 /* @ECU_Address@FDMAka_e_SWINve_e_GCU_COM_ValiditySQ@ */ Scalar_UBYTE 0 CM_SPARte_e_Validity 0 3 EXTENDED_LIMITS 0 0 NUMBER 4 /end CHARACTERISTIC
/begin CHARACTERISTIC FDMAka_e_SWINve_e_MCU_COM_ValiditySQ "Each element of this Signal Quality (SQ) array is associated with a calibratable Function Action (FA)." VAL_BLK 0x0000 /* @ECU_Address@FDMAka_e_SWINve_e_MCU_COM_ValiditySQ@ */ Scalar_UBYTE 0 CM_SPARte_e_Validity 0 3 EXTENDED_LIMITS 0 0 NUMBER 4 /end CHARACTERISTIC
/begin CHARACTERISTIC FDMAka_e_SWINve_e_VCU_COM_ValiditySQ "Each element of this Signal Quality (SQ) array is associated with a calibratable Function Action (FA)." VAL_BLK 0x0000 /* @ECU_Address@FDMAka_e_SWINve_e_VCU_COM_ValiditySQ@ */ Scalar_UBYTE 0 CM_SPARte_e_Validity 0 3 EXTENDED_LIMITS 0 0 NUMBER 5 /end CHARACTERISTIC
/begin CHARACTERISTIC FDMAka_e_TAMDve_e_ClutchActPwrStgTempVldSQ "Each element of this Signal Quality (SQ) array is associated with a calibratable Function Action (FA)." VAL_BLK 0x0000 /* @ECU_Address@FDMAka_e_TAMDve_e_ClutchActPwrStgTempVldSQ@ */ Scalar_UBYTE 0 CM_SPARte_e_Validity 0 3 EXTENDED_LIMITS 0 0 NUMBER 3 /end CHARACTERISTIC
/begin CHARACTERISTIC FDMAka_e_TAMDve_e_ClutchActuatorVldSQ "Each element of this Signal Quality (SQ) array is associated with a calibratable Function Action (FA)." VAL_BLK 0x0000 /* @ECU_Address@FDMAka_e_TAMDve_e_ClutchActuatorVldSQ@ */ Scalar_UBYTE 0 CM_SPARte_e_Validity 0 3 EXTENDED_LIMITS 0 0 NUMBER 4 /end CHARACTERISTIC
/begin CHARACTERISTIC FDMAka_e_TCPDve_e_ClutchPressureHighVldSQ "Each element of this Signal Quality (SQ) array is associated with a calibratable Function Action (FA)." VAL_BLK 0x0000 /* @ECU_Address@FDMAka_e_TCPDve_e_ClutchPressureHighVldSQ@ */ Scalar_UBYTE 0 CM_SPARte_e_Validity 0 3 EXTENDED_LIMITS 0 0 NUMBER 2 /end CHARACTERISTIC
/begin CHARACTERISTIC FDMAka_e_TCPDve_e_ClutchPressureLowVldSQ "Each element of this Signal Quality (SQ) array is associated with a calibratable Function Action (FA)." VAL_BLK 0x0000 /* @ECU_Address@FDMAka_e_TCPDve_e_ClutchPressureLowVldSQ@ */ Scalar_UBYTE 0 CM_SPARte_e_Validity 0 3 EXTENDED_LIMITS 0 0 NUMBER 2 /end CHARACTERISTIC
/begin CHARACTERISTIC FDMAka_e_TCPDve_e_ClutchPressureSensPerfVldSQ "Each element of this Signal Quality (SQ) array is associated with a calibratable Function Action (FA)." VAL_BLK 0x0000 /* @ECU_Address@FDMAka_e_TCPDve_e_ClutchPressureSensPerfVldSQ@ */ Scalar_UBYTE 0 CM_SPARte_e_Validity 0 3 EXTENDED_LIMITS 0 0 NUMBER 3 /end CHARACTERISTIC
/begin CHARACTERISTIC FDMAka_e_TCPDve_e_ClutchPressureSensorVldSQ "Each element of this Signal Quality (SQ) array is associated with a calibratable Function Action (FA)." VAL_BLK 0x0000 /* @ECU_Address@FDMAka_e_TCPDve_e_ClutchPressureSensorVldSQ@ */ Scalar_UBYTE 0 CM_SPARte_e_Validity 0 3 EXTENDED_LIMITS 0 0 NUMBER 2 /end CHARACTERISTIC
/begin CHARACTERISTIC FDMAka_e_TOTDve_e_TransmissionTempSensorVldSQ "Each element of this Signal Quality (SQ) array is associated with a calibratable Function Action (FA)." VAL_BLK 0x0000 /* @ECU_Address@FDMAka_e_TOTDve_e_TransmissionTempSensorVldSQ@ */ Scalar_UBYTE 0 CM_SPARte_e_Validity 0 3 EXTENDED_LIMITS 0 0 NUMBER 4 /end CHARACTERISTIC
/begin CHARACTERISTIC FDMAka_e_TSSDve_e_ClutchCapacityInsuffVldSQ "Each element of this Signal Quality (SQ) array is associated with a calibratable Function Action (FA)." VAL_BLK 0x0000 /* @ECU_Address@FDMAka_e_TSSDve_e_ClutchCapacityInsuffVldSQ@ */ Scalar_UBYTE 0 CM_SPARte_e_Validity 0 3 EXTENDED_LIMITS 0 0 NUMBER 3 /end CHARACTERISTIC
/begin CHARACTERISTIC FDMAka_e_TSSDve_e_ClutchDragTrqTooHighVldSQ "Each element of this Signal Quality (SQ) array is associated with a calibratable Function Action (FA)." VAL_BLK 0x0000 /* @ECU_Address@FDMAka_e_TSSDve_e_ClutchDragTrqTooHighVldSQ@ */ Scalar_UBYTE 0 CM_SPARte_e_Validity 0 3 EXTENDED_LIMITS 0 0 NUMBER 3 /end CHARACTERISTIC
/begin CHARACTERISTIC FDMAka_e_V5RDve_e_EC_StatusRef1VldSQ "Each element of this Signal Quality (SQ) array is associated with a calibratable Function Action (FA)." VAL_BLK 0x0000 /* @ECU_Address@FDMAka_e_V5RDve_e_EC_StatusRef1VldSQ@ */ Scalar_UBYTE 0 CM_SPARte_e_Validity 0 3 EXTENDED_LIMITS 0 0 NUMBER 17 /end CHARACTERISTIC
/begin CHARACTERISTIC FDMAka_e_V5RDve_e_EC_StatusRef2VldSQ "Each element of this Signal Quality (SQ) array is associated with a calibratable Function Action (FA)." VAL_BLK 0x0000 /* @ECU_Address@FDMAka_e_V5RDve_e_EC_StatusRef2VldSQ@ */ Scalar_UBYTE 0 CM_SPARte_e_Validity 0 3 EXTENDED_LIMITS 0 0 NUMBER 5 /end CHARACTERISTIC
/begin CHARACTERISTIC FDMAka_e_V5RDve_e_EC_StatusRef3VldSQ "Each element of this Signal Quality (SQ) array is associated with a calibratable Function Action (FA)." VAL_BLK 0x0000 /* @ECU_Address@FDMAka_e_V5RDve_e_EC_StatusRef3VldSQ@ */ Scalar_UBYTE 0 CM_SPARte_e_Validity 0 3 EXTENDED_LIMITS 0 0 NUMBER 4 /end CHARACTERISTIC
/begin CHARACTERISTIC FDMAka_e_CANComErrExtFA "
      Each element of this array will trigger any calibrated Function Action (FA) depending on the associated calibratable Signal Quality (SQ) level
      " VAL_BLK 0x0000 /* @ECU_Address@FDMAka_e_CANComErrExtFA@ */ Scalar_UBYTE 0 CM_FDMAte_e_FunctionAction 0 141 EXTENDED_LIMITS 0 0 NUMBER 4 /end CHARACTERISTIC
/begin CHARACTERISTIC FDMAka_e_CANDve_e_VCU_InvalidDataVldFA "Each element of this array will trigger any calibrated Function Action (FA) depending on the associated calibratable Signal Quality (SQ) level." VAL_BLK 0x0000 /* @ECU_Address@FDMAka_e_CANDve_e_VCU_InvalidDataVldFA@ */ Scalar_UBYTE 0 CM_FDMAte_e_FunctionAction 0 141 EXTENDED_LIMITS 0 0 NUMBER 3 /end CHARACTERISTIC
/begin CHARACTERISTIC FDMAka_e_LV_VltgCntrlErrExtFA "Each element of this array will trigger any calibrated Function Action (FA)" VAL_BLK 0x0000 /* @ECU_Address@FDMAka_e_LV_VltgCntrlErrExtFA@ */ Scalar_UBYTE 0 CM_FDMAte_e_FunctionAction 0 141 EXTENDED_LIMITS 0 0 NUMBER 2 /end CHARACTERISTIC
/begin CHARACTERISTIC FDMAka_e_LV_VltgHiErrExtFA "Each element of this array will trigger any calibrated Function Action (FA)" VAL_BLK 0x0000 /* @ECU_Address@FDMAka_e_LV_VltgHiErrExtFA@ */ Scalar_UBYTE 0 CM_FDMAte_e_FunctionAction 0 141 EXTENDED_LIMITS 0 0 NUMBER 2 /end CHARACTERISTIC
/begin CHARACTERISTIC FDMAka_e_LV_VltgLoCriticalErrExtFA "Each element of this array will trigger any calibrated Function Action (FA)" VAL_BLK 0x0000 /* @ECU_Address@FDMAka_e_LV_VltgLoCriticalErrExtFA@ */ Scalar_UBYTE 0 CM_FDMAte_e_FunctionAction 0 141 EXTENDED_LIMITS 0 0 NUMBER 2 /end CHARACTERISTIC
/begin CHARACTERISTIC FDMAka_e_SWINve_e_GCU_COM_ValidityFA "Each element of this array will trigger any calibrated Function Action (FA) depending on the associated calibratable Signal Quality (SQ) level." VAL_BLK 0x0000 /* @ECU_Address@FDMAka_e_SWINve_e_GCU_COM_ValidityFA@ */ Scalar_UBYTE 0 CM_FDMAte_e_FunctionAction 0 141 EXTENDED_LIMITS 0 0 NUMBER 4 /end CHARACTERISTIC
/begin CHARACTERISTIC FDMAka_e_SWINve_e_MCU_COM_ValidityFA "Each element of this array will trigger any calibrated Function Action (FA) depending on the associated calibratable Signal Quality (SQ) level." VAL_BLK 0x0000 /* @ECU_Address@FDMAka_e_SWINve_e_MCU_COM_ValidityFA@ */ Scalar_UBYTE 0 CM_FDMAte_e_FunctionAction 0 141 EXTENDED_LIMITS 0 0 NUMBER 4 /end CHARACTERISTIC
/begin CHARACTERISTIC FDMAka_e_SWINve_e_VCU_COM_ValidityFA "Each element of this array will trigger any calibrated Function Action (FA) depending on the associated calibratable Signal Quality (SQ) level." VAL_BLK 0x0000 /* @ECU_Address@FDMAka_e_SWINve_e_VCU_COM_ValidityFA@ */ Scalar_UBYTE 0 CM_FDMAte_e_FunctionAction 0 141 EXTENDED_LIMITS 0 0 NUMBER 5 /end CHARACTERISTIC
/begin CHARACTERISTIC FDMAka_e_TAMDve_e_ClutchActPwrStgTempVldFA "Each element of this array will trigger any calibrated Function Action (FA) depending on the associated calibratable Signal Quality (SQ) level." VAL_BLK 0x0000 /* @ECU_Address@FDMAka_e_TAMDve_e_ClutchActPwrStgTempVldFA@ */ Scalar_UBYTE 0 CM_FDMAte_e_FunctionAction 0 141 EXTENDED_LIMITS 0 0 NUMBER 3 /end CHARACTERISTIC
/begin CHARACTERISTIC FDMAka_e_TAMDve_e_ClutchActuatorVldFA "Each element of this array will trigger any calibrated Function Action (FA) depending on the associated calibratable Signal Quality (SQ) level." VAL_BLK 0x0000 /* @ECU_Address@FDMAka_e_TAMDve_e_ClutchActuatorVldFA@ */ Scalar_UBYTE 0 CM_FDMAte_e_FunctionAction 0 141 EXTENDED_LIMITS 0 0 NUMBER 4 /end CHARACTERISTIC
/begin CHARACTERISTIC FDMAka_e_TAMDve_e_MosfetVldFA "
      Each element of this array will trigger any calibrated Function Action (FA) depending on the associated calibratable Signal Quality (SQ) level
      " VAL_BLK 0x0000 /* @ECU_Address@FDMAka_e_TAMDve_e_MosfetVldFA@ */ Scalar_UBYTE 0 CM_FDMAte_e_FunctionAction 0 141 EXTENDED_LIMITS 0 0 NUMBER 4 /end CHARACTERISTIC
/begin CHARACTERISTIC FDMAka_e_TAMDve_e_StuckVldFA "
      Each element of this array will trigger any calibrated Function Action (FA) depending on the associated calibratable Signal Quality (SQ) level
      " VAL_BLK 0x0000 /* @ECU_Address@FDMAka_e_TAMDve_e_StuckVldFA@ */ Scalar_UBYTE 0 CM_FDMAte_e_FunctionAction 0 141 EXTENDED_LIMITS 0 0 NUMBER 4 /end CHARACTERISTIC
/begin CHARACTERISTIC FDMAka_e_TCMDve_e_CoolingActSpdDevVldFA "
      Each element of this array will trigger any calibrated Function Action (FA) depending on the associated calibratable Signal Quality (SQ) level
      " VAL_BLK 0x0000 /* @ECU_Address@FDMAka_e_TCMDve_e_CoolingActSpdDevVldFA@ */ Scalar_UBYTE 0 CM_FDMAte_e_FunctionAction 0 141 EXTENDED_LIMITS 0 0 NUMBER 4 /end CHARACTERISTIC
/begin CHARACTERISTIC FDMAka_e_TCMDve_e_CoolingActuatorVldFA "
      Each element of this array will trigger any calibrated Function Action (FA) depending on the associated calibratable Signal Quality (SQ) level
      " VAL_BLK 0x0000 /* @ECU_Address@FDMAka_e_TCMDve_e_CoolingActuatorVldFA@ */ Scalar_UBYTE 0 CM_FDMAte_e_FunctionAction 0 141 EXTENDED_LIMITS 0 0 NUMBER 4 /end CHARACTERISTIC
/begin CHARACTERISTIC FDMAka_e_TCMDve_e_MosfetVldFA "
      Each element of this array will trigger any calibrated Function Action (FA) depending on the associated calibratable Signal Quality (SQ) level
      " VAL_BLK 0x0000 /* @ECU_Address@FDMAka_e_TCMDve_e_MosfetVldFA@ */ Scalar_UBYTE 0 CM_FDMAte_e_FunctionAction 0 141 EXTENDED_LIMITS 0 0 NUMBER 4 /end CHARACTERISTIC
/begin CHARACTERISTIC FDMAka_e_TCMDve_e_StuckVldFA "
      Each element of this array will trigger any calibrated Function Action (FA) depending on the associated calibratable Signal Quality (SQ) level
      " VAL_BLK 0x0000 /* @ECU_Address@FDMAka_e_TCMDve_e_StuckVldFA@ */ Scalar_UBYTE 0 CM_FDMAte_e_FunctionAction 0 141 EXTENDED_LIMITS 0 0 NUMBER 4 /end CHARACTERISTIC
/begin CHARACTERISTIC FDMAka_e_TCPDve_e_ClutchPressureHighVldFA "Each element of this array will trigger any calibrated Function Action (FA) depending on the associated calibratable Signal Quality (SQ) level." VAL_BLK 0x0000 /* @ECU_Address@FDMAka_e_TCPDve_e_ClutchPressureHighVldFA@ */ Scalar_UBYTE 0 CM_FDMAte_e_FunctionAction 0 141 EXTENDED_LIMITS 0 0 NUMBER 2 /end CHARACTERISTIC
/begin CHARACTERISTIC FDMAka_e_TCPDve_e_ClutchPressureLowVldFA "Each element of this array will trigger any calibrated Function Action (FA) depending on the associated calibratable Signal Quality (SQ) level." VAL_BLK 0x0000 /* @ECU_Address@FDMAka_e_TCPDve_e_ClutchPressureLowVldFA@ */ Scalar_UBYTE 0 CM_FDMAte_e_FunctionAction 0 141 EXTENDED_LIMITS 0 0 NUMBER 2 /end CHARACTERISTIC
/begin CHARACTERISTIC FDMAka_e_TCPDve_e_ClutchPressureSensPerfVldFA "Each element of this array will trigger any calibrated Function Action (FA) depending on the associated calibratable Signal Quality (SQ) level." VAL_BLK 0x0000 /* @ECU_Address@FDMAka_e_TCPDve_e_ClutchPressureSensPerfVldFA@ */ Scalar_UBYTE 0 CM_FDMAte_e_FunctionAction 0 141 EXTENDED_LIMITS 0 0 NUMBER 3 /end CHARACTERISTIC
/begin CHARACTERISTIC FDMAka_e_TCPDve_e_ClutchPressureSensorVldFA "Each element of this array will trigger any calibrated Function Action (FA) depending on the associated calibratable Signal Quality (SQ) level." VAL_BLK 0x0000 /* @ECU_Address@FDMAka_e_TCPDve_e_ClutchPressureSensorVldFA@ */ Scalar_UBYTE 0 CM_FDMAte_e_FunctionAction 0 141 EXTENDED_LIMITS 0 0 NUMBER 2 /end CHARACTERISTIC
/begin CHARACTERISTIC FDMAka_e_TLMDve_e_TransCtrlSysPerfVldFA "Each element of this array will trigger any calibrated Function Action (FA) depending on the associated calibratable Signal Quality (SQ) level" VAL_BLK 0x0000 /* @ECU_Address@FDMAka_e_TLMDve_e_TransCtrlSysPerfVldFA@ */ Scalar_UBYTE 0 CM_FDMAte_e_FunctionAction 0 141 EXTENDED_LIMITS 0 0 NUMBER 4 /end CHARACTERISTIC
/begin CHARACTERISTIC FDMAka_e_TOTDve_e_TransmissionOilTempCritVldFA "
      Each element of this array will trigger any calibrated Function Action (FA) depending on the associated calibratable Signal Quality (SQ) level
      " VAL_BLK 0x0000 /* @ECU_Address@FDMAka_e_TOTDve_e_TransmissionOilTempCritVldFA@ */ Scalar_UBYTE 0 CM_FDMAte_e_FunctionAction 0 141 EXTENDED_LIMITS 0 0 NUMBER 4 /end CHARACTERISTIC
/begin CHARACTERISTIC FDMAka_e_TOTDve_e_TransmissionTempSensorVldFA "Each element of this array will trigger any calibrated Function Action (FA) depending on the associated calibratable Signal Quality (SQ) level." VAL_BLK 0x0000 /* @ECU_Address@FDMAka_e_TOTDve_e_TransmissionTempSensorVldFA@ */ Scalar_UBYTE 0 CM_FDMAte_e_FunctionAction 0 141 EXTENDED_LIMITS 0 0 NUMBER 4 /end CHARACTERISTIC
/begin CHARACTERISTIC FDMAka_e_TSSDve_e_ClutchCapacityInsuffVldFA "Each element of this array will trigger any calibrated Function Action (FA) depending on the associated calibratable Signal Quality (SQ) level." VAL_BLK 0x0000 /* @ECU_Address@FDMAka_e_TSSDve_e_ClutchCapacityInsuffVldFA@ */ Scalar_UBYTE 0 CM_FDMAte_e_FunctionAction 0 141 EXTENDED_LIMITS 0 0 NUMBER 3 /end CHARACTERISTIC
/begin CHARACTERISTIC FDMAka_e_TSSDve_e_ClutchDragTrqTooHighVldFA "Each element of this array will trigger any calibrated Function Action (FA) depending on the associated calibratable Signal Quality (SQ) level." VAL_BLK 0x0000 /* @ECU_Address@FDMAka_e_TSSDve_e_ClutchDragTrqTooHighVldFA@ */ Scalar_UBYTE 0 CM_FDMAte_e_FunctionAction 0 141 EXTENDED_LIMITS 0 0 NUMBER 3 /end CHARACTERISTIC
/begin CHARACTERISTIC FDMAka_e_V5RDve_e_EC_StatusRef1VldFA "Each element of this array will trigger any calibrated Function Action (FA) depending on the associated calibratable Signal Quality (SQ) level." VAL_BLK 0x0000 /* @ECU_Address@FDMAka_e_V5RDve_e_EC_StatusRef1VldFA@ */ Scalar_UBYTE 0 CM_FDMAte_e_FunctionAction 0 141 EXTENDED_LIMITS 0 0 NUMBER 17 /end CHARACTERISTIC
/begin CHARACTERISTIC FDMAka_e_V5RDve_e_EC_StatusRef2VldFA "Each element of this array will trigger any calibrated Function Action (FA) depending on the associated calibratable Signal Quality (SQ) level." VAL_BLK 0x0000 /* @ECU_Address@FDMAka_e_V5RDve_e_EC_StatusRef2VldFA@ */ Scalar_UBYTE 0 CM_FDMAte_e_FunctionAction 0 141 EXTENDED_LIMITS 0 0 NUMBER 5 /end CHARACTERISTIC
/begin CHARACTERISTIC FDMAka_e_V5RDve_e_EC_StatusRef3VldFA "Each element of this array will trigger any calibrated Function Action (FA) depending on the associated calibratable Signal Quality (SQ) level." VAL_BLK 0x0000 /* @ECU_Address@FDMAka_e_V5RDve_e_EC_StatusRef3VldFA@ */ Scalar_UBYTE 0 CM_FDMAte_e_FunctionAction 0 141 EXTENDED_LIMITS 0 0 NUMBER 4 /end CHARACTERISTIC
/begin CHARACTERISTIC FDMAie_e_ETC_ControlMode_ov "Override value" VALUE 0x0000 /* @ECU_Address@FDMAie_e_ETC_ControlMode_ov@ */ Scalar_UBYTE 0 CM_FDMAte_e_ETC_ControlMode 0 10 EXTENDED_LIMITS 0 0 /end CHARACTERISTIC
/begin CHARACTERISTIC FDMAie_Cnt_TicksToDwnsmpl "This slew can be used to slow down the execution of FDMA functions in order to reduce CPU load." VALUE 0x0000 /* @ECU_Address@FDMAie_Cnt_TicksToDwnsmpl@ */ Scalar_SWORD 0 CM_T_Cnt_Num_1_1_s16 0.0 9.0 EXTENDED_LIMITS -32768.0 32767.0 /end CHARACTERISTIC
/begin CHARACTERISTIC FDMAke_t_IncaUpdatePeriod "Periodicity for rolling list measurement variable." VALUE 0x0000 /* @ECU_Address@FDMAke_t_IncaUpdatePeriod@ */ Scalar_SWORD 0 CM_T_t_s_1000_1_s16 0.1 10.0 EXTENDED_LIMITS -32.768 32.767 /end CHARACTERISTIC
/begin CHARACTERISTIC FDMAke_t_InitDelay "Delay for cocking any Function Action. Used for letting all diagnostic routines have time to execute at key on, before their validity outputs are evaluated. This is in order not to latch any faults from previous key cycle." VALUE 0x0000 /* @ECU_Address@FDMAke_t_InitDelay@ */ Scalar_SWORD 0 CM_T_t_s_1000_1_s16 0.0 3.0 EXTENDED_LIMITS -32.768 32.767 /end CHARACTERISTIC
/begin CHARACTERISTIC FDMAke_t_dT_FastRunnable "Execution period of this runnable." VALUE 0x0000 /* @ECU_Address@FDMAke_t_dT_FastRunnable@ */ Scalar_SWORD 0 CM_T_t_s_1000_1_s16 0.001 1.0 EXTENDED_LIMITS -32.768 32.767 /end CHARACTERISTIC
/begin CHARACTERISTIC FDMAke_t_LV_VltgCntrlErrDelay "Delay for taking action on voltage control error." VALUE 0x0000 /* @ECU_Address@FDMAke_t_LV_VltgCntrlErrDelay@ */ Scalar_SWORD 0 CM_T_t_s_10_1_s16 0.0 3000.0 EXTENDED_LIMITS -3276.8 3276.7000000000003 /end CHARACTERISTIC
/begin CHARACTERISTIC FDMAke_Cnt_CtrlMon_100ms_Index "This is the index reported to the control flow function. It should be unique and in the correct order of execution according to the scheduler." VALUE 0x0000 /* @ECU_Address@FDMAke_Cnt_CtrlMon_100ms_Index@ */ Scalar_UBYTE 0 CM_T_Cnt_Num_1_1_u8 0.0 255.0 /end CHARACTERISTIC
/begin CHARACTERISTIC FDMAke_Cnt_CtrlMon_10ms_Index "This is the index reported to the control flow function. It should be unique and in the correct order of execution according to the scheduler." VALUE 0x0000 /* @ECU_Address@FDMAke_Cnt_CtrlMon_10ms_Index@ */ Scalar_UBYTE 0 CM_T_Cnt_Num_1_1_u8 0.0 255.0 /end CHARACTERISTIC
/begin CHARACTERISTIC FDMAie_b_CtrlMon_100ms_BlockReport "This override blocks the report of the execution to the monitoring system.
      Should be used during testing to verify correct behaviour of the monitoring system.
      " VALUE 0x0000 /* @ECU_Address@FDMAie_b_CtrlMon_100ms_BlockReport@ */ Scalar_BOOLEAN 0 CM_T_BOOLEAN 0.0 1.0 /end CHARACTERISTIC
/begin CHARACTERISTIC FDMAie_b_CtrlMon_10ms_BlockReport "This override blocks the report of the execution to the monitoring system.
      Should be used during testing to verify correct behaviour of the monitoring system.
      " VALUE 0x0000 /* @ECU_Address@FDMAie_b_CtrlMon_10ms_BlockReport@ */ Scalar_BOOLEAN 0 CM_T_BOOLEAN 0.0 1.0 /end CHARACTERISTIC
/begin COMPU_METHOD CM_DPSCte_e_VehicleModes "Enumerated data type: DPSCte_e_VehicleModes" TAB_VERB "%0.6" "" COMPU_TAB_REF VTAB_FOR_CM_DPSCte_e_VehicleModes /end COMPU_METHOD
/begin COMPU_VTAB VTAB_FOR_CM_DPSCte_e_VehicleModes "Enumerated data type: DPSCte_e_VehicleModes" TAB_VERB 7 0 "DPSCce_e_VehMd_Off" 3 "DPSCce_e_VehMd_Afterrun" 5 "DPSCce_e_VehMd_Postrun" 6 "DPSCce_e_VehMd_Standby" 9 "DPSCce_e_VehMd_Charging" 10 "DPSCce_e_VehMd_Propulsion" 12 "DPSCce_e_VehMd_220AcOutput" /end COMPU_VTAB
/begin COMPU_METHOD CM_SPARte_e_Validity "Enumerated data type: SPARte_e_Validity" TAB_VERB "%0.6" "" COMPU_TAB_REF VTAB_FOR_CM_SPARte_e_Validity /end COMPU_METHOD
/begin COMPU_VTAB VTAB_FOR_CM_SPARte_e_Validity "Enumerated data type: SPARte_e_Validity" TAB_VERB 4 0 "SPARce_e_Valid" 1 "SPARce_e_Invalid" 2 "SPARce_e_EstimatedReplaceValue" 3 "SPARce_e_NotEvaluatedYet" /end COMPU_VTAB
/begin COMPU_METHOD CM_FDMAte_e_FunctionAction "Enumerated data type: FDMAte_e_FunctionAction" TAB_VERB "%0.6" "" COMPU_TAB_REF VTAB_FOR_CM_FDMAte_e_FunctionAction /end COMPU_METHOD
/begin COMPU_VTAB VTAB_FOR_CM_FDMAte_e_FunctionAction "Enumerated data type: FDMAte_e_FunctionAction" TAB_VERB 142 0 "FDMAce_e_NoAction" 1 "FDMAce_e_ForceAirEstimationByMAP_SensorToOff" 2 "FDMAce_e_ForceAC_CompressorToOff" 3 "FDMAce_e_ForceAC_LoadCompensationToOff" 4 "FDMAce_e_ForceCamPositionToParked" 5 "FDMAce_e_ForceCruiseControlToOff" 6 "FDMAce_e_ForceEngineTorqueReductionToMedium" 7 "FDMAce_e_ForceFuelControlToOpenLoop" 8 "FDMAce_e_ForceFuelPressureActivationToOff" 9 "FDMAce_e_ForceIdleControlToElevatedMode" 10 "FDMAce_e_ForceIgnitionToLowOctane" 11 "FDMAce_e_ForceIgnitionToOffCylinder1" 12 "FDMAce_e_ForceIgnitionToOffCylinder2" 13 "FDMAce_e_ForceIgnitionToOffCylinder3" 14 "FDMAce_e_ForceIgnitionToOffCylinder4" 15 "FDMAce_e_ForceLongTermAdaptionToOff" 16 "FDMAce_e_ForcePowerSteeringCompensationToOff" 17 "FDMAce_e_ForcePurgeControlToOff" 18 "FDMAce_e_ForceRearO2SensorFuelControlToOff" 19 "FDMAce_e_ForceThrottleMassAirFlowToDefaultAir" 20 "FDMAce_e_ForceUnderHoodCoolingToHigh" 21 "FDMAce_e_SetAutoTransTorqueRequestToNoRequest" 22 "FDMAce_e_SetDriversRequestToZero" 23 "FDMAce_e_SetFuelMassToZeroCylinder1" 24 "FDMAce_e_SetFuelMassToZeroCylinder2" 25 "FDMAce_e_SetFuelMassToZeroCylinder3" 26 "FDMAce_e_SetFuelMassToZeroCylinder4" 27 "FDMAce_e_SetICETrqCapToSafeVal" 28 "FDMAce_e_SetESP_TCS_TorqueRequestToNoRequest" 29 "FDMAce_e_ForceElectricThermostatToOff" 30 "FDMAce_e_LockoutEngineStateChange" 31 "FDMAce_e_ForceEngineRunning" 32 "FDMAce_e_ForceGearRecommendationToOff" 33 "FDMAce_e_ForceIgnitionToOff" 34 "FDMAce_e_ForceBoostTorqueOff" 35 "FDMAce_e_ForceBrakeRegenerationTorqueOff" 36 "FDMAce_e_ForceCoastRegenerationTorqueOff" 37 "FDMAce_e_ForceContactorsOpen" 38 "FDMAce_e_ForceDCDC_ON" 39 "FDMAce_e_ForceEngTransientLimOff" 40 "FDMAce_e_ForceHVBattSOC_ControlOff" 41 "FDMAce_e_ForceHybridOptimizationTrqOff" 42 "FDMAce_e_ForceLftDrvnWhlSpdInfoExclusion" 43 "FDMAce_e_ForceLftNnDrvnWhlSpdInfoExclusion" 44 "FDMAce_e_ForceP1ElectricTorqueReserveOff" 45 "FDMAce_e_ForceP3MtrSpdInfoExclusion" 46 "FDMAce_e_ForcePropulsionAllowedToNotAllowed" 47 "FDMAce_e_ForceRghtDrvnWhlSpdInfoExclusion" 48 "FDMAce_e_ForceRghtNnDrvnWhlSpdInfoExclusion" 49 "FDMAce_e_ForceVehicleSpeedInfoExclusion" 50 "FDMAce_e_LimitHV_BattSOC_CntrlAuthorityToLow" 51 "FDMAce_e_LockoutPropulsionSystemStart" 52 "FDMAce_e_LockoutSpdDepCntctrAfterrun" 53 "FDMAce_e_SetDCDC_ActualLoadDefaultVal" 54 "FDMAce_e_SetDCDCChargeVoltageHigh" 55 "FDMAce_e_SetElectricTorqueRequestZero" 56 "FDMAce_e_SetHVBattElectricPowerLimToHalf" 57 "FDMAce_e_ForcePropModeCalcToExcludeVehSpd" 58 "FDMAce_e_SetLoTempCoolantCircuitPumpFlowHigh" 59 "FDMAce_e_SetAccPedPosToZero" 60 "FDMAce_e_ForceElectricLoadCompensationToOff" 61 "FDMAce_e_ForceEngTrqRdctnToMediumUnlatched" 62 "FDMAce_e_ForceBackupPowerModeToActive" 63 "FDMAce_e_ForceBoostPressureControlToLowPressure" 64 "FDMAce_e_ForceElectricThermostatControlToLowTemp" 65 "FDMAce_e_ForceEngCoolantTempToEstimationModel" 66 "FDMAce_e_ForceFuelRailPressureFeedbackExclusion" 67 "FDMAce_e_ForceIntelligentGeneratorControlToDefault" 68 "FDMAce_e_ForceTCU_CreepTorqueControlToOff" 69 "FDMAce_e_SetAutoTransIdleSpdRqstToNoRqst" 70 "FDMAce_e_LockoutStopStartEngineStateChange" 71 "FDMAce_e_SetMAT_ToTempBeforeThrottle" 72 "FDMAce_e_ForceEngineStop" 73 "FDMAce_e_ForceFrntO2SnsrBnk1ToPrtctnMd" 74 "FDMAce_e_ForceHiPressFuelPumpEnblToDisable" 75 "FDMAce_e_ForcePowerModeLock" 76 "FDMAce_e_ForceDCDC_ControlToDefault" 77 "FDMAce_e_SetP1ElectricMotorCapabilityToZero" 78 "FDMAce_e_ForceP1ElectricMotorToNeutral" 79 "FDMAce_e_ForceEGR_ControlToOff" 80 "FDMAce_e_ForceElectricVacuumPumpOff" 81 "FDMAce_e_ForcePF_ActiveRegenOff" 82 "FDMAce_e_ForcePF_PrssrSnsrAdptnOff" 83 "FDMAce_e_ForcePF_PrssrSnsrBasedSootEstOff" 84 "FDMAce_e_ForceElectricVacuumPumpPulseMode" 85 "FDMAce_e_ForceNeutralGear" 86 "FDMAce_e_ForceEngineTorqueFillOff" 87 "FDMAce_e_ForceAntiJerkControlOff" 88 "FDMAce_e_ForceAC_CompressorCpbyPrioHigh" 89 "FDMAce_e_SetP3ElectricMotorCapabilityToZero" 90 "FDMAce_e_ForceCreepControlToOff" 91 "FDMAce_e_ForceDCDC_BuckConversionOff" 92 "FDMAce_e_ForceHVAC_ElectricHeaterOff" 93 "FDMAce_e_ForceActiveDischarge" 94 "FDMAce_e_SetShftLvrPstnToLstKnwnVal" 95 "FDMAce_e_SetShftLvrPstnToN" 96 "FDMAce_e_SetShftLvrPstnToP" 97 "FDMAce_e_ForceClutchOddOpen" 98 "FDMAce_e_ForceCntctrsOpnngCmd" 99 "FDMAce_e_ForceCntctrsOpnngCmdWthActvDschrg" 100 "FDMAce_e_ForceCntctrsOpnngRqst" 101 "FDMAce_e_ForceAutonomousModeOff" 102 "FDMAce_e_ForceElectricSteeringPowerToOff" 103 "FDMAce_e_ForceAutParkAsstToOff" 104 "FDMAce_e_ForceHrdwrdBrkVcmInfoExclusion" 105 "FDMAce_e_LimitVhclSpdToLmpHmSpd" 106 "FDMAce_e_LimitHV_BattCurrToSfCntctrOpnng" 107 "FDMAce_e_ForceTransIOCControlToOff" 108 "FDMAce_e_ForceGCUTorqueToExclusionFromTransPresTarget" 109 "FDMAce_e_ForceTransOilCoolingToSafeCoolingMode" 110 "FDMAce_e_ForceTransOilLubricationtoSafeLubricationMode" 111 "FDMAce_e_ForceHiTmpRdtrClntFlwHi" 112 "FDMAce_e_ForceStoichiometricCombustion" 113 "FDMAce_e_ForceRrO2SnsrBnk1ToPrtctnMd" 114 "FDMAce_e_ForceAVH_RltdDrvrRqTrqRtLmtrOff" 115 "FDMAce_e_FDMAve_b_ForceSteeringAssistToOff" 116 "FDMAce_e_LimitSteeringAssistToLow" 117 "FDMAce_e_ForceHiTmpRdtrFanOff" 118 "FDMAce_e_SetAPA_TorqueRequestToNoRequest" 119 "FDMAce_e_ForceEngineTorqueReductionToModerate" 120 "FDMAce_e_SetHV_BattCurrRxToZero" 121 "FDMAce_e_SetAC_EvapTempToDefaultTemp" 122 "FDMAce_e_LimitP1ShaftSpeedToLow" 123 "FDMAce_e_LimitVhclSpdToMedium" 124 "FDMAce_e_LimitVhclSpdToModerate" 125 "FDMAce_e_ForceFuelCutAllowed" 126 "FDMAce_e_ForceHonorImmediate" 127 "FDMAce_e_ForceIntelligentECU_ModeOff" 128 "FDMAce_e_SetHVBattElectricPowerToLim" 129 "FDMAce_e_SetP4ElectricMotorCapabilityToZero" 130 "FDMAce_e_ForceFrontDiffLockOpen" 131 "FDMAce_e_ForceRearDiffLockOpen" 132 "FDMAce_e_ForceDCDC2_BuckConversionOff" 133 "FDMAce_e_ForceDCDC2_ControlToDefault" 134 "FDMAce_e_SetFrontAxleToN" 135 "FDMAce_e_SetRearAxleToN" 136 "FDMAce_e_ForceCCPCancleSpdLimit" 137 "FDMAce_e_LimitHV_BattCurrToSfCntctrOpnngUnltchd" 138 "FDMAce_e_SetElectricMotorCapabilityToZero" 139 "FDMAce_e_ForceMosfetOff" 140 "FDMAce_e_ForceSafeclockOff" 141 "FDMAce_e_SetSoftwareASC" /end COMPU_VTAB
/begin COMPU_METHOD CM_FDMAte_e_ETC_ControlMode "Enumerated data type: FDMAte_e_ETC_ControlMode" TAB_VERB "%0.6" "" COMPU_TAB_REF VTAB_FOR_CM_FDMAte_e_ETC_ControlMode /end COMPU_METHOD
/begin COMPU_VTAB VTAB_FOR_CM_FDMAte_e_ETC_ControlMode "Enumerated data type: FDMAte_e_ETC_ControlMode" TAB_VERB 6 0 "FDMAce_e_ECM_ForcedEngShutdown" 3 "FDMAce_e_ECM_ForcedIdlePwrMng" 5 "FDMAce_e_ECM_ForcedIdle" 6 "FDMAce_e_ECM_LimitPerfPwrMng" 9 "FDMAce_e_ECM_LimitPerf" 10 "FDMAce_e_ECM_Normal" /end COMPU_VTAB
/begin COMPU_METHOD CM_T_Cnt_Num_1_1_s16 "Q = V" RAT_FUNC "%5.0" "Num (counts)" COEFFS 0 1 0 0 0 1 /end COMPU_METHOD
/begin COMPU_METHOD CM_T_t_s_1000_1_s16 "Q = V*1000.000000" RAT_FUNC "%0.6" "s (seconds  (s))" COEFFS 0 1000 0 0 0 1 /end COMPU_METHOD
/begin COMPU_METHOD CM_T_t_s_10_1_s16 "Q = V*10.000000" RAT_FUNC "%0.6" "s (seconds  (s))" COEFFS 0 10 0 0 0 1 /end COMPU_METHOD
/begin COMPU_METHOD CM_T_Cnt_Num_1_1_u8 "Q = V" RAT_FUNC "%3.0" "Num (counts)" COEFFS 0 1 0 0 0 1 /end COMPU_METHOD
/begin COMPU_METHOD CM_T_BOOLEAN "Q = V" RAT_FUNC "%1.0" "Bool" COEFFS 0 1 0 0 0 1 /end COMPU_METHOD
/* EOF FDMA.a2l */
/begin RECORD_LAYOUT Scalar_BOOLEAN FNC_VALUES 1 UBYTE COLUMN_DIR DIRECT /end RECORD_LAYOUT
/begin RECORD_LAYOUT Scalar_UBYTE FNC_VALUES 1 UBYTE COLUMN_DIR DIRECT /end RECORD_LAYOUT
/begin RECORD_LAYOUT Scalar_BYTE FNC_VALUES 1 SBYTE COLUMN_DIR DIRECT /end RECORD_LAYOUT
/begin RECORD_LAYOUT Scalar_UWORD FNC_VALUES 1 UWORD COLUMN_DIR DIRECT /end RECORD_LAYOUT
/begin RECORD_LAYOUT Scalar_SWORD FNC_VALUES 1 SWORD COLUMN_DIR DIRECT /end RECORD_LAYOUT
/begin RECORD_LAYOUT Scalar_LONG FNC_VALUES 1 SLONG COLUMN_DIR DIRECT /end RECORD_LAYOUT
/begin RECORD_LAYOUT Scalar_FLOAT32_IEEE FNC_VALUES 1 FLOAT32_IEEE COLUMN_DIR DIRECT /end RECORD_LAYOUT
/begin RECORD_LAYOUT Scalar_FLOAT64_IEEE FNC_VALUES 1 FLOAT64_IEEE COLUMN_DIR DIRECT /end RECORD_LAYOUT
/begin RECORD_LAYOUT Lookup1D_BYTE FNC_VALUES 1 SBYTE COLUMN_DIR DIRECT /end RECORD_LAYOUT
/begin RECORD_LAYOUT Lookup1D_X_BYTE AXIS_PTS_X 1 SBYTE INDEX_INCR DIRECT /end RECORD_LAYOUT
/begin RECORD_LAYOUT Lookup1D_X_UBYTE AXIS_PTS_X 1 UBYTE INDEX_INCR DIRECT /end RECORD_LAYOUT
/begin RECORD_LAYOUT Lookup1D_UWORD FNC_VALUES 1 UWORD COLUMN_DIR DIRECT /end RECORD_LAYOUT
/begin RECORD_LAYOUT Lookup1D_X_UWORD AXIS_PTS_X 1 UWORD INDEX_INCR DIRECT /end RECORD_LAYOUT
/begin RECORD_LAYOUT Lookup1D_WORD FNC_VALUES 1 SWORD COLUMN_DIR DIRECT /end RECORD_LAYOUT
/begin RECORD_LAYOUT Lookup1D_X_WORD AXIS_PTS_X 1 SWORD INDEX_INCR DIRECT /end RECORD_LAYOUT
/begin RECORD_LAYOUT Lookup1D_ULONG FNC_VALUES 1 ULONG COLUMN_DIR DIRECT /end RECORD_LAYOUT
/begin RECORD_LAYOUT Lookup1D_X_ULONG AXIS_PTS_X 1 ULONG INDEX_INCR DIRECT /end RECORD_LAYOUT
/begin RECORD_LAYOUT Lookup1D_SLONG FNC_VALUES 1 SLONG COLUMN_DIR DIRECT /end RECORD_LAYOUT
/begin RECORD_LAYOUT Lookup1D_X_LONG AXIS_PTS_X 1 SLONG INDEX_INCR DIRECT /end RECORD_LAYOUT
/begin RECORD_LAYOUT Lookup1D_FLOAT32_IEEE FNC_VALUES 1 FLOAT32_IEEE COLUMN_DIR DIRECT /end RECORD_LAYOUT
/begin RECORD_LAYOUT Lookup1D_X_FLOAT32_IEEE AXIS_PTS_X 1 FLOAT32_IEEE INDEX_INCR DIRECT /end RECORD_LAYOUT
/begin RECORD_LAYOUT Lookup1D_FLOAT64_IEEE FNC_VALUES 1 FLOAT64_IEEE COLUMN_DIR DIRECT /end RECORD_LAYOUT
/begin RECORD_LAYOUT Lookup1D_X_FLOAT64_IEEE AXIS_PTS_X 1 FLOAT64_IEEE INDEX_INCR DIRECT /end RECORD_LAYOUT
/begin RECORD_LAYOUT Lookup2D_UBYTE FNC_VALUES 1 UBYTE COLUMN_DIR DIRECT /end RECORD_LAYOUT
/begin RECORD_LAYOUT Lookup2D_X_UBYTE AXIS_PTS_X 1 UBYTE INDEX_INCR DIRECT /end RECORD_LAYOUT
/begin RECORD_LAYOUT Lookup2D_BYTE FNC_VALUES 1 SBYTE COLUMN_DIR DIRECT /end RECORD_LAYOUT
/begin RECORD_LAYOUT Lookup2D_X_BYTE AXIS_PTS_X 1 SBYTE INDEX_INCR DIRECT /end RECORD_LAYOUT
/begin RECORD_LAYOUT Lookup2D_UWORD FNC_VALUES 1 UWORD COLUMN_DIR DIRECT /end RECORD_LAYOUT
/begin RECORD_LAYOUT Lookup2D_X_UWORD AXIS_PTS_X 1 UWORD INDEX_INCR DIRECT /end RECORD_LAYOUT
/begin RECORD_LAYOUT Lookup2D_WORD FNC_VALUES 1 SWORD COLUMN_DIR DIRECT /end RECORD_LAYOUT
/begin RECORD_LAYOUT Lookup2D_X_WORD AXIS_PTS_X 1 SWORD INDEX_INCR DIRECT /end RECORD_LAYOUT
/begin RECORD_LAYOUT Lookup2D_ULONG FNC_VALUES 1 ULONG COLUMN_DIR DIRECT /end RECORD_LAYOUT
/begin RECORD_LAYOUT Lookup2D_X_ULONG AXIS_PTS_X 1 ULONG INDEX_INCR DIRECT /end RECORD_LAYOUT
/begin RECORD_LAYOUT Lookup2D_LONG FNC_VALUES 1 SLONG COLUMN_DIR DIRECT /end RECORD_LAYOUT
/begin RECORD_LAYOUT Lookup2D_X_LONG AXIS_PTS_X 1 SLONG INDEX_INCR DIRECT /end RECORD_LAYOUT
/begin RECORD_LAYOUT Lookup2D_FLOAT32_IEEE FNC_VALUES 1 FLOAT32_IEEE COLUMN_DIR DIRECT /end RECORD_LAYOUT
/begin RECORD_LAYOUT Lookup2D_X_FLOAT32_IEEE AXIS_PTS_X 1 FLOAT32_IEEE INDEX_INCR DIRECT /end RECORD_LAYOUT
/begin RECORD_LAYOUT Lookup2D_FLOAT64_IEEE FNC_VALUES 1 FLOAT64_IEEE COLUMN_DIR DIRECT /end RECORD_LAYOUT
/begin RECORD_LAYOUT Lookup2D_X_FLOAT64_IEEE AXIS_PTS_X 1 FLOAT64_IEEE INDEX_INCR DIRECT /end RECORD_LAYOUT
/begin COMPU_METHOD CM_T_n_rpm_1_1_s16 "Q = V" RAT_FUNC "%5.0" "rpm (revolutions / minute  (rpm))" COEFFS 0 1 0 0 0 1 /end COMPU_METHOD
/begin COMPU_METHOD CM_SPARte_e_Validity "Enumerated data type: SPARte_e_Validity" TAB_VERB "%0.6" "" COMPU_TAB_REF VTAB_FOR_CM_SPARte_e_Validity /end COMPU_METHOD
/begin COMPU_VTAB VTAB_FOR_CM_SPARte_e_Validity "Enumerated data type: SPARte_e_Validity" TAB_VERB 4 0 "SPARce_e_Valid" 1 "SPARce_e_Invalid" 2 "SPARce_e_EstimatedReplaceValue" 3 "SPARce_e_NotEvaluatedYet" /end COMPU_VTAB
/begin COMPU_METHOD CM_T_Cnt_Num_1_1_u8 "Q = V" RAT_FUNC "%3.0" "Num (counts)" COEFFS 0 1 0 0 0 1 /end COMPU_METHOD
/begin COMPU_METHOD CM_T_BOOLEAN "Q = V" RAT_FUNC "%1.0" "Bool" COEFFS 0 1 0 0 0 1 /end COMPU_METHOD
/begin RECORD_LAYOUT DATA_RECORD_SBYTE FNC_VALUES 1 SBYTE ROW_DIR DIRECT /end RECORD_LAYOUT
/begin RECORD_LAYOUT DATA_RECORD_FLOAT64_IEEE FNC_VALUES 1 FLOAT64_IEEE ROW_DIR DIRECT /end RECORD_LAYOUT
/begin RECORD_LAYOUT AXIS_PTS_X_UBYTE_VEMS AXIS_PTS_X 1 UBYTE INDEX_INCR DIRECT /end RECORD_LAYOUT
/begin RECORD_LAYOUT AXIS_PTS_X_SBYTE_VEMS AXIS_PTS_X 1 SBYTE INDEX_INCR DIRECT /end RECORD_LAYOUT
/begin RECORD_LAYOUT AXIS_PTS_X_UWORD_VEMS AXIS_PTS_X 1 UWORD INDEX_INCR DIRECT /end RECORD_LAYOUT
/begin RECORD_LAYOUT AXIS_PTS_X_SWORD_VEMS AXIS_PTS_X 1 SWORD INDEX_INCR DIRECT /end RECORD_LAYOUT
/begin RECORD_LAYOUT AXIS_PTS_X_ULONG_VEMS AXIS_PTS_X 1 ULONG INDEX_INCR DIRECT /end RECORD_LAYOUT
/begin RECORD_LAYOUT AXIS_PTS_X_SLONG_VEMS AXIS_PTS_X 1 SLONG INDEX_INCR DIRECT /end RECORD_LAYOUT
/begin RECORD_LAYOUT AXIS_PTS_X_FLOAT32_IEEE_VEMS AXIS_PTS_X 1 FLOAT32_IEEE INDEX_INCR DIRECT /end RECORD_LAYOUT
/begin RECORD_LAYOUT AXIS_PTS_X_FLOAT64_IEEE_VEMS AXIS_PTS_X 1 FLOAT64_IEEE INDEX_INCR DIRECT /end RECORD_LAYOUT
/begin RECORD_LAYOUT AXIS_PTS_X_UBYTE NO_AXIS_PTS_X 1 UBYTE AXIS_PTS_X 2 UBYTE INDEX_INCR DIRECT /end RECORD_LAYOUT
/begin RECORD_LAYOUT AXIS_PTS_X_SBYTE NO_AXIS_PTS_X 1 SBYTE AXIS_PTS_X 2 SBYTE INDEX_INCR DIRECT /end RECORD_LAYOUT
/begin RECORD_LAYOUT AXIS_PTS_X_UWORD NO_AXIS_PTS_X 1 UWORD AXIS_PTS_X 2 UWORD INDEX_INCR DIRECT /end RECORD_LAYOUT
/begin RECORD_LAYOUT AXIS_PTS_X_SWORD NO_AXIS_PTS_X 1 SWORD AXIS_PTS_X 2 SWORD INDEX_INCR DIRECT /end RECORD_LAYOUT
/begin RECORD_LAYOUT AXIS_PTS_X_ULONG NO_AXIS_PTS_X 1 ULONG AXIS_PTS_X 2 ULONG INDEX_INCR DIRECT /end RECORD_LAYOUT
/begin RECORD_LAYOUT AXIS_PTS_X_SLONG NO_AXIS_PTS_X 1 SLONG AXIS_PTS_X 2 SLONG INDEX_INCR DIRECT /end RECORD_LAYOUT
/begin RECORD_LAYOUT AXIS_PTS_X_FLOAT32_IEEE NO_AXIS_PTS_X 1 FLOAT32_IEEE AXIS_PTS_X 2 FLOAT32_IEEE INDEX_INCR DIRECT /end RECORD_LAYOUT
/begin RECORD_LAYOUT AXIS_PTS_X_FLOAT64_IEEE NO_AXIS_PTS_X 1 FLOAT64_IEEE AXIS_PTS_X 2 FLOAT64_IEEE INDEX_INCR DIRECT /end RECORD_LAYOUT
/begin RECORD_LAYOUT Scalar_BOOLEAN FNC_VALUES 1 UBYTE COLUMN_DIR DIRECT /end RECORD_LAYOUT
/begin RECORD_LAYOUT Scalar_UBYTE FNC_VALUES 1 UBYTE COLUMN_DIR DIRECT /end RECORD_LAYOUT
/begin RECORD_LAYOUT Scalar_BYTE FNC_VALUES 1 SBYTE COLUMN_DIR DIRECT /end RECORD_LAYOUT
/begin RECORD_LAYOUT Scalar_UWORD FNC_VALUES 1 UWORD COLUMN_DIR DIRECT /end RECORD_LAYOUT
/begin RECORD_LAYOUT Scalar_SWORD FNC_VALUES 1 SWORD COLUMN_DIR DIRECT /end RECORD_LAYOUT
/begin RECORD_LAYOUT Scalar_LONG FNC_VALUES 1 SLONG COLUMN_DIR DIRECT /end RECORD_LAYOUT
/begin RECORD_LAYOUT Scalar_FLOAT32_IEEE FNC_VALUES 1 FLOAT32_IEEE COLUMN_DIR DIRECT /end RECORD_LAYOUT
/begin RECORD_LAYOUT Scalar_FLOAT64_IEEE FNC_VALUES 1 FLOAT64_IEEE COLUMN_DIR DIRECT /end RECORD_LAYOUT
/begin RECORD_LAYOUT Lookup1D_BYTE FNC_VALUES 1 SBYTE COLUMN_DIR DIRECT /end RECORD_LAYOUT
/begin RECORD_LAYOUT Lookup1D_X_BYTE AXIS_PTS_X 1 SBYTE INDEX_INCR DIRECT /end RECORD_LAYOUT
/begin RECORD_LAYOUT Lookup1D_X_UBYTE AXIS_PTS_X 1 UBYTE INDEX_INCR DIRECT /end RECORD_LAYOUT
/begin RECORD_LAYOUT Lookup1D_UWORD FNC_VALUES 1 UWORD COLUMN_DIR DIRECT /end RECORD_LAYOUT
/begin RECORD_LAYOUT Lookup1D_X_UWORD AXIS_PTS_X 1 UWORD INDEX_INCR DIRECT /end RECORD_LAYOUT
/begin RECORD_LAYOUT Lookup1D_WORD FNC_VALUES 1 SWORD COLUMN_DIR DIRECT /end RECORD_LAYOUT
/begin RECORD_LAYOUT Lookup1D_X_WORD AXIS_PTS_X 1 SWORD INDEX_INCR DIRECT /end RECORD_LAYOUT
/begin RECORD_LAYOUT Lookup1D_ULONG FNC_VALUES 1 ULONG COLUMN_DIR DIRECT /end RECORD_LAYOUT
/begin RECORD_LAYOUT Lookup1D_X_ULONG AXIS_PTS_X 1 ULONG INDEX_INCR DIRECT /end RECORD_LAYOUT
/begin RECORD_LAYOUT Lookup1D_SLONG FNC_VALUES 1 SLONG COLUMN_DIR DIRECT /end RECORD_LAYOUT
/begin RECORD_LAYOUT Lookup1D_X_LONG AXIS_PTS_X 1 SLONG INDEX_INCR DIRECT /end RECORD_LAYOUT
/begin RECORD_LAYOUT Lookup1D_FLOAT32_IEEE FNC_VALUES 1 FLOAT32_IEEE COLUMN_DIR DIRECT /end RECORD_LAYOUT
/begin RECORD_LAYOUT Lookup1D_X_FLOAT32_IEEE AXIS_PTS_X 1 FLOAT32_IEEE INDEX_INCR DIRECT /end RECORD_LAYOUT
/begin RECORD_LAYOUT Lookup1D_FLOAT64_IEEE FNC_VALUES 1 FLOAT64_IEEE COLUMN_DIR DIRECT /end RECORD_LAYOUT
/begin RECORD_LAYOUT Lookup1D_X_FLOAT64_IEEE AXIS_PTS_X 1 FLOAT64_IEEE INDEX_INCR DIRECT /end RECORD_LAYOUT
/begin RECORD_LAYOUT Lookup2D_UBYTE FNC_VALUES 1 UBYTE COLUMN_DIR DIRECT /end RECORD_LAYOUT
/begin RECORD_LAYOUT Lookup2D_UWORD FNC_VALUES 1 UWORD COLUMN_DIR DIRECT /end RECORD_LAYOUT
/begin RECORD_LAYOUT Lookup2D_X_UWORD AXIS_PTS_X 1 UWORD INDEX_INCR DIRECT /end RECORD_LAYOUT
/begin RECORD_LAYOUT Lookup2D_WORD FNC_VALUES 1 SWORD COLUMN_DIR DIRECT /end RECORD_LAYOUT
/begin RECORD_LAYOUT Lookup2D_X_WORD AXIS_PTS_X 1 SWORD INDEX_INCR DIRECT /end RECORD_LAYOUT
/begin COMPU_METHOD CM_T_n_rpm_1_1_s16 "Q = V" RAT_FUNC "%5.0" "rpm (revolutions / minute  (rpm))" COEFFS 0 1 0 0 0 1 /end COMPU_METHOD
/begin COMPU_METHOD CM_T_Cnt_Num_1_1_u16 "Q = V" RAT_FUNC "%5.0" "Num (counts)" COEFFS 0 1 0 0 0 1 /end COMPU_METHOD
/begin COMPU_METHOD CM_T_p_kPa_32_1_u16 "Q = V*32.000000" RAT_FUNC "%9.5" "kPa (kiloPascals  (kPa))" COEFFS 0 32 0 0 0 1 /end COMPU_METHOD
/begin COMPU_METHOD CM_T_M_Nm_32_1_s16 "Q = V*32.000000" RAT_FUNC "%9.5" "Nm (newton-meters  (Nm))" COEFFS 0 32 0 0 0 1 /end COMPU_METHOD
/begin COMPU_METHOD CM_T_T_degC_16_1_s16 "Q = V*16.000000" RAT_FUNC "%8.4" "degC (degrees Celsius  (deg C))" COEFFS 0 16 0 0 0 1 /end COMPU_METHOD
/begin COMPU_METHOD CM_T_U_V_512_1_s16 "Q = V*512.000000" RAT_FUNC "%12.9" "V (volts  (V))" COEFFS 0 512 0 0 0 1 /end COMPU_METHOD
/begin COMPU_METHOD CM_T_v_kph_64_1_s16 "Q = V*64.000000" RAT_FUNC "%10.6" "kph (kilometers / hour  (kph))" COEFFS 0 64 0 0 0 1 /end COMPU_METHOD
/begin COMPU_METHOD CM_T_l_m_1024_1_s16 "Q = V*1024.000000" RAT_FUNC "%12.10" "m (meters  (m))" COEFFS 0 1024 0 0 0 1 /end COMPU_METHOD
/begin COMPU_METHOD CM_T_r_NA_1024_1_s16 "Q = V*1024.000000" RAT_FUNC "%12.10" "NA (none)" COEFFS 0 1024 0 0 0 1 /end COMPU_METHOD
/begin COMPU_METHOD CM_T_BOOLEAN "Q = V" RAT_FUNC "%1.0" "Bool" COEFFS 0 1 0 0 0 1 /end COMPU_METHOD
/* EOF SWIN.a2l */
/begin RECORD_LAYOUT Scalar_BOOLEAN FNC_VALUES 1 UBYTE COLUMN_DIR DIRECT /end RECORD_LAYOUT
/begin RECORD_LAYOUT Scalar_UBYTE FNC_VALUES 1 UBYTE COLUMN_DIR DIRECT /end RECORD_LAYOUT
/begin RECORD_LAYOUT Scalar_UWORD FNC_VALUES 1 UWORD COLUMN_DIR DIRECT /end RECORD_LAYOUT
/begin RECORD_LAYOUT Scalar_SWORD FNC_VALUES 1 SWORD COLUMN_DIR DIRECT /end RECORD_LAYOUT
/begin RECORD_LAYOUT Scalar_FLOAT32_IEEE FNC_VALUES 1 FLOAT32_IEEE COLUMN_DIR DIRECT /end RECORD_LAYOUT
/begin RECORD_LAYOUT Lookup1D_UWORD FNC_VALUES 1 UWORD COLUMN_DIR DIRECT /end RECORD_LAYOUT
/begin RECORD_LAYOUT Lookup1D_X_UWORD AXIS_PTS_X 1 UWORD INDEX_INCR DIRECT /end RECORD_LAYOUT
/begin RECORD_LAYOUT Lookup1D_WORD FNC_VALUES 1 SWORD COLUMN_DIR DIRECT /end RECORD_LAYOUT
/begin RECORD_LAYOUT Lookup1D_X_WORD AXIS_PTS_X 1 SWORD INDEX_INCR DIRECT /end RECORD_LAYOUT
/begin RECORD_LAYOUT Lookup2D_UWORD FNC_VALUES 1 UWORD COLUMN_DIR DIRECT /end RECORD_LAYOUT
/begin RECORD_LAYOUT Lookup2D_X_UWORD AXIS_PTS_X 1 UWORD INDEX_INCR DIRECT /end RECORD_LAYOUT
/begin RECORD_LAYOUT Lookup2D_WORD FNC_VALUES 1 SWORD COLUMN_DIR DIRECT /end RECORD_LAYOUT
/begin RECORD_LAYOUT Lookup2D_X_WORD AXIS_PTS_X 1 SWORD INDEX_INCR DIRECT /end RECORD_LAYOUT
/begin COMPU_METHOD CM_T_T_degC_16_1_s16 "Q = V*16.000000" RAT_FUNC "%8.4" "degC (degrees Celsius  (deg C))" COEFFS 0 16 0 0 0 1 /end COMPU_METHOD
/begin COMPU_METHOD CM_T_BOOLEAN "Q = V" RAT_FUNC "%1.0" "Bool" COEFFS 0 1 0 0 0 1 /end COMPU_METHOD
/begin COMPU_METHOD CM_T_n_rpm_1_1_s16 "Q = V" RAT_FUNC "%5.0" "rpm (revolutions / minute  (rpm))" COEFFS 0 1 0 0 0 1 /end COMPU_METHOD
/begin COMPU_METHOD CM_T_I_A_32_1_s16 "Q = V*32.000000" RAT_FUNC "%9.5" "A (amperes  (A))" COEFFS 0 32 0 0 0 1 /end COMPU_METHOD
/begin COMPU_METHOD CM_T_Pct_pct_10_1_s16 "Q = V*10.000000" RAT_FUNC "%0.6" "pct (percent  (%))" COEFFS 0 10 0 0 0 1 /end COMPU_METHOD
/* EOF TAMD.a2l */
/begin RECORD_LAYOUT Scalar_BOOLEAN FNC_VALUES 1 UBYTE COLUMN_DIR DIRECT /end RECORD_LAYOUT
/begin RECORD_LAYOUT Scalar_UBYTE FNC_VALUES 1 UBYTE COLUMN_DIR DIRECT /end RECORD_LAYOUT
/begin RECORD_LAYOUT Scalar_UWORD FNC_VALUES 1 UWORD COLUMN_DIR DIRECT /end RECORD_LAYOUT
/begin RECORD_LAYOUT Scalar_SWORD FNC_VALUES 1 SWORD COLUMN_DIR DIRECT /end RECORD_LAYOUT
/begin RECORD_LAYOUT Scalar_FLOAT32_IEEE FNC_VALUES 1 FLOAT32_IEEE COLUMN_DIR DIRECT /end RECORD_LAYOUT
/begin RECORD_LAYOUT Lookup1D_UWORD FNC_VALUES 1 UWORD COLUMN_DIR DIRECT /end RECORD_LAYOUT
/begin RECORD_LAYOUT Lookup1D_X_UWORD AXIS_PTS_X 1 UWORD INDEX_INCR DIRECT /end RECORD_LAYOUT
/begin RECORD_LAYOUT Lookup1D_WORD FNC_VALUES 1 SWORD COLUMN_DIR DIRECT /end RECORD_LAYOUT
/begin RECORD_LAYOUT Lookup1D_X_WORD AXIS_PTS_X 1 SWORD INDEX_INCR DIRECT /end RECORD_LAYOUT
/begin RECORD_LAYOUT Lookup2D_UWORD FNC_VALUES 1 UWORD COLUMN_DIR DIRECT /end RECORD_LAYOUT
/begin RECORD_LAYOUT Lookup2D_X_UWORD AXIS_PTS_X 1 UWORD INDEX_INCR DIRECT /end RECORD_LAYOUT
/begin RECORD_LAYOUT Lookup2D_WORD FNC_VALUES 1 SWORD COLUMN_DIR DIRECT /end RECORD_LAYOUT
/begin RECORD_LAYOUT Lookup2D_X_WORD AXIS_PTS_X 1 SWORD INDEX_INCR DIRECT /end RECORD_LAYOUT
/begin COMPU_METHOD CM_T_n_rpm_1_1_s16 "Q = V" RAT_FUNC "%5.0" "rpm (revolutions / minute  (rpm))" COEFFS 0 1 0 0 0 1 /end COMPU_METHOD
/begin COMPU_METHOD CM_T_T_degC_16_1_s16 "Q = V*16.000000" RAT_FUNC "%8.4" "degC (degrees Celsius  (deg C))" COEFFS 0 16 0 0 0 1 /end COMPU_METHOD
/begin COMPU_METHOD CM_T_Pct_pct_256_1_s16 "Q = V*256.000000" RAT_FUNC "%11.8" "pct (percent  (%))" COEFFS 0 256 0 0 0 1 /end COMPU_METHOD
/begin COMPU_METHOD CM_T_I_A_Float32 "Q = V" RAT_FUNC "%8.6" "A (amperes  (A))" COEFFS 0 1 0 0 0 1 /end COMPU_METHOD
/begin COMPU_METHOD CM_T_K_NA_Float32 "Q = V" RAT_FUNC "%8.6" "NA (dependent upon the gain)" COEFFS 0 1 0 0 0 1 /end COMPU_METHOD
/begin COMPU_METHOD CM_T_Cnt_Num_1_1_u16 "Q = V" RAT_FUNC "%5.0" "Num (counts)" COEFFS 0 1 0 0 0 1 /end COMPU_METHOD
/begin COMPU_METHOD CM_T_V_ml_128_1_s16 "Q = V*128.000000" RAT_FUNC "%10.7" "ml (milliliters  (ml))" COEFFS 0 128 0 0 0 1 /end COMPU_METHOD
/begin COMPU_METHOD CM_T_U_V_512_1_s16 "Q = V*512.000000" RAT_FUNC "%12.9" "V (volts  (V))" COEFFS 0 512 0 0 0 1 /end COMPU_METHOD
/begin COMPU_METHOD CM_T_v_kph_64_1_s16 "Q = V*64.000000" RAT_FUNC "%10.6" "kph (kilometers / hour  (kph))" COEFFS 0 64 0 0 0 1 /end COMPU_METHOD
/begin COMPU_METHOD CM_T_Pct_pct_10_1_s16 "Q = V*10.000000" RAT_FUNC "%0.6" "pct (percent  (%))" COEFFS 0 10 0 0 0 1 /end COMPU_METHOD
/begin COMPU_METHOD CM_T_K_NA_32768_1_u16 "Q = V*32768.000000" RAT_FUNC "%16.15" "NA (dependent upon the gain)" COEFFS 0 32768 0 0 0 1 /end COMPU_METHOD
/begin COMPU_METHOD CM_T_r_NA_32768_1_u16 "Q = V*32768.000000" RAT_FUNC "%16.15" "NA (none)" COEFFS 0 32768 0 0 0 1 /end COMPU_METHOD
/begin COMPU_METHOD CM_T_BOOLEAN "Q = V" RAT_FUNC "%1.0" "Bool" COEFFS 0 1 0 0 0 1 /end COMPU_METHOD
/begin COMPU_METHOD CM_T_r_NA_Float32 "Q = V" RAT_FUNC "%8.6" "NA (none)" COEFFS 0 1 0 0 0 1 /end COMPU_METHOD
/begin COMPU_METHOD CM_T_P_W_Float32 "Q = V" RAT_FUNC "%8.6" "W (watts  (W))" COEFFS 0 1 0 0 0 1 /end COMPU_METHOD
/begin COMPU_METHOD CM_T_Cnt_Num_1_1_s16 "Q = V" RAT_FUNC "%5.0" "Num (counts)" COEFFS 0 1 0 0 0 1 /end COMPU_METHOD
/begin COMPU_METHOD CM_T_Cnt_Num_1_1_u8 "Q = V" RAT_FUNC "%3.0" "Num (counts)" COEFFS 0 1 0 0 0 1 /end COMPU_METHOD
/* EOF TCFC.a2l */
/begin RECORD_LAYOUT Scalar_BOOLEAN FNC_VALUES 1 UBYTE COLUMN_DIR DIRECT /end RECORD_LAYOUT
/begin RECORD_LAYOUT Scalar_UBYTE FNC_VALUES 1 UBYTE COLUMN_DIR DIRECT /end RECORD_LAYOUT
/begin RECORD_LAYOUT Scalar_UWORD FNC_VALUES 1 UWORD COLUMN_DIR DIRECT /end RECORD_LAYOUT
/begin RECORD_LAYOUT Scalar_SWORD FNC_VALUES 1 SWORD COLUMN_DIR DIRECT /end RECORD_LAYOUT
/begin RECORD_LAYOUT Scalar_FLOAT32_IEEE FNC_VALUES 1 FLOAT32_IEEE COLUMN_DIR DIRECT /end RECORD_LAYOUT
/begin RECORD_LAYOUT Lookup1D_UWORD FNC_VALUES 1 UWORD COLUMN_DIR DIRECT /end RECORD_LAYOUT
/begin RECORD_LAYOUT Lookup1D_X_UWORD AXIS_PTS_X 1 UWORD INDEX_INCR DIRECT /end RECORD_LAYOUT
/begin RECORD_LAYOUT Lookup1D_WORD FNC_VALUES 1 SWORD COLUMN_DIR DIRECT /end RECORD_LAYOUT
/begin RECORD_LAYOUT Lookup1D_X_WORD AXIS_PTS_X 1 SWORD INDEX_INCR DIRECT /end RECORD_LAYOUT
/begin RECORD_LAYOUT Lookup2D_UWORD FNC_VALUES 1 UWORD COLUMN_DIR DIRECT /end RECORD_LAYOUT
/begin RECORD_LAYOUT Lookup2D_X_UWORD AXIS_PTS_X 1 UWORD INDEX_INCR DIRECT /end RECORD_LAYOUT
/begin RECORD_LAYOUT Lookup2D_WORD FNC_VALUES 1 SWORD COLUMN_DIR DIRECT /end RECORD_LAYOUT
/begin RECORD_LAYOUT Lookup2D_X_WORD AXIS_PTS_X 1 SWORD INDEX_INCR DIRECT /end RECORD_LAYOUT
/begin COMPU_METHOD CM_T_T_degC_16_1_s16 "Q = V*16.000000" RAT_FUNC "%8.4" "degC (degrees Celsius  (deg C))" COEFFS 0 16 0 0 0 1 /end COMPU_METHOD
/begin COMPU_METHOD CM_T_r_NA_32768_1_u16 "Q = V*32768.000000" RAT_FUNC "%16.15" "NA (none)" COEFFS 0 32768 0 0 0 1 /end COMPU_METHOD
/begin COMPU_METHOD CM_T_n_rpm_1_1_s16 "Q = V" RAT_FUNC "%5.0" "rpm (revolutions / minute  (rpm))" COEFFS 0 1 0 0 0 1 /end COMPU_METHOD
/begin COMPU_METHOD CM_T_I_A_Float32 "Q = V" RAT_FUNC "%8.6" "A (amperes  (A))" COEFFS 0 1 0 0 0 1 /end COMPU_METHOD
/begin COMPU_METHOD CM_T_K_NA_Float32 "Q = V" RAT_FUNC "%8.6" "NA (dependent upon the gain)" COEFFS 0 1 0 0 0 1 /end COMPU_METHOD
/begin COMPU_METHOD CM_T_r_NA_Float32 "Q = V" RAT_FUNC "%8.6" "NA (none)" COEFFS 0 1 0 0 0 1 /end COMPU_METHOD
/begin COMPU_METHOD CM_T_Cnt_Num_1_1_u16 "Q = V" RAT_FUNC "%5.0" "Num (counts)" COEFFS 0 1 0 0 0 1 /end COMPU_METHOD
/begin COMPU_METHOD CM_T_I_A_32_1_s16 "Q = V*32.000000" RAT_FUNC "%9.5" "A (amperes  (A))" COEFFS 0 32 0 0 0 1 /end COMPU_METHOD
/begin COMPU_METHOD CM_T_K_NA_32768_1_u16 "Q = V*32768.000000" RAT_FUNC "%16.15" "NA (dependent upon the gain)" COEFFS 0 32768 0 0 0 1 /end COMPU_METHOD
/begin COMPU_METHOD CM_T_r_NA_1024_1_s16 "Q = V*1024.000000" RAT_FUNC "%12.10" "NA (none)" COEFFS 0 1024 0 0 0 1 /end COMPU_METHOD
/begin COMPU_METHOD CM_T_Pct_pct_256_1_s16 "Q = V*256.000000" RAT_FUNC "%11.8" "pct (percent  (%))" COEFFS 0 256 0 0 0 1 /end COMPU_METHOD
/begin COMPU_METHOD CM_T_BOOLEAN "Q = V" RAT_FUNC "%1.0" "Bool" COEFFS 0 1 0 0 0 1 /end COMPU_METHOD
/begin COMPU_METHOD CM_T_Cnt_Num_1_1_u8 "Q = V" RAT_FUNC "%3.0" "Num (counts)" COEFFS 0 1 0 0 0 1 /end COMPU_METHOD
/* EOF TCFR.a2l */
/begin RECORD_LAYOUT Scalar_BOOLEAN FNC_VALUES 1 UBYTE COLUMN_DIR DIRECT /end RECORD_LAYOUT
/begin RECORD_LAYOUT Scalar_UBYTE FNC_VALUES 1 UBYTE COLUMN_DIR DIRECT /end RECORD_LAYOUT
/begin RECORD_LAYOUT Scalar_UWORD FNC_VALUES 1 UWORD COLUMN_DIR DIRECT /end RECORD_LAYOUT
/begin RECORD_LAYOUT Scalar_SWORD FNC_VALUES 1 SWORD COLUMN_DIR DIRECT /end RECORD_LAYOUT
/begin RECORD_LAYOUT Scalar_FLOAT32_IEEE FNC_VALUES 1 FLOAT32_IEEE COLUMN_DIR DIRECT /end RECORD_LAYOUT
/begin RECORD_LAYOUT Lookup1D_UWORD FNC_VALUES 1 UWORD COLUMN_DIR DIRECT /end RECORD_LAYOUT
/begin RECORD_LAYOUT Lookup1D_X_UWORD AXIS_PTS_X 1 UWORD INDEX_INCR DIRECT /end RECORD_LAYOUT
/begin RECORD_LAYOUT Lookup1D_WORD FNC_VALUES 1 SWORD COLUMN_DIR DIRECT /end RECORD_LAYOUT
/begin RECORD_LAYOUT Lookup1D_X_WORD AXIS_PTS_X 1 SWORD INDEX_INCR DIRECT /end RECORD_LAYOUT
/begin RECORD_LAYOUT Lookup2D_UWORD FNC_VALUES 1 UWORD COLUMN_DIR DIRECT /end RECORD_LAYOUT
/begin RECORD_LAYOUT Lookup2D_X_UWORD AXIS_PTS_X 1 UWORD INDEX_INCR DIRECT /end RECORD_LAYOUT
/begin RECORD_LAYOUT Lookup2D_WORD FNC_VALUES 1 SWORD COLUMN_DIR DIRECT /end RECORD_LAYOUT
/begin RECORD_LAYOUT Lookup2D_X_WORD AXIS_PTS_X 1 SWORD INDEX_INCR DIRECT /end RECORD_LAYOUT
/begin COMPU_METHOD CM_T_n_rpm_1_1_s16 "Q = V" RAT_FUNC "%5.0" "rpm (revolutions / minute  (rpm))" COEFFS 0 1 0 0 0 1 /end COMPU_METHOD
/begin COMPU_METHOD CM_T_Cnt_Num_1_1_u16 "Q = V" RAT_FUNC "%5.0" "Num (counts)" COEFFS 0 1 0 0 0 1 /end COMPU_METHOD
/begin COMPU_METHOD CM_T_T_degC_16_1_s16 "Q = V*16.000000" RAT_FUNC "%8.4" "degC (degrees Celsius  (deg C))" COEFFS 0 16 0 0 0 1 /end COMPU_METHOD
/begin COMPU_METHOD CM_T_BOOLEAN "Q = V" RAT_FUNC "%1.0" "Bool" COEFFS 0 1 0 0 0 1 /end COMPU_METHOD
/begin COMPU_METHOD CM_T_I_A_32_1_s16 "Q = V*32.000000" RAT_FUNC "%9.5" "A (amperes  (A))" COEFFS 0 32 0 0 0 1 /end COMPU_METHOD
/begin COMPU_METHOD CM_T_Pct_pct_10_1_s16 "Q = V*10.000000" RAT_FUNC "%0.6" "pct (percent  (%))" COEFFS 0 10 0 0 0 1 /end COMPU_METHOD
/* EOF TCMD.a2l */
/begin RECORD_LAYOUT Scalar_BOOLEAN FNC_VALUES 1 UBYTE COLUMN_DIR DIRECT /end RECORD_LAYOUT
/begin RECORD_LAYOUT Scalar_UBYTE FNC_VALUES 1 UBYTE COLUMN_DIR DIRECT /end RECORD_LAYOUT
/begin RECORD_LAYOUT Scalar_UWORD FNC_VALUES 1 UWORD COLUMN_DIR DIRECT /end RECORD_LAYOUT
/begin RECORD_LAYOUT Scalar_SWORD FNC_VALUES 1 SWORD COLUMN_DIR DIRECT /end RECORD_LAYOUT
/begin RECORD_LAYOUT Scalar_FLOAT32_IEEE FNC_VALUES 1 FLOAT32_IEEE COLUMN_DIR DIRECT /end RECORD_LAYOUT
/begin RECORD_LAYOUT Lookup1D_UWORD FNC_VALUES 1 UWORD COLUMN_DIR DIRECT /end RECORD_LAYOUT
/begin RECORD_LAYOUT Lookup1D_X_UWORD AXIS_PTS_X 1 UWORD INDEX_INCR DIRECT /end RECORD_LAYOUT
/begin RECORD_LAYOUT Lookup1D_WORD FNC_VALUES 1 SWORD COLUMN_DIR DIRECT /end RECORD_LAYOUT
/begin RECORD_LAYOUT Lookup1D_X_WORD AXIS_PTS_X 1 SWORD INDEX_INCR DIRECT /end RECORD_LAYOUT
/begin RECORD_LAYOUT Lookup2D_UWORD FNC_VALUES 1 UWORD COLUMN_DIR DIRECT /end RECORD_LAYOUT
/begin RECORD_LAYOUT Lookup2D_X_UWORD AXIS_PTS_X 1 UWORD INDEX_INCR DIRECT /end RECORD_LAYOUT
/begin RECORD_LAYOUT Lookup2D_WORD FNC_VALUES 1 SWORD COLUMN_DIR DIRECT /end RECORD_LAYOUT
/begin RECORD_LAYOUT Lookup2D_X_WORD AXIS_PTS_X 1 SWORD INDEX_INCR DIRECT /end RECORD_LAYOUT
/begin COMPU_METHOD CM_T_p_kPa_1_1_s16 "Q = V" RAT_FUNC "%5.0" "kPa (kiloPascals  (kPa))" COEFFS 0 1 0 0 0 1 /end COMPU_METHOD
/begin COMPU_METHOD CM_T_Cnt_Num_1_1_u16 "Q = V" RAT_FUNC "%5.0" "Num (counts)" COEFFS 0 1 0 0 0 1 /end COMPU_METHOD
/begin COMPU_METHOD CM_T_p_kPa_32_1_u16 "Q = V*32.000000" RAT_FUNC "%9.5" "kPa (kiloPascals  (kPa))" COEFFS 0 32 0 0 0 1 /end COMPU_METHOD
/begin COMPU_METHOD CM_T_p_kPa_64_1_s16 "Q = V*64.000000" RAT_FUNC "%10.6" "kPa (kiloPascals  (kPa))" COEFFS 0 64 0 0 0 1 /end COMPU_METHOD
/begin COMPU_METHOD CM_T_K_NA_32768_1_u16 "Q = V*32768.000000" RAT_FUNC "%16.15" "NA (dependent upon the gain)" COEFFS 0 32768 0 0 0 1 /end COMPU_METHOD
/begin COMPU_METHOD CM_T_Cnt_Num_1_1_u8 "Q = V" RAT_FUNC "%3.0" "Num (counts)" COEFFS 0 1 0 0 0 1 /end COMPU_METHOD
/begin COMPU_METHOD CM_T_BOOLEAN "Q = V" RAT_FUNC "%1.0" "Bool" COEFFS 0 1 0 0 0 1 /end COMPU_METHOD
/* EOF TCPD.a2l */
/begin RECORD_LAYOUT Scalar_BOOLEAN FNC_VALUES 1 UBYTE COLUMN_DIR DIRECT /end RECORD_LAYOUT
/begin RECORD_LAYOUT Scalar_UBYTE FNC_VALUES 1 UBYTE COLUMN_DIR DIRECT /end RECORD_LAYOUT
/begin RECORD_LAYOUT Scalar_UWORD FNC_VALUES 1 UWORD COLUMN_DIR DIRECT /end RECORD_LAYOUT
/begin RECORD_LAYOUT Scalar_SWORD FNC_VALUES 1 SWORD COLUMN_DIR DIRECT /end RECORD_LAYOUT
/begin RECORD_LAYOUT Scalar_FLOAT32_IEEE FNC_VALUES 1 FLOAT32_IEEE COLUMN_DIR DIRECT /end RECORD_LAYOUT
/begin RECORD_LAYOUT Lookup1D_UWORD FNC_VALUES 1 UWORD COLUMN_DIR DIRECT /end RECORD_LAYOUT
/begin RECORD_LAYOUT Lookup1D_X_UWORD AXIS_PTS_X 1 UWORD INDEX_INCR DIRECT /end RECORD_LAYOUT
/begin RECORD_LAYOUT Lookup1D_WORD FNC_VALUES 1 SWORD COLUMN_DIR DIRECT /end RECORD_LAYOUT
/begin RECORD_LAYOUT Lookup1D_X_WORD AXIS_PTS_X 1 SWORD INDEX_INCR DIRECT /end RECORD_LAYOUT
/begin RECORD_LAYOUT Lookup2D_UWORD FNC_VALUES 1 UWORD COLUMN_DIR DIRECT /end RECORD_LAYOUT
/begin RECORD_LAYOUT Lookup2D_X_UWORD AXIS_PTS_X 1 UWORD INDEX_INCR DIRECT /end RECORD_LAYOUT
/begin RECORD_LAYOUT Lookup2D_WORD FNC_VALUES 1 SWORD COLUMN_DIR DIRECT /end RECORD_LAYOUT
/begin RECORD_LAYOUT Lookup2D_X_WORD AXIS_PTS_X 1 SWORD INDEX_INCR DIRECT /end RECORD_LAYOUT
/begin COMPU_METHOD CM_T_p_kPa_1_1_s16 "Q = V" RAT_FUNC "%5.0" "kPa (kiloPascals  (kPa))" COEFFS 0 1 0 0 0 1 /end COMPU_METHOD
/begin COMPU_METHOD CM_T_Cnt_Num_1_1_u16 "Q = V" RAT_FUNC "%5.0" "Num (counts)" COEFFS 0 1 0 0 0 1 /end COMPU_METHOD
/begin COMPU_METHOD CM_T_K_NA_1024_1_u16 "Q = V*1024.000000" RAT_FUNC "%12.10" "NA (dependent upon the gain)" COEFFS 0 1024 0 0 0 1 /end COMPU_METHOD
/begin COMPU_METHOD CM_T_Cnt_Num_1_1_u8 "Q = V" RAT_FUNC "%3.0" "Num (counts)" COEFFS 0 1 0 0 0 1 /end COMPU_METHOD
/begin COMPU_METHOD CM_T_BOOLEAN "Q = V" RAT_FUNC "%1.0" "Bool" COEFFS 0 1 0 0 0 1 /end COMPU_METHOD
/begin COMPU_METHOD CM_SPARte_e_Validity "Enumerated data type: SPARte_e_Validity" TAB_VERB "%0.6" "" COMPU_TAB_REF VTAB_FOR_CM_SPARte_e_Validity /end COMPU_METHOD
/begin COMPU_VTAB VTAB_FOR_CM_SPARte_e_Validity "Enumerated data type: SPARte_e_Validity" TAB_VERB 4 0 "SPARce_e_Valid" 1 "SPARce_e_Invalid" 2 "SPARce_e_EstimatedReplaceValue" 3 "SPARce_e_NotEvaluatedYet" /end COMPU_VTAB
/* EOF TLMD.a2l */
/begin RECORD_LAYOUT Scalar_BOOLEAN FNC_VALUES 1 UBYTE COLUMN_DIR DIRECT /end RECORD_LAYOUT
/begin RECORD_LAYOUT Scalar_UBYTE FNC_VALUES 1 UBYTE COLUMN_DIR DIRECT /end RECORD_LAYOUT
/begin RECORD_LAYOUT Scalar_UWORD FNC_VALUES 1 UWORD COLUMN_DIR DIRECT /end RECORD_LAYOUT
/begin RECORD_LAYOUT Scalar_SWORD FNC_VALUES 1 SWORD COLUMN_DIR DIRECT /end RECORD_LAYOUT
/begin RECORD_LAYOUT Scalar_FLOAT32_IEEE FNC_VALUES 1 FLOAT32_IEEE COLUMN_DIR DIRECT /end RECORD_LAYOUT
/begin RECORD_LAYOUT Lookup1D_UWORD FNC_VALUES 1 UWORD COLUMN_DIR DIRECT /end RECORD_LAYOUT
/begin RECORD_LAYOUT Lookup1D_X_UWORD AXIS_PTS_X 1 UWORD INDEX_INCR DIRECT /end RECORD_LAYOUT
/begin RECORD_LAYOUT Lookup1D_WORD FNC_VALUES 1 SWORD COLUMN_DIR DIRECT /end RECORD_LAYOUT
/begin RECORD_LAYOUT Lookup1D_X_WORD AXIS_PTS_X 1 SWORD INDEX_INCR DIRECT /end RECORD_LAYOUT
/begin RECORD_LAYOUT Lookup2D_UWORD FNC_VALUES 1 UWORD COLUMN_DIR DIRECT /end RECORD_LAYOUT
/begin RECORD_LAYOUT Lookup2D_X_UWORD AXIS_PTS_X 1 UWORD INDEX_INCR DIRECT /end RECORD_LAYOUT
/begin RECORD_LAYOUT Lookup2D_WORD FNC_VALUES 1 SWORD COLUMN_DIR DIRECT /end RECORD_LAYOUT
/begin RECORD_LAYOUT Lookup2D_X_WORD AXIS_PTS_X 1 SWORD INDEX_INCR DIRECT /end RECORD_LAYOUT
/begin COMPU_METHOD CM_T_T_degC_16_1_s16 "Q = V*16.000000" RAT_FUNC "%8.4" "degC (degrees Celsius  (deg C))" COEFFS 0 16 0 0 0 1 /end COMPU_METHOD
/begin COMPU_METHOD CM_T_n_rpm_1_1_s16 "Q = V" RAT_FUNC "%5.0" "rpm (revolutions / minute  (rpm))" COEFFS 0 1 0 0 0 1 /end COMPU_METHOD
/begin COMPU_METHOD CM_T_Cnt_Num_1_1_u16 "Q = V" RAT_FUNC "%5.0" "Num (counts)" COEFFS 0 1 0 0 0 1 /end COMPU_METHOD
/begin COMPU_METHOD CM_T_K_NA_32768_1_u16 "Q = V*32768.000000" RAT_FUNC "%16.15" "NA (dependent upon the gain)" COEFFS 0 32768 0 0 0 1 /end COMPU_METHOD
/begin COMPU_METHOD CM_T_Cnt_Num_1_1_u8 "Q = V" RAT_FUNC "%3.0" "Num (counts)" COEFFS 0 1 0 0 0 1 /end COMPU_METHOD
/begin COMPU_METHOD CM_T_BOOLEAN "Q = V" RAT_FUNC "%1.0" "Bool" COEFFS 0 1 0 0 0 1 /end COMPU_METHOD
/* EOF TOTD.a2l */
/begin RECORD_LAYOUT Scalar_BOOLEAN FNC_VALUES 1 UBYTE COLUMN_DIR DIRECT /end RECORD_LAYOUT
/begin RECORD_LAYOUT Scalar_UBYTE FNC_VALUES 1 UBYTE COLUMN_DIR DIRECT /end RECORD_LAYOUT
/begin RECORD_LAYOUT Scalar_UWORD FNC_VALUES 1 UWORD COLUMN_DIR DIRECT /end RECORD_LAYOUT
/begin RECORD_LAYOUT Scalar_SWORD FNC_VALUES 1 SWORD COLUMN_DIR DIRECT /end RECORD_LAYOUT
/begin RECORD_LAYOUT Scalar_FLOAT32_IEEE FNC_VALUES 1 FLOAT32_IEEE COLUMN_DIR DIRECT /end RECORD_LAYOUT
/begin RECORD_LAYOUT Lookup1D_UWORD FNC_VALUES 1 UWORD COLUMN_DIR DIRECT /end RECORD_LAYOUT
/begin RECORD_LAYOUT Lookup1D_X_UWORD AXIS_PTS_X 1 UWORD INDEX_INCR DIRECT /end RECORD_LAYOUT
/begin RECORD_LAYOUT Lookup1D_WORD FNC_VALUES 1 SWORD COLUMN_DIR DIRECT /end RECORD_LAYOUT
/begin RECORD_LAYOUT Lookup1D_X_WORD AXIS_PTS_X 1 SWORD INDEX_INCR DIRECT /end RECORD_LAYOUT
/begin RECORD_LAYOUT Lookup2D_UWORD FNC_VALUES 1 UWORD COLUMN_DIR DIRECT /end RECORD_LAYOUT
/begin RECORD_LAYOUT Lookup2D_X_UWORD AXIS_PTS_X 1 UWORD INDEX_INCR DIRECT /end RECORD_LAYOUT
/begin RECORD_LAYOUT Lookup2D_WORD FNC_VALUES 1 SWORD COLUMN_DIR DIRECT /end RECORD_LAYOUT
/begin RECORD_LAYOUT Lookup2D_X_WORD AXIS_PTS_X 1 SWORD INDEX_INCR DIRECT /end RECORD_LAYOUT
/begin COMPU_METHOD CM_T_BOOLEAN "Q = V" RAT_FUNC "%1.0" "Bool" COEFFS 0 1 0 0 0 1 /end COMPU_METHOD
/* EOF TSPC.a2l */
/begin RECORD_LAYOUT Scalar_BOOLEAN FNC_VALUES 1 UBYTE COLUMN_DIR DIRECT /end RECORD_LAYOUT
/begin RECORD_LAYOUT Scalar_UBYTE FNC_VALUES 1 UBYTE COLUMN_DIR DIRECT /end RECORD_LAYOUT
/begin RECORD_LAYOUT Scalar_UWORD FNC_VALUES 1 UWORD COLUMN_DIR DIRECT /end RECORD_LAYOUT
/begin RECORD_LAYOUT Scalar_SWORD FNC_VALUES 1 SWORD COLUMN_DIR DIRECT /end RECORD_LAYOUT
/begin RECORD_LAYOUT Scalar_FLOAT32_IEEE FNC_VALUES 1 FLOAT32_IEEE COLUMN_DIR DIRECT /end RECORD_LAYOUT
/begin RECORD_LAYOUT Lookup1D_UWORD FNC_VALUES 1 UWORD COLUMN_DIR DIRECT /end RECORD_LAYOUT
/begin RECORD_LAYOUT Lookup1D_X_UWORD AXIS_PTS_X 1 UWORD INDEX_INCR DIRECT /end RECORD_LAYOUT
/begin RECORD_LAYOUT Lookup1D_WORD FNC_VALUES 1 SWORD COLUMN_DIR DIRECT /end RECORD_LAYOUT
/begin RECORD_LAYOUT Lookup1D_X_WORD AXIS_PTS_X 1 SWORD INDEX_INCR DIRECT /end RECORD_LAYOUT
/begin RECORD_LAYOUT Lookup2D_UWORD FNC_VALUES 1 UWORD COLUMN_DIR DIRECT /end RECORD_LAYOUT
/begin RECORD_LAYOUT Lookup2D_X_UWORD AXIS_PTS_X 1 UWORD INDEX_INCR DIRECT /end RECORD_LAYOUT
/begin RECORD_LAYOUT Lookup2D_WORD FNC_VALUES 1 SWORD COLUMN_DIR DIRECT /end RECORD_LAYOUT
/begin RECORD_LAYOUT Lookup2D_X_WORD AXIS_PTS_X 1 SWORD INDEX_INCR DIRECT /end RECORD_LAYOUT
/begin COMPU_METHOD CM_T_r_NA_Float32 "Q = V" RAT_FUNC "%8.6" "NA (none)" COEFFS 0 1 0 0 0 1 /end COMPU_METHOD
/begin COMPU_METHOD CM_T_n_rpm_1_1_s16 "Q = V" RAT_FUNC "%5.0" "rpm (revolutions / minute  (rpm))" COEFFS 0 1 0 0 0 1 /end COMPU_METHOD
/begin COMPU_METHOD CM_T_Cnt_Num_1_1_u16 "Q = V" RAT_FUNC "%5.0" "Num (counts)" COEFFS 0 1 0 0 0 1 /end COMPU_METHOD
/begin COMPU_METHOD CM_T_M_Nm_32_1_s16 "Q = V*32.000000" RAT_FUNC "%9.5" "Nm (newton-meters  (Nm))" COEFFS 0 32 0 0 0 1 /end COMPU_METHOD
/begin COMPU_METHOD CM_T_p_kPa_32_1_u16 "Q = V*32.000000" RAT_FUNC "%9.5" "kPa (kiloPascals  (kPa))" COEFFS 0 32 0 0 0 1 /end COMPU_METHOD
/begin COMPU_METHOD CM_T_K_NA_32768_1_u16 "Q = V*32768.000000" RAT_FUNC "%16.15" "NA (dependent upon the gain)" COEFFS 0 32768 0 0 0 1 /end COMPU_METHOD
/begin COMPU_METHOD CM_T_Cnt_Num_1_1_u8 "Q = V" RAT_FUNC "%3.0" "Num (counts)" COEFFS 0 1 0 0 0 1 /end COMPU_METHOD
/begin COMPU_METHOD CM_T_BOOLEAN "Q = V" RAT_FUNC "%1.0" "Bool" COEFFS 0 1 0 0 0 1 /end COMPU_METHOD
/begin COMPU_METHOD CM_SPARte_e_Validity "Enumerated data type: SPARte_e_Validity" TAB_VERB "%0.6" "" COMPU_TAB_REF VTAB_FOR_CM_SPARte_e_Validity /end COMPU_METHOD
/begin COMPU_VTAB VTAB_FOR_CM_SPARte_e_Validity "Enumerated data type: SPARte_e_Validity" TAB_VERB 4 0 "SPARce_e_Valid" 1 "SPARce_e_Invalid" 2 "SPARce_e_EstimatedReplaceValue" 3 "SPARce_e_NotEvaluatedYet" /end COMPU_VTAB
/* EOF TSSD.a2l */
/begin RECORD_LAYOUT Scalar_BOOLEAN FNC_VALUES 1 UBYTE COLUMN_DIR DIRECT /end RECORD_LAYOUT
/begin RECORD_LAYOUT Scalar_UBYTE FNC_VALUES 1 UBYTE COLUMN_DIR DIRECT /end RECORD_LAYOUT
/begin RECORD_LAYOUT Scalar_UWORD FNC_VALUES 1 UWORD COLUMN_DIR DIRECT /end RECORD_LAYOUT
/begin RECORD_LAYOUT Scalar_SWORD FNC_VALUES 1 SWORD COLUMN_DIR DIRECT /end RECORD_LAYOUT
/begin RECORD_LAYOUT Scalar_FLOAT32_IEEE FNC_VALUES 1 FLOAT32_IEEE COLUMN_DIR DIRECT /end RECORD_LAYOUT
/begin RECORD_LAYOUT Lookup1D_UWORD FNC_VALUES 1 UWORD COLUMN_DIR DIRECT /end RECORD_LAYOUT
/begin RECORD_LAYOUT Lookup1D_X_UWORD AXIS_PTS_X 1 UWORD INDEX_INCR DIRECT /end RECORD_LAYOUT
/begin RECORD_LAYOUT Lookup1D_WORD FNC_VALUES 1 SWORD COLUMN_DIR DIRECT /end RECORD_LAYOUT
/begin RECORD_LAYOUT Lookup1D_X_WORD AXIS_PTS_X 1 SWORD INDEX_INCR DIRECT /end RECORD_LAYOUT
/begin RECORD_LAYOUT Lookup2D_UWORD FNC_VALUES 1 UWORD COLUMN_DIR DIRECT /end RECORD_LAYOUT
/begin RECORD_LAYOUT Lookup2D_X_UWORD AXIS_PTS_X 1 UWORD INDEX_INCR DIRECT /end RECORD_LAYOUT
/begin RECORD_LAYOUT Lookup2D_WORD FNC_VALUES 1 SWORD COLUMN_DIR DIRECT /end RECORD_LAYOUT
/begin RECORD_LAYOUT Lookup2D_X_WORD AXIS_PTS_X 1 SWORD INDEX_INCR DIRECT /end RECORD_LAYOUT
/begin COMPU_METHOD CM_T_BOOLEAN "Q = V" RAT_FUNC "%1.0" "Bool" COEFFS 0 1 0 0 0 1 /end COMPU_METHOD
/* EOF V5RD.a2l */
/begin RECORD_LAYOUT Scalar_BOOLEAN FNC_VALUES 1 UBYTE COLUMN_DIR DIRECT /end RECORD_LAYOUT
/begin RECORD_LAYOUT Scalar_UBYTE FNC_VALUES 1 UBYTE COLUMN_DIR DIRECT /end RECORD_LAYOUT
/begin RECORD_LAYOUT Scalar_UWORD FNC_VALUES 1 UWORD COLUMN_DIR DIRECT /end RECORD_LAYOUT
/begin RECORD_LAYOUT Scalar_SWORD FNC_VALUES 1 SWORD COLUMN_DIR DIRECT /end RECORD_LAYOUT
/begin RECORD_LAYOUT Scalar_FLOAT32_IEEE FNC_VALUES 1 FLOAT32_IEEE COLUMN_DIR DIRECT /end RECORD_LAYOUT
/begin RECORD_LAYOUT Lookup1D_UWORD FNC_VALUES 1 UWORD COLUMN_DIR DIRECT /end RECORD_LAYOUT
/begin RECORD_LAYOUT Lookup1D_X_UWORD AXIS_PTS_X 1 UWORD INDEX_INCR DIRECT /end RECORD_LAYOUT
/begin RECORD_LAYOUT Lookup1D_WORD FNC_VALUES 1 SWORD COLUMN_DIR DIRECT /end RECORD_LAYOUT
/begin RECORD_LAYOUT Lookup1D_X_WORD AXIS_PTS_X 1 SWORD INDEX_INCR DIRECT /end RECORD_LAYOUT
/begin RECORD_LAYOUT Lookup2D_UWORD FNC_VALUES 1 UWORD COLUMN_DIR DIRECT /end RECORD_LAYOUT
/begin RECORD_LAYOUT Lookup2D_X_UWORD AXIS_PTS_X 1 UWORD INDEX_INCR DIRECT /end RECORD_LAYOUT
/begin RECORD_LAYOUT Lookup2D_WORD FNC_VALUES 1 SWORD COLUMN_DIR DIRECT /end RECORD_LAYOUT
/begin RECORD_LAYOUT Lookup2D_X_WORD AXIS_PTS_X 1 SWORD INDEX_INCR DIRECT /end RECORD_LAYOUT
/begin COMPU_METHOD CM_T_BOOLEAN "Q = V" RAT_FUNC "%1.0" "Bool" COEFFS 0 1 0 0 0 1 /end COMPU_METHOD
/begin COMPU_METHOD CM_SPARte_e_Validity "Enumerated data type: SPARte_e_Validity" TAB_VERB "%0.6" "" COMPU_TAB_REF VTAB_FOR_CM_SPARte_e_Validity /end COMPU_METHOD
/begin COMPU_VTAB VTAB_FOR_CM_SPARte_e_Validity "Enumerated data type: SPARte_e_Validity" TAB_VERB 4 0 "SPARce_e_Valid" 1 "SPARce_e_Invalid" 2 "SPARce_e_EstimatedReplaceValue" 3 "SPARce_e_NotEvaluatedYet" /end COMPU_VTAB
/end MODULE
/end PROJECT
