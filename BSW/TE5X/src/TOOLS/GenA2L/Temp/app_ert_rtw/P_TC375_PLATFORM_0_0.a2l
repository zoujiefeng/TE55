ASAP2_VERSION 1 3
/begin PROJECT P_TC375_PLATFORM_0_0 "P_TC375_PLATFORM_0_0"
/begin HEADER "" VERSION "5210.00" PROJECT_NO D0 /end HEADER
/begin MODULE P_TC375_PLATFORM_0_0 "Invt"
/begin MOD_COMMON "" DEPOSIT ABSOLUTE ALIGNMENT_BYTE 1 ALIGNMENT_WORD 2 ALIGNMENT_LONG 4 ALIGNMENT_FLOAT32_IEEE 4 ALIGNMENT_FLOAT64_IEEE 8 BYTE_ORDER MSB_LAST /end MOD_COMMON
/begin RECORD_LAYOUT DATA_RECORD_UBYTE FNC_VALUES 1 UBYTE ROW_DIR DIRECT /end RECORD_LAYOUT
/begin RECORD_LAYOUT DATA_RECORD_UWORD FNC_VALUES 1 UWORD ROW_DIR DIRECT /end RECORD_LAYOUT
/begin RECORD_LAYOUT DATA_RECORD_ULONG FNC_VALUES 1 ULONG ROW_DIR DIRECT /end RECORD_LAYOUT
/begin RECORD_LAYOUT DATA_RECORD_SLONG FNC_VALUES 1 SLONG ROW_DIR DIRECT /end RECORD_LAYOUT
/begin RECORD_LAYOUT DATA_RECORD_FLOAT32_IEEE FNC_VALUES 1 FLOAT32_IEEE ROW_DIR DIRECT /end RECORD_LAYOUT
/begin RECORD_LAYOUT AXIS_PTS_X_SWORD_VEMS AXIS_PTS_X 1 SWORD INDEX_INCR DIRECT /end RECORD_LAYOUT
/begin RECORD_LAYOUT AXIS_PTS_X_ULONG_VEMS AXIS_PTS_X 1 ULONG INDEX_INCR DIRECT /end RECORD_LAYOUT
/begin RECORD_LAYOUT AXIS_PTS_X_SLONG_VEMS AXIS_PTS_X 1 SLONG INDEX_INCR DIRECT /end RECORD_LAYOUT
/begin RECORD_LAYOUT AXIS_PTS_X_FLOAT32_IEEE_VEMS AXIS_PTS_X 1 FLOAT32_IEEE INDEX_INCR DIRECT /end RECORD_LAYOUT
/begin RECORD_LAYOUT AXIS_PTS_X_FLOAT64_IEEE_VEMS AXIS_PTS_X 1 FLOAT64_IEEE INDEX_INCR DIRECT /end RECORD_LAYOUT
/begin RECORD_LAYOUT AXIS_PTS_X_UBYTE NO_AXIS_PTS_X 1 UBYTE AXIS_PTS_X 2 UBYTE INDEX_INCR DIRECT /end RECORD_LAYOUT
/begin RECORD_LAYOUT AXIS_PTS_X_SBYTE NO_AXIS_PTS_X 1 SBYTE AXIS_PTS_X 2 SBYTE INDEX_INCR DIRECT /end RECORD_LAYOUT
/begin RECORD_LAYOUT AXIS_PTS_X_UWORD NO_AXIS_PTS_X 1 UWORD AXIS_PTS_X 2 UWORD INDEX_INCR DIRECT /end RECORD_LAYOUT
/begin RECORD_LAYOUT AXIS_PTS_X_SWORD NO_AXIS_PTS_X 1 SWORD AXIS_PTS_X 2 SWORD INDEX_INCR DIRECT /end RECORD_LAYOUT
/begin RECORD_LAYOUT AXIS_PTS_X_ULONG NO_AXIS_PTS_X 1 ULONG AXIS_PTS_X 2 ULONG INDEX_INCR DIRECT /end RECORD_LAYOUT
/begin RECORD_LAYOUT AXIS_PTS_X_SLONG NO_AXIS_PTS_X 1 SLONG AXIS_PTS_X 2 SLONG INDEX_INCR DIRECT /end RECORD_LAYOUT
/begin RECORD_LAYOUT AXIS_PTS_X_FLOAT32_IEEE NO_AXIS_PTS_X 1 FLOAT32_IEEE AXIS_PTS_X 2 FLOAT32_IEEE INDEX_INCR DIRECT /end RECORD_LAYOUT
/begin RECORD_LAYOUT AXIS_PTS_X_FLOAT64_IEEE NO_AXIS_PTS_X 1 FLOAT64_IEEE AXIS_PTS_X 2 FLOAT64_IEEE INDEX_INCR DIRECT /end RECORD_LAYOUT
/begin CHARACTERISTIC FTCIVDC_SpdMaxC "FTCIVDC_SpdMaxC" VALUE 0x80061920 DATA_RECORD_FLOAT32_IEEE 3.402823466E+038 F_1_p0_50 -3.402823466E+038 3.402823466E+038 /end CHARACTERISTIC
/begin CHARACTERISTIC FTCIVDC_SpdMinC "FTCIVDC_SpdMinC" VALUE 0x8006191C DATA_RECORD_FLOAT32_IEEE 3.402823466E+038 F_1_p0_50 -3.402823466E+038 3.402823466E+038 /end CHARACTERISTIC
/begin CHARACTERISTIC FTCIVDC_UbatHVLowSatC "FTCIVDC_UbatHVLowSatC" VALUE 0x80061918 DATA_RECORD_FLOAT32_IEEE 99 F_1_p0_38 1 100 /end CHARACTERISTIC
/begin CHARACTERISTIC FTCIVDC_VFreqEnableC "FTCIVDC_VFreqEnableC" VALUE 0x80061914 DATA_RECORD_UBYTE 1 Bool_ON_OFF 0 1 BIT_MASK 0x01 /end CHARACTERISTIC
/begin CHARACTERISTIC FTCMCCS_CurrentLoopOrgEnC "FTCMCCS_CurrentLoopOrgEnC" VALUE 0x80061EF4 DATA_RECORD_UBYTE 1 Bool_ON_OFF 0 1 BIT_MASK 0x01 /end CHARACTERISTIC
/begin CHARACTERISTIC FTCMCCS_EM1dOpenLoopGainC "FTCMCCS_EM1dOpenLoopGainC" VALUE 0x80061EF0 DATA_RECORD_FLOAT32_IEEE 3.402823466E+038 F_1_p0_4 -3.402823466E+038 3.402823466E+038 /end CHARACTERISTIC
/begin CHARACTERISTIC FTCMCCS_EM1qOpenLoopGainC "FTCMCCS_EM1qOpenLoopGainC" VALUE 0x80061EEC DATA_RECORD_FLOAT32_IEEE 3.402823466E+038 F_1_p0_4 -3.402823466E+038 3.402823466E+038 /end CHARACTERISTIC
/begin CHARACTERISTIC FTCMCCS_GenTableTorqueThrdC "FTCMCCS_GenTableTorqueThrdC" VALUE 0x80061EE8 DATA_RECORD_FLOAT32_IEEE 3.402823466E+038 F_1_p0_45 -3.402823466E+038 3.402823466E+038 /end CHARACTERISTIC
/begin CHARACTERISTIC FTCMCCS_IdCurrLoopParOnOffC "FTCMCCS_IdCurrLoopParOnOffC" VALUE 0x80061EE4 DATA_RECORD_UBYTE 1 Bool_ON_OFF 0 1 BIT_MASK 0x01 /end CHARACTERISTIC
/begin CHARACTERISTIC FTCMCCS_InitU0dqTgt3C "FTCMCCS_InitU0dqTgt3C" CURVE 0x80061ED8 DATA_RECORD_FLOAT32_IEEE 3.402823466E+038 F_1_p0_38 -3.402823466E+038 3.402823466E+038
 /begin AXIS_DESCR FIX_AXIS NO_INPUT_QUANTITY Id_0x00 3 0 2 MAX_GRAD 100.0 FIX_AXIS_PAR_DIST 0 1 3 /end AXIS_DESCR
/end CHARACTERISTIC
/begin CHARACTERISTIC FTCMCCS_IqCurrLoopParOnOffC "FTCMCCS_IqCurrLoopParOnOffC" VALUE 0x80061ED4 DATA_RECORD_UBYTE 1 Bool_ON_OFF 0 1 BIT_MASK 0x01 /end CHARACTERISTIC
/begin CHARACTERISTIC FTCMCCS_Lm0C "FTCMCCS_Lm0C" VALUE 0x80061ED0 DATA_RECORD_FLOAT32_IEEE 3.402823466E+038 F_1_p0_4 -3.402823466E+038 3.402823466E+038 /end CHARACTERISTIC
/begin CHARACTERISTIC FTCMCCS_Lm1dC "FTCMCCS_Lm1dC" VALUE 0x80061ECC DATA_RECORD_FLOAT32_IEEE 3.402823466E+038 F_1_p0_4 -3.402823466E+038 3.402823466E+038 /end CHARACTERISTIC
/begin CHARACTERISTIC FTCMCCS_Lm1qC "FTCMCCS_Lm1qC" VALUE 0x80061EC8 DATA_RECORD_FLOAT32_IEEE 3.402823466E+038 F_1_p0_4 -3.402823466E+038 3.402823466E+038 /end CHARACTERISTIC
/begin CHARACTERISTIC FTCMCCS_LutElecSpeedRds3C "FTCMCCS_LutElecSpeedRds3C" CURVE 0x80061EBC DATA_RECORD_FLOAT32_IEEE 3.402823466E+038 F_1_p0_4 -3.402823466E+038 3.402823466E+038
 /begin AXIS_DESCR FIX_AXIS NO_INPUT_QUANTITY Id_0x00 3 0 2 MAX_GRAD 100.0 FIX_AXIS_PAR_DIST 0 1 3 /end AXIS_DESCR
/end CHARACTERISTIC
/begin CHARACTERISTIC FTCMCCS_LutInSpeedRpmC "FTCMCCS_LutInSpeedRpmC" CURVE 0x8008EA68 DATA_RECORD_FLOAT32_IEEE 3.402823466E+038 F_1_p0_4 -3.402823466E+038 3.402823466E+038
 /begin AXIS_DESCR FIX_AXIS NO_INPUT_QUANTITY Id_0x00 17 0 16 MAX_GRAD 100.0 FIX_AXIS_PAR_DIST 0 1 17 /end AXIS_DESCR
/end CHARACTERISTIC
/begin CHARACTERISTIC FTCMCCS_LutInUbatC "FTCMCCS_LutInUbatC" CURVE 0x8008EA58 DATA_RECORD_FLOAT32_IEEE 3.402823466E+038 F_1_p0_4 -3.402823466E+038 3.402823466E+038
 /begin AXIS_DESCR FIX_AXIS NO_INPUT_QUANTITY Id_0x00 4 0 3 MAX_GRAD 100.0 FIX_AXIS_PAR_DIST 0 1 4 /end AXIS_DESCR
/end CHARACTERISTIC
/begin CHARACTERISTIC FTCMCCS_LutM0CtrlTrC "FTCMCCS_LutM0CtrlTrC" CURVE 0x80061EB0 DATA_RECORD_FLOAT32_IEEE 999.9999 F_1_p0_53 0.0001 1000
 /begin AXIS_DESCR FIX_AXIS NO_INPUT_QUANTITY Id_0x00 3 0 2 MAX_GRAD 100.0 FIX_AXIS_PAR_DIST 0 1 3 /end AXIS_DESCR
/end CHARACTERISTIC
/begin CHARACTERISTIC FTCMCCS_LutOutM1dCtrlTrGC "FTCMCCS_LutOutM1dCtrlTrGC" MAP 0x80061DA0 DATA_RECORD_FLOAT32_IEEE 3.402823466E+038 F_1_p0_4 -3.402823466E+038 3.402823466E+038
 /begin AXIS_DESCR FIX_AXIS NO_INPUT_QUANTITY Id_0x00 4 0 3 MAX_GRAD 100.0 FIX_AXIS_PAR_DIST 0 1 4 /end AXIS_DESCR
 /begin AXIS_DESCR FIX_AXIS NO_INPUT_QUANTITY Id_0x00 17 0 16 MAX_GRAD 100.0 FIX_AXIS_PAR_DIST 0 1 17 /end AXIS_DESCR
/end CHARACTERISTIC
/begin CHARACTERISTIC FTCMCCS_LutOutM1dCtrlTrMC "FTCMCCS_LutOutM1dCtrlTrMC" MAP 0x80061C90 DATA_RECORD_FLOAT32_IEEE 3.402823466E+038 F_1_p0_4 -3.402823466E+038 3.402823466E+038
 /begin AXIS_DESCR FIX_AXIS NO_INPUT_QUANTITY Id_0x00 4 0 3 MAX_GRAD 100.0 FIX_AXIS_PAR_DIST 0 1 4 /end AXIS_DESCR
 /begin AXIS_DESCR FIX_AXIS NO_INPUT_QUANTITY Id_0x00 17 0 16 MAX_GRAD 100.0 FIX_AXIS_PAR_DIST 0 1 17 /end AXIS_DESCR
/end CHARACTERISTIC
/begin CHARACTERISTIC FTCMCCS_LutOutM1qCtrlTrGC "FTCMCCS_LutOutM1qCtrlTrGC" MAP 0x80061B80 DATA_RECORD_FLOAT32_IEEE 3.402823466E+038 F_1_p0_4 -3.402823466E+038 3.402823466E+038
 /begin AXIS_DESCR FIX_AXIS NO_INPUT_QUANTITY Id_0x00 4 0 3 MAX_GRAD 100.0 FIX_AXIS_PAR_DIST 0 1 4 /end AXIS_DESCR
 /begin AXIS_DESCR FIX_AXIS NO_INPUT_QUANTITY Id_0x00 17 0 16 MAX_GRAD 100.0 FIX_AXIS_PAR_DIST 0 1 17 /end AXIS_DESCR
/end CHARACTERISTIC
/begin CHARACTERISTIC FTCMCCS_LutOutM1qCtrlTrMC "FTCMCCS_LutOutM1qCtrlTrMC" MAP 0x80061A70 DATA_RECORD_FLOAT32_IEEE 3.402823466E+038 F_1_p0_4 -3.402823466E+038 3.402823466E+038
 /begin AXIS_DESCR FIX_AXIS NO_INPUT_QUANTITY Id_0x00 4 0 3 MAX_GRAD 100.0 FIX_AXIS_PAR_DIST 0 1 4 /end AXIS_DESCR
 /begin AXIS_DESCR FIX_AXIS NO_INPUT_QUANTITY Id_0x00 17 0 16 MAX_GRAD 100.0 FIX_AXIS_PAR_DIST 0 1 17 /end AXIS_DESCR
/end CHARACTERISTIC
/begin CHARACTERISTIC FTCMCCS_M1dCtrlTrC "FTCMCCS_M1dCtrlTrC" VALUE 0x80061A6C DATA_RECORD_FLOAT32_IEEE 999.9999 F_1_p0_53 0.0001 1000 /end CHARACTERISTIC
/begin CHARACTERISTIC FTCMCCS_M1qCtrlTrC "FTCMCCS_M1qCtrlTrC" VALUE 0x80061A68 DATA_RECORD_FLOAT32_IEEE 999.9999 F_1_p0_53 0.0001 1000 /end CHARACTERISTIC
/begin CHARACTERISTIC FTCMCCS_PhimC "FTCMCCS_PhimC" VALUE 0x80061A64 DATA_RECORD_FLOAT32_IEEE 3.402823466E+038 F_1_p0_4 -3.402823466E+038 3.402823466E+038 /end CHARACTERISTIC
/begin CHARACTERISTIC FTCMCCS_RsC "FTCMCCS_RsC" VALUE 0x80061A60 DATA_RECORD_FLOAT32_IEEE 3.402823466E+038 F_1_p0_61 -3.402823466E+038 3.402823466E+038 /end CHARACTERISTIC
/begin CHARACTERISTIC FTCMCCS_SampleTimeFactC "FTCMCCS_SampleTimeFactC" VALUE 0x80061A5C DATA_RECORD_FLOAT32_IEEE 3.402823466E+038 F_1_p0_4 -3.402823466E+038 3.402823466E+038 /end CHARACTERISTIC
/begin CHARACTERISTIC FTCMCCS_TransEmfM1dGainC "FTCMCCS_TransEmfM1dGainC" VALUE 0x80061A58 DATA_RECORD_FLOAT32_IEEE 3.402823466E+038 F_1_p0_4 -3.402823466E+038 3.402823466E+038 /end CHARACTERISTIC
/begin CHARACTERISTIC FTCMCCS_TransEmfM1qGainC "FTCMCCS_TransEmfM1qGainC" VALUE 0x80061A54 DATA_RECORD_FLOAT32_IEEE 3.402823466E+038 F_1_p0_4 -3.402823466E+038 3.402823466E+038 /end CHARACTERISTIC
/begin CHARACTERISTIC FTCMCCS_VariableLm1dOnOffC "FTCMCCS_VariableLm1dOnOffC" VALUE 0x80061A50 DATA_RECORD_UBYTE 1 Bool_ON_OFF 0 1 BIT_MASK 0x01 /end CHARACTERISTIC
/begin CHARACTERISTIC FTCMCCS_VariableLm1qOnOffC "FTCMCCS_VariableLm1qOnOffC" VALUE 0x80061A4C DATA_RECORD_UBYTE 1 Bool_ON_OFF 0 1 BIT_MASK 0x01 /end CHARACTERISTIC
/begin CHARACTERISTIC FTCMCCS_VariablePhimOnOffC "FTCMCCS_VariablePhimOnOffC" VALUE 0x80061A48 DATA_RECORD_UBYTE 1 Bool_ON_OFF 0 1 BIT_MASK 0x01 /end CHARACTERISTIC
/begin CHARACTERISTIC FTCMCCS_iM1dTgtFildTrC "FTCMCCS_iM1dTgtFildTrC" VALUE 0x80061A44 DATA_RECORD_FLOAT32_IEEE 999.9999 F_1_p0_53 0.0001 1000 /end CHARACTERISTIC
/begin CHARACTERISTIC FTCMCCS_iM1qTgtFildTrC "FTCMCCS_iM1qTgtFildTrC" VALUE 0x80061A40 DATA_RECORD_FLOAT32_IEEE 999.9999 F_1_p0_53 0.0001 1000 /end CHARACTERISTIC
/begin CHARACTERISTIC FTCMCTC_CoggingCompGainC "FTCMCTC_CoggingCompGainC" VALUE 0x80061F3C DATA_RECORD_FLOAT32_IEEE 3.402823466E+038 F_1_p0_4 -3.402823466E+038 3.402823466E+038 /end CHARACTERISTIC
/begin CHARACTERISTIC FTCMCTC_CoggingCompOnOffC "FTCMCTC_CoggingCompOnOffC" VALUE 0x80061F38 DATA_RECORD_UBYTE 1 Bool_ON_OFF 0 1 BIT_MASK 0x01 /end CHARACTERISTIC
/begin CHARACTERISTIC FTCMCTC_CoggingPhaseRdC "FTCMCTC_CoggingPhaseRdC" VALUE 0x80061F34 DATA_RECORD_FLOAT32_IEEE 3.402823466E+038 F_1_p0_62 -3.402823466E+038 3.402823466E+038 /end CHARACTERISTIC
/begin CHARACTERISTIC FTCMCTC_H3CurrentOnOffC "FTCMCTC_H3CurrentOnOffC" VALUE 0x80061F30 DATA_RECORD_UBYTE 1 Bool_ON_OFF 0 1 BIT_MASK 0x01 /end CHARACTERISTIC
/begin CHARACTERISTIC FTCMCTC_H3CurrentRatioC "FTCMCTC_H3CurrentRatioC" VALUE 0x80061F2C DATA_RECORD_FLOAT32_IEEE 3.402823466E+038 F_1_p0_4 -3.402823466E+038 3.402823466E+038 /end CHARACTERISTIC
/begin CHARACTERISTIC FTCMCTC_LutCoggingCompGainC "FTCMCTC_LutCoggingCompGainC" CURVE 0x80061F20 DATA_RECORD_FLOAT32_IEEE 3.402823466E+038 F_1_p0_4 -3.402823466E+038 3.402823466E+038
 /begin AXIS_DESCR FIX_AXIS NO_INPUT_QUANTITY Id_0x00 3 0 2 MAX_GRAD 100.0 FIX_AXIS_PAR_DIST 0 1 3 /end AXIS_DESCR
/end CHARACTERISTIC
/begin CHARACTERISTIC FTCMCTC_LutElecSpeedRds2C "FTCMCTC_LutElecSpeedRds2C" CURVE 0x80061F14 DATA_RECORD_FLOAT32_IEEE 3.402823466E+038 F_1_p0_4 -3.402823466E+038 3.402823466E+038
 /begin AXIS_DESCR FIX_AXIS NO_INPUT_QUANTITY Id_0x00 3 0 2 MAX_GRAD 100.0 FIX_AXIS_PAR_DIST 0 1 3 /end AXIS_DESCR
/end CHARACTERISTIC
/begin CHARACTERISTIC FTCMCTC_LutElecSpeedRdsC "FTCMCTC_LutElecSpeedRdsC" CURVE 0x80061F08 DATA_RECORD_FLOAT32_IEEE 3.402823466E+038 F_1_p0_4 -3.402823466E+038 3.402823466E+038
 /begin AXIS_DESCR FIX_AXIS NO_INPUT_QUANTITY Id_0x00 3 0 2 MAX_GRAD 100.0 FIX_AXIS_PAR_DIST 0 1 3 /end AXIS_DESCR
/end CHARACTERISTIC
/begin CHARACTERISTIC FTCMCTC_LutH3CompGainC "FTCMCTC_LutH3CompGainC" CURVE 0x80061EFC DATA_RECORD_FLOAT32_IEEE 3.402823466E+038 F_1_p0_4 -3.402823466E+038 3.402823466E+038
 /begin AXIS_DESCR FIX_AXIS NO_INPUT_QUANTITY Id_0x00 3 0 2 MAX_GRAD 100.0 FIX_AXIS_PAR_DIST 0 1 3 /end AXIS_DESCR
/end CHARACTERISTIC
/begin CHARACTERISTIC FTCMCTC_SpyThresholdC "FTCMCTC_SpyThresholdC" VALUE 0x80061EF8 DATA_RECORD_FLOAT32_IEEE 3.402823466E+038 F_1_p0_46 -3.402823466E+038 3.402823466E+038 /end CHARACTERISTIC
/begin CHARACTERISTIC FTCMHIJ_24IdEnableC "FTCMHIJ_24IdEnableC" VALUE 0x800639A8 DATA_RECORD_UBYTE 1 Bool_ON_OFF 0 1 BIT_MASK 0x01 /end CHARACTERISTIC
/begin CHARACTERISTIC FTCMHIJ_24IqEnableC "FTCMHIJ_24IqEnableC" VALUE 0x800639A4 DATA_RECORD_UBYTE 1 Bool_ON_OFF 0 1 BIT_MASK 0x01 /end CHARACTERISTIC
/begin CHARACTERISTIC FTCMHIJ_24thTimesIdC "FTCMHIJ_24thTimesIdC" VALUE 0x800639A0 DATA_RECORD_FLOAT32_IEEE 3.402823466E+038 F_1_p0_4 -3.402823466E+038 3.402823466E+038 /end CHARACTERISTIC
/begin CHARACTERISTIC FTCMHIJ_24thTimesIqC "FTCMHIJ_24thTimesIqC" VALUE 0x8006399C DATA_RECORD_FLOAT32_IEEE 3.402823466E+038 F_1_p0_4 -3.402823466E+038 3.402823466E+038 /end CHARACTERISTIC
/begin CHARACTERISTIC FTCMHIJ_HijCurrentOnOffC "FTCMHIJ_HijCurrentOnOffC" VALUE 0x80063998 DATA_RECORD_UBYTE 1 Bool_ON_OFF 0 1 BIT_MASK 0x01 /end CHARACTERISTIC
/begin CHARACTERISTIC FTCMHIJ_HijMecaSpdRpmMaxC "speed greater than this value ,stop HIJ" VALUE 0x80063994 DATA_RECORD_FLOAT32_IEEE 3.402823466E+038 F_1_p0_4 -3.402823466E+038 3.402823466E+038 /end CHARACTERISTIC
/begin CHARACTERISTIC FTCMHIJ_IdqMaxLmtC "FTCMHIJ_IdqMaxLmtC" VALUE 0x80063990 DATA_RECORD_FLOAT32_IEEE 3.402823466E+038 F_1_p0_4 -3.402823466E+038 3.402823466E+038 /end CHARACTERISTIC
/begin CHARACTERISTIC FTCMHIJ_IdqMinLmtC "FTCMHIJ_IdqMinLmtC" VALUE 0x8006398C DATA_RECORD_FLOAT32_IEEE 3.402823466E+038 F_1_p0_4 -3.402823466E+038 3.402823466E+038 /end CHARACTERISTIC
/begin CHARACTERISTIC FTCMHIJ_LutInSpeed24C "FTCMHIJ_LutInSpeed24C" CURVE 0x8006395C DATA_RECORD_FLOAT32_IEEE 3.402823466E+038 F_1_p0_4 -3.402823466E+038 3.402823466E+038
 /begin AXIS_DESCR FIX_AXIS NO_INPUT_QUANTITY Id_0x00 12 0 11 MAX_GRAD 100.0 FIX_AXIS_PAR_DIST 0 1 12 /end AXIS_DESCR
/end CHARACTERISTIC
/begin CHARACTERISTIC FTCMHIJ_LutInSpeed6dC "FTCMHIJ_LutInSpeed6dC" CURVE 0x8006392C DATA_RECORD_FLOAT32_IEEE 3.402823466E+038 F_1_p0_4 -3.402823466E+038 3.402823466E+038
 /begin AXIS_DESCR FIX_AXIS NO_INPUT_QUANTITY Id_0x00 12 0 11 MAX_GRAD 100.0 FIX_AXIS_PAR_DIST 0 1 12 /end AXIS_DESCR
/end CHARACTERISTIC
/begin CHARACTERISTIC FTCMHIJ_LutInSpeedC "FTCMHIJ_LutInSpeedC" CURVE 0x80063908 DATA_RECORD_FLOAT32_IEEE 3.402823466E+038 F_1_p0_4 -3.402823466E+038 3.402823466E+038
 /begin AXIS_DESCR FIX_AXIS NO_INPUT_QUANTITY Id_0x00 9 0 8 MAX_GRAD 100.0 FIX_AXIS_PAR_DIST 0 1 9 /end AXIS_DESCR
/end CHARACTERISTIC
/begin CHARACTERISTIC FTCMHIJ_LutInSpeedPhaseIdC "FTCMHIJ_LutInSpeedPhaseIdC" CURVE 0x800638CC DATA_RECORD_FLOAT32_IEEE 3.402823466E+038 F_1_p0_4 -3.402823466E+038 3.402823466E+038
 /begin AXIS_DESCR FIX_AXIS NO_INPUT_QUANTITY Id_0x00 15 0 14 MAX_GRAD 100.0 FIX_AXIS_PAR_DIST 0 1 15 /end AXIS_DESCR
/end CHARACTERISTIC
/begin CHARACTERISTIC FTCMHIJ_LutInSpeedPhaseIqC "FTCMHIJ_LutInSpeedPhaseIqC" CURVE 0x80063890 DATA_RECORD_FLOAT32_IEEE 3.402823466E+038 F_1_p0_4 -3.402823466E+038 3.402823466E+038
 /begin AXIS_DESCR FIX_AXIS NO_INPUT_QUANTITY Id_0x00 15 0 14 MAX_GRAD 100.0 FIX_AXIS_PAR_DIST 0 1 15 /end AXIS_DESCR
/end CHARACTERISTIC
/begin CHARACTERISTIC FTCMHIJ_LutInTorque24C "FTCMHIJ_LutInTorque24C" CURVE 0x80063864 DATA_RECORD_FLOAT32_IEEE 3.402823466E+038 F_1_p0_4 -3.402823466E+038 3.402823466E+038
 /begin AXIS_DESCR FIX_AXIS NO_INPUT_QUANTITY Id_0x00 11 0 10 MAX_GRAD 100.0 FIX_AXIS_PAR_DIST 0 1 11 /end AXIS_DESCR
/end CHARACTERISTIC
/begin CHARACTERISTIC FTCMHIJ_LutInTorqueC "FTCMHIJ_LutInTorqueC" CURVE 0x80063838 DATA_RECORD_FLOAT32_IEEE 3.402823466E+038 F_1_p0_4 -3.402823466E+038 3.402823466E+038
 /begin AXIS_DESCR FIX_AXIS NO_INPUT_QUANTITY Id_0x00 11 0 10 MAX_GRAD 100.0 FIX_AXIS_PAR_DIST 0 1 11 /end AXIS_DESCR
/end CHARACTERISTIC
/begin CHARACTERISTIC FTCMHIJ_LutInTorqueGen24C "FTCMHIJ_LutInTorqueGen24C" CURVE 0x80063820 DATA_RECORD_FLOAT32_IEEE 3.402823466E+038 F_1_p0_4 -3.402823466E+038 3.402823466E+038
 /begin AXIS_DESCR FIX_AXIS NO_INPUT_QUANTITY Id_0x00 6 0 5 MAX_GRAD 100.0 FIX_AXIS_PAR_DIST 0 1 6 /end AXIS_DESCR
/end CHARACTERISTIC
/begin CHARACTERISTIC FTCMHIJ_LutInTorqueGenC "FTCMHIJ_LutInTorqueGenC" CURVE 0x80063808 DATA_RECORD_FLOAT32_IEEE 3.402823466E+038 F_1_p0_4 -3.402823466E+038 3.402823466E+038
 /begin AXIS_DESCR FIX_AXIS NO_INPUT_QUANTITY Id_0x00 6 0 5 MAX_GRAD 100.0 FIX_AXIS_PAR_DIST 0 1 6 /end AXIS_DESCR
/end CHARACTERISTIC
/begin CHARACTERISTIC FTCMHIJ_LutOut24thPhaseIdC "FTCMHIJ_LutOut24thPhaseIdC" MAP 0x800635F8 DATA_RECORD_FLOAT32_IEEE 3.402823466E+038 F_1_p0_4 -3.402823466E+038 3.402823466E+038
 /begin AXIS_DESCR FIX_AXIS NO_INPUT_QUANTITY Id_0x00 11 0 10 MAX_GRAD 100.0 FIX_AXIS_PAR_DIST 0 1 11 /end AXIS_DESCR
 /begin AXIS_DESCR FIX_AXIS NO_INPUT_QUANTITY Id_0x00 12 0 11 MAX_GRAD 100.0 FIX_AXIS_PAR_DIST 0 1 12 /end AXIS_DESCR
/end CHARACTERISTIC
/begin CHARACTERISTIC FTCMHIJ_LutOut24thPhaseIdGenC "FTCMHIJ_LutOut24thPhaseIdGenC" MAP 0x800634D8 DATA_RECORD_FLOAT32_IEEE 3.402823466E+038 F_1_p0_4 -3.402823466E+038 3.402823466E+038
 /begin AXIS_DESCR FIX_AXIS NO_INPUT_QUANTITY Id_0x00 6 0 5 MAX_GRAD 100.0 FIX_AXIS_PAR_DIST 0 1 6 /end AXIS_DESCR
 /begin AXIS_DESCR FIX_AXIS NO_INPUT_QUANTITY Id_0x00 12 0 11 MAX_GRAD 100.0 FIX_AXIS_PAR_DIST 0 1 12 /end AXIS_DESCR
/end CHARACTERISTIC
/begin CHARACTERISTIC FTCMHIJ_LutOut24thPhaseIqC "FTCMHIJ_LutOut24thPhaseIqC" MAP 0x800632C8 DATA_RECORD_FLOAT32_IEEE 3.402823466E+038 F_1_p0_4 -3.402823466E+038 3.402823466E+038
 /begin AXIS_DESCR FIX_AXIS NO_INPUT_QUANTITY Id_0x00 11 0 10 MAX_GRAD 100.0 FIX_AXIS_PAR_DIST 0 1 11 /end AXIS_DESCR
 /begin AXIS_DESCR FIX_AXIS NO_INPUT_QUANTITY Id_0x00 12 0 11 MAX_GRAD 100.0 FIX_AXIS_PAR_DIST 0 1 12 /end AXIS_DESCR
/end CHARACTERISTIC
/begin CHARACTERISTIC FTCMHIJ_LutOut24thPhaseIqGenC "FTCMHIJ_LutOut24thPhaseIqGenC" MAP 0x800631A8 DATA_RECORD_FLOAT32_IEEE 3.402823466E+038 F_1_p0_4 -3.402823466E+038 3.402823466E+038
 /begin AXIS_DESCR FIX_AXIS NO_INPUT_QUANTITY Id_0x00 6 0 5 MAX_GRAD 100.0 FIX_AXIS_PAR_DIST 0 1 6 /end AXIS_DESCR
 /begin AXIS_DESCR FIX_AXIS NO_INPUT_QUANTITY Id_0x00 12 0 11 MAX_GRAD 100.0 FIX_AXIS_PAR_DIST 0 1 12 /end AXIS_DESCR
/end CHARACTERISTIC
/begin CHARACTERISTIC FTCMHIJ_LutOutBaseMagnitude12IdC "FTCMHIJ_LutOutBaseMagnitude12IdC" CURVE 0x80063184 DATA_RECORD_FLOAT32_IEEE 3.402823466E+038 F_1_p0_4 -3.402823466E+038 3.402823466E+038
 /begin AXIS_DESCR FIX_AXIS NO_INPUT_QUANTITY Id_0x00 9 0 8 MAX_GRAD 100.0 FIX_AXIS_PAR_DIST 0 1 9 /end AXIS_DESCR
/end CHARACTERISTIC
/begin CHARACTERISTIC FTCMHIJ_LutOutBaseMagnitude12IqC "FTCMHIJ_LutOutBaseMagnitude12IqC" MAP 0x80062FF8 DATA_RECORD_FLOAT32_IEEE 3.402823466E+038 F_1_p0_4 -3.402823466E+038 3.402823466E+038
 /begin AXIS_DESCR FIX_AXIS NO_INPUT_QUANTITY Id_0x00 11 0 10 MAX_GRAD 100.0 FIX_AXIS_PAR_DIST 0 1 11 /end AXIS_DESCR
 /begin AXIS_DESCR FIX_AXIS NO_INPUT_QUANTITY Id_0x00 9 0 8 MAX_GRAD 100.0 FIX_AXIS_PAR_DIST 0 1 9 /end AXIS_DESCR
/end CHARACTERISTIC
/begin CHARACTERISTIC FTCMHIJ_LutOutBaseMagnitude12IqGenC "FTCMHIJ_LutOutBaseMagnitude12IqGenC" MAP 0x80062F20 DATA_RECORD_FLOAT32_IEEE 3.402823466E+038 F_1_p0_4 -3.402823466E+038 3.402823466E+038
 /begin AXIS_DESCR FIX_AXIS NO_INPUT_QUANTITY Id_0x00 6 0 5 MAX_GRAD 100.0 FIX_AXIS_PAR_DIST 0 1 6 /end AXIS_DESCR
 /begin AXIS_DESCR FIX_AXIS NO_INPUT_QUANTITY Id_0x00 9 0 8 MAX_GRAD 100.0 FIX_AXIS_PAR_DIST 0 1 9 /end AXIS_DESCR
/end CHARACTERISTIC
/begin CHARACTERISTIC FTCMHIJ_LutOutBaseMagnitude24IdC "FTCMHIJ_LutOutBaseMagnitude24IdC" MAP 0x80062D10 DATA_RECORD_FLOAT32_IEEE 3.402823466E+038 F_1_p0_4 -3.402823466E+038 3.402823466E+038
 /begin AXIS_DESCR FIX_AXIS NO_INPUT_QUANTITY Id_0x00 11 0 10 MAX_GRAD 100.0 FIX_AXIS_PAR_DIST 0 1 11 /end AXIS_DESCR
 /begin AXIS_DESCR FIX_AXIS NO_INPUT_QUANTITY Id_0x00 12 0 11 MAX_GRAD 100.0 FIX_AXIS_PAR_DIST 0 1 12 /end AXIS_DESCR
/end CHARACTERISTIC
/begin CHARACTERISTIC FTCMHIJ_LutOutBaseMagnitude24IdGenC "FTCMHIJ_LutOutBaseMagnitude24IdGenC" MAP 0x80062BF0 DATA_RECORD_FLOAT32_IEEE 3.402823466E+038 F_1_p0_4 -3.402823466E+038 3.402823466E+038
 /begin AXIS_DESCR FIX_AXIS NO_INPUT_QUANTITY Id_0x00 6 0 5 MAX_GRAD 100.0 FIX_AXIS_PAR_DIST 0 1 6 /end AXIS_DESCR
 /begin AXIS_DESCR FIX_AXIS NO_INPUT_QUANTITY Id_0x00 12 0 11 MAX_GRAD 100.0 FIX_AXIS_PAR_DIST 0 1 12 /end AXIS_DESCR
/end CHARACTERISTIC
/begin CHARACTERISTIC FTCMHIJ_LutOutBaseMagnitude24IqC "FTCMHIJ_LutOutBaseMagnitude24IqC" MAP 0x800629E0 DATA_RECORD_FLOAT32_IEEE 3.402823466E+038 F_1_p0_4 -3.402823466E+038 3.402823466E+038
 /begin AXIS_DESCR FIX_AXIS NO_INPUT_QUANTITY Id_0x00 11 0 10 MAX_GRAD 100.0 FIX_AXIS_PAR_DIST 0 1 11 /end AXIS_DESCR
 /begin AXIS_DESCR FIX_AXIS NO_INPUT_QUANTITY Id_0x00 12 0 11 MAX_GRAD 100.0 FIX_AXIS_PAR_DIST 0 1 12 /end AXIS_DESCR
/end CHARACTERISTIC
/begin CHARACTERISTIC FTCMHIJ_LutOutBaseMagnitude24IqGenC "FTCMHIJ_LutOutBaseMagnitude24IqGenC" MAP 0x800628C0 DATA_RECORD_FLOAT32_IEEE 3.402823466E+038 F_1_p0_4 -3.402823466E+038 3.402823466E+038
 /begin AXIS_DESCR FIX_AXIS NO_INPUT_QUANTITY Id_0x00 6 0 5 MAX_GRAD 100.0 FIX_AXIS_PAR_DIST 0 1 6 /end AXIS_DESCR
 /begin AXIS_DESCR FIX_AXIS NO_INPUT_QUANTITY Id_0x00 12 0 11 MAX_GRAD 100.0 FIX_AXIS_PAR_DIST 0 1 12 /end AXIS_DESCR
/end CHARACTERISTIC
/begin CHARACTERISTIC FTCMHIJ_LutOutBaseMagnitude6IdC "FTCMHIJ_LutOutBaseMagnitude6IdC" MAP 0x800626B0 DATA_RECORD_FLOAT32_IEEE 3.402823466E+038 F_1_p0_4 -3.402823466E+038 3.402823466E+038
 /begin AXIS_DESCR FIX_AXIS NO_INPUT_QUANTITY Id_0x00 11 0 10 MAX_GRAD 100.0 FIX_AXIS_PAR_DIST 0 1 11 /end AXIS_DESCR
 /begin AXIS_DESCR FIX_AXIS NO_INPUT_QUANTITY Id_0x00 12 0 11 MAX_GRAD 100.0 FIX_AXIS_PAR_DIST 0 1 12 /end AXIS_DESCR
/end CHARACTERISTIC
/begin CHARACTERISTIC FTCMHIJ_LutOutBaseMagnitude6IdGenC "FTCMHIJ_LutOutBaseMagnitude6IdGenC" MAP 0x80062590 DATA_RECORD_FLOAT32_IEEE 3.402823466E+038 F_1_p0_4 -3.402823466E+038 3.402823466E+038
 /begin AXIS_DESCR FIX_AXIS NO_INPUT_QUANTITY Id_0x00 6 0 5 MAX_GRAD 100.0 FIX_AXIS_PAR_DIST 0 1 6 /end AXIS_DESCR
 /begin AXIS_DESCR FIX_AXIS NO_INPUT_QUANTITY Id_0x00 12 0 11 MAX_GRAD 100.0 FIX_AXIS_PAR_DIST 0 1 12 /end AXIS_DESCR
/end CHARACTERISTIC
/begin CHARACTERISTIC FTCMHIJ_LutOutBaseMagnitude6IqC "FTCMHIJ_LutOutBaseMagnitude6IqC" CURVE 0x8006256C DATA_RECORD_FLOAT32_IEEE 3.402823466E+038 F_1_p0_4 -3.402823466E+038 3.402823466E+038
 /begin AXIS_DESCR FIX_AXIS NO_INPUT_QUANTITY Id_0x00 9 0 8 MAX_GRAD 100.0 FIX_AXIS_PAR_DIST 0 1 9 /end AXIS_DESCR
/end CHARACTERISTIC
/begin CHARACTERISTIC FTCMHIJ_LutOutSixthPhaseIdC "FTCMHIJ_LutOutSixthPhaseIdC" MAP 0x8006235C DATA_RECORD_FLOAT32_IEEE 3.402823466E+038 F_1_p0_4 -3.402823466E+038 3.402823466E+038
 /begin AXIS_DESCR FIX_AXIS NO_INPUT_QUANTITY Id_0x00 11 0 10 MAX_GRAD 100.0 FIX_AXIS_PAR_DIST 0 1 11 /end AXIS_DESCR
 /begin AXIS_DESCR FIX_AXIS NO_INPUT_QUANTITY Id_0x00 12 0 11 MAX_GRAD 100.0 FIX_AXIS_PAR_DIST 0 1 12 /end AXIS_DESCR
/end CHARACTERISTIC
/begin CHARACTERISTIC FTCMHIJ_LutOutSixthPhaseIdGenC "FTCMHIJ_LutOutSixthPhaseIdGenC" MAP 0x8006223C DATA_RECORD_FLOAT32_IEEE 3.402823466E+038 F_1_p0_4 -3.402823466E+038 3.402823466E+038
 /begin AXIS_DESCR FIX_AXIS NO_INPUT_QUANTITY Id_0x00 6 0 5 MAX_GRAD 100.0 FIX_AXIS_PAR_DIST 0 1 6 /end AXIS_DESCR
 /begin AXIS_DESCR FIX_AXIS NO_INPUT_QUANTITY Id_0x00 12 0 11 MAX_GRAD 100.0 FIX_AXIS_PAR_DIST 0 1 12 /end AXIS_DESCR
/end CHARACTERISTIC
/begin CHARACTERISTIC FTCMHIJ_LutOutSixthPhaseIqC "FTCMHIJ_LutOutSixthPhaseIqC" CURVE 0x80062200 DATA_RECORD_FLOAT32_IEEE 3.402823466E+038 F_1_p0_4 -3.402823466E+038 3.402823466E+038
 /begin AXIS_DESCR FIX_AXIS NO_INPUT_QUANTITY Id_0x00 15 0 14 MAX_GRAD 100.0 FIX_AXIS_PAR_DIST 0 1 15 /end AXIS_DESCR
/end CHARACTERISTIC
/begin CHARACTERISTIC FTCMHIJ_LutOutTwelfthPhaseIdC "FTCMHIJ_LutOutTwelfthPhaseIdC" CURVE 0x800621C4 DATA_RECORD_FLOAT32_IEEE 3.402823466E+038 F_1_p0_4 -3.402823466E+038 3.402823466E+038
 /begin AXIS_DESCR FIX_AXIS NO_INPUT_QUANTITY Id_0x00 15 0 14 MAX_GRAD 100.0 FIX_AXIS_PAR_DIST 0 1 15 /end AXIS_DESCR
/end CHARACTERISTIC
/begin CHARACTERISTIC FTCMHIJ_LutOutTwelfthPhaseIqC "FTCMHIJ_LutOutTwelfthPhaseIqC" MAP 0x80062038 DATA_RECORD_FLOAT32_IEEE 3.402823466E+038 F_1_p0_4 -3.402823466E+038 3.402823466E+038
 /begin AXIS_DESCR FIX_AXIS NO_INPUT_QUANTITY Id_0x00 11 0 10 MAX_GRAD 100.0 FIX_AXIS_PAR_DIST 0 1 11 /end AXIS_DESCR
 /begin AXIS_DESCR FIX_AXIS NO_INPUT_QUANTITY Id_0x00 9 0 8 MAX_GRAD 100.0 FIX_AXIS_PAR_DIST 0 1 9 /end AXIS_DESCR
/end CHARACTERISTIC
/begin CHARACTERISTIC FTCMHIJ_LutOutTwelfthPhaseIqGenC "FTCMHIJ_LutOutTwelfthPhaseIqGenC" MAP 0x80061F60 DATA_RECORD_FLOAT32_IEEE 3.402823466E+038 F_1_p0_4 -3.402823466E+038 3.402823466E+038
 /begin AXIS_DESCR FIX_AXIS NO_INPUT_QUANTITY Id_0x00 6 0 5 MAX_GRAD 100.0 FIX_AXIS_PAR_DIST 0 1 6 /end AXIS_DESCR
 /begin AXIS_DESCR FIX_AXIS NO_INPUT_QUANTITY Id_0x00 9 0 8 MAX_GRAD 100.0 FIX_AXIS_PAR_DIST 0 1 9 /end AXIS_DESCR
/end CHARACTERISTIC
/begin CHARACTERISTIC FTCMHIJ_SixIdEnableC "FTCMHIJ_SixIdEnableC" VALUE 0x80061F5C DATA_RECORD_UBYTE 1 Bool_ON_OFF 0 1 BIT_MASK 0x01 /end CHARACTERISTIC
/begin CHARACTERISTIC FTCMHIJ_SixIqEnableC "FTCMHIJ_SixIqEnableC" VALUE 0x80061F58 DATA_RECORD_UBYTE 1 Bool_ON_OFF 0 1 BIT_MASK 0x01 /end CHARACTERISTIC
/begin CHARACTERISTIC FTCMHIJ_SixTimesIdC "FTCMHIJ_SixTimesIdC" VALUE 0x80061F54 DATA_RECORD_FLOAT32_IEEE 3.402823466E+038 F_1_p0_4 -3.402823466E+038 3.402823466E+038 /end CHARACTERISTIC
/begin CHARACTERISTIC FTCMHIJ_SixTimesIqC "FTCMHIJ_SixTimesIqC" VALUE 0x80061F50 DATA_RECORD_FLOAT32_IEEE 3.402823466E+038 F_1_p0_4 -3.402823466E+038 3.402823466E+038 /end CHARACTERISTIC
/begin CHARACTERISTIC FTCMHIJ_TwelveIdEnableC "FTCMHIJ_TwelveIdEnableC" VALUE 0x80061F4C DATA_RECORD_UBYTE 1 Bool_ON_OFF 0 1 BIT_MASK 0x01 /end CHARACTERISTIC
/begin CHARACTERISTIC FTCMHIJ_TwelveIqEnableC "FTCMHIJ_TwelveIqEnableC" VALUE 0x80061F48 DATA_RECORD_UBYTE 1 Bool_ON_OFF 0 1 BIT_MASK 0x01 /end CHARACTERISTIC
/begin CHARACTERISTIC FTCMHIJ_TwelveTimesIdC "FTCMHIJ_TwelveTimesIdC" VALUE 0x80061F44 DATA_RECORD_FLOAT32_IEEE 3.402823466E+038 F_1_p0_4 -3.402823466E+038 3.402823466E+038 /end CHARACTERISTIC
/begin CHARACTERISTIC FTCMHIJ_TwelveTimesIqC "FTCMHIJ_TwelveTimesIqC" VALUE 0x80061F40 DATA_RECORD_FLOAT32_IEEE 3.402823466E+038 F_1_p0_4 -3.402823466E+038 3.402823466E+038 /end CHARACTERISTIC
/begin CHARACTERISTIC FTCMRPC_ConcordiaTrans33C "concordia transformation matrix" MAP 0x800639AC DATA_RECORD_FLOAT32_IEEE 3.402823466E+038 F_1_p0_55 -3.402823466E+038 3.402823466E+038
 /begin AXIS_DESCR FIX_AXIS NO_INPUT_QUANTITY Id_0x00 3 0 2 MAX_GRAD 100.0 FIX_AXIS_PAR_DIST 0 1 3 /end AXIS_DESCR
 /begin AXIS_DESCR FIX_AXIS NO_INPUT_QUANTITY Id_0x00 3 0 2 MAX_GRAD 100.0 FIX_AXIS_PAR_DIST 0 1 3 /end AXIS_DESCR
/end CHARACTERISTIC
/begin CHARACTERISTIC FTCMSCS_CtrlSatToC "FTCMSCS_CtrlSatToC" VALUE 0x800639F0 DATA_RECORD_FLOAT32_IEEE 3.402823466E+038 F_1_p0_66 -3.402823466E+038 3.402823466E+038 /end CHARACTERISTIC
/begin CHARACTERISTIC FTCMSCS_CtrlTrC "FTCMSCS_CtrlTrC" VALUE 0x800639EC DATA_RECORD_FLOAT32_IEEE 3.402823466E+038 F_1_p0_4 -3.402823466E+038 3.402823466E+038 /end CHARACTERISTIC
/begin CHARACTERISTIC FTCMSCS_InitalValueEnC "FTCMSCS_InitalValueEnC" VALUE 0x800639E8 DATA_RECORD_UBYTE 1 Bool_ON_OFF 0 1 BIT_MASK 0x01 /end CHARACTERISTIC
/begin CHARACTERISTIC FTCMSCS_SpdAccPerMsThrC "FTCMSCS_SpdAccPerMsThrC" VALUE 0x800639E4 DATA_RECORD_FLOAT32_IEEE 3.402823466E+038 F_1_p0_52 -3.402823466E+038 3.402823466E+038 /end CHARACTERISTIC
/begin CHARACTERISTIC FTCMSCS_SpdOvershootFaultC "FTCMSCS_SpdOvershootFaultC" VALUE 0x800639E0 DATA_RECORD_FLOAT32_IEEE 3.402823466E+038 F_1_p0_4 -3.402823466E+038 3.402823466E+038 /end CHARACTERISTIC
/begin CHARACTERISTIC FTCMSCS_ZeroSpdThrC "FTCMSCS_ZeroSpdThrC" VALUE 0x800639DC DATA_RECORD_FLOAT32_IEEE 3.402823466E+038 F_1_p0_52 -3.402823466E+038 3.402823466E+038 /end CHARACTERISTIC
/begin CHARACTERISTIC FTCMSCS_ZeroSpdTimoutC "FTCMSCS_ZeroSpdTimoutC" VALUE 0x800639D8 DATA_RECORD_FLOAT32_IEEE 3.402823466E+038 F_1_p0_66 -3.402823466E+038 3.402823466E+038 /end CHARACTERISTIC
/begin CHARACTERISTIC FTCMSCS_fC "FTCMSCS_fC" VALUE 0x800639D4 DATA_RECORD_FLOAT32_IEEE 3.402823466E+038 F_1_p0_4 -3.402823466E+038 3.402823466E+038 /end CHARACTERISTIC
/begin CHARACTERISTIC FTCMSCS_jC "FTCMSCS_jC" VALUE 0x800639D0 DATA_RECORD_FLOAT32_IEEE 3.402823466E+038 F_1_p0_4 -3.402823466E+038 3.402823466E+038 /end CHARACTERISTIC
/begin CHARACTERISTIC FTCMSTC_AccelNegRpmBySecondC "target max acceleration toward negative infinity" VALUE 0x800639F8 DATA_RECORD_FLOAT32_IEEE 3.402823466E+038 F_1_p0_67 -3.402823466E+038 3.402823466E+038 /end CHARACTERISTIC
/begin CHARACTERISTIC FTCMSTC_AccelPosRpmBySecondC "target max acceleration toward positive infinity" VALUE 0x800639F4 DATA_RECORD_FLOAT32_IEEE 3.402823466E+038 F_1_p0_67 -3.402823466E+038 3.402823466E+038 /end CHARACTERISTIC
/begin CHARACTERISTIC FTCMTCS_AccelPosRpmBySecondC "FTCMTCS_AccelPosRpmBySecondC" VALUE 0x80064260 DATA_RECORD_FLOAT32_IEEE 3.402823466E+038 F_1_p0_4 -3.402823466E+038 3.402823466E+038 /end CHARACTERISTIC
/begin CHARACTERISTIC FTCMTCS_AntiSlideEnaCountMaxC "FTCMTCS_AntiSlideEnaCountMaxC" VALUE 0x8006425C DATA_RECORD_SLONG 4294967295 F_1_p0_4 -2147483648 2147483647 /end CHARACTERISTIC
/begin CHARACTERISTIC FTCMTCS_AntiSlideEnableC "FTCMTCS_AntiSlideEnableC" VALUE 0x80064258 DATA_RECORD_UBYTE 1 Bool_ON_OFF 0 1 BIT_MASK 0x01 /end CHARACTERISTIC
/begin CHARACTERISTIC FTCMTCS_AntiSlideTorqueThrC "FTCMTCS_AntiSlideTorqueThrC" VALUE 0x80064254 DATA_RECORD_FLOAT32_IEEE 255 F_1_p0_4 0 255 /end CHARACTERISTIC
/begin CHARACTERISTIC FTCMTCS_BenchElecPowerMaxC "FTCMTCS_BenchElecPowerMaxC" VALUE 0x80064250 DATA_RECORD_FLOAT32_IEEE 3.402823466E+038 F_1_p0_69 -3.402823466E+038 3.402823466E+038 /end CHARACTERISTIC
/begin CHARACTERISTIC FTCMTCS_BenchElecTorqueMaxC "FTCMTCS_BenchElecTorqueMaxC" VALUE 0x8006424C DATA_RECORD_FLOAT32_IEEE 3.402823466E+038 F_1_p0_56 -3.402823466E+038 3.402823466E+038 /end CHARACTERISTIC
/begin CHARACTERISTIC FTCMTCS_CutOffFrequencySpdRpmC "FTCMTCS_CutOffFrequencySpdRpmC" VALUE 0x80064248 DATA_RECORD_FLOAT32_IEEE 3.402823466E+038 F_1_p0_4 -3.402823466E+038 3.402823466E+038 /end CHARACTERISTIC
/begin CHARACTERISTIC FTCMTCS_DivideTorqMinC "FTCMTCS_DivideTorqMinC" VALUE 0x80064244 DATA_RECORD_FLOAT32_IEEE 3.402823466E+038 F_1_p0_4 -3.402823466E+038 3.402823466E+038 /end CHARACTERISTIC
/begin CHARACTERISTIC FTCMTCS_EntrySlideCountMaxC "FTCMTCS_EntrySlideCountMaxC" VALUE 0x80064240 DATA_RECORD_SLONG 4294967295 F_1_p0_4 -2147483648 2147483647 /end CHARACTERISTIC
/begin CHARACTERISTIC FTCMTCS_ExtTorqueMaxMinC "FTCMTCS_ExtTorqueMaxMinC" CURVE 0x80064238 DATA_RECORD_FLOAT32_IEEE 3.402823466E+038 F_1_p0_56 -3.402823466E+038 3.402823466E+038
 /begin AXIS_DESCR FIX_AXIS NO_INPUT_QUANTITY Id_0x00 2 0 1 MAX_GRAD 100.0 FIX_AXIS_PAR_DIST 0 1 2 /end AXIS_DESCR
/end CHARACTERISTIC
/begin CHARACTERISTIC FTCMTCS_FluxControllerGainC "FTCMTCS_FluxControllerGainC" VALUE 0x80064234 DATA_RECORD_FLOAT32_IEEE 3.402823466E+038 F_1_p0_4 -3.402823466E+038 3.402823466E+038 /end CHARACTERISTIC
/begin CHARACTERISTIC FTCMTCS_FluxControllerGainKiC "FTCMTCS_FluxControllerGainKiC" VALUE 0x80064230 DATA_RECORD_FLOAT32_IEEE 3.402823466E+038 F_1_p0_4 -3.402823466E+038 3.402823466E+038 /end CHARACTERISTIC
/begin CHARACTERISTIC FTCMTCS_FluxControllerGainKpC "FTCMTCS_FluxControllerGainKpC" VALUE 0x8006422C DATA_RECORD_FLOAT32_IEEE 3.402823466E+038 F_1_p0_4 -3.402823466E+038 3.402823466E+038 /end CHARACTERISTIC
/begin CHARACTERISTIC FTCMTCS_FluxCtrPiEnableC "FTCMTCS_FluxCtrPiEnableC" VALUE 0x80064228 DATA_RECORD_UBYTE 1 Bool_ON_OFF 0 1 BIT_MASK 0x01 /end CHARACTERISTIC
/begin CHARACTERISTIC FTCMTCS_GainPhaseVoltagePeakC "FTCMTCS_GainPhaseVoltagePeakC" VALUE 0x80064224 DATA_RECORD_FLOAT32_IEEE 3.402823466E+038 F_1_p0_4 -3.402823466E+038 3.402823466E+038 /end CHARACTERISTIC
/begin CHARACTERISTIC FTCMTCS_GenTableTorqueThrdC "FTCMTCS_GenTableTorqueThrdC" VALUE 0x80064220 DATA_RECORD_FLOAT32_IEEE 3.402823466E+038 F_1_p0_4 -3.402823466E+038 3.402823466E+038 /end CHARACTERISTIC
/begin CHARACTERISTIC FTCMTCS_IdModeOnOffC "FTCMTCS_IdModeOnOffC" VALUE 0x8006421C DATA_RECORD_UBYTE 1 Bool_ON_OFF 0 1 BIT_MASK 0x01 /end CHARACTERISTIC
/begin CHARACTERISTIC FTCMTCS_IdentificationAngleDegC "FTCMTCS_IdentificationAngleDegC" VALUE 0x80064218 DATA_RECORD_FLOAT32_IEEE 3.402823466E+038 F_1_p0_4 -3.402823466E+038 3.402823466E+038 /end CHARACTERISTIC
/begin CHARACTERISTIC FTCMTCS_IdentificationIsTgtC "FTCMTCS_IdentificationIsTgtC" VALUE 0x80064214 DATA_RECORD_FLOAT32_IEEE 3.402823466E+038 F_1_p0_46 -3.402823466E+038 3.402823466E+038 /end CHARACTERISTIC
/begin CHARACTERISTIC FTCMTCS_InitTorqueMaxMinC "FTCMTCS_InitTorqueMaxMinC" CURVE 0x8006420C DATA_RECORD_FLOAT32_IEEE 3.402823466E+038 F_1_p0_56 -3.402823466E+038 3.402823466E+038
 /begin AXIS_DESCR FIX_AXIS NO_INPUT_QUANTITY Id_0x00 2 0 1 MAX_GRAD 100.0 FIX_AXIS_PAR_DIST 0 1 2 /end AXIS_DESCR
/end CHARACTERISTIC
/begin CHARACTERISTIC FTCMTCS_Initi0dqTgt3C "FTCMTCS_Initi0dqTgt3C" CURVE 0x80064200 DATA_RECORD_FLOAT32_IEEE 3.402823466E+038 F_1_p0_46 -3.402823466E+038 3.402823466E+038
 /begin AXIS_DESCR FIX_AXIS NO_INPUT_QUANTITY Id_0x00 3 0 2 MAX_GRAD 100.0 FIX_AXIS_PAR_DIST 0 1 3 /end AXIS_DESCR
/end CHARACTERISTIC
/begin CHARACTERISTIC FTCMTCS_KilLmtC "FTCMTCS_KilLmtC" VALUE 0x800641FC DATA_RECORD_FLOAT32_IEEE 3.402823466E+038 F_1_p0_4 -3.402823466E+038 3.402823466E+038 /end CHARACTERISTIC
/begin CHARACTERISTIC FTCMTCS_LutCutOffFreqSlideC "FTCMTCS_LutCutOffFreqSlideC" CURVE 0x800641F4 DATA_RECORD_FLOAT32_IEEE 3.402823466E+038 F_1_p0_4 -3.402823466E+038 3.402823466E+038
 /begin AXIS_DESCR FIX_AXIS NO_INPUT_QUANTITY Id_0x00 2 0 1 MAX_GRAD 100.0 FIX_AXIS_PAR_DIST 0 1 2 /end AXIS_DESCR
/end CHARACTERISTIC
/begin CHARACTERISTIC FTCMTCS_LutInAddSpeedRpmC "FTCMTCS_LutInAddSpeedRpmC" CURVE 0x800641C4 DATA_RECORD_FLOAT32_IEEE 3.402823466E+038 F_1_p0_4 -3.402823466E+038 3.402823466E+038
 /begin AXIS_DESCR FIX_AXIS NO_INPUT_QUANTITY Id_0x00 12 0 11 MAX_GRAD 100.0 FIX_AXIS_PAR_DIST 0 1 12 /end AXIS_DESCR
/end CHARACTERISTIC
/begin CHARACTERISTIC FTCMTCS_LutInAddUbatC "FTCMTCS_LutInAddUbatC" CURVE 0x800641B4 DATA_RECORD_FLOAT32_IEEE 3.402823466E+038 F_1_p0_38 -3.402823466E+038 3.402823466E+038
 /begin AXIS_DESCR FIX_AXIS NO_INPUT_QUANTITY Id_0x00 4 0 3 MAX_GRAD 100.0 FIX_AXIS_PAR_DIST 0 1 4 /end AXIS_DESCR
/end CHARACTERISTIC
/begin CHARACTERISTIC FTCMTCS_LutInMecaSpeedRpmC "FTCMTCS_LutInMecaSpeedRpmC" CURVE 0x80064134 DATA_RECORD_FLOAT32_IEEE 3.402823466E+038 F_1_p0_52 -3.402823466E+038 3.402823466E+038
 /begin AXIS_DESCR FIX_AXIS NO_INPUT_QUANTITY Id_0x00 32 0 31 MAX_GRAD 100.0 FIX_AXIS_PAR_DIST 0 1 32 /end AXIS_DESCR
/end CHARACTERISTIC
/begin CHARACTERISTIC FTCMTCS_LutInSpeedRpmC "FTCMTCS_LutInSpeedRpmC" CURVE 0x8008F284 DATA_RECORD_FLOAT32_IEEE 3.402823466E+038 F_1_p0_4 -3.402823466E+038 3.402823466E+038
 /begin AXIS_DESCR FIX_AXIS NO_INPUT_QUANTITY Id_0x00 11 0 10 MAX_GRAD 100.0 FIX_AXIS_PAR_DIST 0 1 11 /end AXIS_DESCR
/end CHARACTERISTIC
/begin CHARACTERISTIC FTCMTCS_LutInTorqueTgtC "FTCMTCS_LutInTorqueTgtC" CURVE 0x8008F0C0 DATA_RECORD_FLOAT32_IEEE 3.402823466E+038 F_1_p0_56 -3.402823466E+038 3.402823466E+038
 /begin AXIS_DESCR FIX_AXIS NO_INPUT_QUANTITY Id_0x00 113 0 112 MAX_GRAD 100.0 FIX_AXIS_PAR_DIST 0 1 113 /end AXIS_DESCR
/end CHARACTERISTIC
/begin CHARACTERISTIC FTCMTCS_LutInUbatC "FTCMTCS_LutInUbatC" CURVE 0x8008F0AC DATA_RECORD_FLOAT32_IEEE 3.402823466E+038 F_1_p0_4 -3.402823466E+038 3.402823466E+038
 /begin AXIS_DESCR FIX_AXIS NO_INPUT_QUANTITY Id_0x00 5 0 4 MAX_GRAD 100.0 FIX_AXIS_PAR_DIST 0 1 5 /end AXIS_DESCR
/end CHARACTERISTIC
/begin CHARACTERISTIC FTCMTCS_LutInUbatHVC "FTCMTCS_LutInUbatHVC" CURVE 0x8006411C DATA_RECORD_FLOAT32_IEEE 3.402823466E+038 F_1_p0_38 -3.402823466E+038 3.402823466E+038
 /begin AXIS_DESCR FIX_AXIS NO_INPUT_QUANTITY Id_0x00 6 0 5 MAX_GRAD 100.0 FIX_AXIS_PAR_DIST 0 1 6 /end AXIS_DESCR
/end CHARACTERISTIC
/begin CHARACTERISTIC FTCMTCS_LutOutAddElecTorqPoitC "FTCMTCS_LutOutAddElecTorqPoitC" MAP 0x8006405C DATA_RECORD_FLOAT32_IEEE 3.402823466E+038 F_1_p0_56 -3.402823466E+038 3.402823466E+038
 /begin AXIS_DESCR FIX_AXIS NO_INPUT_QUANTITY Id_0x00 4 0 3 MAX_GRAD 100.0 FIX_AXIS_PAR_DIST 0 1 4 /end AXIS_DESCR
 /begin AXIS_DESCR FIX_AXIS NO_INPUT_QUANTITY Id_0x00 12 0 11 MAX_GRAD 100.0 FIX_AXIS_PAR_DIST 0 1 12 /end AXIS_DESCR
/end CHARACTERISTIC
/begin CHARACTERISTIC FTCMTCS_LutOutIdAdd0C "FTCMTCS_LutOutIdAdd0C" MAP 0x80063F9C DATA_RECORD_FLOAT32_IEEE 3.402823466E+038 F_1_p0_46 -3.402823466E+038 3.402823466E+038
 /begin AXIS_DESCR FIX_AXIS NO_INPUT_QUANTITY Id_0x00 4 0 3 MAX_GRAD 100.0 FIX_AXIS_PAR_DIST 0 1 4 /end AXIS_DESCR
 /begin AXIS_DESCR FIX_AXIS NO_INPUT_QUANTITY Id_0x00 12 0 11 MAX_GRAD 100.0 FIX_AXIS_PAR_DIST 0 1 12 /end AXIS_DESCR
/end CHARACTERISTIC
/begin CHARACTERISTIC FTCMTCS_LutOutIdAdd0MotC "FTCMTCS_LutOutIdAdd0MotC" MAP 0x80063EDC DATA_RECORD_FLOAT32_IEEE 3.402823466E+038 F_1_p0_46 -3.402823466E+038 3.402823466E+038
 /begin AXIS_DESCR FIX_AXIS NO_INPUT_QUANTITY Id_0x00 4 0 3 MAX_GRAD 100.0 FIX_AXIS_PAR_DIST 0 1 4 /end AXIS_DESCR
 /begin AXIS_DESCR FIX_AXIS NO_INPUT_QUANTITY Id_0x00 12 0 11 MAX_GRAD 100.0 FIX_AXIS_PAR_DIST 0 1 12 /end AXIS_DESCR
/end CHARACTERISTIC
/begin CHARACTERISTIC FTCMTCS_LutOutIdAddGenC "FTCMTCS_LutOutIdAddGenC" MAP 0x80063E1C DATA_RECORD_FLOAT32_IEEE 3.402823466E+038 F_1_p0_46 -3.402823466E+038 3.402823466E+038
 /begin AXIS_DESCR FIX_AXIS NO_INPUT_QUANTITY Id_0x00 4 0 3 MAX_GRAD 100.0 FIX_AXIS_PAR_DIST 0 1 4 /end AXIS_DESCR
 /begin AXIS_DESCR FIX_AXIS NO_INPUT_QUANTITY Id_0x00 12 0 11 MAX_GRAD 100.0 FIX_AXIS_PAR_DIST 0 1 12 /end AXIS_DESCR
/end CHARACTERISTIC
/begin CHARACTERISTIC FTCMTCS_LutOutIdAddMotC "FTCMTCS_LutOutIdAddMotC" MAP 0x80063D5C DATA_RECORD_FLOAT32_IEEE 3.402823466E+038 F_1_p0_46 -3.402823466E+038 3.402823466E+038
 /begin AXIS_DESCR FIX_AXIS NO_INPUT_QUANTITY Id_0x00 4 0 3 MAX_GRAD 100.0 FIX_AXIS_PAR_DIST 0 1 4 /end AXIS_DESCR
 /begin AXIS_DESCR FIX_AXIS NO_INPUT_QUANTITY Id_0x00 12 0 11 MAX_GRAD 100.0 FIX_AXIS_PAR_DIST 0 1 12 /end AXIS_DESCR
/end CHARACTERISTIC
/begin CHARACTERISTIC FTCMTCS_LutOutIqAddGenC "FTCMTCS_LutOutIqAddGenC" MAP 0x80063C9C DATA_RECORD_FLOAT32_IEEE 3.402823466E+038 F_1_p0_46 -3.402823466E+038 3.402823466E+038
 /begin AXIS_DESCR FIX_AXIS NO_INPUT_QUANTITY Id_0x00 4 0 3 MAX_GRAD 100.0 FIX_AXIS_PAR_DIST 0 1 4 /end AXIS_DESCR
 /begin AXIS_DESCR FIX_AXIS NO_INPUT_QUANTITY Id_0x00 12 0 11 MAX_GRAD 100.0 FIX_AXIS_PAR_DIST 0 1 12 /end AXIS_DESCR
/end CHARACTERISTIC
/begin CHARACTERISTIC FTCMTCS_LutOutIqAddMotC "FTCMTCS_LutOutIqAddMotC" MAP 0x80063BDC DATA_RECORD_FLOAT32_IEEE 3.402823466E+038 F_1_p0_46 -3.402823466E+038 3.402823466E+038
 /begin AXIS_DESCR FIX_AXIS NO_INPUT_QUANTITY Id_0x00 4 0 3 MAX_GRAD 100.0 FIX_AXIS_PAR_DIST 0 1 4 /end AXIS_DESCR
 /begin AXIS_DESCR FIX_AXIS NO_INPUT_QUANTITY Id_0x00 12 0 11 MAX_GRAD 100.0 FIX_AXIS_PAR_DIST 0 1 12 /end AXIS_DESCR
/end CHARACTERISTIC
/begin CHARACTERISTIC FTCMTCS_LutOutTorqueMaxC "FTCMTCS_LutOutTorqueMaxC" MAP 0x8008EDAC DATA_RECORD_FLOAT32_IEEE 3.402823466E+038 F_1_p0_56 -3.402823466E+038 3.402823466E+038
 /begin AXIS_DESCR FIX_AXIS NO_INPUT_QUANTITY Id_0x00 6 0 5 MAX_GRAD 100.0 FIX_AXIS_PAR_DIST 0 1 6 /end AXIS_DESCR
 /begin AXIS_DESCR FIX_AXIS NO_INPUT_QUANTITY Id_0x00 32 0 31 MAX_GRAD 100.0 FIX_AXIS_PAR_DIST 0 1 32 /end AXIS_DESCR
/end CHARACTERISTIC
/begin CHARACTERISTIC FTCMTCS_LutOutTorqueMinC "FTCMTCS_LutOutTorqueMinC" MAP 0x8008EAAC DATA_RECORD_FLOAT32_IEEE 3.402823466E+038 F_1_p0_56 -3.402823466E+038 3.402823466E+038
 /begin AXIS_DESCR FIX_AXIS NO_INPUT_QUANTITY Id_0x00 6 0 5 MAX_GRAD 100.0 FIX_AXIS_PAR_DIST 0 1 6 /end AXIS_DESCR
 /begin AXIS_DESCR FIX_AXIS NO_INPUT_QUANTITY Id_0x00 32 0 31 MAX_GRAD 100.0 FIX_AXIS_PAR_DIST 0 1 32 /end AXIS_DESCR
/end CHARACTERISTIC
/begin CHARACTERISTIC FTCMTCS_LutOutVolMarginGenC "FTCMTCS_LutOutVolMarginGenC" MAP 0x80063B00 DATA_RECORD_FLOAT32_IEEE 3.402823466E+038 F_1_p0_4 -3.402823466E+038 3.402823466E+038
 /begin AXIS_DESCR FIX_AXIS NO_INPUT_QUANTITY Id_0x00 5 0 4 MAX_GRAD 100.0 FIX_AXIS_PAR_DIST 0 1 5 /end AXIS_DESCR
 /begin AXIS_DESCR FIX_AXIS NO_INPUT_QUANTITY Id_0x00 11 0 10 MAX_GRAD 100.0 FIX_AXIS_PAR_DIST 0 1 11 /end AXIS_DESCR
/end CHARACTERISTIC
/begin CHARACTERISTIC FTCMTCS_LutOutVolMarginMotC "FTCMTCS_LutOutVolMarginMotC" MAP 0x80063A24 DATA_RECORD_FLOAT32_IEEE 3.402823466E+038 F_1_p0_4 -3.402823466E+038 3.402823466E+038
 /begin AXIS_DESCR FIX_AXIS NO_INPUT_QUANTITY Id_0x00 5 0 4 MAX_GRAD 100.0 FIX_AXIS_PAR_DIST 0 1 5 /end AXIS_DESCR
 /begin AXIS_DESCR FIX_AXIS NO_INPUT_QUANTITY Id_0x00 11 0 10 MAX_GRAD 100.0 FIX_AXIS_PAR_DIST 0 1 11 /end AXIS_DESCR
/end CHARACTERISTIC
/begin CHARACTERISTIC FTCMTCS_MaxErrorFor100C "FTCMTCS_MaxErrorFor100C" VALUE 0x80063A20 DATA_RECORD_FLOAT32_IEEE 3.402823466E+038 F_1_p0_4 -3.402823466E+038 3.402823466E+038 /end CHARACTERISTIC
/begin CHARACTERISTIC FTCMTCS_ParkCurrentMaxC "FTCMTCS_ParkCurrentMaxC" VALUE 0x80063A1C DATA_RECORD_FLOAT32_IEEE 3.402823466E+038 F_1_p0_46 -3.402823466E+038 3.402823466E+038 /end CHARACTERISTIC
/begin CHARACTERISTIC FTCMTCS_SlideSpdRpmC "FTCMTCS_SlideSpdRpmC" VALUE 0x80063A18 DATA_RECORD_FLOAT32_IEEE 3.402823466E+038 F_1_p0_50 -3.402823466E+038 3.402823466E+038 /end CHARACTERISTIC
/begin CHARACTERISTIC FTCMTCS_SwitchElecTorqueRangeC "FTCMTCS_SwitchElecTorqueRangeC" VALUE 0x80063A14 DATA_RECORD_FLOAT32_IEEE 3.402823466E+038 F_1_p0_49 -3.402823466E+038 3.402823466E+038 /end CHARACTERISTIC
/begin CHARACTERISTIC FTCMTCS_SwitchElecTrqRange0C "FTCMTCS_SwitchElecTrqRange0C" VALUE 0x80063A10 DATA_RECORD_FLOAT32_IEEE 3.402823466E+038 F_1_p0_4 -3.402823466E+038 3.402823466E+038 /end CHARACTERISTIC
/begin CHARACTERISTIC FTCMTCS_VoltMarginCtrlOnOffC "FTCMTCS_VoltMarginCtrlOnOffC" VALUE 0x80063A0C DATA_RECORD_UBYTE 1 Bool_ON_OFF 0 1 BIT_MASK 0x01 /end CHARACTERISTIC
/begin CHARACTERISTIC FTCMTCS_VoltageLimiterOnOffC "FTCMTCS_VoltageLimiterOnOffC" VALUE 0x80063A08 DATA_RECORD_UBYTE 1 Bool_ON_OFF 0 1 BIT_MASK 0x01 /end CHARACTERISTIC
/begin CHARACTERISTIC FTCMTCS_VoltageMarginC "FTCMTCS_VoltageMarginC" VALUE 0x80063A04 DATA_RECORD_FLOAT32_IEEE 3.402823466E+038 F_1_p0_4 -3.402823466E+038 3.402823466E+038 /end CHARACTERISTIC
/begin CHARACTERISTIC FTCMTCS_deg2radC "FTCMTCS_deg2radC" VALUE 0x80063A00 DATA_RECORD_FLOAT32_IEEE 3.402823466E+038 F_1_p0_4 -3.402823466E+038 3.402823466E+038 /end CHARACTERISTIC
/begin CHARACTERISTIC FTCMTCS_iqCorEnaC "FTCMTCS_iqCorEnaC" VALUE 0x800639FC DATA_RECORD_UBYTE 1 Bool_ON_OFF 0 1 BIT_MASK 0x01 /end CHARACTERISTIC
/begin CHARACTERISTIC FTCMTTC_AntiJerkMecaTorqueMaxC "FTCMTTC_AntiJerkMecaTorqueMaxC" VALUE 0x80064514 DATA_RECORD_FLOAT32_IEEE 3.402823466E+038 F_1_p0_4 -3.402823466E+038 3.402823466E+038 /end CHARACTERISTIC
/begin CHARACTERISTIC FTCMTTC_AntiJerkMecaTorqueMinC "FTCMTTC_AntiJerkMecaTorqueMinC" VALUE 0x80064510 DATA_RECORD_FLOAT32_IEEE 3.402823466E+038 F_1_p0_4 -3.402823466E+038 3.402823466E+038 /end CHARACTERISTIC
/begin CHARACTERISTIC FTCMTTC_BpAccHighCutOffFrequencyC "FTCMTTC_BpAccHighCutOffFrequencyC" VALUE 0x8006450C DATA_RECORD_FLOAT32_IEEE 3.402823466E+038 F_1_p0_4 -3.402823466E+038 3.402823466E+038 /end CHARACTERISTIC
/begin CHARACTERISTIC FTCMTTC_DampTorqTgtHighThdC "FTCMTTC_DampTorqTgtHighThdC" VALUE 0x80064508 DATA_RECORD_FLOAT32_IEEE 3.402823466E+038 F_1_p0_4 -3.402823466E+038 3.402823466E+038 /end CHARACTERISTIC
/begin CHARACTERISTIC FTCMTTC_DampTorqueTargetThdC "FTCMTTC_DampTorqueTargetThdC" VALUE 0x80064504 DATA_RECORD_FLOAT32_IEEE 3.402823466E+038 F_1_p0_4 -3.402823466E+038 3.402823466E+038 /end CHARACTERISTIC
/begin CHARACTERISTIC FTCMTTC_DampingEnableC "FTCMTTC_DampingEnableC" VALUE 0x80064500 DATA_RECORD_UBYTE 1 Bool_ON_OFF 0 1 BIT_MASK 0x01 /end CHARACTERISTIC
/begin CHARACTERISTIC FTCMTTC_DampingSpdHighC "FTCMTTC_DampingSpdHighC" VALUE 0x800644FC DATA_RECORD_FLOAT32_IEEE 3.402823466E+038 F_1_p0_4 -3.402823466E+038 3.402823466E+038 /end CHARACTERISTIC
/begin CHARACTERISTIC FTCMTTC_DampingSpdLowC "FTCMTTC_DampingSpdLowC" VALUE 0x800644F8 DATA_RECORD_FLOAT32_IEEE 3.402823466E+038 F_1_p0_4 -3.402823466E+038 3.402823466E+038 /end CHARACTERISTIC
/begin CHARACTERISTIC FTCMTTC_Lut3InMecaSpeedRpmC "FTCMTTC_Lut3InMecaSpeedRpmC" CURVE 0x800644B0 DATA_RECORD_FLOAT32_IEEE 3.402823466E+038 F_1_p0_4 -3.402823466E+038 3.402823466E+038
 /begin AXIS_DESCR FIX_AXIS NO_INPUT_QUANTITY Id_0x00 18 0 17 MAX_GRAD 100.0 FIX_AXIS_PAR_DIST 0 1 18 /end AXIS_DESCR
/end CHARACTERISTIC
/begin CHARACTERISTIC FTCMTTC_Lut3InTorqueTgtC "FTCMTTC_Lut3InTorqueTgtC" CURVE 0x800643A4 DATA_RECORD_FLOAT32_IEEE 3.402823466E+038 F_1_p0_4 -3.402823466E+038 3.402823466E+038
 /begin AXIS_DESCR FIX_AXIS NO_INPUT_QUANTITY Id_0x00 67 0 66 MAX_GRAD 100.0 FIX_AXIS_PAR_DIST 0 1 67 /end AXIS_DESCR
/end CHARACTERISTIC
/begin CHARACTERISTIC FTCMTTC_Lut3InUbatC "FTCMTTC_Lut3InUbatC" CURVE 0x8006438C DATA_RECORD_FLOAT32_IEEE 3.402823466E+038 F_1_p0_4 -3.402823466E+038 3.402823466E+038
 /begin AXIS_DESCR FIX_AXIS NO_INPUT_QUANTITY Id_0x00 6 0 5 MAX_GRAD 100.0 FIX_AXIS_PAR_DIST 0 1 6 /end AXIS_DESCR
/end CHARACTERISTIC
/begin CHARACTERISTIC FTCMTTC_LutInMecaSpeedRpmC "FTCMTTC_LutInMecaSpeedRpmC" CURVE 0x8008F490 DATA_RECORD_FLOAT32_IEEE 20000 F_1_p0_52 0 20000
 /begin AXIS_DESCR FIX_AXIS NO_INPUT_QUANTITY Id_0x00 19 0 18 MAX_GRAD 100.0 FIX_AXIS_PAR_DIST 0 1 19 /end AXIS_DESCR
/end CHARACTERISTIC
/begin CHARACTERISTIC FTCMTTC_LutInSpdRpmAtjkDeltaC "FTCMTTC_LutInSpdRpmAtjkDeltaC" CURVE 0x80064370 DATA_RECORD_FLOAT32_IEEE 3.402823466E+038 F_1_p0_4 -3.402823466E+038 3.402823466E+038
 /begin AXIS_DESCR FIX_AXIS NO_INPUT_QUANTITY Id_0x00 7 0 6 MAX_GRAD 100.0 FIX_AXIS_PAR_DIST 0 1 7 /end AXIS_DESCR
/end CHARACTERISTIC
/begin CHARACTERISTIC FTCMTTC_LutInSpdRpmBaseC "FTCMTTC_LutInSpdRpmBaseC" CURVE 0x80064354 DATA_RECORD_FLOAT32_IEEE 3.402823466E+038 F_1_p0_4 -3.402823466E+038 3.402823466E+038
 /begin AXIS_DESCR FIX_AXIS NO_INPUT_QUANTITY Id_0x00 7 0 6 MAX_GRAD 100.0 FIX_AXIS_PAR_DIST 0 1 7 /end AXIS_DESCR
/end CHARACTERISTIC
/begin CHARACTERISTIC FTCMTTC_LutInSpeedRpmBpTrqHacC "FTCMTTC_LutInSpeedRpmBpTrqHacC" CURVE 0x80064344 DATA_RECORD_FLOAT32_IEEE 3.402823466E+038 F_1_p0_52 -3.402823466E+038 3.402823466E+038
 /begin AXIS_DESCR FIX_AXIS NO_INPUT_QUANTITY Id_0x00 4 0 3 MAX_GRAD 100.0 FIX_AXIS_PAR_DIST 0 1 4 /end AXIS_DESCR
/end CHARACTERISTIC
/begin CHARACTERISTIC FTCMTTC_LutInSpeedRpmDampingC "FTCMTTC_LutInSpeedRpmDampingC" CURVE 0x80064328 DATA_RECORD_FLOAT32_IEEE 3.402823466E+038 F_1_p0_45 -3.402823466E+038 3.402823466E+038
 /begin AXIS_DESCR FIX_AXIS NO_INPUT_QUANTITY Id_0x00 7 0 6 MAX_GRAD 100.0 FIX_AXIS_PAR_DIST 0 1 7 /end AXIS_DESCR
/end CHARACTERISTIC
/begin CHARACTERISTIC FTCMTTC_LutInUbatC "FTCMTTC_LutInUbatC" CURVE 0x8008F478 DATA_RECORD_FLOAT32_IEEE 3.402823466E+038 F_1_p0_38 -3.402823466E+038 3.402823466E+038
 /begin AXIS_DESCR FIX_AXIS NO_INPUT_QUANTITY Id_0x00 6 0 5 MAX_GRAD 100.0 FIX_AXIS_PAR_DIST 0 1 6 /end AXIS_DESCR
/end CHARACTERISTIC
/begin CHARACTERISTIC FTCMTTC_LutOutAntiJerkBaseGainC "FTCMTTC_LutOutAntiJerkBaseGainC" CURVE 0x8006430C DATA_RECORD_FLOAT32_IEEE 3.402823466E+038 F_1_p0_45 -3.402823466E+038 3.402823466E+038
 /begin AXIS_DESCR FIX_AXIS NO_INPUT_QUANTITY Id_0x00 7 0 6 MAX_GRAD 100.0 FIX_AXIS_PAR_DIST 0 1 7 /end AXIS_DESCR
/end CHARACTERISTIC
/begin CHARACTERISTIC FTCMTTC_LutOutAntiJerkBaseGainHacC "FTCMTTC_LutOutAntiJerkBaseGainHacC" CURVE 0x800642FC DATA_RECORD_FLOAT32_IEEE 3.402823466E+038 F_1_p0_52 -3.402823466E+038 3.402823466E+038
 /begin AXIS_DESCR FIX_AXIS NO_INPUT_QUANTITY Id_0x00 4 0 3 MAX_GRAD 100.0 FIX_AXIS_PAR_DIST 0 1 4 /end AXIS_DESCR
/end CHARACTERISTIC
/begin CHARACTERISTIC FTCMTTC_LutOutAtjkDeltaGainC "FTCMTTC_LutOutAtjkDeltaGainC" CURVE 0x800642E0 DATA_RECORD_FLOAT32_IEEE 3.402823466E+038 F_1_p0_4 -3.402823466E+038 3.402823466E+038
 /begin AXIS_DESCR FIX_AXIS NO_INPUT_QUANTITY Id_0x00 7 0 6 MAX_GRAD 100.0 FIX_AXIS_PAR_DIST 0 1 7 /end AXIS_DESCR
/end CHARACTERISTIC
/begin CHARACTERISTIC FTCMTTC_LutOutCutOffFrequencyC "FTCMTTC_LutOutCutOffFrequencyC" CURVE 0x800642C4 DATA_RECORD_FLOAT32_IEEE 3.402823466E+038 F_1_p0_35 -3.402823466E+038 3.402823466E+038
 /begin AXIS_DESCR FIX_AXIS NO_INPUT_QUANTITY Id_0x00 7 0 6 MAX_GRAD 100.0 FIX_AXIS_PAR_DIST 0 1 7 /end AXIS_DESCR
/end CHARACTERISTIC
/begin CHARACTERISTIC FTCMTTC_LutOutMecaPowerC "FTCMTTC_LutOutMecaPowerC" MAP 0x8008F2B0 DATA_RECORD_FLOAT32_IEEE 250000 F_1_p0_69 0 250000
 /begin AXIS_DESCR FIX_AXIS NO_INPUT_QUANTITY Id_0x00 6 0 5 MAX_GRAD 100.0 FIX_AXIS_PAR_DIST 0 1 6 /end AXIS_DESCR
 /begin AXIS_DESCR FIX_AXIS NO_INPUT_QUANTITY Id_0x00 19 0 18 MAX_GRAD 100.0 FIX_AXIS_PAR_DIST 0 1 19 /end AXIS_DESCR
/end CHARACTERISTIC
/begin CHARACTERISTIC FTCMTTC_PowerLimtEnableC "FTCMTTC_PowerLimtEnableC" VALUE 0x800642C0 DATA_RECORD_UBYTE 1 Bool_ON_OFF 0 1 BIT_MASK 0x01 /end CHARACTERISTIC
/begin CHARACTERISTIC FTCMTTC_PreTorqTrasRangeC "FTCMTTC_PreTorqTrasRangeC" VALUE 0x800642BC DATA_RECORD_FLOAT32_IEEE 3.402823466E+038 F_1_p0_4 -3.402823466E+038 3.402823466E+038 /end CHARACTERISTIC
/begin CHARACTERISTIC FTCMTTC_PreTorqTrasStep2C "FTCMTTC_PreTorqTrasStep2C" VALUE 0x800642B8 DATA_RECORD_FLOAT32_IEEE 3.402823466E+038 F_1_p0_4 -3.402823466E+038 3.402823466E+038 /end CHARACTERISTIC
/begin CHARACTERISTIC FTCMTTC_PreTorqTrasStepMaxC "FTCMTTC_PreTorqTrasStepMaxC" VALUE 0x800642B4 DATA_RECORD_FLOAT32_IEEE 3.402823466E+038 F_1_p0_4 -3.402823466E+038 3.402823466E+038 /end CHARACTERISTIC
/begin CHARACTERISTIC FTCMTTC_PreTorqTrasStepMinC "FTCMTTC_PreTorqTrasStepMinC" VALUE 0x800642B0 DATA_RECORD_FLOAT32_IEEE 3.402823466E+038 F_1_p0_4 -3.402823466E+038 3.402823466E+038 /end CHARACTERISTIC
/begin CHARACTERISTIC FTCMTTC_PreTorqueC "FTCMTTC_PreTorqueC" VALUE 0x800642AC DATA_RECORD_FLOAT32_IEEE 3.402823466E+038 F_1_p0_4 -3.402823466E+038 3.402823466E+038 /end CHARACTERISTIC
/begin CHARACTERISTIC FTCMTTC_PreTorqueEnableC "FTCMTTC_PreTorqueEnableC" VALUE 0x800642A8 DATA_RECORD_UBYTE 1 Bool_ON_OFF 0 1 BIT_MASK 0x01 /end CHARACTERISTIC
/begin CHARACTERISTIC FTCMTTC_PreTorqueStartC "FTCMTTC_PreTorqueStartC" VALUE 0x800642A4 DATA_RECORD_FLOAT32_IEEE 3.402823466E+038 F_1_p0_4 -3.402823466E+038 3.402823466E+038 /end CHARACTERISTIC
/begin CHARACTERISTIC FTCMTTC_PreTorqueTimeC "FTCMTTC_PreTorqueTimeC" VALUE 0x800642A0 DATA_RECORD_UWORD 65535 F_1_p0_4 0 65535 /end CHARACTERISTIC
/begin CHARACTERISTIC FTCMTTC_Rpm2RdsC "FTCMTTC_Rpm2RdsC" VALUE 0x8006429C DATA_RECORD_FLOAT32_IEEE 3.402823466E+038 F_1_p0_4 -3.402823466E+038 3.402823466E+038 /end CHARACTERISTIC
/begin CHARACTERISTIC FTCMTTC_SpeedHysteresisRangeC "FTCMTTC_SpeedHysteresisRangeC" VALUE 0x80064298 DATA_RECORD_FLOAT32_IEEE 3.402823466E+038 F_1_p0_45 -3.402823466E+038 3.402823466E+038 /end CHARACTERISTIC
/begin CHARACTERISTIC FTCMTTC_SpeedThdC "FTCMTTC_SpeedThdC" VALUE 0x80064294 DATA_RECORD_FLOAT32_IEEE 3.402823466E+038 F_1_p0_52 -3.402823466E+038 3.402823466E+038 /end CHARACTERISTIC
/begin CHARACTERISTIC FTCMTTC_TolTqrLmtEnC "FTCMTTC_TolTqrLmtEnC" VALUE 0x80064290 DATA_RECORD_UBYTE 1 Bool_ON_OFF 0 1 BIT_MASK 0x01 /end CHARACTERISTIC
/begin CHARACTERISTIC FTCMTTC_ToqueHpFilterSpdThrdC "FTCMTTC_ToqueHpFilterSpdThrdC" VALUE 0x8006428C DATA_RECORD_FLOAT32_IEEE 3.402823466E+038 F_1_p0_4 -3.402823466E+038 3.402823466E+038 /end CHARACTERISTIC
/begin CHARACTERISTIC FTCMTTC_TorMaxC "FTCMTTC_TorMaxC" VALUE 0x80064288 DATA_RECORD_FLOAT32_IEEE 3.402823466E+038 F_1_p0_49 -3.402823466E+038 3.402823466E+038 /end CHARACTERISTIC
/begin CHARACTERISTIC FTCMTTC_TorqCorEnableC "FTCMTTC_TorqCorEnableC" VALUE 0x80064284 DATA_RECORD_UBYTE 1 Bool_ON_OFF 0 1 BIT_MASK 0x01 /end CHARACTERISTIC
/begin CHARACTERISTIC FTCMTTC_TorqueBySecondNegC "FTCMTTC_TorqueBySecondNegC" VALUE 0x80064280 DATA_RECORD_FLOAT32_IEEE 3.402823466E+038 F_1_p0_4 -3.402823466E+038 3.402823466E+038 /end CHARACTERISTIC
/begin CHARACTERISTIC FTCMTTC_TorqueBySecondPosC "FTCMTTC_TorqueBySecondPosC" VALUE 0x8006427C DATA_RECORD_FLOAT32_IEEE 3.402823466E+038 F_1_p0_4 -3.402823466E+038 3.402823466E+038 /end CHARACTERISTIC
/begin CHARACTERISTIC FTCMTTC_TorqueCutOffFrequencyC "FTCMTTC_TorqueCutOffFrequencyC" VALUE 0x80064278 DATA_RECORD_FLOAT32_IEEE 3.402823466E+038 F_1_p0_4 -3.402823466E+038 3.402823466E+038 /end CHARACTERISTIC
/begin CHARACTERISTIC FTCMTTC_TorqueFildTrC "FTCMTTC_TorqueFildTrC" VALUE 0x80064274 DATA_RECORD_FLOAT32_IEEE 3.402823466E+038 F_1_p0_4 -3.402823466E+038 3.402823466E+038 /end CHARACTERISTIC
/begin CHARACTERISTIC FTCMTTC_TorqueHpFilterSpdHystRgC "FTCMTTC_TorqueHpFilterSpdHystRgC" VALUE 0x80064270 DATA_RECORD_FLOAT32_IEEE 3.402823466E+038 F_1_p0_4 -3.402823466E+038 3.402823466E+038 /end CHARACTERISTIC
/begin CHARACTERISTIC FTCMTTC_TrqHpCutOffFrequencyC "FTCMTTC_TrqHpCutOffFrequencyC" VALUE 0x8006426C DATA_RECORD_FLOAT32_IEEE 3.402823466E+038 F_1_p0_4 -3.402823466E+038 3.402823466E+038 /end CHARACTERISTIC
/begin CHARACTERISTIC FTCMTTC_TrqSatThrdC "FTCMTTC_TrqSatThrdC" VALUE 0x80064268 DATA_RECORD_FLOAT32_IEEE 3.402823466E+038 F_1_p0_4 -3.402823466E+038 3.402823466E+038 /end CHARACTERISTIC
/begin CHARACTERISTIC FTCMTTC_ZeroSpdC "FTCMTTC_ZeroSpdC" VALUE 0x80064264 DATA_RECORD_FLOAT32_IEEE 3.402823466E+038 F_1_p0_4 -3.402823466E+038 3.402823466E+038 /end CHARACTERISTIC
/begin CHARACTERISTIC FTDDLMP_I0LimitMaxC "The maximum current of I0 limit value in limp control mode." VALUE 0x80064540 DATA_RECORD_FLOAT32_IEEE 2000 F_1_p0_46 -1000 1000 /end CHARACTERISTIC
/begin CHARACTERISTIC FTDDLMP_I0LimitMinC "The minimum current of I0 limit value in limp control mode." VALUE 0x8006453C DATA_RECORD_FLOAT32_IEEE 2000 F_1_p0_46 -1000 1000 /end CHARACTERISTIC
/begin CHARACTERISTIC FTDDLMP_IdLimitMaxC "The maximum current of Id limit value in limp control mode." VALUE 0x80064538 DATA_RECORD_FLOAT32_IEEE 2000 F_1_p0_46 -1000 1000 /end CHARACTERISTIC
/begin CHARACTERISTIC FTDDLMP_IdLimitMinC "The minimum current of Id limit value in limp control mode." VALUE 0x80064534 DATA_RECORD_FLOAT32_IEEE 2000 F_1_p0_46 -1000 1000 /end CHARACTERISTIC
/begin CHARACTERISTIC FTDDLMP_IqLimitMaxC "The maximum current of Iq limit value in limp control mode." VALUE 0x80064530 DATA_RECORD_FLOAT32_IEEE 2000 F_1_p0_46 -1000 1000 /end CHARACTERISTIC
/begin CHARACTERISTIC FTDDLMP_IqLimitMinC "The minimum current of Iq limit value in limp control mode." VALUE 0x8006452C DATA_RECORD_FLOAT32_IEEE 2000 F_1_p0_46 -1000 1000 /end CHARACTERISTIC
/begin CHARACTERISTIC FTDDLMP_PowerLimC "FTDDLMP_PowerLimC" VALUE 0x80064528 DATA_RECORD_FLOAT32_IEEE 3.402823466E+038 F_1_p0_69 -3.402823466E+038 3.402823466E+038 /end CHARACTERISTIC
/begin CHARACTERISTIC FTDDLMP_SpeedLimitMaxC "The maximum speed limit value in limp control mode." VALUE 0x80064524 DATA_RECORD_FLOAT32_IEEE 40000 F_1_p0_52 -20000 20000 /end CHARACTERISTIC
/begin CHARACTERISTIC FTDDLMP_SpeedLimitMinC "The minimum speed limit value in limp control mode." VALUE 0x80064520 DATA_RECORD_FLOAT32_IEEE 40000 F_1_p0_52 -20000 20000 /end CHARACTERISTIC
/begin CHARACTERISTIC FTDDLMP_TorqLimitMaxC "The maximum torque limit value in limp control mode." VALUE 0x8006451C DATA_RECORD_FLOAT32_IEEE 1000 F_1_p0_56 -500 500 /end CHARACTERISTIC
/begin CHARACTERISTIC FTDDLMP_TorqLimitMinC "The minimum torque limit value in limp control mode." VALUE 0x80064518 DATA_RECORD_FLOAT32_IEEE 1000 F_1_p0_56 -500 500 /end CHARACTERISTIC
/begin CHARACTERISTIC FTEVEIT_CommutDataCoeffC "Data for commutation losses estimation : ( floor(ModuleFunctionCallPeriod / SwitchingPeriod) * floor(CommutationNberPerSwtchT / 2) ) / ModuleFunctionCallPeriod." VALUE 0x80064AC4 DATA_RECORD_FLOAT32_IEEE 1000000 F_1_p0_35 0 1000000 /end CHARACTERISTIC
/begin CHARACTERISTIC FTEVEIT_EoffICurrentsC "IGBT Eoff = f(Current) cartography input vector." CURVE 0x80064AA0 DATA_RECORD_FLOAT32_IEEE 1000000 F_1_p0_70 0 1000000
 /begin AXIS_DESCR FIX_AXIS NO_INPUT_QUANTITY Id_0x00 9 0 8 MAX_GRAD 100.0 FIX_AXIS_PAR_DIST 0 1 9 /end AXIS_DESCR
/end CHARACTERISTIC
/begin CHARACTERISTIC FTEVEIT_EoffIEnergiesC "IGBT Eoff = f(Current) cartography output vector." CURVE 0x80064A7C DATA_RECORD_FLOAT32_IEEE 1000000 F_1_p0_71 0 1000000
 /begin AXIS_DESCR FIX_AXIS NO_INPUT_QUANTITY Id_0x00 9 0 8 MAX_GRAD 100.0 FIX_AXIS_PAR_DIST 0 1 9 /end AXIS_DESCR
/end CHARACTERISTIC
/begin CHARACTERISTIC FTEVEIT_EonICurrentsC "IGBT Eon = f(Current) cartography input vector." CURVE 0x80064A58 DATA_RECORD_FLOAT32_IEEE 1000000 F_1_p0_70 0 1000000
 /begin AXIS_DESCR FIX_AXIS NO_INPUT_QUANTITY Id_0x00 9 0 8 MAX_GRAD 100.0 FIX_AXIS_PAR_DIST 0 1 9 /end AXIS_DESCR
/end CHARACTERISTIC
/begin CHARACTERISTIC FTEVEIT_EonIEnergiesC "IGBT Eon = f(Current) cartography output vector." CURVE 0x80064A34 DATA_RECORD_FLOAT32_IEEE 1000000 F_1_p0_71 0 1000000
 /begin AXIS_DESCR FIX_AXIS NO_INPUT_QUANTITY Id_0x00 9 0 8 MAX_GRAD 100.0 FIX_AXIS_PAR_DIST 0 1 9 /end AXIS_DESCR
/end CHARACTERISTIC
/begin CHARACTERISTIC FTEVEIT_ErecICurrentsC "Diode Erec = f(Current) cartography input vector." CURVE 0x80064A10 DATA_RECORD_FLOAT32_IEEE 1000000 F_1_p0_70 0 1000000
 /begin AXIS_DESCR FIX_AXIS NO_INPUT_QUANTITY Id_0x00 9 0 8 MAX_GRAD 100.0 FIX_AXIS_PAR_DIST 0 1 9 /end AXIS_DESCR
/end CHARACTERISTIC
/begin CHARACTERISTIC FTEVEIT_ErecIEnergiesC "Diode Erec = f(Current) cartography output vector." CURVE 0x800649EC DATA_RECORD_FLOAT32_IEEE 1000000 F_1_p0_71 0 1000000
 /begin AXIS_DESCR FIX_AXIS NO_INPUT_QUANTITY Id_0x00 9 0 8 MAX_GRAD 100.0 FIX_AXIS_PAR_DIST 0 1 9 /end AXIS_DESCR
/end CHARACTERISTIC
/begin CHARACTERISTIC FTEVEIT_KoffUdcCoeffsC "IGBT Koff = f(Udc) table output vector." CURVE 0x800649A8 DATA_RECORD_FLOAT32_IEEE 100 F_1_p0_36 0 100
 /begin AXIS_DESCR FIX_AXIS NO_INPUT_QUANTITY Id_0x00 17 0 16 MAX_GRAD 100.0 FIX_AXIS_PAR_DIST 0 1 17 /end AXIS_DESCR
/end CHARACTERISTIC
/begin CHARACTERISTIC FTEVEIT_KoffUdcVoltagesC "IGBT Koff = f(Udc) cartography input vector." CURVE 0x80064964 DATA_RECORD_FLOAT32_IEEE 2000 F_1_p0_39 0 2000
 /begin AXIS_DESCR FIX_AXIS NO_INPUT_QUANTITY Id_0x00 17 0 16 MAX_GRAD 100.0 FIX_AXIS_PAR_DIST 0 1 17 /end AXIS_DESCR
/end CHARACTERISTIC
/begin CHARACTERISTIC FTEVEIT_KonUdcCoeffsC "IGBT Kon = f(Udc) table output vector." CURVE 0x80064920 DATA_RECORD_FLOAT32_IEEE 100 F_1_p0_36 0 100
 /begin AXIS_DESCR FIX_AXIS NO_INPUT_QUANTITY Id_0x00 17 0 16 MAX_GRAD 100.0 FIX_AXIS_PAR_DIST 0 1 17 /end AXIS_DESCR
/end CHARACTERISTIC
/begin CHARACTERISTIC FTEVEIT_KonUdcVoltagesC "IGBT Kon = f(Udc) cartography input vector." CURVE 0x800648DC DATA_RECORD_FLOAT32_IEEE 2000 F_1_p0_39 0 2000
 /begin AXIS_DESCR FIX_AXIS NO_INPUT_QUANTITY Id_0x00 17 0 16 MAX_GRAD 100.0 FIX_AXIS_PAR_DIST 0 1 17 /end AXIS_DESCR
/end CHARACTERISTIC
/begin CHARACTERISTIC FTEVEIT_KrecUdcCoeffsC "Diode Krec = f(Udc) table output vector." CURVE 0x80064898 DATA_RECORD_FLOAT32_IEEE 100 F_1_p0_36 0 100
 /begin AXIS_DESCR FIX_AXIS NO_INPUT_QUANTITY Id_0x00 17 0 16 MAX_GRAD 100.0 FIX_AXIS_PAR_DIST 0 1 17 /end AXIS_DESCR
/end CHARACTERISTIC
/begin CHARACTERISTIC FTEVEIT_KrecUdcVoltagesC "Diode Krec = f(Udc) cartography input vector." CURVE 0x80064854 DATA_RECORD_FLOAT32_IEEE 2000 F_1_p0_39 0 2000
 /begin AXIS_DESCR FIX_AXIS NO_INPUT_QUANTITY Id_0x00 17 0 16 MAX_GRAD 100.0 FIX_AXIS_PAR_DIST 0 1 17 /end AXIS_DESCR
/end CHARACTERISTIC
/begin CHARACTERISTIC FTEVEIT_MaxMechaSpdHysteresisC "Hysteresis maximal temperature for estimation enable." VALUE 0x80064850 DATA_RECORD_FLOAT32_IEEE 16000 F_1_p0_21 0 16000 /end CHARACTERISTIC
/begin CHARACTERISTIC FTEVEIT_MaxTempC "Chips maximal allowed temperature." VALUE 0x8006484C DATA_RECORD_FLOAT32_IEEE 240 F_1_p0_73 -40 200 /end CHARACTERISTIC
/begin CHARACTERISTIC FTEVEIT_MinMechaSpdHysteresisC "Hysteresis minimal temperature for estimation enable." VALUE 0x80064848 DATA_RECORD_FLOAT32_IEEE 16000 F_1_p0_21 0 16000 /end CHARACTERISTIC
/begin CHARACTERISTIC FTEVEIT_OverTempThresC "Maximal temperature value for the IGBTs and Diodes maximal estimated temperatures." VALUE 0x80064844 DATA_RECORD_FLOAT32_IEEE 240 F_1_p0_72 -40 200 /end CHARACTERISTIC
/begin CHARACTERISTIC FTEVEIT_PdiodeTdiodeAlphaS1C "Thermal model : Transfert function from diode power losses to diode junction temperature : subsystem 1 pole." VALUE 0x80064840 DATA_RECORD_FLOAT32_IEEE 1 F_1_p0_47 0 1 /end CHARACTERISTIC
/begin CHARACTERISTIC FTEVEIT_PdiodeTdiodeAlphaS2C "Thermal model : Transfert function from diode power losses to diode junction temperature : subsystem 2 pole." VALUE 0x8006483C DATA_RECORD_FLOAT32_IEEE 1 F_1_p0_47 0 1 /end CHARACTERISTIC
/begin CHARACTERISTIC FTEVEIT_PdiodeTdiodeAlphaS3C "Thermal model : Transfert function from diode power losses to diode junction temperature : subsystem 3 pole." VALUE 0x80064838 DATA_RECORD_FLOAT32_IEEE 1 F_1_p0_47 0 1 /end CHARACTERISTIC
/begin CHARACTERISTIC FTEVEIT_PdiodeTdiodeAlphaS4C "Thermal model : Transfert function from diode power losses to diode junction temperature : subsystem 4 pole." VALUE 0x80064834 DATA_RECORD_FLOAT32_IEEE 1 F_1_p0_47 0 1 /end CHARACTERISTIC
/begin CHARACTERISTIC FTEVEIT_PdiodeTdiodeAlphaS5C "Thermal model : Transfert function from diode power losses to diode junction temperature : subsystem 5 pole." VALUE 0x80064830 DATA_RECORD_FLOAT32_IEEE 1 F_1_p0_47 0 1 /end CHARACTERISTIC
/begin CHARACTERISTIC FTEVEIT_PdiodeTdiodeNumS1C "Thermal model : Transfert function from diode power losses to diode junction temperature : subsystem 1 numerator gain." VALUE 0x8006482C DATA_RECORD_FLOAT32_IEEE 1000000 F_1_p0_47 0 1000000 /end CHARACTERISTIC
/begin CHARACTERISTIC FTEVEIT_PdiodeTdiodeNumS2C "Thermal model : Transfert function from diode power losses to diode junction temperature : subsystem 2 numerator gain." VALUE 0x80064828 DATA_RECORD_FLOAT32_IEEE 1000000 F_1_p0_47 0 1000000 /end CHARACTERISTIC
/begin CHARACTERISTIC FTEVEIT_PdiodeTdiodeNumS3C "Thermal model : Transfert function from diode power losses to diode junction temperature : subsystem 3 numerator gain." VALUE 0x80064824 DATA_RECORD_FLOAT32_IEEE 1000000 F_1_p0_47 0 1000000 /end CHARACTERISTIC
/begin CHARACTERISTIC FTEVEIT_PdiodeTdiodeNumS4C "Thermal model : Transfert function from diode power losses to diode junction temperature : subsystem 4 numerator gain." VALUE 0x80064820 DATA_RECORD_FLOAT32_IEEE 1000000 F_1_p0_47 0 1000000 /end CHARACTERISTIC
/begin CHARACTERISTIC FTEVEIT_PdiodeTdiodeNumS5C "Thermal model : Transfert function from diode power losses to diode junction temperature : subsystem 5 numerator gain." VALUE 0x8006481C DATA_RECORD_FLOAT32_IEEE 1000000 F_1_p0_47 0 1000000 /end CHARACTERISTIC
/begin CHARACTERISTIC FTEVEIT_PdiodeTigbtAlphaC "Thermal model : Transfert function from diode power losses to IGBT junction temperature : pole." VALUE 0x80064818 DATA_RECORD_FLOAT32_IEEE 1 F_1_p0_47 0 1 /end CHARACTERISTIC
/begin CHARACTERISTIC FTEVEIT_PdiodeTigbtNumC "Thermal model : Transfert function from diode power losses to IGBT junction temperature : numerator gain." VALUE 0x80064814 DATA_RECORD_FLOAT32_IEEE 1000000 F_1_p0_47 0 1000000 /end CHARACTERISTIC
/begin CHARACTERISTIC FTEVEIT_PigbtTdiodeAlphaC "Thermal model : Transfert function from IGBT power losses to diode junction temperature : pole." VALUE 0x80064810 DATA_RECORD_FLOAT32_IEEE 1 F_1_p0_47 0 1 /end CHARACTERISTIC
/begin CHARACTERISTIC FTEVEIT_PigbtTdiodeNumC "Thermal model : Transfert function from IGBT power losses to diode junction temperature : numerator gain." VALUE 0x8006480C DATA_RECORD_FLOAT32_IEEE 1000000 F_1_p0_47 0 1000000 /end CHARACTERISTIC
/begin CHARACTERISTIC FTEVEIT_PigbtTigbtAlphaS1C "Thermal model : Transfert function from IGBT power losses to IGBT junction temperature : subsystem 1 pole." VALUE 0x80064808 DATA_RECORD_FLOAT32_IEEE 1 F_1_p0_47 0 1 /end CHARACTERISTIC
/begin CHARACTERISTIC FTEVEIT_PigbtTigbtAlphaS2C "Thermal model : Transfert function from IGBT power losses to IGBT junction temperature : subsystem 2 pole." VALUE 0x80064804 DATA_RECORD_FLOAT32_IEEE 1 F_1_p0_47 0 1 /end CHARACTERISTIC
/begin CHARACTERISTIC FTEVEIT_PigbtTigbtAlphaS3C "Thermal model : Transfert function from IGBT power losses to IGBT junction temperature : subsystem 3 pole." VALUE 0x80064800 DATA_RECORD_FLOAT32_IEEE 1 F_1_p0_47 0 1 /end CHARACTERISTIC
/begin CHARACTERISTIC FTEVEIT_PigbtTigbtAlphaS4C "Thermal model : Transfert function from IGBT power losses to IGBT junction temperature : subsystem 4 pole." VALUE 0x800647FC DATA_RECORD_FLOAT32_IEEE 1 F_1_p0_47 0 1 /end CHARACTERISTIC
/begin CHARACTERISTIC FTEVEIT_PigbtTigbtAlphaS5C "Thermal model : Transfert function from IGBT power losses to IGBT junction temperature : subsystem 5 pole." VALUE 0x800647F8 DATA_RECORD_FLOAT32_IEEE 1 F_1_p0_47 0 1 /end CHARACTERISTIC
/begin CHARACTERISTIC FTEVEIT_PigbtTigbtNumS1C "Thermal model : Transfert function from IGBT power losses to IGBT junction temperature : subsystem 1 numerator gain." VALUE 0x800647F4 DATA_RECORD_FLOAT32_IEEE 1000000 F_1_p0_47 0 1000000 /end CHARACTERISTIC
/begin CHARACTERISTIC FTEVEIT_PigbtTigbtNumS2C "Thermal model : Transfert function from IGBT power losses to IGBT junction temperature : subsystem 2 numerator gain." VALUE 0x800647F0 DATA_RECORD_FLOAT32_IEEE 1000000 F_1_p0_47 0 1000000 /end CHARACTERISTIC
/begin CHARACTERISTIC FTEVEIT_PigbtTigbtNumS3C "Thermal model : Transfert function from IGBT power losses to IGBT junction temperature : subsystem 3 numerator gain." VALUE 0x800647EC DATA_RECORD_FLOAT32_IEEE 1000000 F_1_p0_47 0 1000000 /end CHARACTERISTIC
/begin CHARACTERISTIC FTEVEIT_PigbtTigbtNumS4C "Thermal model : Transfert function from IGBT power losses to IGBT junction temperature : subsystem 4 numerator gain." VALUE 0x800647E8 DATA_RECORD_FLOAT32_IEEE 1000000 F_1_p0_47 0 1000000 /end CHARACTERISTIC
/begin CHARACTERISTIC FTEVEIT_PigbtTigbtNumS5C "Thermal model : Transfert function from IGBT power losses to IGBT junction temperature : subsystem 5 numerator gain." VALUE 0x800647E4 DATA_RECORD_FLOAT32_IEEE 1000000 F_1_p0_47 0 1000000 /end CHARACTERISTIC
/begin CHARACTERISTIC FTEVEIT_TcoolBenchC "Bench mode : demanded cooling temperature asked by the experimenter." VALUE 0x800647E0 DATA_RECORD_FLOAT32_IEEE 400 F_1_p0_72 -200 200 /end CHARACTERISTIC
/begin CHARACTERISTIC FTEVEIT_TcoolChoosePMWC "Set this boolean to 1 to estimate the cooling temperature by using the power module W temperature." VALUE 0x800647DC DATA_RECORD_UBYTE 1 Bool_ON_OFF 0 1 BIT_MASK 0x01 /end CHARACTERISTIC
/begin CHARACTERISTIC FTEVEIT_TcoolScalingAlphaC "Scaling on the estimated cooling temperature : y = Alpha * x + Beta." VALUE 0x800647D8 DATA_RECORD_FLOAT32_IEEE 2000000 F_1_p0_47 -1000000 1000000 /end CHARACTERISTIC
/begin CHARACTERISTIC FTEVEIT_TcoolScalingBetaC "Scaling on the estimated cooling temperature : y = Alpha * x + Beta." VALUE 0x800647D4 DATA_RECORD_FLOAT32_IEEE 2000000 F_1_p0_72 -1000000 1000000 /end CHARACTERISTIC
/begin CHARACTERISTIC FTEVEIT_TempFirstFildTrC "Time response at 95 Percent for the IGBTs and Diodes temperatures estimation first filter." VALUE 0x800647D0 DATA_RECORD_FLOAT32_IEEE 100 F_1_p0_53 0 100 /end CHARACTERISTIC
/begin CHARACTERISTIC FTEVEIT_TempSecFildTrC "Time response at 95 Percent for the IGBTs and Diodes temperatures estimation second filter." VALUE 0x800647CC DATA_RECORD_FLOAT32_IEEE 100 F_1_p0_53 0 100 /end CHARACTERISTIC
/begin CHARACTERISTIC FTEVEIT_TempVectFildTrC "Time response at 95 Percent for the IGBTs and Diodes temperatures estimation vector filter." VALUE 0x800647C8 DATA_RECORD_FLOAT32_IEEE 100 F_1_p0_53 0 100 /end CHARACTERISTIC
/begin CHARACTERISTIC FTEVEIT_UdICurrentsC "Diode Voltage = f(Current) cartography input vector." CURVE 0x80064784 DATA_RECORD_FLOAT32_IEEE 1000000 F_1_p0_70 0 1000000
 /begin AXIS_DESCR FIX_AXIS NO_INPUT_QUANTITY Id_0x00 17 0 16 MAX_GRAD 100.0 FIX_AXIS_PAR_DIST 0 1 17 /end AXIS_DESCR
/end CHARACTERISTIC
/begin CHARACTERISTIC FTEVEIT_UdIVoltagesC "Diode Voltage = f(Current) cartography output vector." CURVE 0x80064740 DATA_RECORD_FLOAT32_IEEE 1000000 F_1_p0_39 0 1000000
 /begin AXIS_DESCR FIX_AXIS NO_INPUT_QUANTITY Id_0x00 17 0 16 MAX_GRAD 100.0 FIX_AXIS_PAR_DIST 0 1 17 /end AXIS_DESCR
/end CHARACTERISTIC
/begin CHARACTERISTIC FTEVEIT_UtICurrentsC "IGBT Voltage = f(Current) cartography input vector." CURVE 0x800646FC DATA_RECORD_FLOAT32_IEEE 1000000 F_1_p0_70 0 1000000
 /begin AXIS_DESCR FIX_AXIS NO_INPUT_QUANTITY Id_0x00 17 0 16 MAX_GRAD 100.0 FIX_AXIS_PAR_DIST 0 1 17 /end AXIS_DESCR
/end CHARACTERISTIC
/begin CHARACTERISTIC FTEVEIT_UtIVoltagesC "IGBT Voltage = f(Current) cartography output vector." CURVE 0x800646B8 DATA_RECORD_FLOAT32_IEEE 1000000 F_1_p0_39 0 1000000
 /begin AXIS_DESCR FIX_AXIS NO_INPUT_QUANTITY Id_0x00 17 0 16 MAX_GRAD 100.0 FIX_AXIS_PAR_DIST 0 1 17 /end AXIS_DESCR
/end CHARACTERISTIC
/begin CHARACTERISTIC FTMTLCS_A2DGainIsuLC "gain used to correct a sensor linearity error" VALUE 0x80064BA0 DATA_RECORD_FLOAT32_IEEE 3.402823466E+038 F_1_p0_55 -3.402823466E+038 3.402823466E+038 /end CHARACTERISTIC
/begin CHARACTERISTIC FTMTLCS_A2DGainIsvLC "gain used to correct a sensor linearity error" VALUE 0x80064B9C DATA_RECORD_FLOAT32_IEEE 3.402823466E+038 F_1_p0_55 -3.402823466E+038 3.402823466E+038 /end CHARACTERISTIC
/begin CHARACTERISTIC FTMTLCS_A2DGainIswLC "gain used to correct a sensor linearity error" VALUE 0x80064B98 DATA_RECORD_FLOAT32_IEEE 3.402823466E+038 F_1_p0_55 -3.402823466E+038 3.402823466E+038 /end CHARACTERISTIC
/begin CHARACTERISTIC FTMTLCS_A2DHighThresholdC "FTMTLCS_A2DHighThresholdC" VALUE 0x80064B94 DATA_RECORD_UWORD 4095 F_1_p0_54 0 4095 /end CHARACTERISTIC
/begin CHARACTERISTIC FTMTLCS_A2DLowThresholdC "FTMTLCS_A2DLowThresholdC" VALUE 0x80064B90 DATA_RECORD_UWORD 4095 F_1_p0_54 0 4095 /end CHARACTERISTIC
/begin CHARACTERISTIC FTMTLCS_A2DOutRngHThresholdHC "FTMTLCS_A2DOutRngHThresholdHC" VALUE 0x80064B8C DATA_RECORD_UWORD 4095 F_1_p0_54 0 4095 /end CHARACTERISTIC
/begin CHARACTERISTIC FTMTLCS_A2DOutRngHThresholdLC "FTMTLCS_A2DOutRngHThresholdLC" VALUE 0x80064B88 DATA_RECORD_UWORD 4095 F_1_p0_54 0 4095 /end CHARACTERISTIC
/begin CHARACTERISTIC FTMTLCS_A2DOutRngLThresholdHC "FTMTLCS_A2DOutRngLThresholdHC" VALUE 0x80064B84 DATA_RECORD_UWORD 4095 F_1_p0_54 0 4095 /end CHARACTERISTIC
/begin CHARACTERISTIC FTMTLCS_A2DOutRngLThresholdLC "FTMTLCS_A2DOutRngLThresholdLC" VALUE 0x80064B80 DATA_RECORD_UWORD 4095 F_1_p0_54 0 4095 /end CHARACTERISTIC
/begin CHARACTERISTIC FTMTLCS_CurrentCalEnableC "FTMTLCS_CurrentCalEnableC" VALUE 0x80064B7C DATA_RECORD_UBYTE 1 Bool_ON_OFF 0 1 BIT_MASK 0x01 /end CHARACTERISTIC
/begin CHARACTERISTIC FTMTLCS_CurrentOffsetInitC "FTMTLCS_CurrentOffsetInitC" VALUE 0x80064B78 DATA_RECORD_FLOAT32_IEEE 3.402823466E+038 F_1_p0_45 -3.402823466E+038 3.402823466E+038 /end CHARACTERISTIC
/begin CHARACTERISTIC FTMTLCS_Init2DurationC "duration of init 2" VALUE 0x80064B74 DATA_RECORD_FLOAT32_IEEE 3.402823466E+038 F_1_p0_53 -3.402823466E+038 3.402823466E+038 /end CHARACTERISTIC
/begin CHARACTERISTIC FTMTLCS_InitIuvw3C "FTMTLCS_InitIuvw3C" CURVE 0x80064B68 DATA_RECORD_FLOAT32_IEEE 3.402823466E+038 F_1_p0_46 -3.402823466E+038 3.402823466E+038
 /begin AXIS_DESCR FIX_AXIS NO_INPUT_QUANTITY Id_0x00 3 0 2 MAX_GRAD 100.0 FIX_AXIS_PAR_DIST 0 1 3 /end AXIS_DESCR
/end CHARACTERISTIC
/begin CHARACTERISTIC FTMTLCS_IuGainC "FTMTLCS_IuGainC" VALUE 0x80064B64 DATA_RECORD_FLOAT32_IEEE 3.402823466E+038 F_1_p0_4 -3.402823466E+038 3.402823466E+038 /end CHARACTERISTIC
/begin CHARACTERISTIC FTMTLCS_IvGainC "FTMTLCS_IvGainC" VALUE 0x80064B60 DATA_RECORD_FLOAT32_IEEE 3.402823466E+038 F_1_p0_4 -3.402823466E+038 3.402823466E+038 /end CHARACTERISTIC
/begin CHARACTERISTIC FTMTLCS_IwGainC "FTMTLCS_IwGainC" VALUE 0x80064B5C DATA_RECORD_FLOAT32_IEEE 3.402823466E+038 F_1_p0_4 -3.402823466E+038 3.402823466E+038 /end CHARACTERISTIC
/begin CHARACTERISTIC FTMTLCS_LostPhaseDelayCntC "FTMTLCS_LostPhaseDelayCntC" VALUE 0x80064B58 DATA_RECORD_UWORD 65535 F_1_p0_54 0 65535 /end CHARACTERISTIC
/begin CHARACTERISTIC FTMTLCS_LostPhaseEnaEleSpdRdsC "FTMTLCS_LostPhaseEnaEleSpdRdsC" VALUE 0x80064B54 DATA_RECORD_FLOAT32_IEEE 3.402823466E+038 F_1_p0_55 -3.402823466E+038 3.402823466E+038 /end CHARACTERISTIC
/begin CHARACTERISTIC FTMTLCS_LostPhaseMaxRateC "FTMTLCS_LostPhaseMaxRateC" VALUE 0x80064B50 DATA_RECORD_FLOAT32_IEEE 3.402823466E+038 F_1_p0_55 -3.402823466E+038 3.402823466E+038 /end CHARACTERISTIC
/begin CHARACTERISTIC FTMTLCS_LostPhaseMinIRmsC "FTMTLCS_LostPhaseMinIRmsC" VALUE 0x80064B4C DATA_RECORD_FLOAT32_IEEE 3.402823466E+038 F_1_p0_55 -3.402823466E+038 3.402823466E+038 /end CHARACTERISTIC
/begin CHARACTERISTIC FTMTLCS_LutInPhaseCurrUC "FTMTLCS_LutInPhaseCurrUC" CURVE 0x80064B38 DATA_RECORD_FLOAT32_IEEE 3.402823466E+038 F_1_p0_4 -3.402823466E+038 3.402823466E+038
 /begin AXIS_DESCR FIX_AXIS NO_INPUT_QUANTITY Id_0x00 5 0 4 MAX_GRAD 100.0 FIX_AXIS_PAR_DIST 0 1 5 /end AXIS_DESCR
/end CHARACTERISTIC
/begin CHARACTERISTIC FTMTLCS_LutInPhaseCurrVC "FTMTLCS_LutInPhaseCurrVC" CURVE 0x80064B24 DATA_RECORD_FLOAT32_IEEE 3.402823466E+038 F_1_p0_4 -3.402823466E+038 3.402823466E+038
 /begin AXIS_DESCR FIX_AXIS NO_INPUT_QUANTITY Id_0x00 5 0 4 MAX_GRAD 100.0 FIX_AXIS_PAR_DIST 0 1 5 /end AXIS_DESCR
/end CHARACTERISTIC
/begin CHARACTERISTIC FTMTLCS_LutInPhaseCurrWC "FTMTLCS_LutInPhaseCurrWC" CURVE 0x80064B10 DATA_RECORD_FLOAT32_IEEE 3.402823466E+038 F_1_p0_4 -3.402823466E+038 3.402823466E+038
 /begin AXIS_DESCR FIX_AXIS NO_INPUT_QUANTITY Id_0x00 5 0 4 MAX_GRAD 100.0 FIX_AXIS_PAR_DIST 0 1 5 /end AXIS_DESCR
/end CHARACTERISTIC
/begin CHARACTERISTIC FTMTLCS_LutOutPhaseCurrUC "FTMTLCS_LutOutPhaseCurrUC" CURVE 0x80064AFC DATA_RECORD_FLOAT32_IEEE 3.402823466E+038 F_1_p0_4 -3.402823466E+038 3.402823466E+038
 /begin AXIS_DESCR FIX_AXIS NO_INPUT_QUANTITY Id_0x00 5 0 4 MAX_GRAD 100.0 FIX_AXIS_PAR_DIST 0 1 5 /end AXIS_DESCR
/end CHARACTERISTIC
/begin CHARACTERISTIC FTMTLCS_LutOutPhaseCurrVC "FTMTLCS_LutOutPhaseCurrVC" CURVE 0x80064AE8 DATA_RECORD_FLOAT32_IEEE 3.402823466E+038 F_1_p0_4 -3.402823466E+038 3.402823466E+038
 /begin AXIS_DESCR FIX_AXIS NO_INPUT_QUANTITY Id_0x00 5 0 4 MAX_GRAD 100.0 FIX_AXIS_PAR_DIST 0 1 5 /end AXIS_DESCR
/end CHARACTERISTIC
/begin CHARACTERISTIC FTMTLCS_LutOutPhaseCurrWC "FTMTLCS_LutOutPhaseCurrWC" CURVE 0x80064AD4 DATA_RECORD_FLOAT32_IEEE 3.402823466E+038 F_1_p0_4 -3.402823466E+038 3.402823466E+038
 /begin AXIS_DESCR FIX_AXIS NO_INPUT_QUANTITY Id_0x00 5 0 4 MAX_GRAD 100.0 FIX_AXIS_PAR_DIST 0 1 5 /end AXIS_DESCR
/end CHARACTERISTIC
/begin CHARACTERISTIC FTMTLCS_SpdCutOffFrequencyC "FTMTLCS_SpdCutOffFrequencyC" VALUE 0x80064AD0 DATA_RECORD_FLOAT32_IEEE 3.402823466E+038 F_1_p0_55 -3.402823466E+038 3.402823466E+038 /end CHARACTERISTIC
/begin CHARACTERISTIC FTMTLCS_SumErrorNegThrC "FTMTLCS_SumErrorNegThrC" VALUE 0x80064ACC DATA_RECORD_FLOAT32_IEEE 200 F_1_p0_46 -200 0 /end CHARACTERISTIC
/begin CHARACTERISTIC FTMTLCS_SumErrorPosThrC "FTMTLCS_SumErrorPosThrC" VALUE 0x80064AC8 DATA_RECORD_FLOAT32_IEEE 200 F_1_p0_46 0 200 /end CHARACTERISTIC
/begin CHARACTERISTIC FTMTSEP_ErrorThetaFactorC "FTMTSEP_ErrorThetaFactorC" VALUE 0x80064BA8 DATA_RECORD_FLOAT32_IEEE 3.402823466E+038 F_1_p0_4 -3.402823466E+038 3.402823466E+038 /end CHARACTERISTIC
/begin CHARACTERISTIC FTMTSEP_TimeAdvanceFactC "FTMTSEP_TimeAdvanceFactC" VALUE 0x80064BA4 DATA_RECORD_FLOAT32_IEEE 3.402823466E+038 F_1_p0_4 -3.402823466E+038 3.402823466E+038 /end CHARACTERISTIC
/begin CHARACTERISTIC FTSMACS_AclSpeedThdC "FTSMACS_AclSpeedThdC" VALUE 0x8006455C DATA_RECORD_FLOAT32_IEEE 65535 F_1_p0_4 0 65535 /end CHARACTERISTIC
/begin CHARACTERISTIC FTSMACS_BenchModeC "FTSMACS_BenchModeC" VALUE 0x80064558 DATA_RECORD_UBYTE 1 Bool_ON_OFF 0 1 BIT_MASK 0x01 /end CHARACTERISTIC
/begin CHARACTERISTIC FTSMACS_PwmOffSpeedThdC "FTSMACS_PwmOffSpeedThdC" VALUE 0x80064554 DATA_RECORD_FLOAT32_IEEE 3.402823466E+038 F_1_p0_4 -3.402823466E+038 3.402823466E+038 /end CHARACTERISTIC
/begin CHARACTERISTIC FTSMACS_ReinitFaultC "reinit all fault" VALUE 0x80064550 DATA_RECORD_UBYTE 1 Bool_ON_OFF 0 1 BIT_MASK 0x01 /end CHARACTERISTIC
/begin CHARACTERISTIC FTSMACS_TestFaultC "reinit all fault" VALUE 0x8006454C DATA_RECORD_UBYTE 1 Bool_ON_OFF 0 1 BIT_MASK 0x01 /end CHARACTERISTIC
/begin CHARACTERISTIC FTSMACS_UbatHVMinC "FTSMACS_UbatHVMinC" VALUE 0x80064548 DATA_RECORD_FLOAT32_IEEE 65535 F_1_p0_38 0 65535 /end CHARACTERISTIC
/begin CHARACTERISTIC FTSMACS_VsiTimerFreqRatioRefC "0 =&gt; VSI switching frequency = SPI freq and 1 =&gt; VSI switching frequency = SPI freq / 2" VALUE 0x80064544 DATA_RECORD_UWORD 65535 F_1_p0_55 0 65535 /end CHARACTERISTIC
/begin CHARACTERISTIC FTSMMAM_AclStateBypassOnOffC "FTSMMAM_AclStateBypassOnOffC" VALUE 0x80064574 DATA_RECORD_UBYTE 1 Bool_ON_OFF 0 1 BIT_MASK 0x01 /end CHARACTERISTIC
/begin CHARACTERISTIC FTSMMAM_AclStateBypassValueC "FTSMMAM_AclStateBypassValueC" VALUE 0x80064570 DATA_RECORD_UWORD 65535 F_1_p0_55 0 65535 /end CHARACTERISTIC
/begin CHARACTERISTIC FTSMMAM_CMCCS_M0ConOnoffC "FTSMMAM_CMCCS_M0ConOnoffC" VALUE 0x8006456C DATA_RECORD_UBYTE 1 Bool_ON_OFF 0 1 BIT_MASK 0x01 /end CHARACTERISTIC
/begin CHARACTERISTIC FTSMMAM_FtModeReqBypassOnOffC "FTSMMAM_FtModeReqBypassOnOffC" VALUE 0x80064568 DATA_RECORD_UBYTE 1 Bool_ON_OFF 0 1 BIT_MASK 0x01 /end CHARACTERISTIC
/begin CHARACTERISTIC FTSMMAM_FtModeReqBypassValueC "FTSMMAM_FtModeReqBypassValueC" VALUE 0x80064564 DATA_RECORD_UWORD 65535 F_1_p0_55 0 65535 /end CHARACTERISTIC
/begin CHARACTERISTIC FTSMMAM_MTMEP_StateC "FTSMMAM_MTMEP_StateC" VALUE 0x80064560 DATA_RECORD_UWORD 65535 F_1_p0_4 0 65535 /end CHARACTERISTIC
/begin CHARACTERISTIC FTSMREF_AutoPhasingOutputNumC "FTSMREF_AutoPhasingOutputNumC" VALUE 0x800646B4 DATA_RECORD_UWORD 65535 F_1_p0_4 0 65535 /end CHARACTERISTIC
/begin CHARACTERISTIC FTSMREF_CalEnableTimeC "FTSMREF_CalEnableTimeC" VALUE 0x800646B0 DATA_RECORD_FLOAT32_IEEE 3.402823466E+038 F_1_p0_4 -3.402823466E+038 3.402823466E+038 /end CHARACTERISTIC
/begin CHARACTERISTIC FTSMREF_CalFinishTimeC "FTSMREF_CalFinishTimeC" VALUE 0x800646AC DATA_RECORD_FLOAT32_IEEE 3.402823466E+038 F_1_p0_4 -3.402823466E+038 3.402823466E+038 /end CHARACTERISTIC
/begin CHARACTERISTIC FTSMREF_CalStartTimeMaxC "FTSMREF_CalStartTimeMaxC" VALUE 0x800646A8 DATA_RECORD_FLOAT32_IEEE 3.402823466E+038 F_1_p0_4 -3.402823466E+038 3.402823466E+038 /end CHARACTERISTIC
/begin CHARACTERISTIC FTSMREF_CyclefinishNumC "FTSMREF_CyclefinishNumC" VALUE 0x800646A4 DATA_RECORD_UWORD 65535 F_1_p0_4 0 65535 /end CHARACTERISTIC
/begin CHARACTERISTIC FTSMREF_IdrefGainC "FTSMREF_IdrefGainC" VALUE 0x80064614 DATA_RECORD_FLOAT32_IEEE 3.402823466E+038 F_1_p0_4 -3.402823466E+038 3.402823466E+038 /end CHARACTERISTIC
/begin CHARACTERISTIC FTSMREF_Neg0TimerThdHighC "FTSMREF_Neg0TimerThdHighC" VALUE 0x80064584 DATA_RECORD_UWORD 65535 F_1_p0_4 0 65535 /end CHARACTERISTIC
/begin CHARACTERISTIC FTSMREF_Neg0TimerThdLowC "FTSMREF_Neg0TimerThdLowC" VALUE 0x80064580 DATA_RECORD_UWORD 65535 F_1_p0_4 0 65535 /end CHARACTERISTIC
/begin CHARACTERISTIC FTSMREF_Pos0TimerThdHighC "FTSMREF_Pos0TimerThdHighC" VALUE 0x8006457C DATA_RECORD_UWORD 65535 F_1_p0_4 0 65535 /end CHARACTERISTIC
/begin CHARACTERISTIC FTSMREF_Pos0TimerThdLowC "FTSMREF_Pos0TimerThdLowC" VALUE 0x80064578 DATA_RECORD_UWORD 65535 F_1_p0_4 0 65535 /end CHARACTERISTIC
/begin CHARACTERISTIC SDMTLCS_CounterInitC "SDMTLCS_CounterInitC" VALUE 0x80064BBC DATA_RECORD_ULONG 4294967295 F_1_p0_4 0 4294967295 /end CHARACTERISTIC
/begin CHARACTERISTIC SDMTLCS_CurrentRmsCounterC "SDMTLCS_CurrentRmsCounterC" VALUE 0x80064BB8 DATA_RECORD_ULONG 4294967295 F_1_p0_4 0 4294967295 /end CHARACTERISTIC
/begin CHARACTERISTIC SDMTLCS_CurrentRmsCounterZC "SDMTLCS_CurrentRmsCounterZC" VALUE 0x80064BB4 DATA_RECORD_FLOAT32_IEEE 3.402823466E+038 F_1_p0_4 -3.402823466E+038 3.402823466E+038 /end CHARACTERISTIC
/begin CHARACTERISTIC SDMTLCS_CurrentRmsSumInitC "SDMTLCS_CurrentRmsSumInitC" VALUE 0x80064BB0 DATA_RECORD_FLOAT32_IEEE 3.402823466E+038 F_1_p0_4 -3.402823466E+038 3.402823466E+038 /end CHARACTERISTIC
/begin CHARACTERISTIC SDMTLCS_CutOffFrequencyC "SDMTLCS_CutOffFrequencyC" VALUE 0x80064BAC DATA_RECORD_FLOAT32_IEEE 3.402823466E+038 F_1_p0_4 -3.402823466E+038 3.402823466E+038 /end CHARACTERISTIC
/begin CHARACTERISTIC SDMTMEP_A2DOutRngHighC "SDMTMEP_A2DOutRngHighC" VALUE 0x80064D24 DATA_RECORD_UWORD 65535 F_1_p0_4 0 65535 /end CHARACTERISTIC
/begin CHARACTERISTIC SDMTMEP_A2DOutRngLowC "SDMTMEP_A2DOutRngLowC" VALUE 0x80064D20 DATA_RECORD_UWORD 65535 F_1_p0_4 0 65535 /end CHARACTERISTIC
/begin CHARACTERISTIC SDMTMEP_A2DShortCircuitGndC "SDMTMEP_A2DShortCircuitGndC" VALUE 0x80064D1C DATA_RECORD_UWORD 65535 F_1_p0_4 0 65535 /end CHARACTERISTIC
/begin CHARACTERISTIC SDMTMEP_A2DShortCircuitVccC "SDMTMEP_A2DShortCircuitVccC" VALUE 0x80064D18 DATA_RECORD_UWORD 65535 F_1_p0_4 0 65535 /end CHARACTERISTIC
/begin CHARACTERISTIC SDMTMEP_AutoPhasingAngOnOffC "SDMTMEP_AutoPhasingAngOnOffC" VALUE 0x80064D14 DATA_RECORD_UBYTE 1 Bool_ON_OFF 0 1 BIT_MASK 0x01 /end CHARACTERISTIC
/begin CHARACTERISTIC SDMTMEP_AutoPhasingAngleC "parameter used to adjust the resolver position to the motor position" VALUE 0x80064D10 DATA_RECORD_FLOAT32_IEEE 2 F_1_p0_76 -1 1 /end CHARACTERISTIC
/begin CHARACTERISTIC SDMTMEP_AutophasingThdHighC "SDMTMEP_AutophasingThdHighC" VALUE 0x80064D0C DATA_RECORD_FLOAT32_IEEE 3.402823466E+038 F_1_p0_4 -3.402823466E+038 3.402823466E+038 /end CHARACTERISTIC
/begin CHARACTERISTIC SDMTMEP_AutophasingThdLowC "SDMTMEP_AutophasingThdLowC" VALUE 0x80064D08 DATA_RECORD_FLOAT32_IEEE 3.402823466E+038 F_1_p0_4 -3.402823466E+038 3.402823466E+038 /end CHARACTERISTIC
/begin CHARACTERISTIC SDMTMEP_AvarageGainC "SDMTMEP_AvarageGainC" VALUE 0x80064D04 DATA_RECORD_FLOAT32_IEEE 3.402823466E+038 F_1_p0_4 -3.402823466E+038 3.402823466E+038 /end CHARACTERISTIC
/begin CHARACTERISTIC SDMTMEP_BenchModeValueC "0 = observer / 1 = manual speed" VALUE 0x80064D00 DATA_RECORD_UBYTE 1 Bool_ON_OFF 0 1 BIT_MASK 0x01 /end CHARACTERISTIC
/begin CHARACTERISTIC SDMTMEP_Filter_NumZC "filter parameter" VALUE 0x80064CFC DATA_RECORD_FLOAT32_IEEE 3.402823466E+038 F_1_p0_4 -3.402823466E+038 3.402823466E+038 /end CHARACTERISTIC
/begin CHARACTERISTIC SDMTMEP_GainCosSignAutoEnC "SDMTMEP_GainCosSignAutoEnC" VALUE 0x80064CF8 DATA_RECORD_UBYTE 1 Bool_ON_OFF 0 1 BIT_MASK 0x01 /end CHARACTERISTIC
/begin CHARACTERISTIC SDMTMEP_GainCosSignC "SDMTMEP_GainCosSignC" VALUE 0x80064CF4 DATA_RECORD_FLOAT32_IEEE 3.402823466E+038 F_1_p0_4 -3.402823466E+038 3.402823466E+038 /end CHARACTERISTIC
/begin CHARACTERISTIC SDMTMEP_GainCosThdHighC "SDMTMEP_GainCosThdHighC" VALUE 0x80064CF0 DATA_RECORD_FLOAT32_IEEE 3.402823466E+038 F_1_p0_4 -3.402823466E+038 3.402823466E+038 /end CHARACTERISTIC
/begin CHARACTERISTIC SDMTMEP_GainCosThdLowC "SDMTMEP_GainCosThdLowC" VALUE 0x80064CEC DATA_RECORD_FLOAT32_IEEE 3.402823466E+038 F_1_p0_4 -3.402823466E+038 3.402823466E+038 /end CHARACTERISTIC
/begin CHARACTERISTIC SDMTMEP_GainCosTrimC "gain used to correct a sensor linearity error" VALUE 0x80064CE8 DATA_RECORD_FLOAT32_IEEE 3.402823466E+038 F_1_p0_55 -3.402823466E+038 3.402823466E+038 /end CHARACTERISTIC
/begin CHARACTERISTIC SDMTMEP_GainSinHighC "SDMTMEP_GainSinHighC" VALUE 0x80064CE4 DATA_RECORD_FLOAT32_IEEE 3.402823466E+038 F_1_p0_4 -3.402823466E+038 3.402823466E+038 /end CHARACTERISTIC
/begin CHARACTERISTIC SDMTMEP_GainSinSignC "SDMTMEP_GainSinSignC" VALUE 0x80064CE0 DATA_RECORD_FLOAT32_IEEE 3.402823466E+038 F_1_p0_4 -3.402823466E+038 3.402823466E+038 /end CHARACTERISTIC
/begin CHARACTERISTIC SDMTMEP_GainSinThdLowC "SDMTMEP_GainSinThdLowC" VALUE 0x80064CDC DATA_RECORD_FLOAT32_IEEE 3.402823466E+038 F_1_p0_4 -3.402823466E+038 3.402823466E+038 /end CHARACTERISTIC
/begin CHARACTERISTIC SDMTMEP_GainSinTrimC "gain used to correct a sensor linearity error" VALUE 0x80064CD8 DATA_RECORD_FLOAT32_IEEE 3.402823466E+038 F_1_p0_55 -3.402823466E+038 3.402823466E+038 /end CHARACTERISTIC
/begin CHARACTERISTIC SDMTMEP_ImpoedThetaStepC "SDMTMEP_ImpoedThetaStepC" VALUE 0x80064CD4 DATA_RECORD_FLOAT32_IEEE 3.402823466E+038 F_1_p0_4 -3.402823466E+038 3.402823466E+038 /end CHARACTERISTIC
/begin CHARACTERISTIC SDMTMEP_ImpoedThetaStepMaxC "SDMTMEP_ImpoedThetaStepMaxC" VALUE 0x80064CD0 DATA_RECORD_FLOAT32_IEEE 3.402823466E+038 F_1_p0_4 -3.402823466E+038 3.402823466E+038 /end CHARACTERISTIC
/begin CHARACTERISTIC SDMTMEP_K1ParameterC "observer parameter (see V03 NT 09 00262)" VALUE 0x80064CCC DATA_RECORD_FLOAT32_IEEE 3.402823466E+038 F_1_p0_4 -3.402823466E+038 3.402823466E+038 /end CHARACTERISTIC
/begin CHARACTERISTIC SDMTMEP_K2ParameterC "observer parameter (see V03 NT 09 00262)" VALUE 0x80064CC8 DATA_RECORD_FLOAT32_IEEE 3.402823466E+038 F_1_p0_4 -3.402823466E+038 3.402823466E+038 /end CHARACTERISTIC
/begin CHARACTERISTIC SDMTMEP_LutInMecaSpeedRpmC "SDMTMEP_LutInMecaSpeedRpmC" CURVE 0x80064CA0 DATA_RECORD_FLOAT32_IEEE 3.402823466E+038 F_1_p0_4 -3.402823466E+038 3.402823466E+038
 /begin AXIS_DESCR FIX_AXIS NO_INPUT_QUANTITY Id_0x00 10 0 9 MAX_GRAD 100.0 FIX_AXIS_PAR_DIST 0 1 10 /end AXIS_DESCR
/end CHARACTERISTIC
/begin CHARACTERISTIC SDMTMEP_LutInUbatHvC "SDMTMEP_LutInUbatHvC" CURVE 0x80064C98 DATA_RECORD_FLOAT32_IEEE 3.402823466E+038 F_1_p0_4 -3.402823466E+038 3.402823466E+038
 /begin AXIS_DESCR FIX_AXIS NO_INPUT_QUANTITY Id_0x00 2 0 1 MAX_GRAD 100.0 FIX_AXIS_PAR_DIST 0 1 2 /end AXIS_DESCR
/end CHARACTERISTIC
/begin CHARACTERISTIC SDMTMEP_LutOutAutoPhaseAngleC "SDMTMEP_LutOutAutoPhaseAngleC" MAP 0x80064C48 DATA_RECORD_FLOAT32_IEEE 3.402823466E+038 F_1_p0_4 -3.402823466E+038 3.402823466E+038
 /begin AXIS_DESCR FIX_AXIS NO_INPUT_QUANTITY Id_0x00 2 0 1 MAX_GRAD 100.0 FIX_AXIS_PAR_DIST 0 1 2 /end AXIS_DESCR
 /begin AXIS_DESCR FIX_AXIS NO_INPUT_QUANTITY Id_0x00 10 0 9 MAX_GRAD 100.0 FIX_AXIS_PAR_DIST 0 1 10 /end AXIS_DESCR
/end CHARACTERISTIC
/begin CHARACTERISTIC SDMTMEP_LutSinC "LUT IN resolver sinus theta" CURVE 0x80064C34 DATA_RECORD_FLOAT32_IEEE 3.402823466E+038 F_1_p0_55 -3.402823466E+038 3.402823466E+038
 /begin AXIS_DESCR FIX_AXIS NO_INPUT_QUANTITY Id_0x00 5 0 4 MAX_GRAD 100.0 FIX_AXIS_PAR_DIST 0 1 5 /end AXIS_DESCR
/end CHARACTERISTIC
/begin CHARACTERISTIC SDMTMEP_LutThetaRdSurPiC "LUT OUT resolver angle" CURVE 0x80064C20 DATA_RECORD_FLOAT32_IEEE 3.402823466E+038 F_1_p0_76 -3.402823466E+038 3.402823466E+038
 /begin AXIS_DESCR FIX_AXIS NO_INPUT_QUANTITY Id_0x00 5 0 4 MAX_GRAD 100.0 FIX_AXIS_PAR_DIST 0 1 5 /end AXIS_DESCR
/end CHARACTERISTIC
/begin CHARACTERISTIC SDMTMEP_MecaRpmToElecRdsC "SDMTMEP_MecaRpmToElecRdsC" VALUE 0x80064C1C DATA_RECORD_FLOAT32_IEEE 3.402823466E+038 F_1_p0_55 -3.402823466E+038 3.402823466E+038 /end CHARACTERISTIC
/begin CHARACTERISTIC SDMTMEP_MecaSpeedRpmC "Value of mechanical speed when SDMTMEP_ManualSpeedActivationC = 1" VALUE 0x80064C18 DATA_RECORD_FLOAT32_IEEE 3.402823466E+038 F_1_p0_52 -3.402823466E+038 3.402823466E+038 /end CHARACTERISTIC
/begin CHARACTERISTIC SDMTMEP_OcGainCosTrimC "SDMTMEP_OcGainCosTrimC" VALUE 0x80064C14 DATA_RECORD_FLOAT32_IEEE 3.402823466E+038 F_1_p0_4 -3.402823466E+038 3.402823466E+038 /end CHARACTERISTIC
/begin CHARACTERISTIC SDMTMEP_OcGainSinTrimC "SDMTMEP_OcGainSinTrimC" VALUE 0x80064C10 DATA_RECORD_FLOAT32_IEEE 3.402823466E+038 F_1_p0_4 -3.402823466E+038 3.402823466E+038 /end CHARACTERISTIC
/begin CHARACTERISTIC SDMTMEP_OcOffsetCosTrimC "SDMTMEP_OcOffsetCosTrimC" VALUE 0x80064C0C DATA_RECORD_FLOAT32_IEEE 3.402823466E+038 F_1_p0_4 -3.402823466E+038 3.402823466E+038 /end CHARACTERISTIC
/begin CHARACTERISTIC SDMTMEP_OcOffsetSinTrimC "SDMTMEP_OcOffsetSinTrimC" VALUE 0x80064C08 DATA_RECORD_FLOAT32_IEEE 3.402823466E+038 F_1_p0_4 -3.402823466E+038 3.402823466E+038 /end CHARACTERISTIC
/begin CHARACTERISTIC SDMTMEP_OcRotoringNormalSumC "SDMTMEP_OcSumRangeResThetaC * 2 * 5" VALUE 0x80064C04 DATA_RECORD_FLOAT32_IEEE 3.402823466E+038 F_1_p0_4 -3.402823466E+038 3.402823466E+038 /end CHARACTERISTIC
/begin CHARACTERISTIC SDMTMEP_OcSinCosAdcFilterNumZC "SDMTMEP_OcSinCosAdcFilterNumZC" VALUE 0x80064C00 DATA_RECORD_FLOAT32_IEEE 3.402823466E+038 F_1_p0_4 -3.402823466E+038 3.402823466E+038 /end CHARACTERISTIC
/begin CHARACTERISTIC SDMTMEP_OcSumRangeResThetaC "SDMTMEP_OcSumRangeResThetaC" VALUE 0x80064BFC DATA_RECORD_FLOAT32_IEEE 3.402823466E+038 F_1_p0_4 -3.402823466E+038 3.402823466E+038 /end CHARACTERISTIC
/begin CHARACTERISTIC SDMTMEP_OffsetCosThdHighC "SDMTMEP_OffsetCosThdHighC" VALUE 0x80064BF8 DATA_RECORD_FLOAT32_IEEE 3.402823466E+038 F_1_p0_4 -3.402823466E+038 3.402823466E+038 /end CHARACTERISTIC
/begin CHARACTERISTIC SDMTMEP_OffsetCosThdLowC "SDMTMEP_OffsetCosThdLowC" VALUE 0x80064BF4 DATA_RECORD_FLOAT32_IEEE 3.402823466E+038 F_1_p0_4 -3.402823466E+038 3.402823466E+038 /end CHARACTERISTIC
/begin CHARACTERISTIC SDMTMEP_OffsetCosTrimC "parameter used to correct the sensor offset error" VALUE 0x80064BF0 DATA_RECORD_FLOAT32_IEEE 3.402823466E+038 F_1_p0_74 -3.402823466E+038 3.402823466E+038 /end CHARACTERISTIC
/begin CHARACTERISTIC SDMTMEP_OffsetSinThdHighC "SDMTMEP_OffsetSinThdHighC" VALUE 0x80064BEC DATA_RECORD_FLOAT32_IEEE 3.402823466E+038 F_1_p0_4 -3.402823466E+038 3.402823466E+038 /end CHARACTERISTIC
/begin CHARACTERISTIC SDMTMEP_OffsetSinThdLowC "SDMTMEP_OffsetSinThdLowC" VALUE 0x80064BE8 DATA_RECORD_FLOAT32_IEEE 3.402823466E+038 F_1_p0_4 -3.402823466E+038 3.402823466E+038 /end CHARACTERISTIC
/begin CHARACTERISTIC SDMTMEP_OffsetSinTrimC "parameter used to correct the sensor offset error" VALUE 0x80064BE4 DATA_RECORD_FLOAT32_IEEE 3.402823466E+038 F_1_p0_74 -3.402823466E+038 3.402823466E+038 /end CHARACTERISTIC
/begin CHARACTERISTIC SDMTMEP_OverSpeedThdC "parameter used to correct the sensor offset error" VALUE 0x80064BE0 DATA_RECORD_FLOAT32_IEEE 3.402823466E+038 F_1_p0_52 -3.402823466E+038 3.402823466E+038 /end CHARACTERISTIC
/begin CHARACTERISTIC SDMTMEP_OverSpeedThdOcC "parameter used to correct the sensor offset error" VALUE 0x80064BDC DATA_RECORD_FLOAT32_IEEE 3.402823466E+038 F_1_p0_52 -3.402823466E+038 3.402823466E+038 /end CHARACTERISTIC
/begin CHARACTERISTIC SDMTMEP_PositionMarginC "SDMTMEP_PositionMarginC" VALUE 0x80064BD8 DATA_RECORD_FLOAT32_IEEE 1 F_1_p0_43 0 1 /end CHARACTERISTIC
/begin CHARACTERISTIC SDMTMEP_ResolverParamStoreEnC "SDMTMEP_ResolverParamStoreEnC" VALUE 0x80064BD4 DATA_RECORD_UBYTE 1 Bool_ON_OFF 0 1 BIT_MASK 0x01 /end CHARACTERISTIC
/begin CHARACTERISTIC SDMTMEP_RotoringPerdCountC "sample time of the function" VALUE 0x80064BD0 DATA_RECORD_UWORD 65535 F_1_p0_53 0 65535 /end CHARACTERISTIC
/begin CHARACTERISTIC SDMTMEP_SpdCompEnableC "SDMTMEP_SpdCompEnableC" VALUE 0x80064BCC DATA_RECORD_UBYTE 1 Bool_ON_OFF 0 1 BIT_MASK 0x01 /end CHARACTERISTIC
/begin CHARACTERISTIC SDMTMEP_SpeedMarginC "SDMTMEP_SpeedMarginC" VALUE 0x80064BC8 DATA_RECORD_FLOAT32_IEEE 500 F_1_p0_21 0 500 /end CHARACTERISTIC
/begin CHARACTERISTIC SDMTMEP_UnderSpeedThdC "parameter used to correct the sensor offset error" VALUE 0x80064BC4 DATA_RECORD_FLOAT32_IEEE 3.402823466E+038 F_1_p0_52 -3.402823466E+038 3.402823466E+038 /end CHARACTERISTIC
/begin CHARACTERISTIC SDMTMEP_UnderSpeedThdOcC "parameter used to correct the sensor offset error" VALUE 0x80064BC0 DATA_RECORD_FLOAT32_IEEE 3.402823466E+038 F_1_p0_52 -3.402823466E+038 3.402823466E+038 /end CHARACTERISTIC
/begin CHARACTERISTIC TLE9180_bDrvOverCurrentTestOnC "TLE9180_bDrvOverCurrentTestOnC" VALUE 0x80060029 DATA_RECORD_UBYTE 1 Bool_ON_OFF 0 1 BIT_MASK 0x01 /end CHARACTERISTIC
/begin CHARACTERISTIC TLE9180_bDrvOverTempTestOnC "TLE9180_bDrvOverTempTestOnC" VALUE 0x8006002C DATA_RECORD_UBYTE 1 Bool_ON_OFF 0 1 BIT_MASK 0x01 /end CHARACTERISTIC
/begin CHARACTERISTIC TLE9180_bDrvOverVoltageTestOnC "TLE9180_bDrvOverVoltageTestOnC" VALUE 0x8006002E DATA_RECORD_UBYTE 1 Bool_ON_OFF 0 1 BIT_MASK 0x01 /end CHARACTERISTIC
/begin CHARACTERISTIC TLE9180_bDrvUnderVoltageTestOnC "TLE9180_bDrvUnderVoltageTestOnC" VALUE 0x8006002D DATA_RECORD_UBYTE 1 Bool_ON_OFF 0 1 BIT_MASK 0x01 /end CHARACTERISTIC
/begin CHARACTERISTIC TLE9180_bManualReadRegC "TLE9180_bManualReadRegC" VALUE 0x8006002F DATA_RECORD_UBYTE 1 Bool_ON_OFF 0 1 BIT_MASK 0x01 /end CHARACTERISTIC
/begin CHARACTERISTIC TLE9180_bPhasePerfTestOnC "TLE9180_bPhasePerfTestOnC" VALUE 0x80060027 DATA_RECORD_UBYTE 1 Bool_ON_OFF 0 1 BIT_MASK 0x01 /end CHARACTERISTIC
/begin CHARACTERISTIC TLE9180_bPhaseShortHighTestOnC "TLE9180_bPhaseShortHighTestOnC" VALUE 0x8006002B DATA_RECORD_UBYTE 1 Bool_ON_OFF 0 1 BIT_MASK 0x01 /end CHARACTERISTIC
/begin CHARACTERISTIC TLE9180_bPhaseShortLowTestOnC "TLE9180_bPhaseShortLowTestOnC" VALUE 0x8006002A DATA_RECORD_UBYTE 1 Bool_ON_OFF 0 1 BIT_MASK 0x01 /end CHARACTERISTIC
/begin CHARACTERISTIC TLE9180_bPhsOverVoltTestOnC "TLE9180_bPhsOverVoltTestOnC" VALUE 0x80060028 DATA_RECORD_UBYTE 1 Bool_ON_OFF 0 1 BIT_MASK 0x01 /end CHARACTERISTIC
/begin CHARACTERISTIC TLE9180_kf32PhsTempFaultC "TLE9180_kf32PhsTempFaultC" VALUE 0x80064D68 DATA_RECORD_FLOAT32_IEEE 3.402823466E+038 I_1 -3.402823466E+038 3.402823466E+038 /end CHARACTERISTIC
/begin CHARACTERISTIC TLE9180_kf32PhsTempFltRecoverC "TLE9180_kf32PhsTempFltRecoverC" VALUE 0x80064D64 DATA_RECORD_FLOAT32_IEEE 3.402823466E+038 I_1 -3.402823466E+038 3.402823466E+038 /end CHARACTERISTIC
/begin CHARACTERISTIC TLE9180_ku16EnaResetTimeC "TLE9180_ku16EnaResetTimeC" VALUE 0x80060AAC DATA_RECORD_UWORD 65535 I_1 0 65535 /end CHARACTERISTIC
/begin CHARACTERISTIC TLE9180_ku16ErrPinChkTimC "TLE9180_ku16ErrPinChkTimC" VALUE 0x80060AAA DATA_RECORD_UWORD 65535 I_1 0 65535 /end CHARACTERISTIC
/begin CHARACTERISTIC TLE9180_ku8EnaResetCntC "TLE9180_ku8EnaResetCntC" VALUE 0x80060036 DATA_RECORD_UBYTE 255 I_1 0 255 /end CHARACTERISTIC
/begin CHARACTERISTIC TLE9180_ku8ErrRecvMaxNumC "TLE9180_ku8ErrRecvMaxNumC" VALUE 0x80060035 DATA_RECORD_UBYTE 255 I_1 0 255 /end CHARACTERISTIC
/begin MEASUREMENT TLE9180_af32ReadPhsTempPhys "TLE9180_af32ReadPhsTempPhys" FLOAT32_IEEE I_1 1 2 -3.402823466E+038 3.402823466E+038 MATRIX_DIM 6 1 1 ECU_ADDRESS 0x7001F7EC /end MEASUREMENT
/begin MEASUREMENT TLE9180_af32ReadPhsTempPhys[0] "TLE9180_af32ReadPhsTempPhys[0]" FLOAT32_IEEE I_1 1 2 -3.402823466E+038 3.402823466E+038 ECU_ADDRESS 0x7001F7EC /end MEASUREMENT
/begin MEASUREMENT TLE9180_af32ReadPhsTempPhys[1] "TLE9180_af32ReadPhsTempPhys[1]" FLOAT32_IEEE I_1 1 2 -3.402823466E+038 3.402823466E+038 ECU_ADDRESS 0x7001F7F0 /end MEASUREMENT
/begin MEASUREMENT TLE9180_af32ReadPhsTempPhys[2] "TLE9180_af32ReadPhsTempPhys[2]" FLOAT32_IEEE I_1 1 2 -3.402823466E+038 3.402823466E+038 ECU_ADDRESS 0x7001F7F4 /end MEASUREMENT
/begin MEASUREMENT TLE9180_af32ReadPhsTempPhys[3] "TLE9180_af32ReadPhsTempPhys[3]" FLOAT32_IEEE I_1 1 2 -3.402823466E+038 3.402823466E+038 ECU_ADDRESS 0x7001F7F8 /end MEASUREMENT
/begin MEASUREMENT TLE9180_af32ReadPhsTempPhys[4] "TLE9180_af32ReadPhsTempPhys[4]" FLOAT32_IEEE I_1 1 2 -3.402823466E+038 3.402823466E+038 ECU_ADDRESS 0x7001F7FC /end MEASUREMENT
/begin MEASUREMENT TLE9180_af32ReadPhsTempPhys[5] "TLE9180_af32ReadPhsTempPhys[5]" FLOAT32_IEEE I_1 1 2 -3.402823466E+038 3.402823466E+038 ECU_ADDRESS 0x7001F800 /end MEASUREMENT
/begin MEASUREMENT TLE9180_au32SpiReadFrame "TLE9180_au32SpiReadFrame" ULONG I_1 1 2 0 4294967295 MATRIX_DIM 30 1 1 ECU_ADDRESS 0x7001F770 /end MEASUREMENT
/begin MEASUREMENT TLE9180_au32SpiReadFrame[0] "TLE9180_au32SpiReadFrame[0]" ULONG I_1 1 2 0 4294967295 ECU_ADDRESS 0x7001F770 /end MEASUREMENT
/begin MEASUREMENT TLE9180_au32SpiReadFrame[10] "TLE9180_au32SpiReadFrame[10]" ULONG I_1 1 2 0 4294967295 ECU_ADDRESS 0x7001F798 /end MEASUREMENT
/begin MEASUREMENT TLE9180_au32SpiReadFrame[11] "TLE9180_au32SpiReadFrame[11]" ULONG I_1 1 2 0 4294967295 ECU_ADDRESS 0x7001F79C /end MEASUREMENT
/begin MEASUREMENT TLE9180_au32SpiReadFrame[12] "TLE9180_au32SpiReadFrame[12]" ULONG I_1 1 2 0 4294967295 ECU_ADDRESS 0x7001F7A0 /end MEASUREMENT
/begin MEASUREMENT TLE9180_au32SpiReadFrame[13] "TLE9180_au32SpiReadFrame[13]" ULONG I_1 1 2 0 4294967295 ECU_ADDRESS 0x7001F7A4 /end MEASUREMENT
/begin MEASUREMENT TLE9180_au32SpiReadFrame[14] "TLE9180_au32SpiReadFrame[14]" ULONG I_1 1 2 0 4294967295 ECU_ADDRESS 0x7001F7A8 /end MEASUREMENT
/begin MEASUREMENT TLE9180_au32SpiReadFrame[15] "TLE9180_au32SpiReadFrame[15]" ULONG I_1 1 2 0 4294967295 ECU_ADDRESS 0x7001F7AC /end MEASUREMENT
/begin MEASUREMENT TLE9180_au32SpiReadFrame[16] "TLE9180_au32SpiReadFrame[16]" ULONG I_1 1 2 0 4294967295 ECU_ADDRESS 0x7001F7B0 /end MEASUREMENT
/begin MEASUREMENT TLE9180_au32SpiReadFrame[17] "TLE9180_au32SpiReadFrame[17]" ULONG I_1 1 2 0 4294967295 ECU_ADDRESS 0x7001F7B4 /end MEASUREMENT
/begin MEASUREMENT TLE9180_au32SpiReadFrame[18] "TLE9180_au32SpiReadFrame[18]" ULONG I_1 1 2 0 4294967295 ECU_ADDRESS 0x7001F7B8 /end MEASUREMENT
/begin MEASUREMENT TLE9180_au32SpiReadFrame[19] "TLE9180_au32SpiReadFrame[19]" ULONG I_1 1 2 0 4294967295 ECU_ADDRESS 0x7001F7BC /end MEASUREMENT
/begin MEASUREMENT TLE9180_au32SpiReadFrame[1] "TLE9180_au32SpiReadFrame[1]" ULONG I_1 1 2 0 4294967295 ECU_ADDRESS 0x7001F774 /end MEASUREMENT
/begin MEASUREMENT TLE9180_au32SpiReadFrame[20] "TLE9180_au32SpiReadFrame[20]" ULONG I_1 1 2 0 4294967295 ECU_ADDRESS 0x7001F7C0 /end MEASUREMENT
/begin MEASUREMENT TLE9180_au32SpiReadFrame[21] "TLE9180_au32SpiReadFrame[21]" ULONG I_1 1 2 0 4294967295 ECU_ADDRESS 0x7001F7C4 /end MEASUREMENT
/begin MEASUREMENT TLE9180_au32SpiReadFrame[22] "TLE9180_au32SpiReadFrame[22]" ULONG I_1 1 2 0 4294967295 ECU_ADDRESS 0x7001F7C8 /end MEASUREMENT
/begin MEASUREMENT TLE9180_au32SpiReadFrame[23] "TLE9180_au32SpiReadFrame[23]" ULONG I_1 1 2 0 4294967295 ECU_ADDRESS 0x7001F7CC /end MEASUREMENT
/begin MEASUREMENT TLE9180_au32SpiReadFrame[24] "TLE9180_au32SpiReadFrame[24]" ULONG I_1 1 2 0 4294967295 ECU_ADDRESS 0x7001F7D0 /end MEASUREMENT
/begin MEASUREMENT TLE9180_au32SpiReadFrame[25] "TLE9180_au32SpiReadFrame[25]" ULONG I_1 1 2 0 4294967295 ECU_ADDRESS 0x7001F7D4 /end MEASUREMENT
/begin MEASUREMENT TLE9180_au32SpiReadFrame[26] "TLE9180_au32SpiReadFrame[26]" ULONG I_1 1 2 0 4294967295 ECU_ADDRESS 0x7001F7D8 /end MEASUREMENT
/begin MEASUREMENT TLE9180_au32SpiReadFrame[27] "TLE9180_au32SpiReadFrame[27]" ULONG I_1 1 2 0 4294967295 ECU_ADDRESS 0x7001F7DC /end MEASUREMENT
/begin MEASUREMENT TLE9180_au32SpiReadFrame[28] "TLE9180_au32SpiReadFrame[28]" ULONG I_1 1 2 0 4294967295 ECU_ADDRESS 0x7001F7E0 /end MEASUREMENT
/begin MEASUREMENT TLE9180_au32SpiReadFrame[29] "TLE9180_au32SpiReadFrame[29]" ULONG I_1 1 2 0 4294967295 ECU_ADDRESS 0x7001F7E4 /end MEASUREMENT
/begin MEASUREMENT TLE9180_au32SpiReadFrame[2] "TLE9180_au32SpiReadFrame[2]" ULONG I_1 1 2 0 4294967295 ECU_ADDRESS 0x7001F778 /end MEASUREMENT
/begin MEASUREMENT TLE9180_au32SpiReadFrame[3] "TLE9180_au32SpiReadFrame[3]" ULONG I_1 1 2 0 4294967295 ECU_ADDRESS 0x7001F77C /end MEASUREMENT
/begin MEASUREMENT TLE9180_au32SpiReadFrame[4] "TLE9180_au32SpiReadFrame[4]" ULONG I_1 1 2 0 4294967295 ECU_ADDRESS 0x7001F780 /end MEASUREMENT
/begin MEASUREMENT TLE9180_au32SpiReadFrame[5] "TLE9180_au32SpiReadFrame[5]" ULONG I_1 1 2 0 4294967295 ECU_ADDRESS 0x7001F784 /end MEASUREMENT
/begin MEASUREMENT TLE9180_au32SpiReadFrame[6] "TLE9180_au32SpiReadFrame[6]" ULONG I_1 1 2 0 4294967295 ECU_ADDRESS 0x7001F788 /end MEASUREMENT
/begin MEASUREMENT TLE9180_au32SpiReadFrame[7] "TLE9180_au32SpiReadFrame[7]" ULONG I_1 1 2 0 4294967295 ECU_ADDRESS 0x7001F78C /end MEASUREMENT
/begin MEASUREMENT TLE9180_au32SpiReadFrame[8] "TLE9180_au32SpiReadFrame[8]" ULONG I_1 1 2 0 4294967295 ECU_ADDRESS 0x7001F790 /end MEASUREMENT
/begin MEASUREMENT TLE9180_au32SpiReadFrame[9] "TLE9180_au32SpiReadFrame[9]" ULONG I_1 1 2 0 4294967295 ECU_ADDRESS 0x7001F794 /end MEASUREMENT
/begin MEASUREMENT TLE9180_au32SpiWriteFrame "TLE9180_au32SpiWriteFrame" ULONG I_1 1 2 0 4294967295 MATRIX_DIM 30 1 1 ECU_ADDRESS 0x7001F6F8 /end MEASUREMENT
/begin MEASUREMENT TLE9180_au32SpiWriteFrame[0] "TLE9180_au32SpiWriteFrame[0]" ULONG I_1 1 2 0 4294967295 ECU_ADDRESS 0x7001F6F8 /end MEASUREMENT
/begin MEASUREMENT TLE9180_au32SpiWriteFrame[10] "TLE9180_au32SpiWriteFrame[10]" ULONG I_1 1 2 0 4294967295 ECU_ADDRESS 0x7001F720 /end MEASUREMENT
/begin MEASUREMENT TLE9180_au32SpiWriteFrame[11] "TLE9180_au32SpiWriteFrame[11]" ULONG I_1 1 2 0 4294967295 ECU_ADDRESS 0x7001F724 /end MEASUREMENT
/begin MEASUREMENT TLE9180_au32SpiWriteFrame[12] "TLE9180_au32SpiWriteFrame[12]" ULONG I_1 1 2 0 4294967295 ECU_ADDRESS 0x7001F728 /end MEASUREMENT
/begin MEASUREMENT TLE9180_au32SpiWriteFrame[13] "TLE9180_au32SpiWriteFrame[13]" ULONG I_1 1 2 0 4294967295 ECU_ADDRESS 0x7001F72C /end MEASUREMENT
/begin MEASUREMENT TLE9180_au32SpiWriteFrame[14] "TLE9180_au32SpiWriteFrame[14]" ULONG I_1 1 2 0 4294967295 ECU_ADDRESS 0x7001F730 /end MEASUREMENT
/begin MEASUREMENT TLE9180_au32SpiWriteFrame[15] "TLE9180_au32SpiWriteFrame[15]" ULONG I_1 1 2 0 4294967295 ECU_ADDRESS 0x7001F734 /end MEASUREMENT
/begin MEASUREMENT TLE9180_au32SpiWriteFrame[16] "TLE9180_au32SpiWriteFrame[16]" ULONG I_1 1 2 0 4294967295 ECU_ADDRESS 0x7001F738 /end MEASUREMENT
/begin MEASUREMENT TLE9180_au32SpiWriteFrame[17] "TLE9180_au32SpiWriteFrame[17]" ULONG I_1 1 2 0 4294967295 ECU_ADDRESS 0x7001F73C /end MEASUREMENT
/begin MEASUREMENT TLE9180_au32SpiWriteFrame[18] "TLE9180_au32SpiWriteFrame[18]" ULONG I_1 1 2 0 4294967295 ECU_ADDRESS 0x7001F740 /end MEASUREMENT
/begin MEASUREMENT TLE9180_au32SpiWriteFrame[19] "TLE9180_au32SpiWriteFrame[19]" ULONG I_1 1 2 0 4294967295 ECU_ADDRESS 0x7001F744 /end MEASUREMENT
/begin MEASUREMENT TLE9180_au32SpiWriteFrame[1] "TLE9180_au32SpiWriteFrame[1]" ULONG I_1 1 2 0 4294967295 ECU_ADDRESS 0x7001F6FC /end MEASUREMENT
/begin MEASUREMENT TLE9180_au32SpiWriteFrame[20] "TLE9180_au32SpiWriteFrame[20]" ULONG I_1 1 2 0 4294967295 ECU_ADDRESS 0x7001F748 /end MEASUREMENT
/begin MEASUREMENT TLE9180_au32SpiWriteFrame[21] "TLE9180_au32SpiWriteFrame[21]" ULONG I_1 1 2 0 4294967295 ECU_ADDRESS 0x7001F74C /end MEASUREMENT
/begin MEASUREMENT TLE9180_au32SpiWriteFrame[22] "TLE9180_au32SpiWriteFrame[22]" ULONG I_1 1 2 0 4294967295 ECU_ADDRESS 0x7001F750 /end MEASUREMENT
/begin MEASUREMENT TLE9180_au32SpiWriteFrame[23] "TLE9180_au32SpiWriteFrame[23]" ULONG I_1 1 2 0 4294967295 ECU_ADDRESS 0x7001F754 /end MEASUREMENT
/begin MEASUREMENT TLE9180_au32SpiWriteFrame[24] "TLE9180_au32SpiWriteFrame[24]" ULONG I_1 1 2 0 4294967295 ECU_ADDRESS 0x7001F758 /end MEASUREMENT
/begin MEASUREMENT TLE9180_au32SpiWriteFrame[25] "TLE9180_au32SpiWriteFrame[25]" ULONG I_1 1 2 0 4294967295 ECU_ADDRESS 0x7001F75C /end MEASUREMENT
/begin MEASUREMENT TLE9180_au32SpiWriteFrame[26] "TLE9180_au32SpiWriteFrame[26]" ULONG I_1 1 2 0 4294967295 ECU_ADDRESS 0x7001F760 /end MEASUREMENT
/begin MEASUREMENT TLE9180_au32SpiWriteFrame[27] "TLE9180_au32SpiWriteFrame[27]" ULONG I_1 1 2 0 4294967295 ECU_ADDRESS 0x7001F764 /end MEASUREMENT
/begin MEASUREMENT TLE9180_au32SpiWriteFrame[28] "TLE9180_au32SpiWriteFrame[28]" ULONG I_1 1 2 0 4294967295 ECU_ADDRESS 0x7001F768 /end MEASUREMENT
/begin MEASUREMENT TLE9180_au32SpiWriteFrame[29] "TLE9180_au32SpiWriteFrame[29]" ULONG I_1 1 2 0 4294967295 ECU_ADDRESS 0x7001F76C /end MEASUREMENT
/begin MEASUREMENT TLE9180_au32SpiWriteFrame[2] "TLE9180_au32SpiWriteFrame[2]" ULONG I_1 1 2 0 4294967295 ECU_ADDRESS 0x7001F700 /end MEASUREMENT
/begin MEASUREMENT TLE9180_au32SpiWriteFrame[3] "TLE9180_au32SpiWriteFrame[3]" ULONG I_1 1 2 0 4294967295 ECU_ADDRESS 0x7001F704 /end MEASUREMENT
/begin MEASUREMENT TLE9180_au32SpiWriteFrame[4] "TLE9180_au32SpiWriteFrame[4]" ULONG I_1 1 2 0 4294967295 ECU_ADDRESS 0x7001F708 /end MEASUREMENT
/begin MEASUREMENT TLE9180_au32SpiWriteFrame[5] "TLE9180_au32SpiWriteFrame[5]" ULONG I_1 1 2 0 4294967295 ECU_ADDRESS 0x7001F70C /end MEASUREMENT
/begin MEASUREMENT TLE9180_au32SpiWriteFrame[6] "TLE9180_au32SpiWriteFrame[6]" ULONG I_1 1 2 0 4294967295 ECU_ADDRESS 0x7001F710 /end MEASUREMENT
/begin MEASUREMENT TLE9180_au32SpiWriteFrame[7] "TLE9180_au32SpiWriteFrame[7]" ULONG I_1 1 2 0 4294967295 ECU_ADDRESS 0x7001F714 /end MEASUREMENT
/begin MEASUREMENT TLE9180_au32SpiWriteFrame[8] "TLE9180_au32SpiWriteFrame[8]" ULONG I_1 1 2 0 4294967295 ECU_ADDRESS 0x7001F718 /end MEASUREMENT
/begin MEASUREMENT TLE9180_au32SpiWriteFrame[9] "TLE9180_au32SpiWriteFrame[9]" ULONG I_1 1 2 0 4294967295 ECU_ADDRESS 0x7001F71C /end MEASUREMENT
/begin MEASUREMENT TLE9180_au8CfgRegReadBk "TLE9180_au8CfgRegReadBk" UBYTE I_1 1 2 0 255 MATRIX_DIM 30 1 1 ECU_ADDRESS 0x7001F644 /end MEASUREMENT
/begin MEASUREMENT TLE9180_au8CfgRegReadBk[0] "TLE9180_au8CfgRegReadBk[0]" UBYTE I_1 1 2 0 255 ECU_ADDRESS 0x7001F644 /end MEASUREMENT
/begin MEASUREMENT TLE9180_au8CfgRegReadBk[10] "TLE9180_au8CfgRegReadBk[10]" UBYTE I_1 1 2 0 255 ECU_ADDRESS 0x7001F64E /end MEASUREMENT
/begin MEASUREMENT TLE9180_au8CfgRegReadBk[11] "TLE9180_au8CfgRegReadBk[11]" UBYTE I_1 1 2 0 255 ECU_ADDRESS 0x7001F64F /end MEASUREMENT
/begin MEASUREMENT TLE9180_au8CfgRegReadBk[12] "TLE9180_au8CfgRegReadBk[12]" UBYTE I_1 1 2 0 255 ECU_ADDRESS 0x7001F650 /end MEASUREMENT
/begin MEASUREMENT TLE9180_au8CfgRegReadBk[13] "TLE9180_au8CfgRegReadBk[13]" UBYTE I_1 1 2 0 255 ECU_ADDRESS 0x7001F651 /end MEASUREMENT
/begin MEASUREMENT TLE9180_au8CfgRegReadBk[14] "TLE9180_au8CfgRegReadBk[14]" UBYTE I_1 1 2 0 255 ECU_ADDRESS 0x7001F652 /end MEASUREMENT
/begin MEASUREMENT TLE9180_au8CfgRegReadBk[15] "TLE9180_au8CfgRegReadBk[15]" UBYTE I_1 1 2 0 255 ECU_ADDRESS 0x7001F653 /end MEASUREMENT
/begin MEASUREMENT TLE9180_au8CfgRegReadBk[16] "TLE9180_au8CfgRegReadBk[16]" UBYTE I_1 1 2 0 255 ECU_ADDRESS 0x7001F654 /end MEASUREMENT
/begin MEASUREMENT TLE9180_au8CfgRegReadBk[17] "TLE9180_au8CfgRegReadBk[17]" UBYTE I_1 1 2 0 255 ECU_ADDRESS 0x7001F655 /end MEASUREMENT
/begin MEASUREMENT TLE9180_au8CfgRegReadBk[18] "TLE9180_au8CfgRegReadBk[18]" UBYTE I_1 1 2 0 255 ECU_ADDRESS 0x7001F656 /end MEASUREMENT
/begin MEASUREMENT TLE9180_au8CfgRegReadBk[19] "TLE9180_au8CfgRegReadBk[19]" UBYTE I_1 1 2 0 255 ECU_ADDRESS 0x7001F657 /end MEASUREMENT
/begin MEASUREMENT TLE9180_au8CfgRegReadBk[1] "TLE9180_au8CfgRegReadBk[1]" UBYTE I_1 1 2 0 255 ECU_ADDRESS 0x7001F645 /end MEASUREMENT
/begin MEASUREMENT TLE9180_au8CfgRegReadBk[20] "TLE9180_au8CfgRegReadBk[20]" UBYTE I_1 1 2 0 255 ECU_ADDRESS 0x7001F658 /end MEASUREMENT
/begin MEASUREMENT TLE9180_au8CfgRegReadBk[21] "TLE9180_au8CfgRegReadBk[21]" UBYTE I_1 1 2 0 255 ECU_ADDRESS 0x7001F659 /end MEASUREMENT
/begin MEASUREMENT TLE9180_au8CfgRegReadBk[22] "TLE9180_au8CfgRegReadBk[22]" UBYTE I_1 1 2 0 255 ECU_ADDRESS 0x7001F65A /end MEASUREMENT
/begin MEASUREMENT TLE9180_au8CfgRegReadBk[23] "TLE9180_au8CfgRegReadBk[23]" UBYTE I_1 1 2 0 255 ECU_ADDRESS 0x7001F65B /end MEASUREMENT
/begin MEASUREMENT TLE9180_au8CfgRegReadBk[24] "TLE9180_au8CfgRegReadBk[24]" UBYTE I_1 1 2 0 255 ECU_ADDRESS 0x7001F65C /end MEASUREMENT
/begin MEASUREMENT TLE9180_au8CfgRegReadBk[25] "TLE9180_au8CfgRegReadBk[25]" UBYTE I_1 1 2 0 255 ECU_ADDRESS 0x7001F65D /end MEASUREMENT
/begin MEASUREMENT TLE9180_au8CfgRegReadBk[26] "TLE9180_au8CfgRegReadBk[26]" UBYTE I_1 1 2 0 255 ECU_ADDRESS 0x7001F65E /end MEASUREMENT
/begin MEASUREMENT TLE9180_au8CfgRegReadBk[27] "TLE9180_au8CfgRegReadBk[27]" UBYTE I_1 1 2 0 255 ECU_ADDRESS 0x7001F65F /end MEASUREMENT
/begin MEASUREMENT TLE9180_au8CfgRegReadBk[28] "TLE9180_au8CfgRegReadBk[28]" UBYTE I_1 1 2 0 255 ECU_ADDRESS 0x7001F660 /end MEASUREMENT
/begin MEASUREMENT TLE9180_au8CfgRegReadBk[29] "TLE9180_au8CfgRegReadBk[29]" UBYTE I_1 1 2 0 255 ECU_ADDRESS 0x7001F661 /end MEASUREMENT
/begin MEASUREMENT TLE9180_au8CfgRegReadBk[2] "TLE9180_au8CfgRegReadBk[2]" UBYTE I_1 1 2 0 255 ECU_ADDRESS 0x7001F646 /end MEASUREMENT
/begin MEASUREMENT TLE9180_au8CfgRegReadBk[3] "TLE9180_au8CfgRegReadBk[3]" UBYTE I_1 1 2 0 255 ECU_ADDRESS 0x7001F647 /end MEASUREMENT
/begin MEASUREMENT TLE9180_au8CfgRegReadBk[4] "TLE9180_au8CfgRegReadBk[4]" UBYTE I_1 1 2 0 255 ECU_ADDRESS 0x7001F648 /end MEASUREMENT
/begin MEASUREMENT TLE9180_au8CfgRegReadBk[5] "TLE9180_au8CfgRegReadBk[5]" UBYTE I_1 1 2 0 255 ECU_ADDRESS 0x7001F649 /end MEASUREMENT
/begin MEASUREMENT TLE9180_au8CfgRegReadBk[6] "TLE9180_au8CfgRegReadBk[6]" UBYTE I_1 1 2 0 255 ECU_ADDRESS 0x7001F64A /end MEASUREMENT
/begin MEASUREMENT TLE9180_au8CfgRegReadBk[7] "TLE9180_au8CfgRegReadBk[7]" UBYTE I_1 1 2 0 255 ECU_ADDRESS 0x7001F64B /end MEASUREMENT
/begin MEASUREMENT TLE9180_au8CfgRegReadBk[8] "TLE9180_au8CfgRegReadBk[8]" UBYTE I_1 1 2 0 255 ECU_ADDRESS 0x7001F64C /end MEASUREMENT
/begin MEASUREMENT TLE9180_au8CfgRegReadBk[9] "TLE9180_au8CfgRegReadBk[9]" UBYTE I_1 1 2 0 255 ECU_ADDRESS 0x7001F64D /end MEASUREMENT
/begin MEASUREMENT TLE9180_au8CfgRegister "TLE9180_au8CfgRegister" UBYTE I_1 1 2 0 255 MATRIX_DIM 30 1 1 ECU_ADDRESS 0x7001F662 /end MEASUREMENT
/begin MEASUREMENT TLE9180_au8CfgRegister[0] "TLE9180_au8CfgRegister[0]" UBYTE I_1 1 2 0 255 ECU_ADDRESS 0x7001F662 /end MEASUREMENT
/begin MEASUREMENT TLE9180_au8CfgRegister[10] "TLE9180_au8CfgRegister[10]" UBYTE I_1 1 2 0 255 ECU_ADDRESS 0x7001F66C /end MEASUREMENT
/begin MEASUREMENT TLE9180_au8CfgRegister[11] "TLE9180_au8CfgRegister[11]" UBYTE I_1 1 2 0 255 ECU_ADDRESS 0x7001F66D /end MEASUREMENT
/begin MEASUREMENT TLE9180_au8CfgRegister[12] "TLE9180_au8CfgRegister[12]" UBYTE I_1 1 2 0 255 ECU_ADDRESS 0x7001F66E /end MEASUREMENT
/begin MEASUREMENT TLE9180_au8CfgRegister[13] "TLE9180_au8CfgRegister[13]" UBYTE I_1 1 2 0 255 ECU_ADDRESS 0x7001F66F /end MEASUREMENT
/begin MEASUREMENT TLE9180_au8CfgRegister[14] "TLE9180_au8CfgRegister[14]" UBYTE I_1 1 2 0 255 ECU_ADDRESS 0x7001F670 /end MEASUREMENT
/begin MEASUREMENT TLE9180_au8CfgRegister[15] "TLE9180_au8CfgRegister[15]" UBYTE I_1 1 2 0 255 ECU_ADDRESS 0x7001F671 /end MEASUREMENT
/begin MEASUREMENT TLE9180_au8CfgRegister[16] "TLE9180_au8CfgRegister[16]" UBYTE I_1 1 2 0 255 ECU_ADDRESS 0x7001F672 /end MEASUREMENT
/begin MEASUREMENT TLE9180_au8CfgRegister[17] "TLE9180_au8CfgRegister[17]" UBYTE I_1 1 2 0 255 ECU_ADDRESS 0x7001F673 /end MEASUREMENT
/begin MEASUREMENT TLE9180_au8CfgRegister[18] "TLE9180_au8CfgRegister[18]" UBYTE I_1 1 2 0 255 ECU_ADDRESS 0x7001F674 /end MEASUREMENT
/begin MEASUREMENT TLE9180_au8CfgRegister[19] "TLE9180_au8CfgRegister[19]" UBYTE I_1 1 2 0 255 ECU_ADDRESS 0x7001F675 /end MEASUREMENT
/begin MEASUREMENT TLE9180_au8CfgRegister[1] "TLE9180_au8CfgRegister[1]" UBYTE I_1 1 2 0 255 ECU_ADDRESS 0x7001F663 /end MEASUREMENT
/begin MEASUREMENT TLE9180_au8CfgRegister[20] "TLE9180_au8CfgRegister[20]" UBYTE I_1 1 2 0 255 ECU_ADDRESS 0x7001F676 /end MEASUREMENT
/begin MEASUREMENT TLE9180_au8CfgRegister[21] "TLE9180_au8CfgRegister[21]" UBYTE I_1 1 2 0 255 ECU_ADDRESS 0x7001F677 /end MEASUREMENT
/begin MEASUREMENT TLE9180_au8CfgRegister[22] "TLE9180_au8CfgRegister[22]" UBYTE I_1 1 2 0 255 ECU_ADDRESS 0x7001F678 /end MEASUREMENT
/begin MEASUREMENT TLE9180_au8CfgRegister[23] "TLE9180_au8CfgRegister[23]" UBYTE I_1 1 2 0 255 ECU_ADDRESS 0x7001F679 /end MEASUREMENT
/begin MEASUREMENT TLE9180_au8CfgRegister[24] "TLE9180_au8CfgRegister[24]" UBYTE I_1 1 2 0 255 ECU_ADDRESS 0x7001F67A /end MEASUREMENT
/begin MEASUREMENT TLE9180_au8CfgRegister[25] "TLE9180_au8CfgRegister[25]" UBYTE I_1 1 2 0 255 ECU_ADDRESS 0x7001F67B /end MEASUREMENT
/begin MEASUREMENT TLE9180_au8CfgRegister[26] "TLE9180_au8CfgRegister[26]" UBYTE I_1 1 2 0 255 ECU_ADDRESS 0x7001F67C /end MEASUREMENT
/begin MEASUREMENT TLE9180_au8CfgRegister[27] "TLE9180_au8CfgRegister[27]" UBYTE I_1 1 2 0 255 ECU_ADDRESS 0x7001F67D /end MEASUREMENT
/begin MEASUREMENT TLE9180_au8CfgRegister[28] "TLE9180_au8CfgRegister[28]" UBYTE I_1 1 2 0 255 ECU_ADDRESS 0x7001F67E /end MEASUREMENT
/begin MEASUREMENT TLE9180_au8CfgRegister[29] "TLE9180_au8CfgRegister[29]" UBYTE I_1 1 2 0 255 ECU_ADDRESS 0x7001F67F /end MEASUREMENT
/begin MEASUREMENT TLE9180_au8CfgRegister[2] "TLE9180_au8CfgRegister[2]" UBYTE I_1 1 2 0 255 ECU_ADDRESS 0x7001F664 /end MEASUREMENT
/begin MEASUREMENT TLE9180_au8CfgRegister[3] "TLE9180_au8CfgRegister[3]" UBYTE I_1 1 2 0 255 ECU_ADDRESS 0x7001F665 /end MEASUREMENT
/begin MEASUREMENT TLE9180_au8CfgRegister[4] "TLE9180_au8CfgRegister[4]" UBYTE I_1 1 2 0 255 ECU_ADDRESS 0x7001F666 /end MEASUREMENT
/begin MEASUREMENT TLE9180_au8CfgRegister[5] "TLE9180_au8CfgRegister[5]" UBYTE I_1 1 2 0 255 ECU_ADDRESS 0x7001F667 /end MEASUREMENT
/begin MEASUREMENT TLE9180_au8CfgRegister[6] "TLE9180_au8CfgRegister[6]" UBYTE I_1 1 2 0 255 ECU_ADDRESS 0x7001F668 /end MEASUREMENT
/begin MEASUREMENT TLE9180_au8CfgRegister[7] "TLE9180_au8CfgRegister[7]" UBYTE I_1 1 2 0 255 ECU_ADDRESS 0x7001F669 /end MEASUREMENT
/begin MEASUREMENT TLE9180_au8CfgRegister[8] "TLE9180_au8CfgRegister[8]" UBYTE I_1 1 2 0 255 ECU_ADDRESS 0x7001F66A /end MEASUREMENT
/begin MEASUREMENT TLE9180_au8CfgRegister[9] "TLE9180_au8CfgRegister[9]" UBYTE I_1 1 2 0 255 ECU_ADDRESS 0x7001F66B /end MEASUREMENT
/begin MEASUREMENT TLE9180_au8ReadPhsTemp "TLE9180_au8ReadPhsTemp" UBYTE I_1 1 2 0 255 MATRIX_DIM 6 1 1 ECU_ADDRESS 0x7001F63E /end MEASUREMENT
/begin MEASUREMENT TLE9180_au8ReadPhsTemp[0] "TLE9180_au8ReadPhsTemp[0]" UBYTE I_1 1 2 0 255 ECU_ADDRESS 0x7001F63E /end MEASUREMENT
/begin MEASUREMENT TLE9180_au8ReadPhsTemp[1] "TLE9180_au8ReadPhsTemp[1]" UBYTE I_1 1 2 0 255 ECU_ADDRESS 0x7001F63F /end MEASUREMENT
/begin MEASUREMENT TLE9180_au8ReadPhsTemp[2] "TLE9180_au8ReadPhsTemp[2]" UBYTE I_1 1 2 0 255 ECU_ADDRESS 0x7001F640 /end MEASUREMENT
/begin MEASUREMENT TLE9180_au8ReadPhsTemp[3] "TLE9180_au8ReadPhsTemp[3]" UBYTE I_1 1 2 0 255 ECU_ADDRESS 0x7001F641 /end MEASUREMENT
/begin MEASUREMENT TLE9180_au8ReadPhsTemp[4] "TLE9180_au8ReadPhsTemp[4]" UBYTE I_1 1 2 0 255 ECU_ADDRESS 0x7001F642 /end MEASUREMENT
/begin MEASUREMENT TLE9180_au8ReadPhsTemp[5] "TLE9180_au8ReadPhsTemp[5]" UBYTE I_1 1 2 0 255 ECU_ADDRESS 0x7001F643 /end MEASUREMENT
/begin MEASUREMENT TLE9180_au8ReadRegs "TLE9180_au8ReadRegs" UBYTE I_1 1 2 0 255 MATRIX_DIM 30 1 1 ECU_ADDRESS 0x7001F620 /end MEASUREMENT
/begin MEASUREMENT TLE9180_au8ReadRegs[0] "TLE9180_au8ReadRegs[0]" UBYTE I_1 1 2 0 255 ECU_ADDRESS 0x7001F620 /end MEASUREMENT
/begin MEASUREMENT TLE9180_au8ReadRegs[10] "TLE9180_au8ReadRegs[10]" UBYTE I_1 1 2 0 255 ECU_ADDRESS 0x7001F62A /end MEASUREMENT
/begin MEASUREMENT TLE9180_au8ReadRegs[11] "TLE9180_au8ReadRegs[11]" UBYTE I_1 1 2 0 255 ECU_ADDRESS 0x7001F62B /end MEASUREMENT
/begin MEASUREMENT TLE9180_au8ReadRegs[12] "TLE9180_au8ReadRegs[12]" UBYTE I_1 1 2 0 255 ECU_ADDRESS 0x7001F62C /end MEASUREMENT
/begin MEASUREMENT TLE9180_au8ReadRegs[13] "TLE9180_au8ReadRegs[13]" UBYTE I_1 1 2 0 255 ECU_ADDRESS 0x7001F62D /end MEASUREMENT
/begin MEASUREMENT TLE9180_au8ReadRegs[14] "TLE9180_au8ReadRegs[14]" UBYTE I_1 1 2 0 255 ECU_ADDRESS 0x7001F62E /end MEASUREMENT
/begin MEASUREMENT TLE9180_au8ReadRegs[15] "TLE9180_au8ReadRegs[15]" UBYTE I_1 1 2 0 255 ECU_ADDRESS 0x7001F62F /end MEASUREMENT
/begin MEASUREMENT TLE9180_au8ReadRegs[16] "TLE9180_au8ReadRegs[16]" UBYTE I_1 1 2 0 255 ECU_ADDRESS 0x7001F630 /end MEASUREMENT
/begin MEASUREMENT TLE9180_au8ReadRegs[17] "TLE9180_au8ReadRegs[17]" UBYTE I_1 1 2 0 255 ECU_ADDRESS 0x7001F631 /end MEASUREMENT
/begin MEASUREMENT TLE9180_au8ReadRegs[18] "TLE9180_au8ReadRegs[18]" UBYTE I_1 1 2 0 255 ECU_ADDRESS 0x7001F632 /end MEASUREMENT
/begin MEASUREMENT TLE9180_au8ReadRegs[19] "TLE9180_au8ReadRegs[19]" UBYTE I_1 1 2 0 255 ECU_ADDRESS 0x7001F633 /end MEASUREMENT
/begin MEASUREMENT TLE9180_au8ReadRegs[1] "TLE9180_au8ReadRegs[1]" UBYTE I_1 1 2 0 255 ECU_ADDRESS 0x7001F621 /end MEASUREMENT
/begin MEASUREMENT TLE9180_au8ReadRegs[20] "TLE9180_au8ReadRegs[20]" UBYTE I_1 1 2 0 255 ECU_ADDRESS 0x7001F634 /end MEASUREMENT
/begin MEASUREMENT TLE9180_au8ReadRegs[21] "TLE9180_au8ReadRegs[21]" UBYTE I_1 1 2 0 255 ECU_ADDRESS 0x7001F635 /end MEASUREMENT
/begin MEASUREMENT TLE9180_au8ReadRegs[22] "TLE9180_au8ReadRegs[22]" UBYTE I_1 1 2 0 255 ECU_ADDRESS 0x7001F636 /end MEASUREMENT
/begin MEASUREMENT TLE9180_au8ReadRegs[23] "TLE9180_au8ReadRegs[23]" UBYTE I_1 1 2 0 255 ECU_ADDRESS 0x7001F637 /end MEASUREMENT
/begin MEASUREMENT TLE9180_au8ReadRegs[24] "TLE9180_au8ReadRegs[24]" UBYTE I_1 1 2 0 255 ECU_ADDRESS 0x7001F638 /end MEASUREMENT
/begin MEASUREMENT TLE9180_au8ReadRegs[25] "TLE9180_au8ReadRegs[25]" UBYTE I_1 1 2 0 255 ECU_ADDRESS 0x7001F639 /end MEASUREMENT
/begin MEASUREMENT TLE9180_au8ReadRegs[26] "TLE9180_au8ReadRegs[26]" UBYTE I_1 1 2 0 255 ECU_ADDRESS 0x7001F63A /end MEASUREMENT
/begin MEASUREMENT TLE9180_au8ReadRegs[27] "TLE9180_au8ReadRegs[27]" UBYTE I_1 1 2 0 255 ECU_ADDRESS 0x7001F63B /end MEASUREMENT
/begin MEASUREMENT TLE9180_au8ReadRegs[28] "TLE9180_au8ReadRegs[28]" UBYTE I_1 1 2 0 255 ECU_ADDRESS 0x7001F63C /end MEASUREMENT
/begin MEASUREMENT TLE9180_au8ReadRegs[29] "TLE9180_au8ReadRegs[29]" UBYTE I_1 1 2 0 255 ECU_ADDRESS 0x7001F63D /end MEASUREMENT
/begin MEASUREMENT TLE9180_au8ReadRegs[2] "TLE9180_au8ReadRegs[2]" UBYTE I_1 1 2 0 255 ECU_ADDRESS 0x7001F622 /end MEASUREMENT
/begin MEASUREMENT TLE9180_au8ReadRegs[3] "TLE9180_au8ReadRegs[3]" UBYTE I_1 1 2 0 255 ECU_ADDRESS 0x7001F623 /end MEASUREMENT
/begin MEASUREMENT TLE9180_au8ReadRegs[4] "TLE9180_au8ReadRegs[4]" UBYTE I_1 1 2 0 255 ECU_ADDRESS 0x7001F624 /end MEASUREMENT
/begin MEASUREMENT TLE9180_au8ReadRegs[5] "TLE9180_au8ReadRegs[5]" UBYTE I_1 1 2 0 255 ECU_ADDRESS 0x7001F625 /end MEASUREMENT
/begin MEASUREMENT TLE9180_au8ReadRegs[6] "TLE9180_au8ReadRegs[6]" UBYTE I_1 1 2 0 255 ECU_ADDRESS 0x7001F626 /end MEASUREMENT
/begin MEASUREMENT TLE9180_au8ReadRegs[7] "TLE9180_au8ReadRegs[7]" UBYTE I_1 1 2 0 255 ECU_ADDRESS 0x7001F627 /end MEASUREMENT
/begin MEASUREMENT TLE9180_au8ReadRegs[8] "TLE9180_au8ReadRegs[8]" UBYTE I_1 1 2 0 255 ECU_ADDRESS 0x7001F628 /end MEASUREMENT
/begin MEASUREMENT TLE9180_au8ReadRegs[9] "TLE9180_au8ReadRegs[9]" UBYTE I_1 1 2 0 255 ECU_ADDRESS 0x7001F629 /end MEASUREMENT
/begin MEASUREMENT TLE9180_bDataTransferDone "..." UBYTE Bool_ON_OFF 1 2 0 1 BIT_MASK 0x01 ECU_ADDRESS 0x7001F817 /end MEASUREMENT
/begin MEASUREMENT TLE9180_bDrvOverCurrent "..." UBYTE Bool_ON_OFF 1 2 0 1 BIT_MASK 0x01 ECU_ADDRESS 0x7001F816 /end MEASUREMENT
/begin MEASUREMENT TLE9180_bDrvOverTemp "..." UBYTE Bool_ON_OFF 1 2 0 1 BIT_MASK 0x01 ECU_ADDRESS 0x7001F815 /end MEASUREMENT
/begin MEASUREMENT TLE9180_bDrvOverVoltage "..." UBYTE Bool_ON_OFF 1 2 0 1 BIT_MASK 0x01 ECU_ADDRESS 0x7001F814 /end MEASUREMENT
/begin MEASUREMENT TLE9180_bDrvUnderVoltage "..." UBYTE Bool_ON_OFF 1 2 0 1 BIT_MASK 0x01 ECU_ADDRESS 0x7001F813 /end MEASUREMENT
/begin MEASUREMENT TLE9180_bErrorFlag "..." UBYTE Bool_ON_OFF 1 2 0 1 BIT_MASK 0x01 ECU_ADDRESS 0x7001F812 /end MEASUREMENT
/begin MEASUREMENT TLE9180_bErrorPinLevel "..." UBYTE Bool_ON_OFF 1 2 0 1 BIT_MASK 0x01 ECU_ADDRESS 0x7001F811 /end MEASUREMENT
/begin MEASUREMENT TLE9180_bHALOverVolt "..." UBYTE Bool_ON_OFF 1 2 0 1 BIT_MASK 0x01 ECU_ADDRESS 0x7001F80F /end MEASUREMENT
/begin MEASUREMENT TLE9180_bHALUnderVolt "..." UBYTE Bool_ON_OFF 1 2 0 1 BIT_MASK 0x01 ECU_ADDRESS 0x7001F80E /end MEASUREMENT
/begin MEASUREMENT TLE9180_bInitFailFlg "..." UBYTE Bool_ON_OFF 1 2 0 1 BIT_MASK 0x01 ECU_ADDRESS 0x7001F80D /end MEASUREMENT
/begin MEASUREMENT TLE9180_bPhasePerf "..." UBYTE Bool_ON_OFF 1 2 0 1 BIT_MASK 0x01 ECU_ADDRESS 0x7001F80C /end MEASUREMENT
/begin MEASUREMENT TLE9180_bPhaseShortHigh "..." UBYTE Bool_ON_OFF 1 2 0 1 BIT_MASK 0x01 ECU_ADDRESS 0x7001F80B /end MEASUREMENT
/begin MEASUREMENT TLE9180_bPhaseShortLow "..." UBYTE Bool_ON_OFF 1 2 0 1 BIT_MASK 0x01 ECU_ADDRESS 0x7001F80A /end MEASUREMENT
/begin MEASUREMENT TLE9180_bPhsOverVolt "..." UBYTE Bool_ON_OFF 1 2 0 1 BIT_MASK 0x01 ECU_ADDRESS 0x7001F809 /end MEASUREMENT
/begin MEASUREMENT TLE9180_bReadErrInfoFlg "..." UBYTE Bool_ON_OFF 1 2 0 1 BIT_MASK 0x01 ECU_ADDRESS 0x7001F808 /end MEASUREMENT
/begin MEASUREMENT TLE9180_bTempWarning "..." UBYTE Bool_ON_OFF 1 2 0 1 BIT_MASK 0x01 ECU_ADDRESS 0x7001F807 /end MEASUREMENT
/begin MEASUREMENT TLE9180_bTestReadErrRegs "..." UBYTE Bool_ON_OFF 1 2 0 1 BIT_MASK 0x01 ECU_ADDRESS 0x7001F806 /end MEASUREMENT
/begin MEASUREMENT TLE9180_bTestReadReg "..." UBYTE Bool_ON_OFF 1 2 0 1 BIT_MASK 0x01 ECU_ADDRESS 0x7001F805 /end MEASUREMENT
/begin MEASUREMENT TLE9180_bTestWriteReg "..." UBYTE Bool_ON_OFF 1 2 0 1 BIT_MASK 0x01 ECU_ADDRESS 0x7001F804 /end MEASUREMENT
/begin MEASUREMENT TLE9180_f32MaxPhsTempPhys "..." FLOAT32_IEEE I_1 1 2 -3.402823466E+038 3.402823466E+038 ECU_ADDRESS 0x7001F7E8 /end MEASUREMENT
/begin MEASUREMENT TLE9180_u16EnaResetTime "..." UWORD I_1 1 2 0 65535 ECU_ADDRESS 0x7001F60C /end MEASUREMENT
/begin MEASUREMENT TLE9180_u16ErrPinChkCnt "..." UWORD I_1 1 2 0 65535 ECU_ADDRESS 0x7001F60A /end MEASUREMENT
/begin MEASUREMENT TLE9180_u16HallSupVolt "..." UWORD I_1 1 2 0 65535 ECU_ADDRESS 0x7001F608 /end MEASUREMENT
/begin MEASUREMENT TLE9180_u8CurOperMode "..." UBYTE I_1 1 2 0 255 ECU_ADDRESS 0x7001F61E /end MEASUREMENT
/begin MEASUREMENT TLE9180_u8EnaResetCnt "..." UBYTE I_1 1 2 0 255 ECU_ADDRESS 0x7001F61F /end MEASUREMENT
/begin MEASUREMENT TLE9180_u8ErrRecoverCnt "..." UBYTE I_1 1 2 0 255 ECU_ADDRESS 0x7001F61C /end MEASUREMENT
/begin MEASUREMENT TLE9180_u8ErrorFrameCnt "..." UBYTE I_1 1 2 0 255 ECU_ADDRESS 0x7001F61D /end MEASUREMENT
/begin MEASUREMENT TLE9180_u8FeedBackAddr "..." UBYTE I_1 1 2 0 255 ECU_ADDRESS 0x7001F61B /end MEASUREMENT
/begin MEASUREMENT TLE9180_u8FeedBackData "..." UBYTE I_1 1 2 0 255 ECU_ADDRESS 0x7001F61A /end MEASUREMENT
/begin MEASUREMENT TLE9180_u8FeedBackStatus "..." UBYTE I_1 1 2 0 255 ECU_ADDRESS 0x7001F619 /end MEASUREMENT
/begin MEASUREMENT TLE9180_u8HallSupVolt "..." UBYTE I_1 1 2 0 255 ECU_ADDRESS 0x7001F618 /end MEASUREMENT
/begin MEASUREMENT TLE9180_u8IndexFrame "..." UBYTE I_1 1 2 0 255 ECU_ADDRESS 0x7001F617 /end MEASUREMENT
/begin MEASUREMENT TLE9180_u8Mode "..." UBYTE I_1 1 2 0 255 ECU_ADDRESS 0x7001F616 /end MEASUREMENT
/begin MEASUREMENT TLE9180_u8RdRegTimCnt "..." UBYTE I_1 1 2 0 255 ECU_ADDRESS 0x7001F615 /end MEASUREMENT
/begin MEASUREMENT TLE9180_u8ReadRegAddr "..." UBYTE I_1 1 2 0 255 ECU_ADDRESS 0x7001F614 /end MEASUREMENT
/begin MEASUREMENT TLE9180_u8SelfTestStep "..." UBYTE I_1 1 2 0 255 ECU_ADDRESS 0x7001F613 /end MEASUREMENT
/begin MEASUREMENT TLE9180_u8SelfTstModChk "..." UBYTE I_1 1 2 0 255 ECU_ADDRESS 0x7001F612 /end MEASUREMENT
/begin MEASUREMENT TLE9180_u8SpiTxFrameMaxNb "..." UBYTE I_1 1 2 0 255 ECU_ADDRESS 0x7001F611 /end MEASUREMENT
/begin MEASUREMENT TLE9180_u8TestMode "..." UBYTE I_1 1 2 0 255 ECU_ADDRESS 0x7001F610 /end MEASUREMENT
/begin MEASUREMENT TLE9180_u8WriteData "..." UBYTE I_1 1 2 0 255 ECU_ADDRESS 0x7001F60F /end MEASUREMENT
/begin MEASUREMENT TLE9180_u8WriteRegAddr "..." UBYTE I_1 1 2 0 255 ECU_ADDRESS 0x7001F60E /end MEASUREMENT
/begin COMPU_METHOD I_1 "" RAT_FUNC "%9.2" "-" COEFFS 0 1 0 0 0 1 /end COMPU_METHOD
/begin COMPU_METHOD F_1_p0_4 "" RAT_FUNC "%9.2" "-" COEFFS 0 1 0 0 0 1 /end COMPU_METHOD
/begin COMPU_METHOD F_1_p0_21 "" RAT_FUNC "%9.2" "RPM" COEFFS 0 1 0 0 0 1 /end COMPU_METHOD
/begin COMPU_METHOD F_1_p0_35 "" RAT_FUNC "%9.2" "Hz" COEFFS 0 1 0 0 0 1 /end COMPU_METHOD
/begin COMPU_METHOD F_1_p0_36 "" RAT_FUNC "%9.2" "None." COEFFS 0 1 0 0 0 1 /end COMPU_METHOD
/begin COMPU_METHOD F_1_p0_38 "" RAT_FUNC "%9.2" "V" COEFFS 0 1 0 0 0 1 /end COMPU_METHOD
/begin COMPU_METHOD F_1_p0_39 "" RAT_FUNC "%9.2" "V." COEFFS 0 1 0 0 0 1 /end COMPU_METHOD
/begin COMPU_METHOD F_1_p0_43 "" RAT_FUNC "%9.2" "Nan." COEFFS 0 1 0 0 0 1 /end COMPU_METHOD
/begin COMPU_METHOD F_1_p0_45 "" RAT_FUNC "%9.2" "Nan" COEFFS 0 1 0 0 0 1 /end COMPU_METHOD
/begin COMPU_METHOD F_1_p0_46 "" RAT_FUNC "%9.2" "A" COEFFS 0 1 0 0 0 1 /end COMPU_METHOD
/begin COMPU_METHOD F_1_p0_47 "" RAT_FUNC "%9.2" "None" COEFFS 0 1 0 0 0 1 /end COMPU_METHOD
/begin COMPU_METHOD F_1_p0_49 "" RAT_FUNC "%9.2" "Nm" COEFFS 0 1 0 0 0 1 /end COMPU_METHOD
/begin COMPU_METHOD F_1_p0_50 "" RAT_FUNC "%9.2" "Rpm" COEFFS 0 1 0 0 0 1 /end COMPU_METHOD
/begin COMPU_METHOD F_1_p0_52 "" RAT_FUNC "%9.2" "rpm" COEFFS 0 1 0 0 0 1 /end COMPU_METHOD
/begin COMPU_METHOD F_1_p0_53 "" RAT_FUNC "%9.2" "s" COEFFS 0 1 0 0 0 1 /end COMPU_METHOD
/begin COMPU_METHOD F_1_p0_54 "" RAT_FUNC "%9.2" "NaN" COEFFS 0 1 0 0 0 1 /end COMPU_METHOD
/begin COMPU_METHOD F_1_p0_55 "" RAT_FUNC "%9.2" "none" COEFFS 0 1 0 0 0 1 /end COMPU_METHOD
/begin COMPU_METHOD F_1_p0_56 "" RAT_FUNC "%9.2" "N.m" COEFFS 0 1 0 0 0 1 /end COMPU_METHOD
/begin COMPU_METHOD F_1_p0_61 "" RAT_FUNC "%9.2" "Ohms" COEFFS 0 1 0 0 0 1 /end COMPU_METHOD
/begin COMPU_METHOD F_1_p0_62 "" RAT_FUNC "%9.2" "rd" COEFFS 0 1 0 0 0 1 /end COMPU_METHOD
/begin COMPU_METHOD F_1_p0_66 "" RAT_FUNC "%9.2" "ms" COEFFS 0 1 0 0 0 1 /end COMPU_METHOD
/begin COMPU_METHOD F_1_p0_67 "" RAT_FUNC "%9.2" "rpm/s" COEFFS 0 1 0 0 0 1 /end COMPU_METHOD
/begin COMPU_METHOD F_1_p0_69 "" RAT_FUNC "%9.2" "W" COEFFS 0 1 0 0 0 1 /end COMPU_METHOD
/begin COMPU_METHOD F_1_p0_70 "" RAT_FUNC "%9.2" "A." COEFFS 0 1 0 0 0 1 /end COMPU_METHOD
/begin COMPU_METHOD F_1_p0_71 "" RAT_FUNC "%9.2" "J." COEFFS 0 1 0 0 0 1 /end COMPU_METHOD
/begin COMPU_METHOD F_1_p0_72 "" RAT_FUNC "%9.2" "Deg Celsius" COEFFS 0 1 0 0 0 1 /end COMPU_METHOD
/begin COMPU_METHOD F_1_p0_73 "" RAT_FUNC "%9.2" "Deg_Celsius" COEFFS 0 1 0 0 0 1 /end COMPU_METHOD
/begin COMPU_METHOD F_1_p0_74 "" RAT_FUNC "%9.2" "dec" COEFFS 0 1 0 0 0 1 /end COMPU_METHOD
/begin COMPU_METHOD F_1_p0_76 "" RAT_FUNC "%9.2" "rd/pi" COEFFS 0 1 0 0 0 1 /end COMPU_METHOD
/begin COMPU_METHOD Id_0x00 "" RAT_FUNC "%9.2" "." COEFFS 0 1 0 0 0 1 /end COMPU_METHOD
/begin COMPU_METHOD Bool_ON_OFF "" TAB_VERB "%8.4" "." COMPU_TAB_REF Bool_ON_OFF_table /end COMPU_METHOD
/begin COMPU_VTAB Bool_ON_OFF_table "" TAB_VERB 2 0 "OFF" 1 "ON" /end COMPU_VTAB
/begin FUNCTION SWC_FT ""
 /begin DEF_CHARACTERISTIC FTCIVDC_SpdMaxC FTCIVDC_SpdMinC FTCIVDC_UbatHVLowSatC FTCIVDC_VFreqEnableC FTCMCCS_CurrentLoopOrgEnC FTCMCCS_EM1dOpenLoopGainC FTCMCCS_EM1qOpenLoopGainC FTCMCCS_GenTableTorqueThrdC FTCMCCS_IdCurrLoopParOnOffC FTCMCCS_iM1dTgtFildTrC FTCMCCS_iM1qTgtFildTrC FTCMCCS_InitU0dqTgt3C FTCMCCS_IqCurrLoopParOnOffC FTCMCCS_Lm0C FTCMCCS_Lm1dC FTCMCCS_Lm1qC FTCMCCS_LutElecSpeedRds3C FTCMCCS_LutInSpeedRpmC FTCMCCS_LutInUbatC FTCMCCS_LutM0CtrlTrC FTCMCCS_LutOutM1dCtrlTrGC FTCMCCS_LutOutM1dCtrlTrMC FTCMCCS_LutOutM1qCtrlTrGC FTCMCCS_LutOutM1qCtrlTrMC FTCMCCS_M1dCtrlTrC FTCMCCS_M1qCtrlTrC FTCMCCS_PhimC FTCMCCS_RsC FTCMCCS_SampleTimeFactC FTCMCCS_TransEmfM1dGainC FTCMCCS_TransEmfM1qGainC FTCMCCS_VariableLm1dOnOffC FTCMCCS_VariableLm1qOnOffC FTCMCCS_VariablePhimOnOffC FTCMCTC_CoggingCompGainC FTCMCTC_CoggingCompOnOffC FTCMCTC_CoggingPhaseRdC FTCMCTC_H3CurrentOnOffC FTCMCTC_H3CurrentRatioC FTCMCTC_LutCoggingCompGainC FTCMCTC_LutElecSpeedRds2C FTCMCTC_LutElecSpeedRdsC FTCMCTC_LutH3CompGainC FTCMCTC_SpyThresholdC FTCMHIJ_24IdEnableC FTCMHIJ_24IqEnableC FTCMHIJ_24thTimesIdC FTCMHIJ_24thTimesIqC FTCMHIJ_HijCurrentOnOffC FTCMHIJ_HijMecaSpdRpmMaxC FTCMHIJ_IdqMaxLmtC FTCMHIJ_IdqMinLmtC FTCMHIJ_LutInSpeed24C FTCMHIJ_LutInSpeed6dC FTCMHIJ_LutInSpeedC FTCMHIJ_LutInSpeedPhaseIdC FTCMHIJ_LutInSpeedPhaseIqC FTCMHIJ_LutInTorque24C FTCMHIJ_LutInTorqueC FTCMHIJ_LutInTorqueGen24C FTCMHIJ_LutInTorqueGenC FTCMHIJ_LutOut24thPhaseIdC FTCMHIJ_LutOut24thPhaseIdGenC FTCMHIJ_LutOut24thPhaseIqC FTCMHIJ_LutOut24thPhaseIqGenC FTCMHIJ_LutOutBaseMagnitude12IdC FTCMHIJ_LutOutBaseMagnitude12IqC FTCMHIJ_LutOutBaseMagnitude12IqGenC FTCMHIJ_LutOutBaseMagnitude24IdC FTCMHIJ_LutOutBaseMagnitude24IdGenC FTCMHIJ_LutOutBaseMagnitude24IqC FTCMHIJ_LutOutBaseMagnitude24IqGenC FTCMHIJ_LutOutBaseMagnitude6IdC FTCMHIJ_LutOutBaseMagnitude6IdGenC FTCMHIJ_LutOutBaseMagnitude6IqC FTCMHIJ_LutOutSixthPhaseIdC FTCMHIJ_LutOutSixthPhaseIdGenC FTCMHIJ_LutOutSixthPhaseIqC FTCMHIJ_LutOutTwelfthPhaseIdC FTCMHIJ_LutOutTwelfthPhaseIqC FTCMHIJ_LutOutTwelfthPhaseIqGenC FTCMHIJ_SixIdEnableC FTCMHIJ_SixIqEnableC FTCMHIJ_SixTimesIdC FTCMHIJ_SixTimesIqC FTCMHIJ_TwelveIdEnableC FTCMHIJ_TwelveIqEnableC FTCMHIJ_TwelveTimesIdC FTCMHIJ_TwelveTimesIqC FTCMRPC_ConcordiaTrans33C FTCMSCS_CtrlSatToC FTCMSCS_CtrlTrC FTCMSCS_fC FTCMSCS_InitalValueEnC FTCMSCS_jC FTCMSCS_SpdAccPerMsThrC FTCMSCS_SpdOvershootFaultC FTCMSCS_ZeroSpdThrC FTCMSCS_ZeroSpdTimoutC FTCMSTC_AccelNegRpmBySecondC FTCMSTC_AccelPosRpmBySecondC FTCMTCS_AccelPosRpmBySecondC FTCMTCS_AntiSlideEnableC FTCMTCS_AntiSlideEnaCountMaxC FTCMTCS_AntiSlideTorqueThrC FTCMTCS_BenchElecPowerMaxC FTCMTCS_BenchElecTorqueMaxC FTCMTCS_CutOffFrequencySpdRpmC FTCMTCS_deg2radC FTCMTCS_DivideTorqMinC FTCMTCS_EntrySlideCountMaxC FTCMTCS_ExtTorqueMaxMinC FTCMTCS_FluxControllerGainC FTCMTCS_FluxControllerGainKiC FTCMTCS_FluxControllerGainKpC FTCMTCS_FluxCtrPiEnableC FTCMTCS_GainPhaseVoltagePeakC FTCMTCS_GenTableTorqueThrdC FTCMTCS_IdentificationAngleDegC FTCMTCS_IdentificationIsTgtC FTCMTCS_IdModeOnOffC FTCMTCS_Initi0dqTgt3C FTCMTCS_InitTorqueMaxMinC FTCMTCS_iqCorEnaC FTCMTCS_KilLmtC FTCMTCS_LutCutOffFreqSlideC FTCMTCS_LutInAddSpeedRpmC FTCMTCS_LutInAddUbatC FTCMTCS_LutInMecaSpeedRpmC FTCMTCS_LutInSpeedRpmC FTCMTCS_LutInTorqueTgtC FTCMTCS_LutInUbatC FTCMTCS_LutInUbatHVC FTCMTCS_LutOutAddElecTorqPoitC FTCMTCS_LutOutIdAdd0C FTCMTCS_LutOutIdAdd0MotC FTCMTCS_LutOutIdAddGenC FTCMTCS_LutOutIdAddMotC FTCMTCS_LutOutIqAddGenC FTCMTCS_LutOutIqAddMotC FTCMTCS_LutOutTorqueMaxC FTCMTCS_LutOutTorqueMinC FTCMTCS_LutOutVolMarginGenC FTCMTCS_LutOutVolMarginMotC FTCMTCS_MaxErrorFor100C FTCMTCS_ParkCurrentMaxC FTCMTCS_SlideSpdRpmC FTCMTCS_SwitchElecTorqueRangeC FTCMTCS_SwitchElecTrqRange0C FTCMTCS_VoltageLimiterOnOffC FTCMTCS_VoltageMarginC FTCMTCS_VoltMarginCtrlOnOffC FTCMTTC_AntiJerkMecaTorqueMaxC FTCMTTC_AntiJerkMecaTorqueMinC FTCMTTC_BpAccHighCutOffFrequencyC FTCMTTC_DampingEnableC FTCMTTC_DampingSpdHighC FTCMTTC_DampingSpdLowC FTCMTTC_DampTorqTgtHighThdC FTCMTTC_DampTorqueTargetThdC FTCMTTC_Lut3InMecaSpeedRpmC FTCMTTC_Lut3InTorqueTgtC FTCMTTC_Lut3InUbatC FTCMTTC_LutInMecaSpeedRpmC FTCMTTC_LutInSpdRpmAtjkDeltaC FTCMTTC_LutInSpdRpmBaseC FTCMTTC_LutInSpeedRpmBpTrqHacC FTCMTTC_LutInSpeedRpmDampingC FTCMTTC_LutInUbatC FTCMTTC_LutOutAntiJerkBaseGainC FTCMTTC_LutOutAntiJerkBaseGainHacC FTCMTTC_LutOutAtjkDeltaGainC FTCMTTC_LutOutCutOffFrequencyC FTCMTTC_LutOutMecaPowerC FTCMTTC_PowerLimtEnableC FTCMTTC_PreTorqTrasRangeC FTCMTTC_PreTorqTrasStep2C FTCMTTC_PreTorqTrasStepMaxC FTCMTTC_PreTorqTrasStepMinC FTCMTTC_PreTorqueC FTCMTTC_PreTorqueEnableC FTCMTTC_PreTorqueStartC FTCMTTC_PreTorqueTimeC FTCMTTC_Rpm2RdsC FTCMTTC_SpeedHysteresisRangeC FTCMTTC_SpeedThdC FTCMTTC_TolTqrLmtEnC FTCMTTC_ToqueHpFilterSpdThrdC FTCMTTC_TorMaxC FTCMTTC_TorqCorEnableC FTCMTTC_TorqueBySecondNegC FTCMTTC_TorqueBySecondPosC FTCMTTC_TorqueCutOffFrequencyC FTCMTTC_TorqueFildTrC FTCMTTC_TorqueHpFilterSpdHystRgC FTCMTTC_TrqHpCutOffFrequencyC FTCMTTC_TrqSatThrdC FTCMTTC_ZeroSpdC FTDDLMP_I0LimitMaxC FTDDLMP_I0LimitMinC FTDDLMP_IdLimitMaxC FTDDLMP_IdLimitMinC FTDDLMP_IqLimitMaxC FTDDLMP_IqLimitMinC FTDDLMP_PowerLimC FTDDLMP_SpeedLimitMaxC FTDDLMP_SpeedLimitMinC FTDDLMP_TorqLimitMaxC FTDDLMP_TorqLimitMinC FTEVEIT_CommutDataCoeffC FTEVEIT_EoffICurrentsC FTEVEIT_EoffIEnergiesC FTEVEIT_EonICurrentsC FTEVEIT_EonIEnergiesC FTEVEIT_ErecICurrentsC FTEVEIT_ErecIEnergiesC FTEVEIT_KoffUdcCoeffsC FTEVEIT_KoffUdcVoltagesC FTEVEIT_KonUdcCoeffsC FTEVEIT_KonUdcVoltagesC FTEVEIT_KrecUdcCoeffsC FTEVEIT_KrecUdcVoltagesC FTEVEIT_MaxMechaSpdHysteresisC FTEVEIT_MaxTempC FTEVEIT_MinMechaSpdHysteresisC FTEVEIT_OverTempThresC FTEVEIT_PdiodeTdiodeAlphaS1C FTEVEIT_PdiodeTdiodeAlphaS2C FTEVEIT_PdiodeTdiodeAlphaS3C FTEVEIT_PdiodeTdiodeAlphaS4C FTEVEIT_PdiodeTdiodeAlphaS5C FTEVEIT_PdiodeTdiodeNumS1C FTEVEIT_PdiodeTdiodeNumS2C FTEVEIT_PdiodeTdiodeNumS3C FTEVEIT_PdiodeTdiodeNumS4C FTEVEIT_PdiodeTdiodeNumS5C FTEVEIT_PdiodeTigbtAlphaC FTEVEIT_PdiodeTigbtNumC FTEVEIT_PigbtTdiodeAlphaC FTEVEIT_PigbtTdiodeNumC FTEVEIT_PigbtTigbtAlphaS1C FTEVEIT_PigbtTigbtAlphaS2C FTEVEIT_PigbtTigbtAlphaS3C FTEVEIT_PigbtTigbtAlphaS4C FTEVEIT_PigbtTigbtAlphaS5C FTEVEIT_PigbtTigbtNumS1C FTEVEIT_PigbtTigbtNumS2C FTEVEIT_PigbtTigbtNumS3C FTEVEIT_PigbtTigbtNumS4C FTEVEIT_PigbtTigbtNumS5C FTEVEIT_TcoolBenchC FTEVEIT_TcoolChoosePMWC FTEVEIT_TcoolScalingAlphaC FTEVEIT_TcoolScalingBetaC FTEVEIT_TempFirstFildTrC FTEVEIT_TempSecFildTrC FTEVEIT_TempVectFildTrC FTEVEIT_UdICurrentsC FTEVEIT_UdIVoltagesC FTEVEIT_UtICurrentsC FTEVEIT_UtIVoltagesC FTMTLCS_A2DGainIsuLC FTMTLCS_A2DGainIsvLC FTMTLCS_A2DGainIswLC FTMTLCS_A2DHighThresholdC FTMTLCS_A2DLowThresholdC FTMTLCS_A2DOutRngHThresholdHC FTMTLCS_A2DOutRngHThresholdLC FTMTLCS_A2DOutRngLThresholdHC FTMTLCS_A2DOutRngLThresholdLC FTMTLCS_CurrentCalEnableC FTMTLCS_CurrentOffsetInitC FTMTLCS_Init2DurationC FTMTLCS_InitIuvw3C FTMTLCS_IuGainC FTMTLCS_IvGainC FTMTLCS_IwGainC FTMTLCS_LostPhaseDelayCntC FTMTLCS_LostPhaseEnaEleSpdRdsC FTMTLCS_LostPhaseMaxRateC FTMTLCS_LostPhaseMinIRmsC FTMTLCS_LutInPhaseCurrUC FTMTLCS_LutInPhaseCurrVC FTMTLCS_LutInPhaseCurrWC FTMTLCS_LutOutPhaseCurrUC FTMTLCS_LutOutPhaseCurrVC FTMTLCS_LutOutPhaseCurrWC FTMTLCS_SpdCutOffFrequencyC FTMTLCS_SumErrorNegThrC FTMTLCS_SumErrorPosThrC FTMTSEP_ErrorThetaFactorC FTMTSEP_TimeAdvanceFactC FTSMACS_AclSpeedThdC FTSMACS_BenchModeC FTSMACS_PwmOffSpeedThdC FTSMACS_ReinitFaultC FTSMACS_TestFaultC FTSMACS_UbatHVMinC FTSMACS_VsiTimerFreqRatioRefC FTSMMAM_AclStateBypassOnOffC FTSMMAM_AclStateBypassValueC FTSMMAM_CMCCS_M0ConOnoffC FTSMMAM_FtModeReqBypassOnOffC FTSMMAM_FtModeReqBypassValueC FTSMMAM_MTMEP_StateC FTSMREF_AutoPhasingOutputNumC FTSMREF_CalEnableTimeC FTSMREF_CalFinishTimeC FTSMREF_CalStartTimeMaxC FTSMREF_CyclefinishNumC FTSMREF_IdrefGainC FTSMREF_Neg0TimerThdHighC FTSMREF_Neg0TimerThdLowC FTSMREF_Pos0TimerThdHighC FTSMREF_Pos0TimerThdLowC SDMTLCS_CounterInitC SDMTLCS_CurrentRmsCounterC SDMTLCS_CurrentRmsCounterZC SDMTLCS_CurrentRmsSumInitC SDMTLCS_CutOffFrequencyC SDMTMEP_A2DOutRngHighC SDMTMEP_A2DOutRngLowC SDMTMEP_A2DShortCircuitGndC SDMTMEP_A2DShortCircuitVccC SDMTMEP_AutoPhasingAngleC SDMTMEP_AutoPhasingAngOnOffC SDMTMEP_AutophasingThdHighC SDMTMEP_AutophasingThdLowC SDMTMEP_AvarageGainC SDMTMEP_BenchModeValueC SDMTMEP_Filter_NumZC SDMTMEP_GainCosSignAutoEnC SDMTMEP_GainCosSignC SDMTMEP_GainCosThdHighC SDMTMEP_GainCosThdLowC SDMTMEP_GainCosTrimC SDMTMEP_GainSinHighC SDMTMEP_GainSinSignC SDMTMEP_GainSinThdLowC SDMTMEP_GainSinTrimC SDMTMEP_ImpoedThetaStepC SDMTMEP_ImpoedThetaStepMaxC SDMTMEP_K1ParameterC SDMTMEP_K2ParameterC SDMTMEP_LutInMecaSpeedRpmC SDMTMEP_LutInUbatHvC SDMTMEP_LutOutAutoPhaseAngleC SDMTMEP_LutSinC SDMTMEP_LutThetaRdSurPiC SDMTMEP_MecaRpmToElecRdsC SDMTMEP_MecaSpeedRpmC SDMTMEP_OcGainCosTrimC SDMTMEP_OcGainSinTrimC SDMTMEP_OcOffsetCosTrimC SDMTMEP_OcOffsetSinTrimC SDMTMEP_OcRotoringNormalSumC SDMTMEP_OcSinCosAdcFilterNumZC SDMTMEP_OcSumRangeResThetaC SDMTMEP_OffsetCosThdHighC SDMTMEP_OffsetCosThdLowC SDMTMEP_OffsetCosTrimC SDMTMEP_OffsetSinThdHighC SDMTMEP_OffsetSinThdLowC SDMTMEP_OffsetSinTrimC SDMTMEP_OverSpeedThdC SDMTMEP_OverSpeedThdOcC SDMTMEP_PositionMarginC SDMTMEP_ResolverParamStoreEnC SDMTMEP_RotoringPerdCountC SDMTMEP_SpdCompEnableC SDMTMEP_SpeedMarginC SDMTMEP_UnderSpeedThdC SDMTMEP_UnderSpeedThdOcC /end DEF_CHARACTERISTIC
/end FUNCTION
/begin FUNCTION TLE9180 ""
 /begin DEF_CHARACTERISTIC TLE9180_bDrvOverCurrentTestOnC TLE9180_bDrvOverTempTestOnC TLE9180_bDrvOverVoltageTestOnC TLE9180_bDrvUnderVoltageTestOnC TLE9180_bManualReadRegC TLE9180_bPhasePerfTestOnC TLE9180_bPhaseShortHighTestOnC TLE9180_bPhaseShortLowTestOnC TLE9180_bPhsOverVoltTestOnC TLE9180_kf32PhsTempFaultC TLE9180_kf32PhsTempFltRecoverC TLE9180_ku16EnaResetTimeC TLE9180_ku16ErrPinChkTimC TLE9180_ku8EnaResetCntC TLE9180_ku8ErrRecvMaxNumC /end DEF_CHARACTERISTIC
 /begin OUT_MEASUREMENT TLE9180_af32ReadPhsTempPhys TLE9180_af32ReadPhsTempPhys[0] TLE9180_af32ReadPhsTempPhys[1] TLE9180_af32ReadPhsTempPhys[2] TLE9180_af32ReadPhsTempPhys[3] TLE9180_af32ReadPhsTempPhys[4] TLE9180_af32ReadPhsTempPhys[5] TLE9180_au32SpiReadFrame TLE9180_au32SpiReadFrame[0] TLE9180_au32SpiReadFrame[10] TLE9180_au32SpiReadFrame[11] TLE9180_au32SpiReadFrame[12] TLE9180_au32SpiReadFrame[13] TLE9180_au32SpiReadFrame[14] TLE9180_au32SpiReadFrame[15] TLE9180_au32SpiReadFrame[16] TLE9180_au32SpiReadFrame[17] TLE9180_au32SpiReadFrame[18] TLE9180_au32SpiReadFrame[19] TLE9180_au32SpiReadFrame[1] TLE9180_au32SpiReadFrame[20] TLE9180_au32SpiReadFrame[21] TLE9180_au32SpiReadFrame[22] TLE9180_au32SpiReadFrame[23] TLE9180_au32SpiReadFrame[24] TLE9180_au32SpiReadFrame[25] TLE9180_au32SpiReadFrame[26] TLE9180_au32SpiReadFrame[27] TLE9180_au32SpiReadFrame[28] TLE9180_au32SpiReadFrame[29] TLE9180_au32SpiReadFrame[2] TLE9180_au32SpiReadFrame[3] TLE9180_au32SpiReadFrame[4] TLE9180_au32SpiReadFrame[5] TLE9180_au32SpiReadFrame[6] TLE9180_au32SpiReadFrame[7] TLE9180_au32SpiReadFrame[8] TLE9180_au32SpiReadFrame[9] TLE9180_au32SpiWriteFrame TLE9180_au32SpiWriteFrame[0] TLE9180_au32SpiWriteFrame[10] TLE9180_au32SpiWriteFrame[11] TLE9180_au32SpiWriteFrame[12] TLE9180_au32SpiWriteFrame[13] TLE9180_au32SpiWriteFrame[14] TLE9180_au32SpiWriteFrame[15] TLE9180_au32SpiWriteFrame[16] TLE9180_au32SpiWriteFrame[17] TLE9180_au32SpiWriteFrame[18] TLE9180_au32SpiWriteFrame[19] TLE9180_au32SpiWriteFrame[1] TLE9180_au32SpiWriteFrame[20] TLE9180_au32SpiWriteFrame[21] TLE9180_au32SpiWriteFrame[22] TLE9180_au32SpiWriteFrame[23] TLE9180_au32SpiWriteFrame[24] TLE9180_au32SpiWriteFrame[25] TLE9180_au32SpiWriteFrame[26] TLE9180_au32SpiWriteFrame[27] TLE9180_au32SpiWriteFrame[28] TLE9180_au32SpiWriteFrame[29] TLE9180_au32SpiWriteFrame[2] TLE9180_au32SpiWriteFrame[3] TLE9180_au32SpiWriteFrame[4] TLE9180_au32SpiWriteFrame[5] TLE9180_au32SpiWriteFrame[6] TLE9180_au32SpiWriteFrame[7] TLE9180_au32SpiWriteFrame[8] TLE9180_au32SpiWriteFrame[9] TLE9180_au8CfgRegister TLE9180_au8CfgRegister[0] TLE9180_au8CfgRegister[10] TLE9180_au8CfgRegister[11] TLE9180_au8CfgRegister[12] TLE9180_au8CfgRegister[13] TLE9180_au8CfgRegister[14] TLE9180_au8CfgRegister[15] TLE9180_au8CfgRegister[16] TLE9180_au8CfgRegister[17] TLE9180_au8CfgRegister[18] TLE9180_au8CfgRegister[19] TLE9180_au8CfgRegister[1] TLE9180_au8CfgRegister[20] TLE9180_au8CfgRegister[21] TLE9180_au8CfgRegister[22] TLE9180_au8CfgRegister[23] TLE9180_au8CfgRegister[24] TLE9180_au8CfgRegister[25] TLE9180_au8CfgRegister[26] TLE9180_au8CfgRegister[27] TLE9180_au8CfgRegister[28] TLE9180_au8CfgRegister[29] TLE9180_au8CfgRegister[2] TLE9180_au8CfgRegister[3] TLE9180_au8CfgRegister[4] TLE9180_au8CfgRegister[5] TLE9180_au8CfgRegister[6] TLE9180_au8CfgRegister[7] TLE9180_au8CfgRegister[8] TLE9180_au8CfgRegister[9] TLE9180_au8CfgRegReadBk TLE9180_au8CfgRegReadBk[0] TLE9180_au8CfgRegReadBk[10] TLE9180_au8CfgRegReadBk[11] TLE9180_au8CfgRegReadBk[12] TLE9180_au8CfgRegReadBk[13] TLE9180_au8CfgRegReadBk[14] TLE9180_au8CfgRegReadBk[15] TLE9180_au8CfgRegReadBk[16] TLE9180_au8CfgRegReadBk[17] TLE9180_au8CfgRegReadBk[18] TLE9180_au8CfgRegReadBk[19] TLE9180_au8CfgRegReadBk[1] TLE9180_au8CfgRegReadBk[20] TLE9180_au8CfgRegReadBk[21] TLE9180_au8CfgRegReadBk[22] TLE9180_au8CfgRegReadBk[23] TLE9180_au8CfgRegReadBk[24] TLE9180_au8CfgRegReadBk[25] TLE9180_au8CfgRegReadBk[26] TLE9180_au8CfgRegReadBk[27] TLE9180_au8CfgRegReadBk[28] TLE9180_au8CfgRegReadBk[29] TLE9180_au8CfgRegReadBk[2] TLE9180_au8CfgRegReadBk[3] TLE9180_au8CfgRegReadBk[4] TLE9180_au8CfgRegReadBk[5] TLE9180_au8CfgRegReadBk[6] TLE9180_au8CfgRegReadBk[7] TLE9180_au8CfgRegReadBk[8] TLE9180_au8CfgRegReadBk[9] TLE9180_au8ReadPhsTemp TLE9180_au8ReadPhsTemp[0] TLE9180_au8ReadPhsTemp[1] TLE9180_au8ReadPhsTemp[2] TLE9180_au8ReadPhsTemp[3] TLE9180_au8ReadPhsTemp[4] TLE9180_au8ReadPhsTemp[5] TLE9180_au8ReadRegs TLE9180_au8ReadRegs[0] TLE9180_au8ReadRegs[10] TLE9180_au8ReadRegs[11] TLE9180_au8ReadRegs[12] TLE9180_au8ReadRegs[13] TLE9180_au8ReadRegs[14] TLE9180_au8ReadRegs[15] TLE9180_au8ReadRegs[16] TLE9180_au8ReadRegs[17] TLE9180_au8ReadRegs[18] TLE9180_au8ReadRegs[19] TLE9180_au8ReadRegs[1] TLE9180_au8ReadRegs[20] TLE9180_au8ReadRegs[21] TLE9180_au8ReadRegs[22] TLE9180_au8ReadRegs[23] TLE9180_au8ReadRegs[24] TLE9180_au8ReadRegs[25] TLE9180_au8ReadRegs[26] TLE9180_au8ReadRegs[27] TLE9180_au8ReadRegs[28] TLE9180_au8ReadRegs[29] TLE9180_au8ReadRegs[2] TLE9180_au8ReadRegs[3] TLE9180_au8ReadRegs[4] TLE9180_au8ReadRegs[5] TLE9180_au8ReadRegs[6] TLE9180_au8ReadRegs[7] TLE9180_au8ReadRegs[8] TLE9180_au8ReadRegs[9] TLE9180_bDataTransferDone TLE9180_bDrvOverCurrent TLE9180_bDrvOverTemp TLE9180_bDrvOverVoltage TLE9180_bDrvUnderVoltage TLE9180_bErrorFlag TLE9180_bErrorPinLevel TLE9180_bHALOverVolt TLE9180_bHALUnderVolt TLE9180_bInitFailFlg TLE9180_bPhasePerf TLE9180_bPhaseShortHigh TLE9180_bPhaseShortLow TLE9180_bPhsOverVolt TLE9180_bReadErrInfoFlg TLE9180_bTempWarning TLE9180_bTestReadErrRegs TLE9180_bTestReadReg TLE9180_bTestWriteReg TLE9180_f32MaxPhsTempPhys TLE9180_u16EnaResetTime TLE9180_u16ErrPinChkCnt TLE9180_u16HallSupVolt TLE9180_u8CurOperMode TLE9180_u8EnaResetCnt TLE9180_u8ErrorFrameCnt TLE9180_u8ErrRecoverCnt TLE9180_u8FeedBackAddr TLE9180_u8FeedBackData TLE9180_u8FeedBackStatus TLE9180_u8HallSupVolt TLE9180_u8IndexFrame TLE9180_u8Mode TLE9180_u8RdRegTimCnt TLE9180_u8ReadRegAddr TLE9180_u8SelfTestStep TLE9180_u8SelfTstModChk TLE9180_u8SpiTxFrameMaxNb TLE9180_u8TestMode TLE9180_u8WriteData TLE9180_u8WriteRegAddr /end OUT_MEASUREMENT
/end FUNCTION
/begin GROUP Acquisitions "Acquisitions_GROUP" ROOT /begin FUNCTION_LIST HARD MAIN /end FUNCTION_LIST /end GROUP
/begin GROUP Application "Application_GROUP" ROOT /begin FUNCTION_LIST ESM HARD MAIN /end FUNCTION_LIST /end GROUP
/begin GROUP BLDC "BLDC_GROUP" ROOT /begin FUNCTION_LIST BLDC /end FUNCTION_LIST /end GROUP
/begin GROUP BSW "BSW_GROUP" ROOT /begin FUNCTION_LIST BSW FAIL /end FUNCTION_LIST /end GROUP
/begin GROUP CALUSR "CALUSR_GROUP" ROOT /begin FUNCTION_LIST CALUSR /end FUNCTION_LIST /end GROUP
/begin GROUP CCU6 "CCU6_GROUP" ROOT /begin FUNCTION_LIST CCU6 /end FUNCTION_LIST /end GROUP
/begin GROUP COMMUSR "COMMUSR_GROUP" ROOT /end GROUP
/begin GROUP Calibration "Calibration_GROUP" /begin SUB_GROUP DEV /end SUB_GROUP /end GROUP
/begin GROUP Com "Com_GROUP" ROOT /begin FUNCTION_LIST MAIN /end FUNCTION_LIST /end GROUP
/begin GROUP Communication "Communication_GROUP" ROOT /begin FUNCTION_LIST BLDC CCU6 MAIN RTE /end FUNCTION_LIST /end GROUP
/begin GROUP DEV "DEV_GROUP" /begin FUNCTION_LIST MAIN /end FUNCTION_LIST /end GROUP
/begin GROUP DFLASH "DFLASH_GROUP" ROOT /begin FUNCTION_LIST DFLASH /end FUNCTION_LIST /end GROUP
/begin GROUP DSM "DSM_GROUP" /begin FUNCTION_LIST FAULT_FF /end FUNCTION_LIST /end GROUP
/begin GROUP Develop "Develop_GROUP" /begin FUNCTION_LIST MAIN /end FUNCTION_LIST /end GROUP
/begin GROUP Development_z "Development_z_GROUP" ROOT /begin FUNCTION_LIST DEVHAL SPY /end FUNCTION_LIST /end GROUP
/begin GROUP Developpement "Developpement_GROUP" ROOT /begin FUNCTION_LIST BSW HARD /end FUNCTION_LIST /end GROUP
/begin GROUP Diagnostic "Diagnostic_GROUP" ROOT /begin FUNCTION_LIST BSW DSM FAULT MAIN /end FUNCTION_LIST /end GROUP
/begin GROUP Divers "Divers_GROUP" ROOT /begin FUNCTION_LIST MAIN /end FUNCTION_LIST /end GROUP
/begin GROUP Driver "Driver_GROUP" ROOT /begin FUNCTION_LIST BLDC COMMUSR MAIN RES SBC STFSRV /end FUNCTION_LIST /end GROUP
/begin GROUP EAS "EAS_GROUP" ROOT /end GROUP
/begin GROUP FAIL "FAIL_GROUP" ROOT /begin FUNCTION_LIST FAIL /end FUNCTION_LIST /end GROUP
/begin GROUP FAULT_FF "FAULT_FF_GROUP" ROOT /begin SUB_GROUP DSM /end SUB_GROUP /end GROUP
/begin GROUP FRecord "FRecord_GROUP" ROOT /begin FUNCTION_LIST FRecord /end FUNCTION_LIST /end GROUP
/begin GROUP MAIN "MAIN_GROUP" ROOT /begin FUNCTION_LIST MAIN /end FUNCTION_LIST /end GROUP
/begin GROUP Main "Main_GROUP" ROOT /begin FUNCTION_LIST BSW MAIN SPY /end FUNCTION_LIST /end GROUP
/begin GROUP Miscellaneous "Miscellaneous_GROUP" ROOT /end GROUP
/begin GROUP Noyau "Noyau_GROUP" ROOT /end GROUP
/begin GROUP NvM "NvM_GROUP" ROOT /begin FUNCTION_LIST BSW /end FUNCTION_LIST /end GROUP
/begin GROUP OBD "OBD_GROUP" ROOT /end GROUP
/begin GROUP RSTSRV "RSTSRV_GROUP" ROOT /end GROUP
/begin GROUP RTE "RTE_GROUP" ROOT /begin FUNCTION_LIST RTE /end FUNCTION_LIST /end GROUP
/begin GROUP Raw "Raw_GROUP" ROOT /begin SUB_GROUP Calibration /end SUB_GROUP /end GROUP
/begin GROUP SWC_FS "SWC_FS_GROUP" ROOT /begin FUNCTION_LIST SWC_FS /end FUNCTION_LIST /end GROUP
/begin GROUP SWC_FT "SWC_FT_GROUP" ROOT /begin FUNCTION_LIST SWC_FT /end FUNCTION_LIST /end GROUP
/begin GROUP TJA1145 "TJA1145_GROUP" ROOT /end GROUP
/begin GROUP TLE9180 "TLE9180_GROUP" ROOT /begin FUNCTION_LIST TLE9180 /end FUNCTION_LIST /end GROUP
/begin GROUP TST "TST_GROUP" ROOT /begin FUNCTION_LIST HARD /end FUNCTION_LIST /end GROUP
/begin GROUP Tsk "Tsk_GROUP" ROOT /begin SUB_GROUP Develop /end SUB_GROUP /end GROUP
/begin GROUP UDS "UDS_GROUP" ROOT /end GROUP
/begin GROUP miscellaneous "miscellaneous_GROUP" ROOT /end GROUP
/begin GROUP miscellenious "miscellenious_GROUP" ROOT /end GROUP
/end MODULE
/end PROJECT
