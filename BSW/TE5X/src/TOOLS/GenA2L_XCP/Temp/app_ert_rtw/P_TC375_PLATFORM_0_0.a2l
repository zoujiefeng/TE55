ASAP2_VERSION 1 3
/begin PROJECT P_TC375_PLATFORM_0_0 "P_TC375_PLATFORM_0_0"
/begin HEADER "" VERSION "5210.00" PROJECT_NO D0 /end HEADER
/begin MODULE P_TC375_PLATFORM_0_0 "Invt"
/begin MOD_COMMON "" DEPOSIT ABSOLUTE ALIGNMENT_BYTE 1 ALIGNMENT_WORD 2 ALIGNMENT_LONG 4 ALIGNMENT_FLOAT32_IEEE 4 ALIGNMENT_FLOAT64_IEEE 8 BYTE_ORDER MSB_LAST /end MOD_COMMON
/begin RECORD_LAYOUT DATA_RECORD_UBYTE FNC_VALUES 1 UBYTE ROW_DIR DIRECT /end RECORD_LAYOUT
/begin RECORD_LAYOUT DATA_RECORD_UWORD FNC_VALUES 1 UWORD ROW_DIR DIRECT /end RECORD_LAYOUT
/begin RECORD_LAYOUT DATA_RECORD_SWORD FNC_VALUES 1 SWORD ROW_DIR DIRECT /end RECORD_LAYOUT
/begin RECORD_LAYOUT DATA_RECORD_ULONG FNC_VALUES 1 ULONG ROW_DIR DIRECT /end RECORD_LAYOUT
/begin RECORD_LAYOUT AXIS_PTS_X_UBYTE_VEMS AXIS_PTS_X 1 UBYTE INDEX_INCR DIRECT /end RECORD_LAYOUT
/begin CHARACTERISTIC FRecord_ku32TimeBeforeFaultOccurC "Spare" VALUE 0x80060BA8 DATA_RECORD_ULONG 4294967295 F_1_m20000_33 -20000 4294947295 /end CHARACTERISTIC
/begin CHARACTERISTIC FaultBSW_COM_BusOff_CAN1Dec "FaultBSW_COM_BusOff_CAN1Dec" VALUE 0x8009A112 DATA_RECORD_UBYTE 255 I_1 0 255 /end CHARACTERISTIC
/begin CHARACTERISTIC FaultBSW_COM_BusOff_CAN1FailMod "FaultBSW_COM_BusOff_CAN1FailMod" VALUE 0x8009A1D2 DATA_RECORD_UBYTE 255 I_1 0 255 /end CHARACTERISTIC
/begin CHARACTERISTIC FaultBSW_COM_BusOff_CAN1Inc "FaultBSW_COM_BusOff_CAN1Inc" VALUE 0x8009A172 DATA_RECORD_UBYTE 255 I_1 0 255 /end CHARACTERISTIC
/begin CHARACTERISTIC FaultBSW_COM_ChecksumErrVCUDec "FaultBSW_COM_ChecksumErrVCUDec" VALUE 0x8009A113 DATA_RECORD_UBYTE 255 I_1 0 255 /end CHARACTERISTIC
/begin CHARACTERISTIC FaultBSW_COM_ChecksumErrVCUFailMod "FaultBSW_COM_ChecksumErrVCUFailMod" VALUE 0x8009A1D3 DATA_RECORD_UBYTE 255 I_1 0 255 /end CHARACTERISTIC
/begin CHARACTERISTIC FaultBSW_COM_ChecksumErrVCUInc "FaultBSW_COM_ChecksumErrVCUInc" VALUE 0x8009A173 DATA_RECORD_UBYTE 255 I_1 0 255 /end CHARACTERISTIC
/begin CHARACTERISTIC FaultBSW_COM_InterFaultVCUDec "FaultBSW_COM_InterFaultVCUDec" VALUE 0x8009A114 DATA_RECORD_UBYTE 255 I_1 0 255 /end CHARACTERISTIC
/begin CHARACTERISTIC FaultBSW_COM_InterFaultVCUFailMod "FaultBSW_COM_InterFaultVCUFailMod" VALUE 0x8009A1D4 DATA_RECORD_UBYTE 255 I_1 0 255 /end CHARACTERISTIC
/begin CHARACTERISTIC FaultBSW_COM_InterFaultVCUInc "FaultBSW_COM_InterFaultVCUInc" VALUE 0x8009A174 DATA_RECORD_UBYTE 255 I_1 0 255 /end CHARACTERISTIC
/begin CHARACTERISTIC FaultBSW_COM_RollCntErrVCUDec "FaultBSW_COM_RollCntErrVCUDec" VALUE 0x8009A115 DATA_RECORD_UBYTE 255 I_1 0 255 /end CHARACTERISTIC
/begin CHARACTERISTIC FaultBSW_COM_RollCntErrVCUFailMod "FaultBSW_COM_RollCntErrVCUFailMod" VALUE 0x8009A1D5 DATA_RECORD_UBYTE 255 I_1 0 255 /end CHARACTERISTIC
/begin CHARACTERISTIC FaultBSW_COM_RollCntErrVCUInc "FaultBSW_COM_RollCntErrVCUInc" VALUE 0x8009A175 DATA_RECORD_UBYTE 255 I_1 0 255 /end CHARACTERISTIC
/begin CHARACTERISTIC FaultBSW_COM_TimoutRxBCMDec "FaultBSW_COM_TimoutRxBCMDec" VALUE 0x8009A116 DATA_RECORD_UBYTE 255 I_1 0 255 /end CHARACTERISTIC
/begin CHARACTERISTIC FaultBSW_COM_TimoutRxBCMFailMod "FaultBSW_COM_TimoutRxBCMFailMod" VALUE 0x8009A1D6 DATA_RECORD_UBYTE 255 I_1 0 255 /end CHARACTERISTIC
/begin CHARACTERISTIC FaultBSW_COM_TimoutRxBCMInc "FaultBSW_COM_TimoutRxBCMInc" VALUE 0x8009A176 DATA_RECORD_UBYTE 255 I_1 0 255 /end CHARACTERISTIC
/begin CHARACTERISTIC FaultBSW_COM_TimoutRxBMSHDec "FaultBSW_COM_TimoutRxBMSHDec" VALUE 0x8009A117 DATA_RECORD_UBYTE 255 I_1 0 255 /end CHARACTERISTIC
/begin CHARACTERISTIC FaultBSW_COM_TimoutRxBMSHFailMod "FaultBSW_COM_TimoutRxBMSHFailMod" VALUE 0x8009A1D7 DATA_RECORD_UBYTE 255 I_1 0 255 /end CHARACTERISTIC
/begin CHARACTERISTIC FaultBSW_COM_TimoutRxBMSHInc "FaultBSW_COM_TimoutRxBMSHInc" VALUE 0x8009A177 DATA_RECORD_UBYTE 255 I_1 0 255 /end CHARACTERISTIC
/begin CHARACTERISTIC FaultBSW_COM_TimoutRxEMSDec "FaultBSW_COM_TimoutRxEMSDec" VALUE 0x8009A118 DATA_RECORD_UBYTE 255 I_1 0 255 /end CHARACTERISTIC
/begin CHARACTERISTIC FaultBSW_COM_TimoutRxEMSFailMod "FaultBSW_COM_TimoutRxEMSFailMod" VALUE 0x8009A1D8 DATA_RECORD_UBYTE 255 I_1 0 255 /end CHARACTERISTIC
/begin CHARACTERISTIC FaultBSW_COM_TimoutRxEMSInc "FaultBSW_COM_TimoutRxEMSInc" VALUE 0x8009A178 DATA_RECORD_UBYTE 255 I_1 0 255 /end CHARACTERISTIC
/begin CHARACTERISTIC FaultBSW_COM_TimoutRxGCUDec "FaultBSW_COM_TimoutRxGCUDec" VALUE 0x8009A119 DATA_RECORD_UBYTE 255 I_1 0 255 /end CHARACTERISTIC
/begin CHARACTERISTIC FaultBSW_COM_TimoutRxGCUFailMod "FaultBSW_COM_TimoutRxGCUFailMod" VALUE 0x8009A1D9 DATA_RECORD_UBYTE 255 I_1 0 255 /end CHARACTERISTIC
/begin CHARACTERISTIC FaultBSW_COM_TimoutRxGCUInc "FaultBSW_COM_TimoutRxGCUInc" VALUE 0x8009A179 DATA_RECORD_UBYTE 255 I_1 0 255 /end CHARACTERISTIC
/begin CHARACTERISTIC FaultBSW_COM_TimoutRxIPCDec "FaultBSW_COM_TimoutRxIPCDec" VALUE 0x8009A11A DATA_RECORD_UBYTE 255 I_1 0 255 /end CHARACTERISTIC
/begin CHARACTERISTIC FaultBSW_COM_TimoutRxIPCFailMod "FaultBSW_COM_TimoutRxIPCFailMod" VALUE 0x8009A1DA DATA_RECORD_UBYTE 255 I_1 0 255 /end CHARACTERISTIC
/begin CHARACTERISTIC FaultBSW_COM_TimoutRxIPCInc "FaultBSW_COM_TimoutRxIPCInc" VALUE 0x8009A17A DATA_RECORD_UBYTE 255 I_1 0 255 /end CHARACTERISTIC
/begin CHARACTERISTIC FaultBSW_COM_TimoutRxTBOXDec "FaultBSW_COM_TimoutRxTBOXDec" VALUE 0x8009A11B DATA_RECORD_UBYTE 255 I_1 0 255 /end CHARACTERISTIC
/begin CHARACTERISTIC FaultBSW_COM_TimoutRxTBOXFailMod "FaultBSW_COM_TimoutRxTBOXFailMod" VALUE 0x8009A1DB DATA_RECORD_UBYTE 255 I_1 0 255 /end CHARACTERISTIC
/begin CHARACTERISTIC FaultBSW_COM_TimoutRxTBOXInc "FaultBSW_COM_TimoutRxTBOXInc" VALUE 0x8009A17B DATA_RECORD_UBYTE 255 I_1 0 255 /end CHARACTERISTIC
/begin CHARACTERISTIC FaultBSW_COM_TimoutRxVCUDec "FaultBSW_COM_TimoutRxVCUDec" VALUE 0x8009A11C DATA_RECORD_UBYTE 255 I_1 0 255 /end CHARACTERISTIC
/begin CHARACTERISTIC FaultBSW_COM_TimoutRxVCUFailMod "FaultBSW_COM_TimoutRxVCUFailMod" VALUE 0x8009A1DC DATA_RECORD_UBYTE 255 I_1 0 255 /end CHARACTERISTIC
/begin CHARACTERISTIC FaultBSW_COM_TimoutRxVCUInc "FaultBSW_COM_TimoutRxVCUInc" VALUE 0x8009A17C DATA_RECORD_UBYTE 255 I_1 0 255 /end CHARACTERISTIC
/begin CHARACTERISTIC FaultBSW_HW2_FPGA_OverVoltVBatDec "FaultBSW_HW2_FPGA_OverVoltVBatDec" VALUE 0x8009A11D DATA_RECORD_UBYTE 255 I_1 0 255 /end CHARACTERISTIC
/begin CHARACTERISTIC FaultBSW_HW2_FPGA_OverVoltVBatFailMod "FaultBSW_HW2_FPGA_OverVoltVBatFailMod" VALUE 0x8009A1DD DATA_RECORD_UBYTE 255 I_1 0 255 /end CHARACTERISTIC
/begin CHARACTERISTIC FaultBSW_HW2_FPGA_OverVoltVBatInc "FaultBSW_HW2_FPGA_OverVoltVBatInc" VALUE 0x8009A17D DATA_RECORD_UBYTE 255 I_1 0 255 /end CHARACTERISTIC
/begin CHARACTERISTIC FaultBSW_HW2_SafeTlib_PreRunDec "FaultBSW_HW2_SafeTlib_PreRunDec" VALUE 0x8009A11E DATA_RECORD_UBYTE 255 I_1 0 255 /end CHARACTERISTIC
/begin CHARACTERISTIC FaultBSW_HW2_SafeTlib_PreRunFailMod "FaultBSW_HW2_SafeTlib_PreRunFailMod" VALUE 0x8009A1DE DATA_RECORD_UBYTE 255 I_1 0 255 /end CHARACTERISTIC
/begin CHARACTERISTIC FaultBSW_HW2_SafeTlib_PreRunInc "FaultBSW_HW2_SafeTlib_PreRunInc" VALUE 0x8009A17E DATA_RECORD_UBYTE 255 I_1 0 255 /end CHARACTERISTIC
/begin CHARACTERISTIC FaultBSW_HW_EasAckFailDec "FaultBSW_HW_EasAckFailDec" VALUE 0x8009A11F DATA_RECORD_UBYTE 255 I_1 0 255 /end CHARACTERISTIC
/begin CHARACTERISTIC FaultBSW_HW_EasAckFailFailMod "FaultBSW_HW_EasAckFailFailMod" VALUE 0x8009A1DF DATA_RECORD_UBYTE 255 I_1 0 255 /end CHARACTERISTIC
/begin CHARACTERISTIC FaultBSW_HW_EasAckFailInc "FaultBSW_HW_EasAckFailInc" VALUE 0x8009A17F DATA_RECORD_UBYTE 255 I_1 0 255 /end CHARACTERISTIC
/begin CHARACTERISTIC FaultBSW_HW_FPGA_IGBT_HDec "FaultBSW_HW_FPGA_IGBT_HDec" VALUE 0x8009A120 DATA_RECORD_UBYTE 255 I_1 0 255 /end CHARACTERISTIC
/begin CHARACTERISTIC FaultBSW_HW_FPGA_IGBT_HFailMod "FaultBSW_HW_FPGA_IGBT_HFailMod" VALUE 0x8009A1E0 DATA_RECORD_UBYTE 255 I_1 0 255 /end CHARACTERISTIC
/begin CHARACTERISTIC FaultBSW_HW_FPGA_IGBT_HInc "FaultBSW_HW_FPGA_IGBT_HInc" VALUE 0x8009A180 DATA_RECORD_UBYTE 255 I_1 0 255 /end CHARACTERISTIC
/begin CHARACTERISTIC FaultBSW_HW_FPGA_IGBT_LDec "FaultBSW_HW_FPGA_IGBT_LDec" VALUE 0x8009A121 DATA_RECORD_UBYTE 255 I_1 0 255 /end CHARACTERISTIC
/begin CHARACTERISTIC FaultBSW_HW_FPGA_IGBT_LFailMod "FaultBSW_HW_FPGA_IGBT_LFailMod" VALUE 0x8009A1E1 DATA_RECORD_UBYTE 255 I_1 0 255 /end CHARACTERISTIC
/begin CHARACTERISTIC FaultBSW_HW_FPGA_IGBT_LInc "FaultBSW_HW_FPGA_IGBT_LInc" VALUE 0x8009A181 DATA_RECORD_UBYTE 255 I_1 0 255 /end CHARACTERISTIC
/begin CHARACTERISTIC FaultBSW_HW_FPGA_OverUnderCurUIDec "FaultBSW_HW_FPGA_OverUnderCurUIDec" VALUE 0x8009A122 DATA_RECORD_UBYTE 255 I_1 0 255 /end CHARACTERISTIC
/begin CHARACTERISTIC FaultBSW_HW_FPGA_OverUnderCurUIFailMod "FaultBSW_HW_FPGA_OverUnderCurUIFailMod" VALUE 0x8009A1E2 DATA_RECORD_UBYTE 255 I_1 0 255 /end CHARACTERISTIC
/begin CHARACTERISTIC FaultBSW_HW_FPGA_OverUnderCurUIInc "FaultBSW_HW_FPGA_OverUnderCurUIInc" VALUE 0x8009A182 DATA_RECORD_UBYTE 255 I_1 0 255 /end CHARACTERISTIC
/begin CHARACTERISTIC FaultBSW_HW_FPGA_OverUnderCurVIDec "FaultBSW_HW_FPGA_OverUnderCurVIDec" VALUE 0x8009A123 DATA_RECORD_UBYTE 255 I_1 0 255 /end CHARACTERISTIC
/begin CHARACTERISTIC FaultBSW_HW_FPGA_OverUnderCurVIFailMod "FaultBSW_HW_FPGA_OverUnderCurVIFailMod" VALUE 0x8009A1E3 DATA_RECORD_UBYTE 255 I_1 0 255 /end CHARACTERISTIC
/begin CHARACTERISTIC FaultBSW_HW_FPGA_OverUnderCurVIInc "FaultBSW_HW_FPGA_OverUnderCurVIInc" VALUE 0x8009A183 DATA_RECORD_UBYTE 255 I_1 0 255 /end CHARACTERISTIC
/begin CHARACTERISTIC FaultBSW_HW_FPGA_OverUnderCurWIDec "FaultBSW_HW_FPGA_OverUnderCurWIDec" VALUE 0x8009A124 DATA_RECORD_UBYTE 255 I_1 0 255 /end CHARACTERISTIC
/begin CHARACTERISTIC FaultBSW_HW_FPGA_OverUnderCurWIFailMod "FaultBSW_HW_FPGA_OverUnderCurWIFailMod" VALUE 0x8009A1E4 DATA_RECORD_UBYTE 255 I_1 0 255 /end CHARACTERISTIC
/begin CHARACTERISTIC FaultBSW_HW_FPGA_OverUnderCurWIInc "FaultBSW_HW_FPGA_OverUnderCurWIInc" VALUE 0x8009A184 DATA_RECORD_UBYTE 255 I_1 0 255 /end CHARACTERISTIC
/begin CHARACTERISTIC FaultBSW_HW_OCDataNotRationalDec "FaultBSW_HW_OCDataNotRationalDec" VALUE 0x8009A125 DATA_RECORD_UBYTE 255 I_1 0 255 /end CHARACTERISTIC
/begin CHARACTERISTIC FaultBSW_HW_OCDataNotRationalFailMod "FaultBSW_HW_OCDataNotRationalFailMod" VALUE 0x8009A1E5 DATA_RECORD_UBYTE 255 I_1 0 255 /end CHARACTERISTIC
/begin CHARACTERISTIC FaultBSW_HW_OCDataNotRationalInc "FaultBSW_HW_OCDataNotRationalInc" VALUE 0x8009A185 DATA_RECORD_UBYTE 255 I_1 0 255 /end CHARACTERISTIC
/begin CHARACTERISTIC FaultBSW_SYS_RstHotDec "FaultBSW_SYS_RstHotDec" VALUE 0x8009A126 DATA_RECORD_UBYTE 255 I_1 0 255 /end CHARACTERISTIC
/begin CHARACTERISTIC FaultBSW_SYS_RstHotFailMod "FaultBSW_SYS_RstHotFailMod" VALUE 0x8009A1E6 DATA_RECORD_UBYTE 255 I_1 0 255 /end CHARACTERISTIC
/begin CHARACTERISTIC FaultBSW_SYS_RstHotInc "FaultBSW_SYS_RstHotInc" VALUE 0x8009A186 DATA_RECORD_UBYTE 255 I_1 0 255 /end CHARACTERISTIC
/begin CHARACTERISTIC FaultBSW_SYS_StackOverflowDec "FaultBSW_SYS_StackOverflowDec" VALUE 0x8009A127 DATA_RECORD_UBYTE 255 I_1 0 255 /end CHARACTERISTIC
/begin CHARACTERISTIC FaultBSW_SYS_StackOverflowFailMod "FaultBSW_SYS_StackOverflowFailMod" VALUE 0x8009A1E7 DATA_RECORD_UBYTE 255 I_1 0 255 /end CHARACTERISTIC
/begin CHARACTERISTIC FaultBSW_SYS_StackOverflowInc "FaultBSW_SYS_StackOverflowInc" VALUE 0x8009A187 DATA_RECORD_UBYTE 255 I_1 0 255 /end CHARACTERISTIC
/begin CHARACTERISTIC FaultBSW_VSI_TimeoutTCalcDec "FaultBSW_VSI_TimeoutTCalcDec" VALUE 0x8009A128 DATA_RECORD_UBYTE 255 I_1 0 255 /end CHARACTERISTIC
/begin CHARACTERISTIC FaultBSW_VSI_TimeoutTCalcFailMod "FaultBSW_VSI_TimeoutTCalcFailMod" VALUE 0x8009A1E8 DATA_RECORD_UBYTE 255 I_1 0 255 /end CHARACTERISTIC
/begin CHARACTERISTIC FaultBSW_VSI_TimeoutTCalcInc "FaultBSW_VSI_TimeoutTCalcInc" VALUE 0x8009A188 DATA_RECORD_UBYTE 255 I_1 0 255 /end CHARACTERISTIC
/begin CHARACTERISTIC FaultFSEVBHV_OverVoltageDec "FaultFSEVBHV_OverVoltageDec" VALUE 0x8009A129 DATA_RECORD_UBYTE 255 I_1 0 255 /end CHARACTERISTIC
/begin CHARACTERISTIC FaultFSEVBHV_OverVoltageFailMod "FaultFSEVBHV_OverVoltageFailMod" VALUE 0x8009A1E9 DATA_RECORD_UBYTE 255 I_1 0 255 /end CHARACTERISTIC
/begin CHARACTERISTIC FaultFSEVBHV_OverVoltageInc "FaultFSEVBHV_OverVoltageInc" VALUE 0x8009A189 DATA_RECORD_UBYTE 255 I_1 0 255 /end CHARACTERISTIC
/begin CHARACTERISTIC FaultFSEVBHV_SampleVolOutRngHDec "FaultFSEVBHV_SampleVolOutRngHDec" VALUE 0x8009A12A DATA_RECORD_UBYTE 255 I_1 0 255 /end CHARACTERISTIC
/begin CHARACTERISTIC FaultFSEVBHV_SampleVolOutRngHFailMod "FaultFSEVBHV_SampleVolOutRngHFailMod" VALUE 0x8009A1EA DATA_RECORD_UBYTE 255 I_1 0 255 /end CHARACTERISTIC
/begin CHARACTERISTIC FaultFSEVBHV_SampleVolOutRngHInc "FaultFSEVBHV_SampleVolOutRngHInc" VALUE 0x8009A18A DATA_RECORD_UBYTE 255 I_1 0 255 /end CHARACTERISTIC
/begin CHARACTERISTIC FaultFSEVBHV_SampleVolOutRngLDec "FaultFSEVBHV_SampleVolOutRngLDec" VALUE 0x8009A12B DATA_RECORD_UBYTE 255 I_1 0 255 /end CHARACTERISTIC
/begin CHARACTERISTIC FaultFSEVBHV_SampleVolOutRngLFailMod "FaultFSEVBHV_SampleVolOutRngLFailMod" VALUE 0x8009A1EB DATA_RECORD_UBYTE 255 I_1 0 255 /end CHARACTERISTIC
/begin CHARACTERISTIC FaultFSEVBHV_SampleVolOutRngLInc "FaultFSEVBHV_SampleVolOutRngLInc" VALUE 0x8009A18B DATA_RECORD_UBYTE 255 I_1 0 255 /end CHARACTERISTIC
/begin CHARACTERISTIC FaultFSEVBHV_UnderVoltageDec "FaultFSEVBHV_UnderVoltageDec" VALUE 0x8009A12C DATA_RECORD_UBYTE 255 I_1 0 255 /end CHARACTERISTIC
/begin CHARACTERISTIC FaultFSEVBHV_UnderVoltageFailMod "FaultFSEVBHV_UnderVoltageFailMod" VALUE 0x8009A1EC DATA_RECORD_UBYTE 255 I_1 0 255 /end CHARACTERISTIC
/begin CHARACTERISTIC FaultFSEVBHV_UnderVoltageInc "FaultFSEVBHV_UnderVoltageInc" VALUE 0x8009A18C DATA_RECORD_UBYTE 255 I_1 0 255 /end CHARACTERISTIC
/begin CHARACTERISTIC FaultFSEVBHV_UnderVoltageWarnDec "FaultFSEVBHV_UnderVoltageWarnDec" VALUE 0x8009A130 DATA_RECORD_UBYTE 255 I_1 0 255 /end CHARACTERISTIC
/begin CHARACTERISTIC FaultFSEVBHV_UnderVoltageWarnFailMod "FaultFSEVBHV_UnderVoltageWarnFailMod" VALUE 0x8009A1F0 DATA_RECORD_UBYTE 255 I_1 0 255 /end CHARACTERISTIC
/begin CHARACTERISTIC FaultFSEVBHV_UnderVoltageWarnInc "FaultFSEVBHV_UnderVoltageWarnInc" VALUE 0x8009A190 DATA_RECORD_UBYTE 255 I_1 0 255 /end CHARACTERISTIC
/begin CHARACTERISTIC FaultFSEVBHV_VolNotRationalDec "FaultFSEVBHV_VolNotRationalDec" VALUE 0x8009A12D DATA_RECORD_UBYTE 255 I_1 0 255 /end CHARACTERISTIC
/begin CHARACTERISTIC FaultFSEVBHV_VolNotRationalFailMod "FaultFSEVBHV_VolNotRationalFailMod" VALUE 0x8009A1ED DATA_RECORD_UBYTE 255 I_1 0 255 /end CHARACTERISTIC
/begin CHARACTERISTIC FaultFSEVBHV_VolNotRationalInc "FaultFSEVBHV_VolNotRationalInc" VALUE 0x8009A18D DATA_RECORD_UBYTE 255 I_1 0 255 /end CHARACTERISTIC
/begin CHARACTERISTIC FaultFSEVBHV_VoltageGndDec "FaultFSEVBHV_VoltageGndDec" VALUE 0x8009A12E DATA_RECORD_UBYTE 255 I_1 0 255 /end CHARACTERISTIC
/begin CHARACTERISTIC FaultFSEVBHV_VoltageGndFailMod "FaultFSEVBHV_VoltageGndFailMod" VALUE 0x8009A1EE DATA_RECORD_UBYTE 255 I_1 0 255 /end CHARACTERISTIC
/begin CHARACTERISTIC FaultFSEVBHV_VoltageGndInc "FaultFSEVBHV_VoltageGndInc" VALUE 0x8009A18E DATA_RECORD_UBYTE 255 I_1 0 255 /end CHARACTERISTIC
/begin CHARACTERISTIC FaultFSEVBHV_VoltageVccDec "FaultFSEVBHV_VoltageVccDec" VALUE 0x8009A12F DATA_RECORD_UBYTE 255 I_1 0 255 /end CHARACTERISTIC
/begin CHARACTERISTIC FaultFSEVBHV_VoltageVccFailMod "FaultFSEVBHV_VoltageVccFailMod" VALUE 0x8009A1EF DATA_RECORD_UBYTE 255 I_1 0 255 /end CHARACTERISTIC
/begin CHARACTERISTIC FaultFSEVBHV_VoltageVccInc "FaultFSEVBHV_VoltageVccInc" VALUE 0x8009A18F DATA_RECORD_UBYTE 255 I_1 0 255 /end CHARACTERISTIC
/begin CHARACTERISTIC FaultFSEVBLV_OverVoltageDec "FaultFSEVBLV_OverVoltageDec" VALUE 0x8009A131 DATA_RECORD_UBYTE 255 I_1 0 255 /end CHARACTERISTIC
/begin CHARACTERISTIC FaultFSEVBLV_OverVoltageFailMod "FaultFSEVBLV_OverVoltageFailMod" VALUE 0x8009A1F1 DATA_RECORD_UBYTE 255 I_1 0 255 /end CHARACTERISTIC
/begin CHARACTERISTIC FaultFSEVBLV_OverVoltageInc "FaultFSEVBLV_OverVoltageInc" VALUE 0x8009A191 DATA_RECORD_UBYTE 255 I_1 0 255 /end CHARACTERISTIC
/begin CHARACTERISTIC FaultFSEVBLV_P5VRefADCFltDec "FaultFSEVBLV_P5VRefADCFltDec" VALUE 0x8009A132 DATA_RECORD_UBYTE 255 I_1 0 255 /end CHARACTERISTIC
/begin CHARACTERISTIC FaultFSEVBLV_P5VRefADCFltFailMod "FaultFSEVBLV_P5VRefADCFltFailMod" VALUE 0x8009A1F2 DATA_RECORD_UBYTE 255 I_1 0 255 /end CHARACTERISTIC
/begin CHARACTERISTIC FaultFSEVBLV_P5VRefADCFltInc "FaultFSEVBLV_P5VRefADCFltInc" VALUE 0x8009A192 DATA_RECORD_UBYTE 255 I_1 0 255 /end CHARACTERISTIC
/begin CHARACTERISTIC FaultFSEVBLV_UnderVoltageDec "FaultFSEVBLV_UnderVoltageDec" VALUE 0x8009A133 DATA_RECORD_UBYTE 255 I_1 0 255 /end CHARACTERISTIC
/begin CHARACTERISTIC FaultFSEVBLV_UnderVoltageFailMod "FaultFSEVBLV_UnderVoltageFailMod" VALUE 0x8009A1F3 DATA_RECORD_UBYTE 255 I_1 0 255 /end CHARACTERISTIC
/begin CHARACTERISTIC FaultFSEVBLV_UnderVoltageInc "FaultFSEVBLV_UnderVoltageInc" VALUE 0x8009A193 DATA_RECORD_UBYTE 255 I_1 0 255 /end CHARACTERISTIC
/begin CHARACTERISTIC FaultFSEVBLV_UnderVoltageWarnDec "FaultFSEVBLV_UnderVoltageWarnDec" VALUE 0x8009A136 DATA_RECORD_UBYTE 255 I_1 0 255 /end CHARACTERISTIC
/begin CHARACTERISTIC FaultFSEVBLV_UnderVoltageWarnFailMod "FaultFSEVBLV_UnderVoltageWarnFailMod" VALUE 0x8009A1F6 DATA_RECORD_UBYTE 255 I_1 0 255 /end CHARACTERISTIC
/begin CHARACTERISTIC FaultFSEVBLV_UnderVoltageWarnInc "FaultFSEVBLV_UnderVoltageWarnInc" VALUE 0x8009A196 DATA_RECORD_UBYTE 255 I_1 0 255 /end CHARACTERISTIC
/begin CHARACTERISTIC FaultFSEVBLV_VoltageGndDec "FaultFSEVBLV_VoltageGndDec" VALUE 0x8009A134 DATA_RECORD_UBYTE 255 I_1 0 255 /end CHARACTERISTIC
/begin CHARACTERISTIC FaultFSEVBLV_VoltageGndFailMod "FaultFSEVBLV_VoltageGndFailMod" VALUE 0x8009A1F4 DATA_RECORD_UBYTE 255 I_1 0 255 /end CHARACTERISTIC
/begin CHARACTERISTIC FaultFSEVBLV_VoltageGndInc "FaultFSEVBLV_VoltageGndInc" VALUE 0x8009A194 DATA_RECORD_UBYTE 255 I_1 0 255 /end CHARACTERISTIC
/begin CHARACTERISTIC FaultFSEVBLV_VoltageVccDec "FaultFSEVBLV_VoltageVccDec" VALUE 0x8009A135 DATA_RECORD_UBYTE 255 I_1 0 255 /end CHARACTERISTIC
/begin CHARACTERISTIC FaultFSEVBLV_VoltageVccFailMod "FaultFSEVBLV_VoltageVccFailMod" VALUE 0x8009A1F5 DATA_RECORD_UBYTE 255 I_1 0 255 /end CHARACTERISTIC
/begin CHARACTERISTIC FaultFSEVBLV_VoltageVccInc "FaultFSEVBLV_VoltageVccInc" VALUE 0x8009A195 DATA_RECORD_UBYTE 255 I_1 0 255 /end CHARACTERISTIC
/begin CHARACTERISTIC FaultFSEVETA_DrvTempRationDec "FaultFSEVETA_DrvTempRationDec" VALUE 0x8009A137 DATA_RECORD_UBYTE 255 I_1 0 255 /end CHARACTERISTIC
/begin CHARACTERISTIC FaultFSEVETA_DrvTempRationFailMod "FaultFSEVETA_DrvTempRationFailMod" VALUE 0x8009A1F7 DATA_RECORD_UBYTE 255 I_1 0 255 /end CHARACTERISTIC
/begin CHARACTERISTIC FaultFSEVETA_DrvTempRationInc "FaultFSEVETA_DrvTempRationInc" VALUE 0x8009A197 DATA_RECORD_UBYTE 255 I_1 0 255 /end CHARACTERISTIC
/begin CHARACTERISTIC FaultFSEVETA_IgbtTempRationalDec "FaultFSEVETA_IgbtTempRationalDec" VALUE 0x8009A138 DATA_RECORD_UBYTE 255 I_1 0 255 /end CHARACTERISTIC
/begin CHARACTERISTIC FaultFSEVETA_IgbtTempRationalFailMod "FaultFSEVETA_IgbtTempRationalFailMod" VALUE 0x8009A1F8 DATA_RECORD_UBYTE 255 I_1 0 255 /end CHARACTERISTIC
/begin CHARACTERISTIC FaultFSEVETA_IgbtTempRationalInc "FaultFSEVETA_IgbtTempRationalInc" VALUE 0x8009A198 DATA_RECORD_UBYTE 255 I_1 0 255 /end CHARACTERISTIC
/begin CHARACTERISTIC FaultFSEVETA_OverTempDrvLeftDec "FaultFSEVETA_OverTempDrvLeftDec" VALUE 0x8009A13B DATA_RECORD_UBYTE 255 I_1 0 255 /end CHARACTERISTIC
/begin CHARACTERISTIC FaultFSEVETA_OverTempDrvLeftFailMod "FaultFSEVETA_OverTempDrvLeftFailMod" VALUE 0x8009A1FB DATA_RECORD_UBYTE 255 I_1 0 255 /end CHARACTERISTIC
/begin CHARACTERISTIC FaultFSEVETA_OverTempDrvLeftInc "FaultFSEVETA_OverTempDrvLeftInc" VALUE 0x8009A19B DATA_RECORD_UBYTE 255 I_1 0 255 /end CHARACTERISTIC
/begin CHARACTERISTIC FaultFSEVETA_OverTempIgbtLeftDec "FaultFSEVETA_OverTempIgbtLeftDec" VALUE 0x8009A13C DATA_RECORD_UBYTE 255 I_1 0 255 /end CHARACTERISTIC
/begin CHARACTERISTIC FaultFSEVETA_OverTempIgbtLeftFailMod "FaultFSEVETA_OverTempIgbtLeftFailMod" VALUE 0x8009A1FC DATA_RECORD_UBYTE 255 I_1 0 255 /end CHARACTERISTIC
/begin CHARACTERISTIC FaultFSEVETA_OverTempIgbtLeftInc "FaultFSEVETA_OverTempIgbtLeftInc" VALUE 0x8009A19C DATA_RECORD_UBYTE 255 I_1 0 255 /end CHARACTERISTIC
/begin CHARACTERISTIC FaultFSEVETA_OverTempNTC1CmdBoardDec "FaultFSEVETA_OverTempNTC1CmdBoardDec" VALUE 0x8009A13D DATA_RECORD_UBYTE 255 I_1 0 255 /end CHARACTERISTIC
/begin CHARACTERISTIC FaultFSEVETA_OverTempNTC1CmdBoardFailMod "FaultFSEVETA_OverTempNTC1CmdBoardFailMod" VALUE 0x8009A1FD DATA_RECORD_UBYTE 255 I_1 0 255 /end CHARACTERISTIC
/begin CHARACTERISTIC FaultFSEVETA_OverTempNTC1CmdBoardInc "FaultFSEVETA_OverTempNTC1CmdBoardInc" VALUE 0x8009A19D DATA_RECORD_UBYTE 255 I_1 0 255 /end CHARACTERISTIC
/begin CHARACTERISTIC FaultFSEVETA_SampleIgbtTempOutRngHDec "FaultFSEVETA_SampleIgbtTempOutRngHDec" VALUE 0x8009A139 DATA_RECORD_UBYTE 255 I_1 0 255 /end CHARACTERISTIC
/begin CHARACTERISTIC FaultFSEVETA_SampleIgbtTempOutRngHFailMod "FaultFSEVETA_SampleIgbtTempOutRngHFailMod" VALUE 0x8009A1F9 DATA_RECORD_UBYTE 255 I_1 0 255 /end CHARACTERISTIC
/begin CHARACTERISTIC FaultFSEVETA_SampleIgbtTempOutRngHInc "FaultFSEVETA_SampleIgbtTempOutRngHInc" VALUE 0x8009A199 DATA_RECORD_UBYTE 255 I_1 0 255 /end CHARACTERISTIC
/begin CHARACTERISTIC FaultFSEVETA_SampleIgbtTempOutRngLDec "FaultFSEVETA_SampleIgbtTempOutRngLDec" VALUE 0x8009A13A DATA_RECORD_UBYTE 255 I_1 0 255 /end CHARACTERISTIC
/begin CHARACTERISTIC FaultFSEVETA_SampleIgbtTempOutRngLFailMod "FaultFSEVETA_SampleIgbtTempOutRngLFailMod" VALUE 0x8009A1FA DATA_RECORD_UBYTE 255 I_1 0 255 /end CHARACTERISTIC
/begin CHARACTERISTIC FaultFSEVETA_SampleIgbtTempOutRngLInc "FaultFSEVETA_SampleIgbtTempOutRngLInc" VALUE 0x8009A19A DATA_RECORD_UBYTE 255 I_1 0 255 /end CHARACTERISTIC
/begin CHARACTERISTIC FaultFSEVETA_TempDrvBoardLeftGndDec "FaultFSEVETA_TempDrvBoardLeftGndDec" VALUE 0x8009A13E DATA_RECORD_UBYTE 255 I_1 0 255 /end CHARACTERISTIC
/begin CHARACTERISTIC FaultFSEVETA_TempDrvBoardLeftGndFailMod "FaultFSEVETA_TempDrvBoardLeftGndFailMod" VALUE 0x8009A1FE DATA_RECORD_UBYTE 255 I_1 0 255 /end CHARACTERISTIC
/begin CHARACTERISTIC FaultFSEVETA_TempDrvBoardLeftGndInc "FaultFSEVETA_TempDrvBoardLeftGndInc" VALUE 0x8009A19E DATA_RECORD_UBYTE 255 I_1 0 255 /end CHARACTERISTIC
/begin CHARACTERISTIC FaultFSEVETA_TempDrvBoardLeftVccDec "FaultFSEVETA_TempDrvBoardLeftVccDec" VALUE 0x8009A13F DATA_RECORD_UBYTE 255 I_1 0 255 /end CHARACTERISTIC
/begin CHARACTERISTIC FaultFSEVETA_TempDrvBoardLeftVccFailMod "FaultFSEVETA_TempDrvBoardLeftVccFailMod" VALUE 0x8009A1FF DATA_RECORD_UBYTE 255 I_1 0 255 /end CHARACTERISTIC
/begin CHARACTERISTIC FaultFSEVETA_TempDrvBoardLeftVccInc "FaultFSEVETA_TempDrvBoardLeftVccInc" VALUE 0x8009A19F DATA_RECORD_UBYTE 255 I_1 0 255 /end CHARACTERISTIC
/begin CHARACTERISTIC FaultFSEVETA_TempIgbtLeftGndDec "FaultFSEVETA_TempIgbtLeftGndDec" VALUE 0x8009A140 DATA_RECORD_UBYTE 255 I_1 0 255 /end CHARACTERISTIC
/begin CHARACTERISTIC FaultFSEVETA_TempIgbtLeftGndFailMod "FaultFSEVETA_TempIgbtLeftGndFailMod" VALUE 0x8009A200 DATA_RECORD_UBYTE 255 I_1 0 255 /end CHARACTERISTIC
/begin CHARACTERISTIC FaultFSEVETA_TempIgbtLeftGndInc "FaultFSEVETA_TempIgbtLeftGndInc" VALUE 0x8009A1A0 DATA_RECORD_UBYTE 255 I_1 0 255 /end CHARACTERISTIC
/begin CHARACTERISTIC FaultFSEVETA_TempIgbtLeftVccDec "FaultFSEVETA_TempIgbtLeftVccDec" VALUE 0x8009A141 DATA_RECORD_UBYTE 255 I_1 0 255 /end CHARACTERISTIC
/begin CHARACTERISTIC FaultFSEVETA_TempIgbtLeftVccFailMod "FaultFSEVETA_TempIgbtLeftVccFailMod" VALUE 0x8009A201 DATA_RECORD_UBYTE 255 I_1 0 255 /end CHARACTERISTIC
/begin CHARACTERISTIC FaultFSEVETA_TempIgbtLeftVccInc "FaultFSEVETA_TempIgbtLeftVccInc" VALUE 0x8009A1A1 DATA_RECORD_UBYTE 255 I_1 0 255 /end CHARACTERISTIC
/begin CHARACTERISTIC FaultFSEVETA_TempNTC1CmdBoardGndDec "FaultFSEVETA_TempNTC1CmdBoardGndDec" VALUE 0x8009A142 DATA_RECORD_UBYTE 255 I_1 0 255 /end CHARACTERISTIC
/begin CHARACTERISTIC FaultFSEVETA_TempNTC1CmdBoardGndFailMod "FaultFSEVETA_TempNTC1CmdBoardGndFailMod" VALUE 0x8009A202 DATA_RECORD_UBYTE 255 I_1 0 255 /end CHARACTERISTIC
/begin CHARACTERISTIC FaultFSEVETA_TempNTC1CmdBoardGndInc "FaultFSEVETA_TempNTC1CmdBoardGndInc" VALUE 0x8009A1A2 DATA_RECORD_UBYTE 255 I_1 0 255 /end CHARACTERISTIC
/begin CHARACTERISTIC FaultFSEVETA_TempNTC1CmdBoardVccDec "FaultFSEVETA_TempNTC1CmdBoardVccDec" VALUE 0x8009A143 DATA_RECORD_UBYTE 255 I_1 0 255 /end CHARACTERISTIC
/begin CHARACTERISTIC FaultFSEVETA_TempNTC1CmdBoardVccFailMod "FaultFSEVETA_TempNTC1CmdBoardVccFailMod" VALUE 0x8009A203 DATA_RECORD_UBYTE 255 I_1 0 255 /end CHARACTERISTIC
/begin CHARACTERISTIC FaultFSEVETA_TempNTC1CmdBoardVccInc "FaultFSEVETA_TempNTC1CmdBoardVccInc" VALUE 0x8009A1A3 DATA_RECORD_UBYTE 255 I_1 0 255 /end CHARACTERISTIC
/begin CHARACTERISTIC FaultFSEVETA_UnderTempDrvLeftDec "FaultFSEVETA_UnderTempDrvLeftDec" VALUE 0x8009A144 DATA_RECORD_UBYTE 255 I_1 0 255 /end CHARACTERISTIC
/begin CHARACTERISTIC FaultFSEVETA_UnderTempDrvLeftFailMod "FaultFSEVETA_UnderTempDrvLeftFailMod" VALUE 0x8009A204 DATA_RECORD_UBYTE 255 I_1 0 255 /end CHARACTERISTIC
/begin CHARACTERISTIC FaultFSEVETA_UnderTempDrvLeftInc "FaultFSEVETA_UnderTempDrvLeftInc" VALUE 0x8009A1A4 DATA_RECORD_UBYTE 255 I_1 0 255 /end CHARACTERISTIC
/begin CHARACTERISTIC FaultFSEVETA_UnderTempIgbtLeftDec "FaultFSEVETA_UnderTempIgbtLeftDec" VALUE 0x8009A145 DATA_RECORD_UBYTE 255 I_1 0 255 /end CHARACTERISTIC
/begin CHARACTERISTIC FaultFSEVETA_UnderTempIgbtLeftFailMod "FaultFSEVETA_UnderTempIgbtLeftFailMod" VALUE 0x8009A205 DATA_RECORD_UBYTE 255 I_1 0 255 /end CHARACTERISTIC
/begin CHARACTERISTIC FaultFSEVETA_UnderTempIgbtLeftInc "FaultFSEVETA_UnderTempIgbtLeftInc" VALUE 0x8009A1A5 DATA_RECORD_UBYTE 255 I_1 0 255 /end CHARACTERISTIC
/begin CHARACTERISTIC FaultFSEVETA_UnderTempNTC1CmdBoardDec "FaultFSEVETA_UnderTempNTC1CmdBoardDec" VALUE 0x8009A146 DATA_RECORD_UBYTE 255 I_1 0 255 /end CHARACTERISTIC
/begin CHARACTERISTIC FaultFSEVETA_UnderTempNTC1CmdBoardFailMod "FaultFSEVETA_UnderTempNTC1CmdBoardFailMod" VALUE 0x8009A206 DATA_RECORD_UBYTE 255 I_1 0 255 /end CHARACTERISTIC
/begin CHARACTERISTIC FaultFSEVETA_UnderTempNTC1CmdBoardInc "FaultFSEVETA_UnderTempNTC1CmdBoardInc" VALUE 0x8009A1A6 DATA_RECORD_UBYTE 255 I_1 0 255 /end CHARACTERISTIC
/begin CHARACTERISTIC FaultFSMTMTA_OverTempWdgHead1Dec "FaultFSMTMTA_OverTempWdgHead1Dec" VALUE 0x8009A147 DATA_RECORD_UBYTE 255 I_1 0 255 /end CHARACTERISTIC
/begin CHARACTERISTIC FaultFSMTMTA_OverTempWdgHead1FailMod "FaultFSMTMTA_OverTempWdgHead1FailMod" VALUE 0x8009A207 DATA_RECORD_UBYTE 255 I_1 0 255 /end CHARACTERISTIC
/begin CHARACTERISTIC FaultFSMTMTA_OverTempWdgHead1Inc "FaultFSMTMTA_OverTempWdgHead1Inc" VALUE 0x8009A1A7 DATA_RECORD_UBYTE 255 I_1 0 255 /end CHARACTERISTIC
/begin CHARACTERISTIC FaultFSMTMTA_TempWindHead1OutRngHDec "FaultFSMTMTA_TempWindHead1OutRngHDec" VALUE 0x8009A148 DATA_RECORD_UBYTE 255 I_1 0 255 /end CHARACTERISTIC
/begin CHARACTERISTIC FaultFSMTMTA_TempWindHead1OutRngHFailMod "FaultFSMTMTA_TempWindHead1OutRngHFailMod" VALUE 0x8009A208 DATA_RECORD_UBYTE 255 I_1 0 255 /end CHARACTERISTIC
/begin CHARACTERISTIC FaultFSMTMTA_TempWindHead1OutRngHInc "FaultFSMTMTA_TempWindHead1OutRngHInc" VALUE 0x8009A1A8 DATA_RECORD_UBYTE 255 I_1 0 255 /end CHARACTERISTIC
/begin CHARACTERISTIC FaultFSMTMTA_TempWindHead1OutRngLDec "FaultFSMTMTA_TempWindHead1OutRngLDec" VALUE 0x8009A149 DATA_RECORD_UBYTE 255 I_1 0 255 /end CHARACTERISTIC
/begin CHARACTERISTIC FaultFSMTMTA_TempWindHead1OutRngLFailMod "FaultFSMTMTA_TempWindHead1OutRngLFailMod" VALUE 0x8009A209 DATA_RECORD_UBYTE 255 I_1 0 255 /end CHARACTERISTIC
/begin CHARACTERISTIC FaultFSMTMTA_TempWindHead1OutRngLInc "FaultFSMTMTA_TempWindHead1OutRngLInc" VALUE 0x8009A1A9 DATA_RECORD_UBYTE 255 I_1 0 255 /end CHARACTERISTIC
/begin CHARACTERISTIC FaultFSMTMTA_TempWindingHead1GndDec "FaultFSMTMTA_TempWindingHead1GndDec" VALUE 0x8009A14A DATA_RECORD_UBYTE 255 I_1 0 255 /end CHARACTERISTIC
/begin CHARACTERISTIC FaultFSMTMTA_TempWindingHead1GndFailMod "FaultFSMTMTA_TempWindingHead1GndFailMod" VALUE 0x8009A20A DATA_RECORD_UBYTE 255 I_1 0 255 /end CHARACTERISTIC
/begin CHARACTERISTIC FaultFSMTMTA_TempWindingHead1GndInc "FaultFSMTMTA_TempWindingHead1GndInc" VALUE 0x8009A1AA DATA_RECORD_UBYTE 255 I_1 0 255 /end CHARACTERISTIC
/begin CHARACTERISTIC FaultFSMTMTA_TempWindingHead1VccDec "FaultFSMTMTA_TempWindingHead1VccDec" VALUE 0x8009A14B DATA_RECORD_UBYTE 255 I_1 0 255 /end CHARACTERISTIC
/begin CHARACTERISTIC FaultFSMTMTA_TempWindingHead1VccFailMod "FaultFSMTMTA_TempWindingHead1VccFailMod" VALUE 0x8009A20B DATA_RECORD_UBYTE 255 I_1 0 255 /end CHARACTERISTIC
/begin CHARACTERISTIC FaultFSMTMTA_TempWindingHead1VccInc "FaultFSMTMTA_TempWindingHead1VccInc" VALUE 0x8009A1AB DATA_RECORD_UBYTE 255 I_1 0 255 /end CHARACTERISTIC
/begin CHARACTERISTIC FaultFSMTMTA_UnderTempWdgHead1Dec "FaultFSMTMTA_UnderTempWdgHead1Dec" VALUE 0x8009A14C DATA_RECORD_UBYTE 255 I_1 0 255 /end CHARACTERISTIC
/begin CHARACTERISTIC FaultFSMTMTA_UnderTempWdgHead1FailMod "FaultFSMTMTA_UnderTempWdgHead1FailMod" VALUE 0x8009A20C DATA_RECORD_UBYTE 255 I_1 0 255 /end CHARACTERISTIC
/begin CHARACTERISTIC FaultFSMTMTA_UnderTempWdgHead1Inc "FaultFSMTMTA_UnderTempWdgHead1Inc" VALUE 0x8009A1AC DATA_RECORD_UBYTE 255 I_1 0 255 /end CHARACTERISTIC
/begin CHARACTERISTIC FaultFSMTRDG_ExcGenerationDec "FaultFSMTRDG_ExcGenerationDec" VALUE 0x8009A14D DATA_RECORD_UBYTE 255 I_1 0 255 /end CHARACTERISTIC
/begin CHARACTERISTIC FaultFSMTRDG_ExcGenerationFailMod "FaultFSMTRDG_ExcGenerationFailMod" VALUE 0x8009A20D DATA_RECORD_UBYTE 255 I_1 0 255 /end CHARACTERISTIC
/begin CHARACTERISTIC FaultFSMTRDG_ExcGenerationInc "FaultFSMTRDG_ExcGenerationInc" VALUE 0x8009A1AD DATA_RECORD_UBYTE 255 I_1 0 255 /end CHARACTERISTIC
/begin CHARACTERISTIC FaultFSMTRDG_ExcSignalGNDDec "FaultFSMTRDG_ExcSignalGNDDec" VALUE 0x8009A14E DATA_RECORD_UBYTE 255 I_1 0 255 /end CHARACTERISTIC
/begin CHARACTERISTIC FaultFSMTRDG_ExcSignalGNDFailMod "FaultFSMTRDG_ExcSignalGNDFailMod" VALUE 0x8009A20E DATA_RECORD_UBYTE 255 I_1 0 255 /end CHARACTERISTIC
/begin CHARACTERISTIC FaultFSMTRDG_ExcSignalGNDInc "FaultFSMTRDG_ExcSignalGNDInc" VALUE 0x8009A1AE DATA_RECORD_UBYTE 255 I_1 0 255 /end CHARACTERISTIC
/begin CHARACTERISTIC FaultFSMTRDG_ExcSignalVCCDec "FaultFSMTRDG_ExcSignalVCCDec" VALUE 0x8009A14F DATA_RECORD_UBYTE 255 I_1 0 255 /end CHARACTERISTIC
/begin CHARACTERISTIC FaultFSMTRDG_ExcSignalVCCFailMod "FaultFSMTRDG_ExcSignalVCCFailMod" VALUE 0x8009A20F DATA_RECORD_UBYTE 255 I_1 0 255 /end CHARACTERISTIC
/begin CHARACTERISTIC FaultFSMTRDG_ExcSignalVCCInc "FaultFSMTRDG_ExcSignalVCCInc" VALUE 0x8009A1AF DATA_RECORD_UBYTE 255 I_1 0 255 /end CHARACTERISTIC
/begin CHARACTERISTIC FaultFSMTRDG_SinCosHLGndDec "FaultFSMTRDG_SinCosHLGndDec" VALUE 0x8009A150 DATA_RECORD_UBYTE 255 I_1 0 255 /end CHARACTERISTIC
/begin CHARACTERISTIC FaultFSMTRDG_SinCosHLGndFailMod "FaultFSMTRDG_SinCosHLGndFailMod" VALUE 0x8009A210 DATA_RECORD_UBYTE 255 I_1 0 255 /end CHARACTERISTIC
/begin CHARACTERISTIC FaultFSMTRDG_SinCosHLGndInc "FaultFSMTRDG_SinCosHLGndInc" VALUE 0x8009A1B0 DATA_RECORD_UBYTE 255 I_1 0 255 /end CHARACTERISTIC
/begin CHARACTERISTIC FaultFSMTRDG_SinCosHLOpenDec "FaultFSMTRDG_SinCosHLOpenDec" VALUE 0x8009A151 DATA_RECORD_UBYTE 255 I_1 0 255 /end CHARACTERISTIC
/begin CHARACTERISTIC FaultFSMTRDG_SinCosHLOpenFailMod "FaultFSMTRDG_SinCosHLOpenFailMod" VALUE 0x8009A211 DATA_RECORD_UBYTE 255 I_1 0 255 /end CHARACTERISTIC
/begin CHARACTERISTIC FaultFSMTRDG_SinCosHLOpenInc "FaultFSMTRDG_SinCosHLOpenInc" VALUE 0x8009A1B1 DATA_RECORD_UBYTE 255 I_1 0 255 /end CHARACTERISTIC
/begin CHARACTERISTIC FaultFSMTRDG_SinCosHLVccDec "FaultFSMTRDG_SinCosHLVccDec" VALUE 0x8009A152 DATA_RECORD_UBYTE 255 I_1 0 255 /end CHARACTERISTIC
/begin CHARACTERISTIC FaultFSMTRDG_SinCosHLVccFailMod "FaultFSMTRDG_SinCosHLVccFailMod" VALUE 0x8009A212 DATA_RECORD_UBYTE 255 I_1 0 255 /end CHARACTERISTIC
/begin CHARACTERISTIC FaultFSMTRDG_SinCosHLVccInc "FaultFSMTRDG_SinCosHLVccInc" VALUE 0x8009A1B2 DATA_RECORD_UBYTE 255 I_1 0 255 /end CHARACTERISTIC
/begin CHARACTERISTIC FaultFSSMACS_AkdFailFlagDec "FaultFSSMACS_AkdFailFlagDec" VALUE 0x8009A153 DATA_RECORD_UBYTE 255 I_1 0 255 /end CHARACTERISTIC
/begin CHARACTERISTIC FaultFSSMACS_AkdFailFlagFailMod "FaultFSSMACS_AkdFailFlagFailMod" VALUE 0x8009A213 DATA_RECORD_UBYTE 255 I_1 0 255 /end CHARACTERISTIC
/begin CHARACTERISTIC FaultFSSMACS_AkdFailFlagInc "FaultFSSMACS_AkdFailFlagInc" VALUE 0x8009A1B3 DATA_RECORD_UBYTE 255 I_1 0 255 /end CHARACTERISTIC
/begin CHARACTERISTIC FaultFTASBDS_BattVoltDeratingActDec "FaultFTASBDS_BattVoltDeratingActDec" VALUE 0x8009A154 DATA_RECORD_UBYTE 255 I_1 0 255 /end CHARACTERISTIC
/begin CHARACTERISTIC FaultFTASBDS_BattVoltDeratingActFailMod "FaultFTASBDS_BattVoltDeratingActFailMod" VALUE 0x8009A214 DATA_RECORD_UBYTE 255 I_1 0 255 /end CHARACTERISTIC
/begin CHARACTERISTIC FaultFTASBDS_BattVoltDeratingActInc "FaultFTASBDS_BattVoltDeratingActInc" VALUE 0x8009A1B4 DATA_RECORD_UBYTE 255 I_1 0 255 /end CHARACTERISTIC
/begin CHARACTERISTIC FaultFTASETP_EstPmDeratingActDec "FaultFTASETP_EstPmDeratingActDec" VALUE 0x8009A155 DATA_RECORD_UBYTE 255 I_1 0 255 /end CHARACTERISTIC
/begin CHARACTERISTIC FaultFTASETP_EstPmDeratingActFailMod "FaultFTASETP_EstPmDeratingActFailMod" VALUE 0x8009A215 DATA_RECORD_UBYTE 255 I_1 0 255 /end CHARACTERISTIC
/begin CHARACTERISTIC FaultFTASETP_EstPmDeratingActInc "FaultFTASETP_EstPmDeratingActInc" VALUE 0x8009A1B5 DATA_RECORD_UBYTE 255 I_1 0 255 /end CHARACTERISTIC
/begin CHARACTERISTIC FaultFTASETP_PmDeratingActDec "FaultFTASETP_PmDeratingActDec" VALUE 0x8009A156 DATA_RECORD_UBYTE 255 I_1 0 255 /end CHARACTERISTIC
/begin CHARACTERISTIC FaultFTASETP_PmDeratingActFailMod "FaultFTASETP_PmDeratingActFailMod" VALUE 0x8009A216 DATA_RECORD_UBYTE 255 I_1 0 255 /end CHARACTERISTIC
/begin CHARACTERISTIC FaultFTASETP_PmDeratingActInc "FaultFTASETP_PmDeratingActInc" VALUE 0x8009A1B6 DATA_RECORD_UBYTE 255 I_1 0 255 /end CHARACTERISTIC
/begin CHARACTERISTIC FaultFTASMTP_Wndg1DeratingActDec "FaultFTASMTP_Wndg1DeratingActDec" VALUE 0x8009A157 DATA_RECORD_UBYTE 255 I_1 0 255 /end CHARACTERISTIC
/begin CHARACTERISTIC FaultFTASMTP_Wndg1DeratingActFailMod "FaultFTASMTP_Wndg1DeratingActFailMod" VALUE 0x8009A217 DATA_RECORD_UBYTE 255 I_1 0 255 /end CHARACTERISTIC
/begin CHARACTERISTIC FaultFTASMTP_Wndg1DeratingActInc "FaultFTASMTP_Wndg1DeratingActInc" VALUE 0x8009A1B7 DATA_RECORD_UBYTE 255 I_1 0 255 /end CHARACTERISTIC
/begin CHARACTERISTIC FaultFTASOSP_MotorSpdDeratingActDec "FaultFTASOSP_MotorSpdDeratingActDec" VALUE 0x8009A158 DATA_RECORD_UBYTE 255 I_1 0 255 /end CHARACTERISTIC
/begin CHARACTERISTIC FaultFTASOSP_MotorSpdDeratingActFailMod "FaultFTASOSP_MotorSpdDeratingActFailMod" VALUE 0x8009A218 DATA_RECORD_UBYTE 255 I_1 0 255 /end CHARACTERISTIC
/begin CHARACTERISTIC FaultFTASOSP_MotorSpdDeratingActInc "FaultFTASOSP_MotorSpdDeratingActInc" VALUE 0x8009A1B8 DATA_RECORD_UBYTE 255 I_1 0 255 /end CHARACTERISTIC
/begin CHARACTERISTIC FaultFTCMSCS_CtrlSatTimoutDec "FaultFTCMSCS_CtrlSatTimoutDec" VALUE 0x8009A159 DATA_RECORD_UBYTE 255 I_1 0 255 /end CHARACTERISTIC
/begin CHARACTERISTIC FaultFTCMSCS_CtrlSatTimoutFailMod "FaultFTCMSCS_CtrlSatTimoutFailMod" VALUE 0x8009A219 DATA_RECORD_UBYTE 255 I_1 0 255 /end CHARACTERISTIC
/begin CHARACTERISTIC FaultFTCMSCS_CtrlSatTimoutInc "FaultFTCMSCS_CtrlSatTimoutInc" VALUE 0x8009A1B9 DATA_RECORD_UBYTE 255 I_1 0 255 /end CHARACTERISTIC
/begin CHARACTERISTIC FaultFTCMSCS_SpdOvershootDec "FaultFTCMSCS_SpdOvershootDec" VALUE 0x8009A15A DATA_RECORD_UBYTE 255 I_1 0 255 /end CHARACTERISTIC
/begin CHARACTERISTIC FaultFTCMSCS_SpdOvershootFailMod "FaultFTCMSCS_SpdOvershootFailMod" VALUE 0x8009A21A DATA_RECORD_UBYTE 255 I_1 0 255 /end CHARACTERISTIC
/begin CHARACTERISTIC FaultFTCMSCS_SpdOvershootInc "FaultFTCMSCS_SpdOvershootInc" VALUE 0x8009A1BA DATA_RECORD_UBYTE 255 I_1 0 255 /end CHARACTERISTIC
/begin CHARACTERISTIC FaultFTCMSCS_ZeroSpeedTimoutDec "FaultFTCMSCS_ZeroSpeedTimoutDec" VALUE 0x8009A15B DATA_RECORD_UBYTE 255 I_1 0 255 /end CHARACTERISTIC
/begin CHARACTERISTIC FaultFTCMSCS_ZeroSpeedTimoutFailMod "FaultFTCMSCS_ZeroSpeedTimoutFailMod" VALUE 0x8009A21B DATA_RECORD_UBYTE 255 I_1 0 255 /end CHARACTERISTIC
/begin CHARACTERISTIC FaultFTCMSCS_ZeroSpeedTimoutInc "FaultFTCMSCS_ZeroSpeedTimoutInc" VALUE 0x8009A1BB DATA_RECORD_UBYTE 255 I_1 0 255 /end CHARACTERISTIC
/begin CHARACTERISTIC FaultFTCMTCS_VoltageMarginLowDec "FaultFTCMTCS_VoltageMarginLowDec" VALUE 0x8009A15C DATA_RECORD_UBYTE 255 I_1 0 255 /end CHARACTERISTIC
/begin CHARACTERISTIC FaultFTCMTCS_VoltageMarginLowFailMod "FaultFTCMTCS_VoltageMarginLowFailMod" VALUE 0x8009A21C DATA_RECORD_UBYTE 255 I_1 0 255 /end CHARACTERISTIC
/begin CHARACTERISTIC FaultFTCMTCS_VoltageMarginLowInc "FaultFTCMTCS_VoltageMarginLowInc" VALUE 0x8009A1BC DATA_RECORD_UBYTE 255 I_1 0 255 /end CHARACTERISTIC
/begin CHARACTERISTIC FaultFTEVEIT_EstOverTempDec "FaultFTEVEIT_EstOverTempDec" VALUE 0x8009A15D DATA_RECORD_UBYTE 255 I_1 0 255 /end CHARACTERISTIC
/begin CHARACTERISTIC FaultFTEVEIT_EstOverTempFailMod "FaultFTEVEIT_EstOverTempFailMod" VALUE 0x8009A21D DATA_RECORD_UBYTE 255 I_1 0 255 /end CHARACTERISTIC
/begin CHARACTERISTIC FaultFTEVEIT_EstOverTempInc "FaultFTEVEIT_EstOverTempInc" VALUE 0x8009A1BD DATA_RECORD_UBYTE 255 I_1 0 255 /end CHARACTERISTIC
/begin CHARACTERISTIC FaultFTMTLCS_CurSenrPhaU_GNDDec "FaultFTMTLCS_CurSenrPhaU_GNDDec" VALUE 0x8009A15F DATA_RECORD_UBYTE 255 I_1 0 255 /end CHARACTERISTIC
/begin CHARACTERISTIC FaultFTMTLCS_CurSenrPhaU_GNDFailMod "FaultFTMTLCS_CurSenrPhaU_GNDFailMod" VALUE 0x8009A21F DATA_RECORD_UBYTE 255 I_1 0 255 /end CHARACTERISTIC
/begin CHARACTERISTIC FaultFTMTLCS_CurSenrPhaU_GNDInc "FaultFTMTLCS_CurSenrPhaU_GNDInc" VALUE 0x8009A1BF DATA_RECORD_UBYTE 255 I_1 0 255 /end CHARACTERISTIC
/begin CHARACTERISTIC FaultFTMTLCS_CurSenrPhaU_OutRngHDec "FaultFTMTLCS_CurSenrPhaU_OutRngHDec" VALUE 0x8009A160 DATA_RECORD_UBYTE 255 I_1 0 255 /end CHARACTERISTIC
/begin CHARACTERISTIC FaultFTMTLCS_CurSenrPhaU_OutRngHFailMod "FaultFTMTLCS_CurSenrPhaU_OutRngHFailMod" VALUE 0x8009A220 DATA_RECORD_UBYTE 255 I_1 0 255 /end CHARACTERISTIC
/begin CHARACTERISTIC FaultFTMTLCS_CurSenrPhaU_OutRngHInc "FaultFTMTLCS_CurSenrPhaU_OutRngHInc" VALUE 0x8009A1C0 DATA_RECORD_UBYTE 255 I_1 0 255 /end CHARACTERISTIC
/begin CHARACTERISTIC FaultFTMTLCS_CurSenrPhaU_OutRngLDec "FaultFTMTLCS_CurSenrPhaU_OutRngLDec" VALUE 0x8009A161 DATA_RECORD_UBYTE 255 I_1 0 255 /end CHARACTERISTIC
/begin CHARACTERISTIC FaultFTMTLCS_CurSenrPhaU_OutRngLFailMod "FaultFTMTLCS_CurSenrPhaU_OutRngLFailMod" VALUE 0x8009A221 DATA_RECORD_UBYTE 255 I_1 0 255 /end CHARACTERISTIC
/begin CHARACTERISTIC FaultFTMTLCS_CurSenrPhaU_OutRngLInc "FaultFTMTLCS_CurSenrPhaU_OutRngLInc" VALUE 0x8009A1C1 DATA_RECORD_UBYTE 255 I_1 0 255 /end CHARACTERISTIC
/begin CHARACTERISTIC FaultFTMTLCS_CurSenrPhaU_VCCDec "FaultFTMTLCS_CurSenrPhaU_VCCDec" VALUE 0x8009A162 DATA_RECORD_UBYTE 255 I_1 0 255 /end CHARACTERISTIC
/begin CHARACTERISTIC FaultFTMTLCS_CurSenrPhaU_VCCFailMod "FaultFTMTLCS_CurSenrPhaU_VCCFailMod" VALUE 0x8009A222 DATA_RECORD_UBYTE 255 I_1 0 255 /end CHARACTERISTIC
/begin CHARACTERISTIC FaultFTMTLCS_CurSenrPhaU_VCCInc "FaultFTMTLCS_CurSenrPhaU_VCCInc" VALUE 0x8009A1C2 DATA_RECORD_UBYTE 255 I_1 0 255 /end CHARACTERISTIC
/begin CHARACTERISTIC FaultFTMTLCS_CurSenrPhaV_GNDDec "FaultFTMTLCS_CurSenrPhaV_GNDDec" VALUE 0x8009A163 DATA_RECORD_UBYTE 255 I_1 0 255 /end CHARACTERISTIC
/begin CHARACTERISTIC FaultFTMTLCS_CurSenrPhaV_GNDFailMod "FaultFTMTLCS_CurSenrPhaV_GNDFailMod" VALUE 0x8009A223 DATA_RECORD_UBYTE 255 I_1 0 255 /end CHARACTERISTIC
/begin CHARACTERISTIC FaultFTMTLCS_CurSenrPhaV_GNDInc "FaultFTMTLCS_CurSenrPhaV_GNDInc" VALUE 0x8009A1C3 DATA_RECORD_UBYTE 255 I_1 0 255 /end CHARACTERISTIC
/begin CHARACTERISTIC FaultFTMTLCS_CurSenrPhaV_OutRngHDec "FaultFTMTLCS_CurSenrPhaV_OutRngHDec" VALUE 0x8009A164 DATA_RECORD_UBYTE 255 I_1 0 255 /end CHARACTERISTIC
/begin CHARACTERISTIC FaultFTMTLCS_CurSenrPhaV_OutRngHFailMod "FaultFTMTLCS_CurSenrPhaV_OutRngHFailMod" VALUE 0x8009A224 DATA_RECORD_UBYTE 255 I_1 0 255 /end CHARACTERISTIC
/begin CHARACTERISTIC FaultFTMTLCS_CurSenrPhaV_OutRngHInc "FaultFTMTLCS_CurSenrPhaV_OutRngHInc" VALUE 0x8009A1C4 DATA_RECORD_UBYTE 255 I_1 0 255 /end CHARACTERISTIC
/begin CHARACTERISTIC FaultFTMTLCS_CurSenrPhaV_OutRngLDec "FaultFTMTLCS_CurSenrPhaV_OutRngLDec" VALUE 0x8009A165 DATA_RECORD_UBYTE 255 I_1 0 255 /end CHARACTERISTIC
/begin CHARACTERISTIC FaultFTMTLCS_CurSenrPhaV_OutRngLFailMod "FaultFTMTLCS_CurSenrPhaV_OutRngLFailMod" VALUE 0x8009A225 DATA_RECORD_UBYTE 255 I_1 0 255 /end CHARACTERISTIC
/begin CHARACTERISTIC FaultFTMTLCS_CurSenrPhaV_OutRngLInc "FaultFTMTLCS_CurSenrPhaV_OutRngLInc" VALUE 0x8009A1C5 DATA_RECORD_UBYTE 255 I_1 0 255 /end CHARACTERISTIC
/begin CHARACTERISTIC FaultFTMTLCS_CurSenrPhaV_VCCDec "FaultFTMTLCS_CurSenrPhaV_VCCDec" VALUE 0x8009A166 DATA_RECORD_UBYTE 255 I_1 0 255 /end CHARACTERISTIC
/begin CHARACTERISTIC FaultFTMTLCS_CurSenrPhaV_VCCFailMod "FaultFTMTLCS_CurSenrPhaV_VCCFailMod" VALUE 0x8009A226 DATA_RECORD_UBYTE 255 I_1 0 255 /end CHARACTERISTIC
/begin CHARACTERISTIC FaultFTMTLCS_CurSenrPhaV_VCCInc "FaultFTMTLCS_CurSenrPhaV_VCCInc" VALUE 0x8009A1C6 DATA_RECORD_UBYTE 255 I_1 0 255 /end CHARACTERISTIC
/begin CHARACTERISTIC FaultFTMTLCS_CurSenrPhaW_GNDDec "FaultFTMTLCS_CurSenrPhaW_GNDDec" VALUE 0x8009A167 DATA_RECORD_UBYTE 255 I_1 0 255 /end CHARACTERISTIC
/begin CHARACTERISTIC FaultFTMTLCS_CurSenrPhaW_GNDFailMod "FaultFTMTLCS_CurSenrPhaW_GNDFailMod" VALUE 0x8009A227 DATA_RECORD_UBYTE 255 I_1 0 255 /end CHARACTERISTIC
/begin CHARACTERISTIC FaultFTMTLCS_CurSenrPhaW_GNDInc "FaultFTMTLCS_CurSenrPhaW_GNDInc" VALUE 0x8009A1C7 DATA_RECORD_UBYTE 255 I_1 0 255 /end CHARACTERISTIC
/begin CHARACTERISTIC FaultFTMTLCS_CurSenrPhaW_OutRngHDec "FaultFTMTLCS_CurSenrPhaW_OutRngHDec" VALUE 0x8009A168 DATA_RECORD_UBYTE 255 I_1 0 255 /end CHARACTERISTIC
/begin CHARACTERISTIC FaultFTMTLCS_CurSenrPhaW_OutRngHFailMod "FaultFTMTLCS_CurSenrPhaW_OutRngHFailMod" VALUE 0x8009A228 DATA_RECORD_UBYTE 255 I_1 0 255 /end CHARACTERISTIC
/begin CHARACTERISTIC FaultFTMTLCS_CurSenrPhaW_OutRngHInc "FaultFTMTLCS_CurSenrPhaW_OutRngHInc" VALUE 0x8009A1C8 DATA_RECORD_UBYTE 255 I_1 0 255 /end CHARACTERISTIC
/begin CHARACTERISTIC FaultFTMTLCS_CurSenrPhaW_OutRngLDec "FaultFTMTLCS_CurSenrPhaW_OutRngLDec" VALUE 0x8009A169 DATA_RECORD_UBYTE 255 I_1 0 255 /end CHARACTERISTIC
/begin CHARACTERISTIC FaultFTMTLCS_CurSenrPhaW_OutRngLFailMod "FaultFTMTLCS_CurSenrPhaW_OutRngLFailMod" VALUE 0x8009A229 DATA_RECORD_UBYTE 255 I_1 0 255 /end CHARACTERISTIC
/begin CHARACTERISTIC FaultFTMTLCS_CurSenrPhaW_OutRngLInc "FaultFTMTLCS_CurSenrPhaW_OutRngLInc" VALUE 0x8009A1C9 DATA_RECORD_UBYTE 255 I_1 0 255 /end CHARACTERISTIC
/begin CHARACTERISTIC FaultFTMTLCS_CurSenrPhaW_VCCDec "FaultFTMTLCS_CurSenrPhaW_VCCDec" VALUE 0x8009A16A DATA_RECORD_UBYTE 255 I_1 0 255 /end CHARACTERISTIC
/begin CHARACTERISTIC FaultFTMTLCS_CurSenrPhaW_VCCFailMod "FaultFTMTLCS_CurSenrPhaW_VCCFailMod" VALUE 0x8009A22A DATA_RECORD_UBYTE 255 I_1 0 255 /end CHARACTERISTIC
/begin CHARACTERISTIC FaultFTMTLCS_CurSenrPhaW_VCCInc "FaultFTMTLCS_CurSenrPhaW_VCCInc" VALUE 0x8009A1CA DATA_RECORD_UBYTE 255 I_1 0 255 /end CHARACTERISTIC
/begin CHARACTERISTIC FaultFTMTLCS_CurrentSumErrorDec "FaultFTMTLCS_CurrentSumErrorDec" VALUE 0x8009A15E DATA_RECORD_UBYTE 255 I_1 0 255 /end CHARACTERISTIC
/begin CHARACTERISTIC FaultFTMTLCS_CurrentSumErrorFailMod "FaultFTMTLCS_CurrentSumErrorFailMod" VALUE 0x8009A21E DATA_RECORD_UBYTE 255 I_1 0 255 /end CHARACTERISTIC
/begin CHARACTERISTIC FaultFTMTLCS_CurrentSumErrorInc "FaultFTMTLCS_CurrentSumErrorInc" VALUE 0x8009A1BE DATA_RECORD_UBYTE 255 I_1 0 255 /end CHARACTERISTIC
/begin CHARACTERISTIC FaultSDMTMEP_CosGndDec "FaultSDMTMEP_CosGndDec" VALUE 0x8009A16B DATA_RECORD_UBYTE 255 I_1 0 255 /end CHARACTERISTIC
/begin CHARACTERISTIC FaultSDMTMEP_CosGndFailMod "FaultSDMTMEP_CosGndFailMod" VALUE 0x8009A22B DATA_RECORD_UBYTE 255 I_1 0 255 /end CHARACTERISTIC
/begin CHARACTERISTIC FaultSDMTMEP_CosGndInc "FaultSDMTMEP_CosGndInc" VALUE 0x8009A1CB DATA_RECORD_UBYTE 255 I_1 0 255 /end CHARACTERISTIC
/begin CHARACTERISTIC FaultSDMTMEP_CosOutRangeHighDec "FaultSDMTMEP_CosOutRangeHighDec" VALUE 0x8009A16C DATA_RECORD_UBYTE 255 I_1 0 255 /end CHARACTERISTIC
/begin CHARACTERISTIC FaultSDMTMEP_CosOutRangeHighFailMod "FaultSDMTMEP_CosOutRangeHighFailMod" VALUE 0x8009A22C DATA_RECORD_UBYTE 255 I_1 0 255 /end CHARACTERISTIC
/begin CHARACTERISTIC FaultSDMTMEP_CosOutRangeHighInc "FaultSDMTMEP_CosOutRangeHighInc" VALUE 0x8009A1CC DATA_RECORD_UBYTE 255 I_1 0 255 /end CHARACTERISTIC
/begin CHARACTERISTIC FaultSDMTMEP_CosOutRangeLowDec "FaultSDMTMEP_CosOutRangeLowDec" VALUE 0x8009A16D DATA_RECORD_UBYTE 255 I_1 0 255 /end CHARACTERISTIC
/begin CHARACTERISTIC FaultSDMTMEP_CosOutRangeLowFailMod "FaultSDMTMEP_CosOutRangeLowFailMod" VALUE 0x8009A22D DATA_RECORD_UBYTE 255 I_1 0 255 /end CHARACTERISTIC
/begin CHARACTERISTIC FaultSDMTMEP_CosOutRangeLowInc "FaultSDMTMEP_CosOutRangeLowInc" VALUE 0x8009A1CD DATA_RECORD_UBYTE 255 I_1 0 255 /end CHARACTERISTIC
/begin CHARACTERISTIC FaultSDMTMEP_CosVccDec "FaultSDMTMEP_CosVccDec" VALUE 0x8009A16E DATA_RECORD_UBYTE 255 I_1 0 255 /end CHARACTERISTIC
/begin CHARACTERISTIC FaultSDMTMEP_CosVccFailMod "FaultSDMTMEP_CosVccFailMod" VALUE 0x8009A22E DATA_RECORD_UBYTE 255 I_1 0 255 /end CHARACTERISTIC
/begin CHARACTERISTIC FaultSDMTMEP_CosVccInc "FaultSDMTMEP_CosVccInc" VALUE 0x8009A1CE DATA_RECORD_UBYTE 255 I_1 0 255 /end CHARACTERISTIC
/begin CHARACTERISTIC FaultSDMTMEP_OverSpeedDec "FaultSDMTMEP_OverSpeedDec" VALUE 0x8009A16F DATA_RECORD_UBYTE 255 I_1 0 255 /end CHARACTERISTIC
/begin CHARACTERISTIC FaultSDMTMEP_OverSpeedFailMod "FaultSDMTMEP_OverSpeedFailMod" VALUE 0x8009A22F DATA_RECORD_UBYTE 255 I_1 0 255 /end CHARACTERISTIC
/begin CHARACTERISTIC FaultSDMTMEP_OverSpeedInc "FaultSDMTMEP_OverSpeedInc" VALUE 0x8009A1CF DATA_RECORD_UBYTE 255 I_1 0 255 /end CHARACTERISTIC
/begin CHARACTERISTIC FaultSDMTMEP_ResSquaSumErrByFTDec "FaultSDMTMEP_ResSquaSumErrByFTDec" VALUE 0x8009A170 DATA_RECORD_UBYTE 255 I_1 0 255 /end CHARACTERISTIC
/begin CHARACTERISTIC FaultSDMTMEP_ResSquaSumErrByFTFailMod "FaultSDMTMEP_ResSquaSumErrByFTFailMod" VALUE 0x8009A230 DATA_RECORD_UBYTE 255 I_1 0 255 /end CHARACTERISTIC
/begin CHARACTERISTIC FaultSDMTMEP_ResSquaSumErrByFTInc "FaultSDMTMEP_ResSquaSumErrByFTInc" VALUE 0x8009A1D0 DATA_RECORD_UBYTE 255 I_1 0 255 /end CHARACTERISTIC
/begin CHARACTERISTIC FaultSDMTMEP_SinGndDec "FaultSDMTMEP_SinGndDec" VALUE 0x8009A171 DATA_RECORD_UBYTE 255 I_1 0 255 /end CHARACTERISTIC
/begin CHARACTERISTIC FaultSDMTMEP_SinGndFailMod "FaultSDMTMEP_SinGndFailMod" VALUE 0x8009A231 DATA_RECORD_UBYTE 255 I_1 0 255 /end CHARACTERISTIC
/begin CHARACTERISTIC FaultSDMTMEP_SinGndInc "FaultSDMTMEP_SinGndInc" VALUE 0x8009A1D1 DATA_RECORD_UBYTE 255 I_1 0 255 /end CHARACTERISTIC
/begin CHARACTERISTIC FaultSDMTMEP_SinOutRangeHighDec "FaultSDMTMEP_SinOutRangeHighDec" VALUE 0x8009A172 DATA_RECORD_UBYTE 255 I_1 0 255 /end CHARACTERISTIC
/begin CHARACTERISTIC FaultSDMTMEP_SinOutRangeHighFailMod "FaultSDMTMEP_SinOutRangeHighFailMod" VALUE 0x8009A232 DATA_RECORD_UBYTE 255 I_1 0 255 /end CHARACTERISTIC
/begin CHARACTERISTIC FaultSDMTMEP_SinOutRangeHighInc "FaultSDMTMEP_SinOutRangeHighInc" VALUE 0x8009A1D2 DATA_RECORD_UBYTE 255 I_1 0 255 /end CHARACTERISTIC
/begin CHARACTERISTIC FaultSDMTMEP_SinOutRangeLowDec "FaultSDMTMEP_SinOutRangeLowDec" VALUE 0x8009A173 DATA_RECORD_UBYTE 255 I_1 0 255 /end CHARACTERISTIC
/begin CHARACTERISTIC FaultSDMTMEP_SinOutRangeLowFailMod "FaultSDMTMEP_SinOutRangeLowFailMod" VALUE 0x8009A233 DATA_RECORD_UBYTE 255 I_1 0 255 /end CHARACTERISTIC
/begin CHARACTERISTIC FaultSDMTMEP_SinOutRangeLowInc "FaultSDMTMEP_SinOutRangeLowInc" VALUE 0x8009A1D3 DATA_RECORD_UBYTE 255 I_1 0 255 /end CHARACTERISTIC
/begin CHARACTERISTIC FaultSDMTMEP_SinVccDec "FaultSDMTMEP_SinVccDec" VALUE 0x8009A174 DATA_RECORD_UBYTE 255 I_1 0 255 /end CHARACTERISTIC
/begin CHARACTERISTIC FaultSDMTMEP_SinVccFailMod "FaultSDMTMEP_SinVccFailMod" VALUE 0x8009A234 DATA_RECORD_UBYTE 255 I_1 0 255 /end CHARACTERISTIC
/begin CHARACTERISTIC FaultSDMTMEP_SinVccInc "FaultSDMTMEP_SinVccInc" VALUE 0x8009A1D4 DATA_RECORD_UBYTE 255 I_1 0 255 /end CHARACTERISTIC
/begin CHARACTERISTIC FaultSDMTMEP_UnderSpeedDec "FaultSDMTMEP_UnderSpeedDec" VALUE 0x8009A175 DATA_RECORD_UBYTE 255 I_1 0 255 /end CHARACTERISTIC
/begin CHARACTERISTIC FaultSDMTMEP_UnderSpeedFailMod "FaultSDMTMEP_UnderSpeedFailMod" VALUE 0x8009A235 DATA_RECORD_UBYTE 255 I_1 0 255 /end CHARACTERISTIC
/begin CHARACTERISTIC FaultSDMTMEP_UnderSpeedInc "FaultSDMTMEP_UnderSpeedInc" VALUE 0x8009A1D5 DATA_RECORD_UBYTE 255 I_1 0 255 /end CHARACTERISTIC
/begin CHARACTERISTIC FaultTCUCAP0_CAPPressureHDec "FaultTCUCAP0_CAPPressureHDec" VALUE 0x8009A176 DATA_RECORD_UBYTE 255 I_1 0 255 /end CHARACTERISTIC
/begin CHARACTERISTIC FaultTCUCAP0_CAPPressureHFailMod "FaultTCUCAP0_CAPPressureHFailMod" VALUE 0x8009A236 DATA_RECORD_UBYTE 255 I_1 0 255 /end CHARACTERISTIC
/begin CHARACTERISTIC FaultTCUCAP0_CAPPressureHInc "FaultTCUCAP0_CAPPressureHInc" VALUE 0x8009A1D6 DATA_RECORD_UBYTE 255 I_1 0 255 /end CHARACTERISTIC
/begin CHARACTERISTIC FaultTCUCAP0_CAPPressureLDec "FaultTCUCAP0_CAPPressureLDec" VALUE 0x8009A177 DATA_RECORD_UBYTE 255 I_1 0 255 /end CHARACTERISTIC
/begin CHARACTERISTIC FaultTCUCAP0_CAPPressureLFailMod "FaultTCUCAP0_CAPPressureLFailMod" VALUE 0x8009A237 DATA_RECORD_UBYTE 255 I_1 0 255 /end CHARACTERISTIC
/begin CHARACTERISTIC FaultTCUCAP0_CAPPressureLInc "FaultTCUCAP0_CAPPressureLInc" VALUE 0x8009A1D7 DATA_RECORD_UBYTE 255 I_1 0 255 /end CHARACTERISTIC
/begin CHARACTERISTIC FaultTCUCAP0_CAPPressureOverHDec "FaultTCUCAP0_CAPPressureOverHDec" VALUE 0x8009A178 DATA_RECORD_UBYTE 255 I_1 0 255 /end CHARACTERISTIC
/begin CHARACTERISTIC FaultTCUCAP0_CAPPressureOverHFailMod "FaultTCUCAP0_CAPPressureOverHFailMod" VALUE 0x8009A238 DATA_RECORD_UBYTE 255 I_1 0 255 /end CHARACTERISTIC
/begin CHARACTERISTIC FaultTCUCAP0_CAPPressureOverHInc "FaultTCUCAP0_CAPPressureOverHInc" VALUE 0x8009A1D8 DATA_RECORD_UBYTE 255 I_1 0 255 /end CHARACTERISTIC
/begin CHARACTERISTIC FaultTCUCAP0_CAPSlipDec "FaultTCUCAP0_CAPSlipDec" VALUE 0x8009A179 DATA_RECORD_UBYTE 255 I_1 0 255 /end CHARACTERISTIC
/begin CHARACTERISTIC FaultTCUCAP0_CAPSlipFailMod "FaultTCUCAP0_CAPSlipFailMod" VALUE 0x8009A239 DATA_RECORD_UBYTE 255 I_1 0 255 /end CHARACTERISTIC
/begin CHARACTERISTIC FaultTCUCAP0_CAPSlipInc "FaultTCUCAP0_CAPSlipInc" VALUE 0x8009A1D9 DATA_RECORD_UBYTE 255 I_1 0 255 /end CHARACTERISTIC
/begin CHARACTERISTIC FaultTCUCAP0_DragMomentHDec "FaultTCUCAP0_DragMomentHDec" VALUE 0x8009A17A DATA_RECORD_UBYTE 255 I_1 0 255 /end CHARACTERISTIC
/begin CHARACTERISTIC FaultTCUCAP0_DragMomentHFailMod "FaultTCUCAP0_DragMomentHFailMod" VALUE 0x8009A23A DATA_RECORD_UBYTE 255 I_1 0 255 /end CHARACTERISTIC
/begin CHARACTERISTIC FaultTCUCAP0_DragMomentHInc "FaultTCUCAP0_DragMomentHInc" VALUE 0x8009A1DA DATA_RECORD_UBYTE 255 I_1 0 255 /end CHARACTERISTIC
/begin CHARACTERISTIC FaultTCUCAP0_HLSinInvalidDec "FaultTCUCAP0_HLSinInvalidDec" VALUE 0x8009A17B DATA_RECORD_UBYTE 255 I_1 0 255 /end CHARACTERISTIC
/begin CHARACTERISTIC FaultTCUCAP0_HLSinInvalidFailMod "FaultTCUCAP0_HLSinInvalidFailMod" VALUE 0x8009A23B DATA_RECORD_UBYTE 255 I_1 0 255 /end CHARACTERISTIC
/begin CHARACTERISTIC FaultTCUCAP0_HLSinInvalidInc "FaultTCUCAP0_HLSinInvalidInc" VALUE 0x8009A1DB DATA_RECORD_UBYTE 255 I_1 0 255 /end CHARACTERISTIC
/begin CHARACTERISTIC FaultTCUCAP0_HLSinUndefineDec "FaultTCUCAP0_HLSinUndefineDec" VALUE 0x8009A17C DATA_RECORD_UBYTE 255 I_1 0 255 /end CHARACTERISTIC
/begin CHARACTERISTIC FaultTCUCAP0_HLSinUndefineFailMod "FaultTCUCAP0_HLSinUndefineFailMod" VALUE 0x8009A23C DATA_RECORD_UBYTE 255 I_1 0 255 /end CHARACTERISTIC
/begin CHARACTERISTIC FaultTCUCAP0_HLSinUndefineInc "FaultTCUCAP0_HLSinUndefineInc" VALUE 0x8009A1DC DATA_RECORD_UBYTE 255 I_1 0 255 /end CHARACTERISTIC
/begin CHARACTERISTIC FaultTCUCAP0_HLSupplyHDec "FaultTCUCAP0_HLSupplyHDec" VALUE 0x8009A17D DATA_RECORD_UBYTE 255 I_1 0 255 /end CHARACTERISTIC
/begin CHARACTERISTIC FaultTCUCAP0_HLSupplyHFailMod "FaultTCUCAP0_HLSupplyHFailMod" VALUE 0x8009A23D DATA_RECORD_UBYTE 255 I_1 0 255 /end CHARACTERISTIC
/begin CHARACTERISTIC FaultTCUCAP0_HLSupplyHInc "FaultTCUCAP0_HLSupplyHInc" VALUE 0x8009A1DD DATA_RECORD_UBYTE 255 I_1 0 255 /end CHARACTERISTIC
/begin CHARACTERISTIC FaultTCUCAP0_HLSupplyLDec "FaultTCUCAP0_HLSupplyLDec" VALUE 0x8009A17E DATA_RECORD_UBYTE 255 I_1 0 255 /end CHARACTERISTIC
/begin CHARACTERISTIC FaultTCUCAP0_HLSupplyLFailMod "FaultTCUCAP0_HLSupplyLFailMod" VALUE 0x8009A23E DATA_RECORD_UBYTE 255 I_1 0 255 /end CHARACTERISTIC
/begin CHARACTERISTIC FaultTCUCAP0_HLSupplyLInc "FaultTCUCAP0_HLSupplyLInc" VALUE 0x8009A1DE DATA_RECORD_UBYTE 255 I_1 0 255 /end CHARACTERISTIC
/begin CHARACTERISTIC FaultTCUCAP0_MotorPhaseVolHDec "FaultTCUCAP0_MotorPhaseVolHDec" VALUE 0x8009A17F DATA_RECORD_UBYTE 255 I_1 0 255 /end CHARACTERISTIC
/begin CHARACTERISTIC FaultTCUCAP0_MotorPhaseVolHFailMod "FaultTCUCAP0_MotorPhaseVolHFailMod" VALUE 0x8009A23F DATA_RECORD_UBYTE 255 I_1 0 255 /end CHARACTERISTIC
/begin CHARACTERISTIC FaultTCUCAP0_MotorPhaseVolHInc "FaultTCUCAP0_MotorPhaseVolHInc" VALUE 0x8009A1DF DATA_RECORD_UBYTE 255 I_1 0 255 /end CHARACTERISTIC
/begin CHARACTERISTIC FaultTCUCAP0_PressureRationalDec "FaultTCUCAP0_PressureRationalDec" VALUE 0x8009A180 DATA_RECORD_UBYTE 255 I_1 0 255 /end CHARACTERISTIC
/begin CHARACTERISTIC FaultTCUCAP0_PressureRationalFailMod "FaultTCUCAP0_PressureRationalFailMod" VALUE 0x8009A240 DATA_RECORD_UBYTE 255 I_1 0 255 /end CHARACTERISTIC
/begin CHARACTERISTIC FaultTCUCAP0_PressureRationalInc "FaultTCUCAP0_PressureRationalInc" VALUE 0x8009A1E0 DATA_RECORD_UBYTE 255 I_1 0 255 /end CHARACTERISTIC
/begin CHARACTERISTIC FaultTCUCAP0_SenSigOpenOrGNDDec "FaultTCUCAP0_SenSigOpenOrGNDDec" VALUE 0x8009A181 DATA_RECORD_UBYTE 255 I_1 0 255 /end CHARACTERISTIC
/begin CHARACTERISTIC FaultTCUCAP0_SenSigOpenOrGNDFailMod "FaultTCUCAP0_SenSigOpenOrGNDFailMod" VALUE 0x8009A241 DATA_RECORD_UBYTE 255 I_1 0 255 /end CHARACTERISTIC
/begin CHARACTERISTIC FaultTCUCAP0_SenSigOpenOrGNDInc "FaultTCUCAP0_SenSigOpenOrGNDInc" VALUE 0x8009A1E1 DATA_RECORD_UBYTE 255 I_1 0 255 /end CHARACTERISTIC
/begin CHARACTERISTIC FaultTCUCAP0_SenSigVCCDec "FaultTCUCAP0_SenSigVCCDec" VALUE 0x8009A182 DATA_RECORD_UBYTE 255 I_1 0 255 /end CHARACTERISTIC
/begin CHARACTERISTIC FaultTCUCAP0_SenSigVCCFailMod "FaultTCUCAP0_SenSigVCCFailMod" VALUE 0x8009A242 DATA_RECORD_UBYTE 255 I_1 0 255 /end CHARACTERISTIC
/begin CHARACTERISTIC FaultTCUCAP0_SenSigVCCInc "FaultTCUCAP0_SenSigVCCInc" VALUE 0x8009A1E2 DATA_RECORD_UBYTE 255 I_1 0 255 /end CHARACTERISTIC
/begin CHARACTERISTIC FaultTCUCAP0_SensorPerforErrDec "FaultTCUCAP0_SensorPerforErrDec" VALUE 0x8009A183 DATA_RECORD_UBYTE 255 I_1 0 255 /end CHARACTERISTIC
/begin CHARACTERISTIC FaultTCUCAP0_SensorPerforErrFailMod "FaultTCUCAP0_SensorPerforErrFailMod" VALUE 0x8009A243 DATA_RECORD_UBYTE 255 I_1 0 255 /end CHARACTERISTIC
/begin CHARACTERISTIC FaultTCUCAP0_SensorPerforErrInc "FaultTCUCAP0_SensorPerforErrInc" VALUE 0x8009A1E3 DATA_RECORD_UBYTE 255 I_1 0 255 /end CHARACTERISTIC
/begin CHARACTERISTIC FaultTCUCAP1_COM_GCUDec "FaultTCUCAP1_COM_GCUDec" VALUE 0x8009A184 DATA_RECORD_UBYTE 255 I_1 0 255 /end CHARACTERISTIC
/begin CHARACTERISTIC FaultTCUCAP1_COM_GCUFailMod "FaultTCUCAP1_COM_GCUFailMod" VALUE 0x8009A244 DATA_RECORD_UBYTE 255 I_1 0 255 /end CHARACTERISTIC
/begin CHARACTERISTIC FaultTCUCAP1_COM_GCUInc "FaultTCUCAP1_COM_GCUInc" VALUE 0x8009A1E4 DATA_RECORD_UBYTE 255 I_1 0 255 /end CHARACTERISTIC
/begin CHARACTERISTIC FaultTCUCAP1_DriverTempHDec "FaultTCUCAP1_DriverTempHDec" VALUE 0x8009A185 DATA_RECORD_UBYTE 255 I_1 0 255 /end CHARACTERISTIC
/begin CHARACTERISTIC FaultTCUCAP1_DriverTempHFailMod "FaultTCUCAP1_DriverTempHFailMod" VALUE 0x8009A245 DATA_RECORD_UBYTE 255 I_1 0 255 /end CHARACTERISTIC
/begin CHARACTERISTIC FaultTCUCAP1_DriverTempHInc "FaultTCUCAP1_DriverTempHInc" VALUE 0x8009A1E5 DATA_RECORD_UBYTE 255 I_1 0 255 /end CHARACTERISTIC
/begin CHARACTERISTIC FaultTCUCAP1_FETShortDec "FaultTCUCAP1_FETShortDec" VALUE 0x8009A186 DATA_RECORD_UBYTE 255 I_1 0 255 /end CHARACTERISTIC
/begin CHARACTERISTIC FaultTCUCAP1_FETShortFailMod "FaultTCUCAP1_FETShortFailMod" VALUE 0x8009A246 DATA_RECORD_UBYTE 255 I_1 0 255 /end CHARACTERISTIC
/begin CHARACTERISTIC FaultTCUCAP1_FETShortInc "FaultTCUCAP1_FETShortInc" VALUE 0x8009A1E6 DATA_RECORD_UBYTE 255 I_1 0 255 /end CHARACTERISTIC
/begin CHARACTERISTIC FaultTCUCAP1_HWOverCurDec "FaultTCUCAP1_HWOverCurDec" VALUE 0x8009A187 DATA_RECORD_UBYTE 255 I_1 0 255 /end CHARACTERISTIC
/begin CHARACTERISTIC FaultTCUCAP1_HWOverCurFailMod "FaultTCUCAP1_HWOverCurFailMod" VALUE 0x8009A247 DATA_RECORD_UBYTE 255 I_1 0 255 /end CHARACTERISTIC
/begin CHARACTERISTIC FaultTCUCAP1_HWOverCurInc "FaultTCUCAP1_HWOverCurInc" VALUE 0x8009A1E7 DATA_RECORD_UBYTE 255 I_1 0 255 /end CHARACTERISTIC
/begin CHARACTERISTIC FaultTCUCAP1_MotorPhaseDriveErrDec "FaultTCUCAP1_MotorPhaseDriveErrDec" VALUE 0x8009A188 DATA_RECORD_UBYTE 255 I_1 0 255 /end CHARACTERISTIC
/begin CHARACTERISTIC FaultTCUCAP1_MotorPhaseDriveErrFailMod "FaultTCUCAP1_MotorPhaseDriveErrFailMod" VALUE 0x8009A248 DATA_RECORD_UBYTE 255 I_1 0 255 /end CHARACTERISTIC
/begin CHARACTERISTIC FaultTCUCAP1_MotorPhaseDriveErrInc "FaultTCUCAP1_MotorPhaseDriveErrInc" VALUE 0x8009A1E8 DATA_RECORD_UBYTE 255 I_1 0 255 /end CHARACTERISTIC
/begin CHARACTERISTIC FaultTCUCAP1_MotorStallDec "FaultTCUCAP1_MotorStallDec" VALUE 0x8009A189 DATA_RECORD_UBYTE 255 I_1 0 255 /end CHARACTERISTIC
/begin CHARACTERISTIC FaultTCUCAP1_MotorStallFailMod "FaultTCUCAP1_MotorStallFailMod" VALUE 0x8009A249 DATA_RECORD_UBYTE 255 I_1 0 255 /end CHARACTERISTIC
/begin CHARACTERISTIC FaultTCUCAP1_MotorStallInc "FaultTCUCAP1_MotorStallInc" VALUE 0x8009A1E9 DATA_RECORD_UBYTE 255 I_1 0 255 /end CHARACTERISTIC
/begin CHARACTERISTIC FaultTCUCAP1_OverVoltageDec "FaultTCUCAP1_OverVoltageDec" VALUE 0x8009A18A DATA_RECORD_UBYTE 255 I_1 0 255 /end CHARACTERISTIC
/begin CHARACTERISTIC FaultTCUCAP1_OverVoltageFailMod "FaultTCUCAP1_OverVoltageFailMod" VALUE 0x8009A24A DATA_RECORD_UBYTE 255 I_1 0 255 /end CHARACTERISTIC
/begin CHARACTERISTIC FaultTCUCAP1_OverVoltageInc "FaultTCUCAP1_OverVoltageInc" VALUE 0x8009A1EA DATA_RECORD_UBYTE 255 I_1 0 255 /end CHARACTERISTIC
/begin CHARACTERISTIC FaultTCUCAP1_PhaseDetectGNDDec "FaultTCUCAP1_PhaseDetectGNDDec" VALUE 0x8009A18B DATA_RECORD_UBYTE 255 I_1 0 255 /end CHARACTERISTIC
/begin CHARACTERISTIC FaultTCUCAP1_PhaseDetectGNDFailMod "FaultTCUCAP1_PhaseDetectGNDFailMod" VALUE 0x8009A24B DATA_RECORD_UBYTE 255 I_1 0 255 /end CHARACTERISTIC
/begin CHARACTERISTIC FaultTCUCAP1_PhaseDetectGNDInc "FaultTCUCAP1_PhaseDetectGNDInc" VALUE 0x8009A1EB DATA_RECORD_UBYTE 255 I_1 0 255 /end CHARACTERISTIC
/begin CHARACTERISTIC FaultTCUCAP1_PhaseDetectVCCDec "FaultTCUCAP1_PhaseDetectVCCDec" VALUE 0x8009A18C DATA_RECORD_UBYTE 255 I_1 0 255 /end CHARACTERISTIC
/begin CHARACTERISTIC FaultTCUCAP1_PhaseDetectVCCFailMod "FaultTCUCAP1_PhaseDetectVCCFailMod" VALUE 0x8009A24C DATA_RECORD_UBYTE 255 I_1 0 255 /end CHARACTERISTIC
/begin CHARACTERISTIC FaultTCUCAP1_PhaseDetectVCCInc "FaultTCUCAP1_PhaseDetectVCCInc" VALUE 0x8009A1EC DATA_RECORD_UBYTE 255 I_1 0 255 /end CHARACTERISTIC
/begin CHARACTERISTIC FaultTCUCAP1_SWOverCurDec "FaultTCUCAP1_SWOverCurDec" VALUE 0x8009A18D DATA_RECORD_UBYTE 255 I_1 0 255 /end CHARACTERISTIC
/begin CHARACTERISTIC FaultTCUCAP1_SWOverCurFailMod "FaultTCUCAP1_SWOverCurFailMod" VALUE 0x8009A24D DATA_RECORD_UBYTE 255 I_1 0 255 /end CHARACTERISTIC
/begin CHARACTERISTIC FaultTCUCAP1_SWOverCurInc "FaultTCUCAP1_SWOverCurInc" VALUE 0x8009A1ED DATA_RECORD_UBYTE 255 I_1 0 255 /end CHARACTERISTIC
/begin CHARACTERISTIC FaultTCUCAP1_ThermalShutDownDec "FaultTCUCAP1_ThermalShutDownDec" VALUE 0x8009A18E DATA_RECORD_UBYTE 255 I_1 0 255 /end CHARACTERISTIC
/begin CHARACTERISTIC FaultTCUCAP1_ThermalShutDownFailMod "FaultTCUCAP1_ThermalShutDownFailMod" VALUE 0x8009A24E DATA_RECORD_UBYTE 255 I_1 0 255 /end CHARACTERISTIC
/begin CHARACTERISTIC FaultTCUCAP1_ThermalShutDownInc "FaultTCUCAP1_ThermalShutDownInc" VALUE 0x8009A1EE DATA_RECORD_UBYTE 255 I_1 0 255 /end CHARACTERISTIC
/begin CHARACTERISTIC FaultTCUCAP1_ThermalWarningDec "FaultTCUCAP1_ThermalWarningDec" VALUE 0x8009A18F DATA_RECORD_UBYTE 255 I_1 0 255 /end CHARACTERISTIC
/begin CHARACTERISTIC FaultTCUCAP1_ThermalWarningFailMod "FaultTCUCAP1_ThermalWarningFailMod" VALUE 0x8009A24F DATA_RECORD_UBYTE 255 I_1 0 255 /end CHARACTERISTIC
/begin CHARACTERISTIC FaultTCUCAP1_ThermalWarningInc "FaultTCUCAP1_ThermalWarningInc" VALUE 0x8009A1EF DATA_RECORD_UBYTE 255 I_1 0 255 /end CHARACTERISTIC
/begin CHARACTERISTIC FaultTCUCAP1_UnderVoltageDec "FaultTCUCAP1_UnderVoltageDec" VALUE 0x8009A190 DATA_RECORD_UBYTE 255 I_1 0 255 /end CHARACTERISTIC
/begin CHARACTERISTIC FaultTCUCAP1_UnderVoltageFailMod "FaultTCUCAP1_UnderVoltageFailMod" VALUE 0x8009A250 DATA_RECORD_UBYTE 255 I_1 0 255 /end CHARACTERISTIC
/begin CHARACTERISTIC FaultTCUCAP1_UnderVoltageInc "FaultTCUCAP1_UnderVoltageInc" VALUE 0x8009A1F0 DATA_RECORD_UBYTE 255 I_1 0 255 /end CHARACTERISTIC
/begin CHARACTERISTIC FaultTCUCCP_OilMotorRationalDec "FaultTCUCCP_OilMotorRationalDec" VALUE 0x8009A191 DATA_RECORD_UBYTE 255 I_1 0 255 /end CHARACTERISTIC
/begin CHARACTERISTIC FaultTCUCCP_OilMotorRationalFailMod "FaultTCUCCP_OilMotorRationalFailMod" VALUE 0x8009A251 DATA_RECORD_UBYTE 255 I_1 0 255 /end CHARACTERISTIC
/begin CHARACTERISTIC FaultTCUCCP_OilMotorRationalInc "FaultTCUCCP_OilMotorRationalInc" VALUE 0x8009A1F1 DATA_RECORD_UBYTE 255 I_1 0 255 /end CHARACTERISTIC
/begin CHARACTERISTIC FaultTCUCCP_OilMotorStallDec "FaultTCUCCP_OilMotorStallDec" VALUE 0x8009A192 DATA_RECORD_UBYTE 255 I_1 0 255 /end CHARACTERISTIC
/begin CHARACTERISTIC FaultTCUCCP_OilMotorStallFailMod "FaultTCUCCP_OilMotorStallFailMod" VALUE 0x8009A252 DATA_RECORD_UBYTE 255 I_1 0 255 /end CHARACTERISTIC
/begin CHARACTERISTIC FaultTCUCCP_OilMotorStallInc "FaultTCUCCP_OilMotorStallInc" VALUE 0x8009A1F2 DATA_RECORD_UBYTE 255 I_1 0 255 /end CHARACTERISTIC
/begin CHARACTERISTIC FaultTCUCCP_OilSenRationalL1Dec "FaultTCUCCP_OilSenRationalL1Dec" VALUE 0x8009A193 DATA_RECORD_UBYTE 255 I_1 0 255 /end CHARACTERISTIC
/begin CHARACTERISTIC FaultTCUCCP_OilSenRationalL1FailMod "FaultTCUCCP_OilSenRationalL1FailMod" VALUE 0x8009A253 DATA_RECORD_UBYTE 255 I_1 0 255 /end CHARACTERISTIC
/begin CHARACTERISTIC FaultTCUCCP_OilSenRationalL1Inc "FaultTCUCCP_OilSenRationalL1Inc" VALUE 0x8009A1F3 DATA_RECORD_UBYTE 255 I_1 0 255 /end CHARACTERISTIC
/begin CHARACTERISTIC FaultTCUCCP_OilSenRationalL2Dec "FaultTCUCCP_OilSenRationalL2Dec" VALUE 0x8009A194 DATA_RECORD_UBYTE 255 I_1 0 255 /end CHARACTERISTIC
/begin CHARACTERISTIC FaultTCUCCP_OilSenRationalL2FailMod "FaultTCUCCP_OilSenRationalL2FailMod" VALUE 0x8009A254 DATA_RECORD_UBYTE 255 I_1 0 255 /end CHARACTERISTIC
/begin CHARACTERISTIC FaultTCUCCP_OilSenRationalL2Inc "FaultTCUCCP_OilSenRationalL2Inc" VALUE 0x8009A1F4 DATA_RECORD_UBYTE 255 I_1 0 255 /end CHARACTERISTIC
/begin CHARACTERISTIC FaultTCUCCP_OilTempRationalHDec "FaultTCUCCP_OilTempRationalHDec" VALUE 0x8009A195 DATA_RECORD_UBYTE 255 I_1 0 255 /end CHARACTERISTIC
/begin CHARACTERISTIC FaultTCUCCP_OilTempRationalHFailMod "FaultTCUCCP_OilTempRationalHFailMod" VALUE 0x8009A255 DATA_RECORD_UBYTE 255 I_1 0 255 /end CHARACTERISTIC
/begin CHARACTERISTIC FaultTCUCCP_OilTempRationalHInc "FaultTCUCCP_OilTempRationalHInc" VALUE 0x8009A1F5 DATA_RECORD_UBYTE 255 I_1 0 255 /end CHARACTERISTIC
/begin CHARACTERISTIC FaultTCUCCP_OilTempRationalLDec "FaultTCUCCP_OilTempRationalLDec" VALUE 0x8009A196 DATA_RECORD_UBYTE 255 I_1 0 255 /end CHARACTERISTIC
/begin CHARACTERISTIC FaultTCUCCP_OilTempRationalLFailMod "FaultTCUCCP_OilTempRationalLFailMod" VALUE 0x8009A256 DATA_RECORD_UBYTE 255 I_1 0 255 /end CHARACTERISTIC
/begin CHARACTERISTIC FaultTCUCCP_OilTempRationalLInc "FaultTCUCCP_OilTempRationalLInc" VALUE 0x8009A1F6 DATA_RECORD_UBYTE 255 I_1 0 255 /end CHARACTERISTIC
/begin CHARACTERISTIC HARDPTG_s16AmplitudeC "HARDPTG_s16AmplitudeC" VALUE 0x80060096 DATA_RECORD_SWORD 200 F_0v0030518044_p0_80 -100.0015259 99.9984741 /end CHARACTERISTIC
/begin CHARACTERISTIC HARDPTG_s16ContinuousRequestC "HARDPTG_s16ContinuousRequestC" VALUE 0x80060094 DATA_RECORD_SWORD 100 F_0v0015259022_p0_81 -50.00076295 49.99923705 /end CHARACTERISTIC
/begin CHARACTERISTIC HARDPTG_s16OffsetC "HARDPTG_s16OffsetC" VALUE 0x80060092 DATA_RECORD_SWORD 200 F_0v0030518044_p0_80 -100.0015259 99.9984741 /end CHARACTERISTIC
/begin CHARACTERISTIC HARDPTG_s16SlewRateC "HARDPTG_s16SlewRateC" VALUE 0x80060090 DATA_RECORD_SWORD 200 F_0v0030518044_p0_80 -100.0015259 99.9984741 /end CHARACTERISTIC
/begin CHARACTERISTIC HARDPTG_u16PulseDutyCycleC "HARDPTG_u16PulseDutyCycleC" VALUE 0x80060088 DATA_RECORD_UWORD 99.9984741 D_2_0v01_p0_82 0.00152590219 100 /end CHARACTERISTIC
/begin CHARACTERISTIC HARDPTG_u32FrequenceC "Sous-multiple de la période SPI VSI" VALUE 0x80060BAC DATA_RECORD_ULONG 4294967295 F_1_p0_4 0 4294967295 /end CHARACTERISTIC
/begin CHARACTERISTIC HARD_bPtgEnablePhaseShiftingC "HARD_bPtgEnablePhaseShiftingC" VALUE 0x80060025 DATA_RECORD_UBYTE 1 Bool_ON_OFF 0 1 BIT_MASK 0x01 /end CHARACTERISTIC
/begin CHARACTERISTIC HARD_u16PtgUSignalShiftC "HARD_u16PtgUSignalShiftC" VALUE 0x8006008E DATA_RECORD_UWORD 1.999969482 F_0v0000305176_p0_84 0 1.999969482 /end CHARACTERISTIC
/begin CHARACTERISTIC HARD_u16PtgVSignalShiftC "HARD_u16PtgVSignalShiftC" VALUE 0x8006008C DATA_RECORD_UWORD 1.999969482 F_0v0000305176_p0_84 0 1.999969482 /end CHARACTERISTIC
/begin CHARACTERISTIC HARD_u16PtgWSignalShiftC "HARD_u16PtgWSignalShiftC" VALUE 0x8006008A DATA_RECORD_UWORD 1.999969482 F_0v0000305176_p0_84 0 1.999969482 /end CHARACTERISTIC
/begin MEASUREMENT FAULT_FF_bFrameLock_FF1 "FAULT_FF_bFrameLock_FF1" UBYTE Bool_ON_OFF 1 2 0 1 BIT_MASK 0x01 ECU_ADDRESS 0x7000A258 /end MEASUREMENT
/begin MEASUREMENT FF_FF1_BMS_HVBusVolt "FF_FF1_BMS_HVBusVolt" UWORD F_1_p0_4 1 2 0 65535 ECU_ADDRESS 0x7000A292 /end MEASUREMENT
/begin MEASUREMENT FF_FF1_BatteryVoltage "FF_FF1_BatteryVoltage" UWORD F_1_p0_4 1 2 0 65535 ECU_ADDRESS 0x7000A25E /end MEASUREMENT
/begin MEASUREMENT FF_FF1_CosScaled "FF_FF1_CosScaled" UWORD F_1_p0_4 1 2 0 65535 ECU_ADDRESS 0x7000A2AA /end MEASUREMENT
/begin MEASUREMENT FF_FF1_DC_Current "FF_FF1_DC_Current" UWORD F_1_p0_4 1 2 0 65535 ECU_ADDRESS 0x7000A28C /end MEASUREMENT
/begin MEASUREMENT FF_FF1_DrivingPermission "FF_FF1_DrivingPermission" UBYTE F_1_p0_4 1 2 0 255 ECU_ADDRESS 0x7000A26E /end MEASUREMENT
/begin MEASUREMENT FF_FF1_EngineSpeed "FF_FF1_EngineSpeed" UWORD F_1_p0_4 1 2 0 65535 ECU_ADDRESS 0x7000A26C /end MEASUREMENT
/begin MEASUREMENT FF_FF1_EstimTempSecFild "FF_FF1_EstimTempSecFild" UWORD F_1_p0_4 1 2 0 65535 ECU_ADDRESS 0x7000A2CC /end MEASUREMENT
/begin MEASUREMENT FF_FF1_ExcVoltageFild "FF_FF1_ExcVoltageFild" UWORD F_1_p0_4 1 2 0 65535 ECU_ADDRESS 0x7000A2AC /end MEASUREMENT
/begin MEASUREMENT FF_FF1_ExcitationDiag "FF_FF1_ExcitationDiag" UWORD F_1_p0_4 1 2 0 65535 ECU_ADDRESS 0x7000A2AE /end MEASUREMENT
/begin MEASUREMENT FF_FF1_FPGA_FaultA "FF_FF1_FPGA_FaultA" UWORD F_1_p0_4 1 2 0 65535 ECU_ADDRESS 0x7000A296 /end MEASUREMENT
/begin MEASUREMENT FF_FF1_FPGA_FaultB "FF_FF1_FPGA_FaultB" UWORD F_1_p0_4 1 2 0 65535 ECU_ADDRESS 0x7000A298 /end MEASUREMENT
/begin MEASUREMENT FF_FF1_FTModeReq "FF_FF1_FTModeReq" UWORD F_1_p0_4 1 2 0 65535 ECU_ADDRESS 0x7000A2A2 /end MEASUREMENT
/begin MEASUREMENT FF_FF1_FT_AclState "FF_FF1_FT_AclState" UWORD F_1_p0_4 1 2 0 65535 ECU_ADDRESS 0x7000A2A4 /end MEASUREMENT
/begin MEASUREMENT FF_FF1_GlbRealTimeDay "FF_FF1_GlbRealTimeDay" UBYTE F_1_p0_4 1 2 0 255 ECU_ADDRESS 0x7000A269 /end MEASUREMENT
/begin MEASUREMENT FF_FF1_GlbRealTimeHour "FF_FF1_GlbRealTimeHour" UBYTE F_1_p0_4 1 2 0 255 ECU_ADDRESS 0x7000A268 /end MEASUREMENT
/begin MEASUREMENT FF_FF1_GlbRealTimeMinute "FF_FF1_GlbRealTimeMinute" UBYTE F_1_p0_4 1 2 0 255 ECU_ADDRESS 0x7000A267 /end MEASUREMENT
/begin MEASUREMENT FF_FF1_GlbRealTimeMonth "FF_FF1_GlbRealTimeMonth" UBYTE F_1_p0_4 1 2 0 255 ECU_ADDRESS 0x7000A26A /end MEASUREMENT
/begin MEASUREMENT FF_FF1_GlbRealTimeSec "FF_FF1_GlbRealTimeSec" UBYTE F_1_p0_4 1 2 0 255 ECU_ADDRESS 0x7000A266 /end MEASUREMENT
/begin MEASUREMENT FF_FF1_GlbRealTimeYear "FF_FF1_GlbRealTimeYear" UBYTE F_1_p0_4 1 2 0 255 ECU_ADDRESS 0x7000A26B /end MEASUREMENT
/begin MEASUREMENT FF_FF1_HV_VoltageFild "FF_FF1_HV_VoltageFild" UWORD F_1_p0_4 1 2 0 65535 ECU_ADDRESS 0x7000A27A /end MEASUREMENT
/begin MEASUREMENT FF_FF1_I0dq3_1 "FF_FF1_I0dq3_1" UWORD F_1_p0_4 1 2 0 65535 ECU_ADDRESS 0x7000A2C4 /end MEASUREMENT
/begin MEASUREMENT FF_FF1_I0dq3_2 "FF_FF1_I0dq3_2" UWORD F_1_p0_4 1 2 0 65535 ECU_ADDRESS 0x7000A2C6 /end MEASUREMENT
/begin MEASUREMENT FF_FF1_IGBTStatus "FF_FF1_IGBTStatus" UBYTE F_1_p0_4 1 2 0 255 ECU_ADDRESS 0x7000A278 /end MEASUREMENT
/begin MEASUREMENT FF_FF1_IPUMode "FF_FF1_IPUMode" UBYTE F_1_p0_4 1 2 0 255 ECU_ADDRESS 0x7000A280 /end MEASUREMENT
/begin MEASUREMENT FF_FF1_ISGCurrentTorq "FF_FF1_ISGCurrentTorq" UWORD F_1_p0_4 1 2 0 65535 ECU_ADDRESS 0x7000A28E /end MEASUREMENT
/begin MEASUREMENT FF_FF1_IgnitionSwSig "FF_FF1_IgnitionSwSig" UBYTE F_1_p0_4 1 2 0 255 ECU_ADDRESS 0x7000A25C /end MEASUREMENT
/begin MEASUREMENT FF_FF1_Iu "FF_FF1_Iu" UWORD F_1_p0_4 1 2 0 65535 ECU_ADDRESS 0x7000A272 /end MEASUREMENT
/begin MEASUREMENT FF_FF1_Iv "FF_FF1_Iv" UWORD F_1_p0_4 1 2 0 65535 ECU_ADDRESS 0x7000A274 /end MEASUREMENT
/begin MEASUREMENT FF_FF1_Iw "FF_FF1_Iw" UWORD F_1_p0_4 1 2 0 65535 ECU_ADDRESS 0x7000A276 /end MEASUREMENT
/begin MEASUREMENT FF_FF1_MCU_HVBusVolt "FF_FF1_MCU_HVBusVolt" UWORD F_1_p0_4 1 2 0 65535 ECU_ADDRESS 0x7000A294 /end MEASUREMENT
/begin MEASUREMENT FF_FF1_MaxMinTorqueDrtVect "FF_FF1_MaxMinTorqueDrtVect" UWORD F_1_p0_4 1 2 0 65535 ECU_ADDRESS 0x7000A2B0 /end MEASUREMENT
/begin MEASUREMENT FF_FF1_MecaSpeedRpm "FF_FF1_MecaSpeedRpm" UWORD F_1_p0_4 1 2 0 65535 ECU_ADDRESS 0x7000A27E /end MEASUREMENT
/begin MEASUREMENT FF_FF1_MecaTorqueMaxMin "FF_FF1_MecaTorqueMaxMin" UWORD F_1_p0_4 1 2 0 65535 ECU_ADDRESS 0x7000A2A6 /end MEASUREMENT
/begin MEASUREMENT FF_FF1_MotTemp "FF_FF1_MotTemp" UBYTE F_1_p0_4 1 2 0 255 ECU_ADDRESS 0x7000A27C /end MEASUREMENT
/begin MEASUREMENT FF_FF1_ParkVoltageTgt "FF_FF1_ParkVoltageTgt" UWORD F_1_p0_4 1 2 0 65535 ECU_ADDRESS 0x7000A2B8 /end MEASUREMENT
/begin MEASUREMENT FF_FF1_RMS_Cur_U "FF_FF1_RMS_Cur_U" UWORD F_1_p0_4 1 2 0 65535 ECU_ADDRESS 0x7000A284 /end MEASUREMENT
/begin MEASUREMENT FF_FF1_RMS_Cur_V "FF_FF1_RMS_Cur_V" UWORD F_1_p0_4 1 2 0 65535 ECU_ADDRESS 0x7000A286 /end MEASUREMENT
/begin MEASUREMENT FF_FF1_RMS_Cur_W "FF_FF1_RMS_Cur_W" UWORD F_1_p0_4 1 2 0 65535 ECU_ADDRESS 0x7000A288 /end MEASUREMENT
/begin MEASUREMENT FF_FF1_ResolNext2ThetaRdByPi "FF_FF1_ResolNext2ThetaRdByPi" UWORD F_1_p0_4 1 2 0 65535 ECU_ADDRESS 0x7000A2B2 /end MEASUREMENT
/begin MEASUREMENT FF_FF1_RstStartUpCnt "FF_FF1_RstStartUpCnt" UWORD F_1_p0_4 1 2 0 65535 ECU_ADDRESS 0x7000A29A /end MEASUREMENT
/begin MEASUREMENT FF_FF1_SOC "FF_FF1_SOC" UBYTE F_1_p0_4 1 2 0 255 ECU_ADDRESS 0x7000A26F /end MEASUREMENT
/begin MEASUREMENT FF_FF1_SinScaled "FF_FF1_SinScaled" UWORD F_1_p0_4 1 2 0 65535 ECU_ADDRESS 0x7000A2A8 /end MEASUREMENT
/begin MEASUREMENT FF_FF1_TempCmdBoard "FF_FF1_TempCmdBoard" UBYTE F_1_p0_4 1 2 0 255 ECU_ADDRESS 0x7000A282 /end MEASUREMENT
/begin MEASUREMENT FF_FF1_TempCoolingFild "FF_FF1_TempCoolingFild" UBYTE F_1_p0_4 1 2 0 255 ECU_ADDRESS 0x7000A270 /end MEASUREMENT
/begin MEASUREMENT FF_FF1_TempDrvBoard "FF_FF1_TempDrvBoard" UWORD F_1_p0_4 1 2 0 65535 ECU_ADDRESS 0x7000A2C8 /end MEASUREMENT
/begin MEASUREMENT FF_FF1_TempIgbt "FF_FF1_TempIgbt" UWORD F_1_p0_4 1 2 0 65535 ECU_ADDRESS 0x7000A2CA /end MEASUREMENT
/begin MEASUREMENT FF_FF1_TimestampIgn "FF_FF1_TimestampIgn" UWORD F_1_p0_4 1 2 0 65535 ECU_ADDRESS 0x7000A29C /end MEASUREMENT
/begin MEASUREMENT FF_FF1_TimestampLife_H "FF_FF1_TimestampLife_H" UWORD F_1_p0_4 1 2 0 65535 ECU_ADDRESS 0x7000A29E /end MEASUREMENT
/begin MEASUREMENT FF_FF1_TimestampLife_L "FF_FF1_TimestampLife_L" UWORD F_1_p0_4 1 2 0 65535 ECU_ADDRESS 0x7000A2A0 /end MEASUREMENT
/begin MEASUREMENT FF_FF1_TotalMiles_H "FF_FF1_TotalMiles_H" UWORD F_1_p0_4 1 2 0 65535 ECU_ADDRESS 0x7000A260 /end MEASUREMENT
/begin MEASUREMENT FF_FF1_TotalMiles_L "FF_FF1_TotalMiles_L" UWORD F_1_p0_4 1 2 0 65535 ECU_ADDRESS 0x7000A262 /end MEASUREMENT
/begin MEASUREMENT FF_FF1_UM1dTgt "FF_FF1_UM1dTgt" UWORD F_1_p0_4 1 2 0 65535 ECU_ADDRESS 0x7000A2B4 /end MEASUREMENT
/begin MEASUREMENT FF_FF1_UM1qTgt "FF_FF1_UM1qTgt" UWORD F_1_p0_4 1 2 0 65535 ECU_ADDRESS 0x7000A2B6 /end MEASUREMENT
/begin MEASUREMENT FF_FF1_VCU_AllowTorq "FF_FF1_VCU_AllowTorq" UBYTE F_1_p0_4 1 2 0 255 ECU_ADDRESS 0x7000A290 /end MEASUREMENT
/begin MEASUREMENT FF_FF1_VCU_DCU_ModeReq "FF_FF1_VCU_DCU_ModeReq" UBYTE F_1_p0_4 1 2 0 255 ECU_ADDRESS 0x7000A281 /end MEASUREMENT
/begin MEASUREMENT FF_FF1_VCU_DCU_TorqSet "FF_FF1_VCU_DCU_TorqSet" UWORD F_1_p0_4 1 2 0 65535 ECU_ADDRESS 0x7000A28A /end MEASUREMENT
/begin MEASUREMENT FF_FF1_VehicleSpd "FF_FF1_VehicleSpd" UWORD F_1_p0_4 1 2 0 65535 ECU_ADDRESS 0x7000A264 /end MEASUREMENT
/begin MEASUREMENT FF_FF1_i0dqTgt3_1 "FF_FF1_i0dqTgt3_1" UWORD F_1_p0_4 1 2 0 65535 ECU_ADDRESS 0x7000A2C0 /end MEASUREMENT
/begin MEASUREMENT FF_FF1_i0dqTgt3_2 "FF_FF1_i0dqTgt3_2" UWORD F_1_p0_4 1 2 0 65535 ECU_ADDRESS 0x7000A2C2 /end MEASUREMENT
/begin MEASUREMENT FF_FF1_idCorTgt "FF_FF1_idCorTgt" UWORD F_1_p0_4 1 2 0 65535 ECU_ADDRESS 0x7000A2BE /end MEASUREMENT
/begin MEASUREMENT FF_FF1_idLutTgt "FF_FF1_idLutTgt" UWORD F_1_p0_4 1 2 0 65535 ECU_ADDRESS 0x7000A2BC /end MEASUREMENT
/begin MEASUREMENT FF_FF1_iqLutTgt "FF_FF1_iqLutTgt" UWORD F_1_p0_4 1 2 0 65535 ECU_ADDRESS 0x7000A2BA /end MEASUREMENT
/begin MEASUREMENT FRecord_u8ClearReq "..." UBYTE I_1 1 2 0 255 ECU_ADDRESS 0x7000A361 /end MEASUREMENT
/begin MEASUREMENT FRecord_u8EventWriteState "..." UBYTE I_1 1 2 0 255 ECU_ADDRESS 0x7000A35F /end MEASUREMENT
/begin MEASUREMENT FRecord_u8FRLockedStatus "..." UBYTE I_1 1 2 0 255 ECU_ADDRESS 0x7000A364 /end MEASUREMENT
/begin MEASUREMENT FRecord_u8FRStoreState "..." UBYTE I_1 1 2 0 255 ECU_ADDRESS 0x7000A35D /end MEASUREMENT
/begin MEASUREMENT FRecord_u8HeadWriteState "..." UBYTE I_1 1 2 0 255 ECU_ADDRESS 0x7000A35E /end MEASUREMENT
/begin MEASUREMENT FaultTCUCAP0_CAPPressureHAut "FaultTCUCAP0_CAPPressureHAut" UBYTE Bool_ON_OFF 1 2 0 1 BIT_MASK 0x01 ECU_ADDRESS 0x7000A17A /end MEASUREMENT
/begin MEASUREMENT FaultTCUCAP0_CAPPressureHDetected "FaultTCUCAP0_CAPPressureHDetected" UBYTE Bool_ON_OFF 1 2 0 1 BIT_MASK 0x01 ECU_ADDRESS 0x7000A1F2 /end MEASUREMENT
/begin MEASUREMENT FaultTCUCAP0_CAPPressureHLogged "FaultTCUCAP0_CAPPressureHLogged" UBYTE Bool_ON_OFF 1 2 0 1 BIT_MASK 0x01 ECU_ADDRESS 0x7000A1B6 /end MEASUREMENT
/begin MEASUREMENT FaultTCUCAP0_CAPPressureLAut "FaultTCUCAP0_CAPPressureLAut" UBYTE Bool_ON_OFF 1 2 0 1 BIT_MASK 0x02 ECU_ADDRESS 0x7000A17A /end MEASUREMENT
/begin MEASUREMENT FaultTCUCAP0_CAPPressureLDetected "FaultTCUCAP0_CAPPressureLDetected" UBYTE Bool_ON_OFF 1 2 0 1 BIT_MASK 0x02 ECU_ADDRESS 0x7000A1F2 /end MEASUREMENT
/begin MEASUREMENT FaultTCUCAP0_CAPPressureLLogged "FaultTCUCAP0_CAPPressureLLogged" UBYTE Bool_ON_OFF 1 2 0 1 BIT_MASK 0x02 ECU_ADDRESS 0x7000A1B6 /end MEASUREMENT
/begin MEASUREMENT FaultTCUCAP0_CAPPressureOverHAut "FaultTCUCAP0_CAPPressureOverHAut" UBYTE Bool_ON_OFF 1 2 0 1 BIT_MASK 0x04 ECU_ADDRESS 0x7000A17A /end MEASUREMENT
/begin MEASUREMENT FaultTCUCAP0_CAPPressureOverHDetected "FaultTCUCAP0_CAPPressureOverHDetected" UBYTE Bool_ON_OFF 1 2 0 1 BIT_MASK 0x04 ECU_ADDRESS 0x7000A1F2 /end MEASUREMENT
/begin MEASUREMENT FaultTCUCAP0_CAPPressureOverHLogged "FaultTCUCAP0_CAPPressureOverHLogged" UBYTE Bool_ON_OFF 1 2 0 1 BIT_MASK 0x04 ECU_ADDRESS 0x7000A1B6 /end MEASUREMENT
/begin MEASUREMENT FaultTCUCAP0_CAPSlipAut "FaultTCUCAP0_CAPSlipAut" UBYTE Bool_ON_OFF 1 2 0 1 BIT_MASK 0x08 ECU_ADDRESS 0x7000A17A /end MEASUREMENT
/begin MEASUREMENT FaultTCUCAP0_CAPSlipDetected "FaultTCUCAP0_CAPSlipDetected" UBYTE Bool_ON_OFF 1 2 0 1 BIT_MASK 0x08 ECU_ADDRESS 0x7000A1F2 /end MEASUREMENT
/begin MEASUREMENT FaultTCUCAP0_CAPSlipLogged "FaultTCUCAP0_CAPSlipLogged" UBYTE Bool_ON_OFF 1 2 0 1 BIT_MASK 0x08 ECU_ADDRESS 0x7000A1B6 /end MEASUREMENT
/begin MEASUREMENT FaultTCUCAP0_Detected "FaultTCUCAP0_Detected" UWORD I_1 1 2 0 65535 ECU_ADDRESS 0x7000A1F2 /end MEASUREMENT
/begin MEASUREMENT FaultTCUCAP0_DragMomentHAut "FaultTCUCAP0_DragMomentHAut" UBYTE Bool_ON_OFF 1 2 0 1 BIT_MASK 0x10 ECU_ADDRESS 0x7000A17A /end MEASUREMENT
/begin MEASUREMENT FaultTCUCAP0_DragMomentHDetected "FaultTCUCAP0_DragMomentHDetected" UBYTE Bool_ON_OFF 1 2 0 1 BIT_MASK 0x10 ECU_ADDRESS 0x7000A1F2 /end MEASUREMENT
/begin MEASUREMENT FaultTCUCAP0_DragMomentHLogged "FaultTCUCAP0_DragMomentHLogged" UBYTE Bool_ON_OFF 1 2 0 1 BIT_MASK 0x10 ECU_ADDRESS 0x7000A1B6 /end MEASUREMENT
/begin MEASUREMENT FaultTCUCAP0_HLSinInvalidAut "FaultTCUCAP0_HLSinInvalidAut" UBYTE Bool_ON_OFF 1 2 0 1 BIT_MASK 0x20 ECU_ADDRESS 0x7000A17A /end MEASUREMENT
/begin MEASUREMENT FaultTCUCAP0_HLSinInvalidDetected "FaultTCUCAP0_HLSinInvalidDetected" UBYTE Bool_ON_OFF 1 2 0 1 BIT_MASK 0x20 ECU_ADDRESS 0x7000A1F2 /end MEASUREMENT
/begin MEASUREMENT FaultTCUCAP0_HLSinInvalidLogged "FaultTCUCAP0_HLSinInvalidLogged" UBYTE Bool_ON_OFF 1 2 0 1 BIT_MASK 0x20 ECU_ADDRESS 0x7000A1B6 /end MEASUREMENT
/begin MEASUREMENT FaultTCUCAP0_HLSinUndefineAut "FaultTCUCAP0_HLSinUndefineAut" UBYTE Bool_ON_OFF 1 2 0 1 BIT_MASK 0x40 ECU_ADDRESS 0x7000A17A /end MEASUREMENT
/begin MEASUREMENT FaultTCUCAP0_HLSinUndefineDetected "FaultTCUCAP0_HLSinUndefineDetected" UBYTE Bool_ON_OFF 1 2 0 1 BIT_MASK 0x40 ECU_ADDRESS 0x7000A1F2 /end MEASUREMENT
/begin MEASUREMENT FaultTCUCAP0_HLSinUndefineLogged "FaultTCUCAP0_HLSinUndefineLogged" UBYTE Bool_ON_OFF 1 2 0 1 BIT_MASK 0x40 ECU_ADDRESS 0x7000A1B6 /end MEASUREMENT
/begin MEASUREMENT FaultTCUCAP0_HLSupplyHAut "FaultTCUCAP0_HLSupplyHAut" UBYTE Bool_ON_OFF 1 2 0 1 BIT_MASK 0x80 ECU_ADDRESS 0x7000A17A /end MEASUREMENT
/begin MEASUREMENT FaultTCUCAP0_HLSupplyHDetected "FaultTCUCAP0_HLSupplyHDetected" UBYTE Bool_ON_OFF 1 2 0 1 BIT_MASK 0x80 ECU_ADDRESS 0x7000A1F2 /end MEASUREMENT
/begin MEASUREMENT FaultTCUCAP0_HLSupplyHLogged "FaultTCUCAP0_HLSupplyHLogged" UBYTE Bool_ON_OFF 1 2 0 1 BIT_MASK 0x80 ECU_ADDRESS 0x7000A1B6 /end MEASUREMENT
/begin MEASUREMENT FaultTCUCAP0_HLSupplyLAut "FaultTCUCAP0_HLSupplyLAut" UBYTE Bool_ON_OFF 1 2 0 1 BIT_MASK 0x01 ECU_ADDRESS 0x7000A17B /end MEASUREMENT
/begin MEASUREMENT FaultTCUCAP0_HLSupplyLDetected "FaultTCUCAP0_HLSupplyLDetected" UBYTE Bool_ON_OFF 1 2 0 1 BIT_MASK 0x01 ECU_ADDRESS 0x7000A1F3 /end MEASUREMENT
/begin MEASUREMENT FaultTCUCAP0_HLSupplyLLogged "FaultTCUCAP0_HLSupplyLLogged" UBYTE Bool_ON_OFF 1 2 0 1 BIT_MASK 0x01 ECU_ADDRESS 0x7000A1B7 /end MEASUREMENT
/begin MEASUREMENT FaultTCUCAP0_Logged "FaultTCUCAP0_Logged" UWORD I_1 1 2 0 65535 ECU_ADDRESS 0x7000A1B6 /end MEASUREMENT
/begin MEASUREMENT FaultTCUCAP0_MotorPhaseVolHAut "FaultTCUCAP0_MotorPhaseVolHAut" UBYTE Bool_ON_OFF 1 2 0 1 BIT_MASK 0x02 ECU_ADDRESS 0x7000A17B /end MEASUREMENT
/begin MEASUREMENT FaultTCUCAP0_MotorPhaseVolHDetected "FaultTCUCAP0_MotorPhaseVolHDetected" UBYTE Bool_ON_OFF 1 2 0 1 BIT_MASK 0x02 ECU_ADDRESS 0x7000A1F3 /end MEASUREMENT
/begin MEASUREMENT FaultTCUCAP0_MotorPhaseVolHLogged "FaultTCUCAP0_MotorPhaseVolHLogged" UBYTE Bool_ON_OFF 1 2 0 1 BIT_MASK 0x02 ECU_ADDRESS 0x7000A1B7 /end MEASUREMENT
/begin MEASUREMENT FaultTCUCAP0_PressureRationalAut "FaultTCUCAP0_PressureRationalAut" UBYTE Bool_ON_OFF 1 2 0 1 BIT_MASK 0x04 ECU_ADDRESS 0x7000A17B /end MEASUREMENT
/begin MEASUREMENT FaultTCUCAP0_PressureRationalDetected "FaultTCUCAP0_PressureRationalDetected" UBYTE Bool_ON_OFF 1 2 0 1 BIT_MASK 0x04 ECU_ADDRESS 0x7000A1F3 /end MEASUREMENT
/begin MEASUREMENT FaultTCUCAP0_PressureRationalLogged "FaultTCUCAP0_PressureRationalLogged" UBYTE Bool_ON_OFF 1 2 0 1 BIT_MASK 0x04 ECU_ADDRESS 0x7000A1B7 /end MEASUREMENT
/begin MEASUREMENT FaultTCUCAP0_SenSigOpenOrGNDAut "FaultTCUCAP0_SenSigOpenOrGNDAut" UBYTE Bool_ON_OFF 1 2 0 1 BIT_MASK 0x08 ECU_ADDRESS 0x7000A17B /end MEASUREMENT
/begin MEASUREMENT FaultTCUCAP0_SenSigOpenOrGNDDetected "FaultTCUCAP0_SenSigOpenOrGNDDetected" UBYTE Bool_ON_OFF 1 2 0 1 BIT_MASK 0x08 ECU_ADDRESS 0x7000A1F3 /end MEASUREMENT
/begin MEASUREMENT FaultTCUCAP0_SenSigOpenOrGNDLogged "FaultTCUCAP0_SenSigOpenOrGNDLogged" UBYTE Bool_ON_OFF 1 2 0 1 BIT_MASK 0x08 ECU_ADDRESS 0x7000A1B7 /end MEASUREMENT
/begin MEASUREMENT FaultTCUCAP0_SenSigVCCAut "FaultTCUCAP0_SenSigVCCAut" UBYTE Bool_ON_OFF 1 2 0 1 BIT_MASK 0x10 ECU_ADDRESS 0x7000A17B /end MEASUREMENT
/begin MEASUREMENT FaultTCUCAP0_SenSigVCCDetected "FaultTCUCAP0_SenSigVCCDetected" UBYTE Bool_ON_OFF 1 2 0 1 BIT_MASK 0x10 ECU_ADDRESS 0x7000A1F3 /end MEASUREMENT
/begin MEASUREMENT FaultTCUCAP0_SenSigVCCLogged "FaultTCUCAP0_SenSigVCCLogged" UBYTE Bool_ON_OFF 1 2 0 1 BIT_MASK 0x10 ECU_ADDRESS 0x7000A1B7 /end MEASUREMENT
/begin MEASUREMENT FaultTCUCAP0_SensorPerforErrAut "FaultTCUCAP0_SensorPerforErrAut" UBYTE Bool_ON_OFF 1 2 0 1 BIT_MASK 0x20 ECU_ADDRESS 0x7000A17B /end MEASUREMENT
/begin MEASUREMENT FaultTCUCAP0_SensorPerforErrDetected "FaultTCUCAP0_SensorPerforErrDetected" UBYTE Bool_ON_OFF 1 2 0 1 BIT_MASK 0x20 ECU_ADDRESS 0x7000A1F3 /end MEASUREMENT
/begin MEASUREMENT FaultTCUCAP0_SensorPerforErrLogged "FaultTCUCAP0_SensorPerforErrLogged" UBYTE Bool_ON_OFF 1 2 0 1 BIT_MASK 0x20 ECU_ADDRESS 0x7000A1B7 /end MEASUREMENT
/begin MEASUREMENT FaultTCUCAP1_COM_GCUAut "FaultTCUCAP1_COM_GCUAut" UBYTE Bool_ON_OFF 1 2 0 1 BIT_MASK 0x01 ECU_ADDRESS 0x7000A17C /end MEASUREMENT
/begin MEASUREMENT FaultTCUCAP1_COM_GCUDetected "FaultTCUCAP1_COM_GCUDetected" UBYTE Bool_ON_OFF 1 2 0 1 BIT_MASK 0x01 ECU_ADDRESS 0x7000A1F4 /end MEASUREMENT
/begin MEASUREMENT FaultTCUCAP1_COM_GCULogged "FaultTCUCAP1_COM_GCULogged" UBYTE Bool_ON_OFF 1 2 0 1 BIT_MASK 0x01 ECU_ADDRESS 0x7000A1B8 /end MEASUREMENT
/begin MEASUREMENT FaultTCUCAP1_Detected "FaultTCUCAP1_Detected" UWORD I_1 1 2 0 65535 ECU_ADDRESS 0x7000A1F4 /end MEASUREMENT
/begin MEASUREMENT FaultTCUCAP1_DriverTempHAut "FaultTCUCAP1_DriverTempHAut" UBYTE Bool_ON_OFF 1 2 0 1 BIT_MASK 0x02 ECU_ADDRESS 0x7000A17C /end MEASUREMENT
/begin MEASUREMENT FaultTCUCAP1_DriverTempHDetected "FaultTCUCAP1_DriverTempHDetected" UBYTE Bool_ON_OFF 1 2 0 1 BIT_MASK 0x02 ECU_ADDRESS 0x7000A1F4 /end MEASUREMENT
/begin MEASUREMENT FaultTCUCAP1_DriverTempHLogged "FaultTCUCAP1_DriverTempHLogged" UBYTE Bool_ON_OFF 1 2 0 1 BIT_MASK 0x02 ECU_ADDRESS 0x7000A1B8 /end MEASUREMENT
/begin MEASUREMENT FaultTCUCAP1_FETShortAut "FaultTCUCAP1_FETShortAut" UBYTE Bool_ON_OFF 1 2 0 1 BIT_MASK 0x04 ECU_ADDRESS 0x7000A17C /end MEASUREMENT
/begin MEASUREMENT FaultTCUCAP1_FETShortDetected "FaultTCUCAP1_FETShortDetected" UBYTE Bool_ON_OFF 1 2 0 1 BIT_MASK 0x04 ECU_ADDRESS 0x7000A1F4 /end MEASUREMENT
/begin MEASUREMENT FaultTCUCAP1_FETShortLogged "FaultTCUCAP1_FETShortLogged" UBYTE Bool_ON_OFF 1 2 0 1 BIT_MASK 0x04 ECU_ADDRESS 0x7000A1B8 /end MEASUREMENT
/begin MEASUREMENT FaultTCUCAP1_HWOverCurAut "FaultTCUCAP1_HWOverCurAut" UBYTE Bool_ON_OFF 1 2 0 1 BIT_MASK 0x08 ECU_ADDRESS 0x7000A17C /end MEASUREMENT
/begin MEASUREMENT FaultTCUCAP1_HWOverCurDetected "FaultTCUCAP1_HWOverCurDetected" UBYTE Bool_ON_OFF 1 2 0 1 BIT_MASK 0x08 ECU_ADDRESS 0x7000A1F4 /end MEASUREMENT
/begin MEASUREMENT FaultTCUCAP1_HWOverCurLogged "FaultTCUCAP1_HWOverCurLogged" UBYTE Bool_ON_OFF 1 2 0 1 BIT_MASK 0x08 ECU_ADDRESS 0x7000A1B8 /end MEASUREMENT
/begin MEASUREMENT FaultTCUCAP1_Logged "FaultTCUCAP1_Logged" UWORD I_1 1 2 0 65535 ECU_ADDRESS 0x7000A1B8 /end MEASUREMENT
/begin MEASUREMENT FaultTCUCAP1_MotorPhaseDriveErrAut "FaultTCUCAP1_MotorPhaseDriveErrAut" UBYTE Bool_ON_OFF 1 2 0 1 BIT_MASK 0x10 ECU_ADDRESS 0x7000A17C /end MEASUREMENT
/begin MEASUREMENT FaultTCUCAP1_MotorPhaseDriveErrDetected "FaultTCUCAP1_MotorPhaseDriveErrDetected" UBYTE Bool_ON_OFF 1 2 0 1 BIT_MASK 0x10 ECU_ADDRESS 0x7000A1F4 /end MEASUREMENT
/begin MEASUREMENT FaultTCUCAP1_MotorPhaseDriveErrLogged "FaultTCUCAP1_MotorPhaseDriveErrLogged" UBYTE Bool_ON_OFF 1 2 0 1 BIT_MASK 0x10 ECU_ADDRESS 0x7000A1B8 /end MEASUREMENT
/begin MEASUREMENT FaultTCUCAP1_MotorStallAut "FaultTCUCAP1_MotorStallAut" UBYTE Bool_ON_OFF 1 2 0 1 BIT_MASK 0x20 ECU_ADDRESS 0x7000A17C /end MEASUREMENT
/begin MEASUREMENT FaultTCUCAP1_MotorStallDetected "FaultTCUCAP1_MotorStallDetected" UBYTE Bool_ON_OFF 1 2 0 1 BIT_MASK 0x20 ECU_ADDRESS 0x7000A1F4 /end MEASUREMENT
/begin MEASUREMENT FaultTCUCAP1_MotorStallLogged "FaultTCUCAP1_MotorStallLogged" UBYTE Bool_ON_OFF 1 2 0 1 BIT_MASK 0x20 ECU_ADDRESS 0x7000A1B8 /end MEASUREMENT
/begin MEASUREMENT FaultTCUCAP1_OverVoltageAut "FaultTCUCAP1_OverVoltageAut" UBYTE Bool_ON_OFF 1 2 0 1 BIT_MASK 0x40 ECU_ADDRESS 0x7000A17C /end MEASUREMENT
/begin MEASUREMENT FaultTCUCAP1_OverVoltageDetected "FaultTCUCAP1_OverVoltageDetected" UBYTE Bool_ON_OFF 1 2 0 1 BIT_MASK 0x40 ECU_ADDRESS 0x7000A1F4 /end MEASUREMENT
/begin MEASUREMENT FaultTCUCAP1_OverVoltageLogged "FaultTCUCAP1_OverVoltageLogged" UBYTE Bool_ON_OFF 1 2 0 1 BIT_MASK 0x40 ECU_ADDRESS 0x7000A1B8 /end MEASUREMENT
/begin MEASUREMENT FaultTCUCAP1_PhaseDetectGNDAut "FaultTCUCAP1_PhaseDetectGNDAut" UBYTE Bool_ON_OFF 1 2 0 1 BIT_MASK 0x80 ECU_ADDRESS 0x7000A17C /end MEASUREMENT
/begin MEASUREMENT FaultTCUCAP1_PhaseDetectGNDDetected "FaultTCUCAP1_PhaseDetectGNDDetected" UBYTE Bool_ON_OFF 1 2 0 1 BIT_MASK 0x80 ECU_ADDRESS 0x7000A1F4 /end MEASUREMENT
/begin MEASUREMENT FaultTCUCAP1_PhaseDetectGNDLogged "FaultTCUCAP1_PhaseDetectGNDLogged" UBYTE Bool_ON_OFF 1 2 0 1 BIT_MASK 0x80 ECU_ADDRESS 0x7000A1B8 /end MEASUREMENT
/begin MEASUREMENT FaultTCUCAP1_PhaseDetectVCCAut "FaultTCUCAP1_PhaseDetectVCCAut" UBYTE Bool_ON_OFF 1 2 0 1 BIT_MASK 0x01 ECU_ADDRESS 0x7000A17D /end MEASUREMENT
/begin MEASUREMENT FaultTCUCAP1_PhaseDetectVCCDetected "FaultTCUCAP1_PhaseDetectVCCDetected" UBYTE Bool_ON_OFF 1 2 0 1 BIT_MASK 0x01 ECU_ADDRESS 0x7000A1F5 /end MEASUREMENT
/begin MEASUREMENT FaultTCUCAP1_PhaseDetectVCCLogged "FaultTCUCAP1_PhaseDetectVCCLogged" UBYTE Bool_ON_OFF 1 2 0 1 BIT_MASK 0x01 ECU_ADDRESS 0x7000A1B9 /end MEASUREMENT
/begin MEASUREMENT FaultTCUCAP1_SWOverCurAut "FaultTCUCAP1_SWOverCurAut" UBYTE Bool_ON_OFF 1 2 0 1 BIT_MASK 0x02 ECU_ADDRESS 0x7000A17D /end MEASUREMENT
/begin MEASUREMENT FaultTCUCAP1_SWOverCurDetected "FaultTCUCAP1_SWOverCurDetected" UBYTE Bool_ON_OFF 1 2 0 1 BIT_MASK 0x02 ECU_ADDRESS 0x7000A1F5 /end MEASUREMENT
/begin MEASUREMENT FaultTCUCAP1_SWOverCurLogged "FaultTCUCAP1_SWOverCurLogged" UBYTE Bool_ON_OFF 1 2 0 1 BIT_MASK 0x02 ECU_ADDRESS 0x7000A1B9 /end MEASUREMENT
/begin MEASUREMENT FaultTCUCAP1_ThermalShutDownAut "FaultTCUCAP1_ThermalShutDownAut" UBYTE Bool_ON_OFF 1 2 0 1 BIT_MASK 0x04 ECU_ADDRESS 0x7000A17D /end MEASUREMENT
/begin MEASUREMENT FaultTCUCAP1_ThermalShutDownDetected "FaultTCUCAP1_ThermalShutDownDetected" UBYTE Bool_ON_OFF 1 2 0 1 BIT_MASK 0x04 ECU_ADDRESS 0x7000A1F5 /end MEASUREMENT
/begin MEASUREMENT FaultTCUCAP1_ThermalShutDownLogged "FaultTCUCAP1_ThermalShutDownLogged" UBYTE Bool_ON_OFF 1 2 0 1 BIT_MASK 0x04 ECU_ADDRESS 0x7000A1B9 /end MEASUREMENT
/begin MEASUREMENT FaultTCUCAP1_ThermalWarningAut "FaultTCUCAP1_ThermalWarningAut" UBYTE Bool_ON_OFF 1 2 0 1 BIT_MASK 0x08 ECU_ADDRESS 0x7000A17D /end MEASUREMENT
/begin MEASUREMENT FaultTCUCAP1_ThermalWarningDetected "FaultTCUCAP1_ThermalWarningDetected" UBYTE Bool_ON_OFF 1 2 0 1 BIT_MASK 0x08 ECU_ADDRESS 0x7000A1F5 /end MEASUREMENT
/begin MEASUREMENT FaultTCUCAP1_ThermalWarningLogged "FaultTCUCAP1_ThermalWarningLogged" UBYTE Bool_ON_OFF 1 2 0 1 BIT_MASK 0x08 ECU_ADDRESS 0x7000A1B9 /end MEASUREMENT
/begin MEASUREMENT FaultTCUCAP1_UnderVoltageAut "FaultTCUCAP1_UnderVoltageAut" UBYTE Bool_ON_OFF 1 2 0 1 BIT_MASK 0x10 ECU_ADDRESS 0x7000A17D /end MEASUREMENT
/begin MEASUREMENT FaultTCUCAP1_UnderVoltageDetected "FaultTCUCAP1_UnderVoltageDetected" UBYTE Bool_ON_OFF 1 2 0 1 BIT_MASK 0x10 ECU_ADDRESS 0x7000A1F5 /end MEASUREMENT
/begin MEASUREMENT FaultTCUCAP1_UnderVoltageLogged "FaultTCUCAP1_UnderVoltageLogged" UBYTE Bool_ON_OFF 1 2 0 1 BIT_MASK 0x10 ECU_ADDRESS 0x7000A1B9 /end MEASUREMENT
/begin MEASUREMENT FaultTCUCCP_Detected "FaultTCUCCP_Detected" UWORD I_1 1 2 0 65535 ECU_ADDRESS 0x7000A1F6 /end MEASUREMENT
/begin MEASUREMENT FaultTCUCCP_Logged "FaultTCUCCP_Logged" UWORD I_1 1 2 0 65535 ECU_ADDRESS 0x7000A1BA /end MEASUREMENT
/begin MEASUREMENT FaultTCUCCP_OilMotorRationalAut "FaultTCUCCP_OilMotorRationalAut" UBYTE Bool_ON_OFF 1 2 0 1 BIT_MASK 0x01 ECU_ADDRESS 0x7000A17E /end MEASUREMENT
/begin MEASUREMENT FaultTCUCCP_OilMotorRationalDetected "FaultTCUCCP_OilMotorRationalDetected" UBYTE Bool_ON_OFF 1 2 0 1 BIT_MASK 0x01 ECU_ADDRESS 0x7000A1F6 /end MEASUREMENT
/begin MEASUREMENT FaultTCUCCP_OilMotorRationalLogged "FaultTCUCCP_OilMotorRationalLogged" UBYTE Bool_ON_OFF 1 2 0 1 BIT_MASK 0x01 ECU_ADDRESS 0x7000A1BA /end MEASUREMENT
/begin MEASUREMENT FaultTCUCCP_OilMotorStallAut "FaultTCUCCP_OilMotorStallAut" UBYTE Bool_ON_OFF 1 2 0 1 BIT_MASK 0x02 ECU_ADDRESS 0x7000A17E /end MEASUREMENT
/begin MEASUREMENT FaultTCUCCP_OilMotorStallDetected "FaultTCUCCP_OilMotorStallDetected" UBYTE Bool_ON_OFF 1 2 0 1 BIT_MASK 0x02 ECU_ADDRESS 0x7000A1F6 /end MEASUREMENT
/begin MEASUREMENT FaultTCUCCP_OilMotorStallLogged "FaultTCUCCP_OilMotorStallLogged" UBYTE Bool_ON_OFF 1 2 0 1 BIT_MASK 0x02 ECU_ADDRESS 0x7000A1BA /end MEASUREMENT
/begin MEASUREMENT FaultTCUCCP_OilSenRationalL1Aut "FaultTCUCCP_OilSenRationalL1Aut" UBYTE Bool_ON_OFF 1 2 0 1 BIT_MASK 0x04 ECU_ADDRESS 0x7000A17E /end MEASUREMENT
/begin MEASUREMENT FaultTCUCCP_OilSenRationalL1Detected "FaultTCUCCP_OilSenRationalL1Detected" UBYTE Bool_ON_OFF 1 2 0 1 BIT_MASK 0x04 ECU_ADDRESS 0x7000A1F6 /end MEASUREMENT
/begin MEASUREMENT FaultTCUCCP_OilSenRationalL1Logged "FaultTCUCCP_OilSenRationalL1Logged" UBYTE Bool_ON_OFF 1 2 0 1 BIT_MASK 0x04 ECU_ADDRESS 0x7000A1BA /end MEASUREMENT
/begin MEASUREMENT FaultTCUCCP_OilSenRationalL2Aut "FaultTCUCCP_OilSenRationalL2Aut" UBYTE Bool_ON_OFF 1 2 0 1 BIT_MASK 0x08 ECU_ADDRESS 0x7000A17E /end MEASUREMENT
/begin MEASUREMENT FaultTCUCCP_OilSenRationalL2Detected "FaultTCUCCP_OilSenRationalL2Detected" UBYTE Bool_ON_OFF 1 2 0 1 BIT_MASK 0x08 ECU_ADDRESS 0x7000A1F6 /end MEASUREMENT
/begin MEASUREMENT FaultTCUCCP_OilSenRationalL2Logged "FaultTCUCCP_OilSenRationalL2Logged" UBYTE Bool_ON_OFF 1 2 0 1 BIT_MASK 0x08 ECU_ADDRESS 0x7000A1BA /end MEASUREMENT
/begin MEASUREMENT FaultTCUCCP_OilTempRationalHAut "FaultTCUCCP_OilTempRationalHAut" UBYTE Bool_ON_OFF 1 2 0 1 BIT_MASK 0x10 ECU_ADDRESS 0x7000A17E /end MEASUREMENT
/begin MEASUREMENT FaultTCUCCP_OilTempRationalHDetected "FaultTCUCCP_OilTempRationalHDetected" UBYTE Bool_ON_OFF 1 2 0 1 BIT_MASK 0x10 ECU_ADDRESS 0x7000A1F6 /end MEASUREMENT
/begin MEASUREMENT FaultTCUCCP_OilTempRationalHLogged "FaultTCUCCP_OilTempRationalHLogged" UBYTE Bool_ON_OFF 1 2 0 1 BIT_MASK 0x10 ECU_ADDRESS 0x7000A1BA /end MEASUREMENT
/begin MEASUREMENT FaultTCUCCP_OilTempRationalLAut "FaultTCUCCP_OilTempRationalLAut" UBYTE Bool_ON_OFF 1 2 0 1 BIT_MASK 0x20 ECU_ADDRESS 0x7000A17E /end MEASUREMENT
/begin MEASUREMENT FaultTCUCCP_OilTempRationalLDetected "FaultTCUCCP_OilTempRationalLDetected" UBYTE Bool_ON_OFF 1 2 0 1 BIT_MASK 0x20 ECU_ADDRESS 0x7000A1F6 /end MEASUREMENT
/begin MEASUREMENT FaultTCUCCP_OilTempRationalLLogged "FaultTCUCCP_OilTempRationalLLogged" UBYTE Bool_ON_OFF 1 2 0 1 BIT_MASK 0x20 ECU_ADDRESS 0x7000A1BA /end MEASUREMENT
/begin MEASUREMENT FaultTableFuncTypeCounter1[120] "FaultTableFuncTypeCounter1[120]" UBYTE I_1 1 2 0 255 ECU_ADDRESS 0x7000A270 /end MEASUREMENT
/begin MEASUREMENT FaultTableFuncTypeCounter1[121] "FaultTableFuncTypeCounter1[121]" UBYTE I_1 1 2 0 255 ECU_ADDRESS 0x7000A271 /end MEASUREMENT
/begin MEASUREMENT FaultTableFuncTypeCounter1[122] "FaultTableFuncTypeCounter1[122]" UBYTE I_1 1 2 0 255 ECU_ADDRESS 0x7000A272 /end MEASUREMENT
/begin MEASUREMENT FaultTableFuncTypeCounter1[123] "FaultTableFuncTypeCounter1[123]" UBYTE I_1 1 2 0 255 ECU_ADDRESS 0x7000A273 /end MEASUREMENT
/begin MEASUREMENT FaultTableFuncTypeCounter1[124] "FaultTableFuncTypeCounter1[124]" UBYTE I_1 1 2 0 255 ECU_ADDRESS 0x7000A274 /end MEASUREMENT
/begin MEASUREMENT FaultTableFuncTypeCounter1[125] "FaultTableFuncTypeCounter1[125]" UBYTE I_1 1 2 0 255 ECU_ADDRESS 0x7000A275 /end MEASUREMENT
/begin MEASUREMENT FaultTableFuncTypeCounter1[126] "FaultTableFuncTypeCounter1[126]" UBYTE I_1 1 2 0 255 ECU_ADDRESS 0x7000A276 /end MEASUREMENT
/begin MEASUREMENT FaultTableFuncTypeCounter1[127] "FaultTableFuncTypeCounter1[127]" UBYTE I_1 1 2 0 255 ECU_ADDRESS 0x7000A277 /end MEASUREMENT
/begin MEASUREMENT FaultTableFuncTypeCounter1[128] "FaultTableFuncTypeCounter1[128]" UBYTE I_1 1 2 0 255 ECU_ADDRESS 0x7000A278 /end MEASUREMENT
/begin MEASUREMENT FaultTableFuncTypeCounter1[129] "FaultTableFuncTypeCounter1[129]" UBYTE I_1 1 2 0 255 ECU_ADDRESS 0x7000A279 /end MEASUREMENT
/begin MEASUREMENT FaultTableFuncTypeCounter1[12] "FaultTableFuncTypeCounter1[12]" UBYTE I_1 1 2 0 255 ECU_ADDRESS 0x7000A204 /end MEASUREMENT
/begin MEASUREMENT FaultTableFuncTypeCounter1[130] "FaultTableFuncTypeCounter1[130]" UBYTE I_1 1 2 0 255 ECU_ADDRESS 0x7000A27A /end MEASUREMENT
/begin MEASUREMENT FaultTableFuncTypeCounter1[131] "FaultTableFuncTypeCounter1[131]" UBYTE I_1 1 2 0 255 ECU_ADDRESS 0x7000A27B /end MEASUREMENT
/begin MEASUREMENT FaultTableFuncTypeCounter1[132] "FaultTableFuncTypeCounter1[132]" UBYTE I_1 1 2 0 255 ECU_ADDRESS 0x7000A27C /end MEASUREMENT
/begin MEASUREMENT FaultTableFuncTypeCounter1[13] "FaultTableFuncTypeCounter1[13]" UBYTE I_1 1 2 0 255 ECU_ADDRESS 0x7000A205 /end MEASUREMENT
/begin MEASUREMENT FaultTableFuncTypeCounter1[14] "FaultTableFuncTypeCounter1[14]" UBYTE I_1 1 2 0 255 ECU_ADDRESS 0x7000A206 /end MEASUREMENT
/begin MEASUREMENT FaultTableFuncTypeCounter1[15] "FaultTableFuncTypeCounter1[15]" UBYTE I_1 1 2 0 255 ECU_ADDRESS 0x7000A207 /end MEASUREMENT
/begin MEASUREMENT FaultTableFuncTypeCounter1[16] "FaultTableFuncTypeCounter1[16]" UBYTE I_1 1 2 0 255 ECU_ADDRESS 0x7000A208 /end MEASUREMENT
/begin MEASUREMENT FaultTableFuncTypeCounter1[17] "FaultTableFuncTypeCounter1[17]" UBYTE I_1 1 2 0 255 ECU_ADDRESS 0x7000A209 /end MEASUREMENT
/begin MEASUREMENT FaultTableFuncTypeCounter1[18] "FaultTableFuncTypeCounter1[18]" UBYTE I_1 1 2 0 255 ECU_ADDRESS 0x7000A20A /end MEASUREMENT
/begin MEASUREMENT FaultTableFuncTypeCounter1[19] "FaultTableFuncTypeCounter1[19]" UBYTE I_1 1 2 0 255 ECU_ADDRESS 0x7000A20B /end MEASUREMENT
/begin MEASUREMENT FaultTableFuncTypeCounter1[1] "FaultTableFuncTypeCounter1[1]" UBYTE I_1 1 2 0 255 ECU_ADDRESS 0x7000A1F9 /end MEASUREMENT
/begin MEASUREMENT FaultTableFuncTypeCounter1[20] "FaultTableFuncTypeCounter1[20]" UBYTE I_1 1 2 0 255 ECU_ADDRESS 0x7000A20C /end MEASUREMENT
/begin MEASUREMENT FaultTableFuncTypeCounter1[21] "FaultTableFuncTypeCounter1[21]" UBYTE I_1 1 2 0 255 ECU_ADDRESS 0x7000A20D /end MEASUREMENT
/begin MEASUREMENT FaultTableFuncTypeCounter1[22] "FaultTableFuncTypeCounter1[22]" UBYTE I_1 1 2 0 255 ECU_ADDRESS 0x7000A20E /end MEASUREMENT
/begin MEASUREMENT FaultTableFuncTypeCounter1[23] "FaultTableFuncTypeCounter1[23]" UBYTE I_1 1 2 0 255 ECU_ADDRESS 0x7000A20F /end MEASUREMENT
/begin MEASUREMENT FaultTableFuncTypeCounter1[24] "FaultTableFuncTypeCounter1[24]" UBYTE I_1 1 2 0 255 ECU_ADDRESS 0x7000A210 /end MEASUREMENT
/begin MEASUREMENT FaultTableFuncTypeCounter1[25] "FaultTableFuncTypeCounter1[25]" UBYTE I_1 1 2 0 255 ECU_ADDRESS 0x7000A211 /end MEASUREMENT
/begin MEASUREMENT FaultTableFuncTypeCounter1[26] "FaultTableFuncTypeCounter1[26]" UBYTE I_1 1 2 0 255 ECU_ADDRESS 0x7000A212 /end MEASUREMENT
/begin MEASUREMENT FaultTableFuncTypeCounter1[27] "FaultTableFuncTypeCounter1[27]" UBYTE I_1 1 2 0 255 ECU_ADDRESS 0x7000A213 /end MEASUREMENT
/begin MEASUREMENT FaultTableFuncTypeCounter1[28] "FaultTableFuncTypeCounter1[28]" UBYTE I_1 1 2 0 255 ECU_ADDRESS 0x7000A214 /end MEASUREMENT
/begin MEASUREMENT FaultTableFuncTypeCounter1[29] "FaultTableFuncTypeCounter1[29]" UBYTE I_1 1 2 0 255 ECU_ADDRESS 0x7000A215 /end MEASUREMENT
/begin MEASUREMENT FaultTableFuncTypeCounter1[2] "FaultTableFuncTypeCounter1[2]" UBYTE I_1 1 2 0 255 ECU_ADDRESS 0x7000A1FA /end MEASUREMENT
/begin MEASUREMENT FaultTableFuncTypeCounter1[30] "FaultTableFuncTypeCounter1[30]" UBYTE I_1 1 2 0 255 ECU_ADDRESS 0x7000A216 /end MEASUREMENT
/begin MEASUREMENT FaultTableFuncTypeCounter1[31] "FaultTableFuncTypeCounter1[31]" UBYTE I_1 1 2 0 255 ECU_ADDRESS 0x7000A217 /end MEASUREMENT
/begin MEASUREMENT FaultTableFuncTypeCounter1[32] "FaultTableFuncTypeCounter1[32]" UBYTE I_1 1 2 0 255 ECU_ADDRESS 0x7000A218 /end MEASUREMENT
/begin MEASUREMENT FaultTableFuncTypeCounter1[33] "FaultTableFuncTypeCounter1[33]" UBYTE I_1 1 2 0 255 ECU_ADDRESS 0x7000A219 /end MEASUREMENT
/begin MEASUREMENT FaultTableFuncTypeCounter1[34] "FaultTableFuncTypeCounter1[34]" UBYTE I_1 1 2 0 255 ECU_ADDRESS 0x7000A21A /end MEASUREMENT
/begin MEASUREMENT FaultTableFuncTypeCounter1[35] "FaultTableFuncTypeCounter1[35]" UBYTE I_1 1 2 0 255 ECU_ADDRESS 0x7000A21B /end MEASUREMENT
/begin MEASUREMENT FaultTableFuncTypeCounter1[36] "FaultTableFuncTypeCounter1[36]" UBYTE I_1 1 2 0 255 ECU_ADDRESS 0x7000A21C /end MEASUREMENT
/begin MEASUREMENT FaultTableFuncTypeCounter1[37] "FaultTableFuncTypeCounter1[37]" UBYTE I_1 1 2 0 255 ECU_ADDRESS 0x7000A21D /end MEASUREMENT
/begin MEASUREMENT FaultTableFuncTypeCounter1[38] "FaultTableFuncTypeCounter1[38]" UBYTE I_1 1 2 0 255 ECU_ADDRESS 0x7000A21E /end MEASUREMENT
/begin MEASUREMENT FaultTableFuncTypeCounter1[39] "FaultTableFuncTypeCounter1[39]" UBYTE I_1 1 2 0 255 ECU_ADDRESS 0x7000A21F /end MEASUREMENT
/begin MEASUREMENT FaultTableFuncTypeCounter1[3] "FaultTableFuncTypeCounter1[3]" UBYTE I_1 1 2 0 255 ECU_ADDRESS 0x7000A1FB /end MEASUREMENT
/begin MEASUREMENT FaultTableFuncTypeCounter1[40] "FaultTableFuncTypeCounter1[40]" UBYTE I_1 1 2 0 255 ECU_ADDRESS 0x7000A220 /end MEASUREMENT
/begin MEASUREMENT FaultTableFuncTypeCounter1[41] "FaultTableFuncTypeCounter1[41]" UBYTE I_1 1 2 0 255 ECU_ADDRESS 0x7000A221 /end MEASUREMENT
/begin MEASUREMENT FaultTableFuncTypeCounter1[42] "FaultTableFuncTypeCounter1[42]" UBYTE I_1 1 2 0 255 ECU_ADDRESS 0x7000A222 /end MEASUREMENT
/begin MEASUREMENT FaultTableFuncTypeCounter1[43] "FaultTableFuncTypeCounter1[43]" UBYTE I_1 1 2 0 255 ECU_ADDRESS 0x7000A223 /end MEASUREMENT
/begin MEASUREMENT FaultTableFuncTypeCounter1[44] "FaultTableFuncTypeCounter1[44]" UBYTE I_1 1 2 0 255 ECU_ADDRESS 0x7000A224 /end MEASUREMENT
/begin MEASUREMENT FaultTableFuncTypeCounter1[45] "FaultTableFuncTypeCounter1[45]" UBYTE I_1 1 2 0 255 ECU_ADDRESS 0x7000A225 /end MEASUREMENT
/begin MEASUREMENT FaultTableFuncTypeCounter1[46] "FaultTableFuncTypeCounter1[46]" UBYTE I_1 1 2 0 255 ECU_ADDRESS 0x7000A226 /end MEASUREMENT
/begin MEASUREMENT FaultTableFuncTypeCounter1[47] "FaultTableFuncTypeCounter1[47]" UBYTE I_1 1 2 0 255 ECU_ADDRESS 0x7000A227 /end MEASUREMENT
/begin MEASUREMENT FaultTableFuncTypeCounter1[48] "FaultTableFuncTypeCounter1[48]" UBYTE I_1 1 2 0 255 ECU_ADDRESS 0x7000A228 /end MEASUREMENT
/begin MEASUREMENT FaultTableFuncTypeCounter1[49] "FaultTableFuncTypeCounter1[49]" UBYTE I_1 1 2 0 255 ECU_ADDRESS 0x7000A229 /end MEASUREMENT
/begin MEASUREMENT FaultTableFuncTypeCounter1[4] "FaultTableFuncTypeCounter1[4]" UBYTE I_1 1 2 0 255 ECU_ADDRESS 0x7000A1FC /end MEASUREMENT
/begin MEASUREMENT FaultTableFuncTypeCounter1[50] "FaultTableFuncTypeCounter1[50]" UBYTE I_1 1 2 0 255 ECU_ADDRESS 0x7000A22A /end MEASUREMENT
/begin MEASUREMENT FaultTableFuncTypeCounter1[51] "FaultTableFuncTypeCounter1[51]" UBYTE I_1 1 2 0 255 ECU_ADDRESS 0x7000A22B /end MEASUREMENT
/begin MEASUREMENT FaultTableFuncTypeCounter1[52] "FaultTableFuncTypeCounter1[52]" UBYTE I_1 1 2 0 255 ECU_ADDRESS 0x7000A22C /end MEASUREMENT
/begin MEASUREMENT FaultTableFuncTypeCounter1[53] "FaultTableFuncTypeCounter1[53]" UBYTE I_1 1 2 0 255 ECU_ADDRESS 0x7000A22D /end MEASUREMENT
/begin MEASUREMENT FaultTableFuncTypeCounter1[54] "FaultTableFuncTypeCounter1[54]" UBYTE I_1 1 2 0 255 ECU_ADDRESS 0x7000A22E /end MEASUREMENT
/begin MEASUREMENT FaultTableFuncTypeCounter1[55] "FaultTableFuncTypeCounter1[55]" UBYTE I_1 1 2 0 255 ECU_ADDRESS 0x7000A22F /end MEASUREMENT
/begin MEASUREMENT FaultTableFuncTypeCounter1[56] "FaultTableFuncTypeCounter1[56]" UBYTE I_1 1 2 0 255 ECU_ADDRESS 0x7000A230 /end MEASUREMENT
/begin MEASUREMENT FaultTableFuncTypeCounter1[57] "FaultTableFuncTypeCounter1[57]" UBYTE I_1 1 2 0 255 ECU_ADDRESS 0x7000A231 /end MEASUREMENT
/begin MEASUREMENT FaultTableFuncTypeCounter1[58] "FaultTableFuncTypeCounter1[58]" UBYTE I_1 1 2 0 255 ECU_ADDRESS 0x7000A232 /end MEASUREMENT
/begin MEASUREMENT FaultTableFuncTypeCounter1[59] "FaultTableFuncTypeCounter1[59]" UBYTE I_1 1 2 0 255 ECU_ADDRESS 0x7000A233 /end MEASUREMENT
/begin MEASUREMENT FaultTableFuncTypeCounter1[5] "FaultTableFuncTypeCounter1[5]" UBYTE I_1 1 2 0 255 ECU_ADDRESS 0x7000A1FD /end MEASUREMENT
/begin MEASUREMENT FaultTableFuncTypeCounter1[60] "FaultTableFuncTypeCounter1[60]" UBYTE I_1 1 2 0 255 ECU_ADDRESS 0x7000A234 /end MEASUREMENT
/begin MEASUREMENT FaultTableFuncTypeCounter1[61] "FaultTableFuncTypeCounter1[61]" UBYTE I_1 1 2 0 255 ECU_ADDRESS 0x7000A235 /end MEASUREMENT
/begin MEASUREMENT FaultTableFuncTypeCounter1[62] "FaultTableFuncTypeCounter1[62]" UBYTE I_1 1 2 0 255 ECU_ADDRESS 0x7000A236 /end MEASUREMENT
/begin MEASUREMENT FaultTableFuncTypeCounter1[63] "FaultTableFuncTypeCounter1[63]" UBYTE I_1 1 2 0 255 ECU_ADDRESS 0x7000A237 /end MEASUREMENT
/begin MEASUREMENT FaultTableFuncTypeCounter1[64] "FaultTableFuncTypeCounter1[64]" UBYTE I_1 1 2 0 255 ECU_ADDRESS 0x7000A238 /end MEASUREMENT
/begin MEASUREMENT FaultTableFuncTypeCounter1[65] "FaultTableFuncTypeCounter1[65]" UBYTE I_1 1 2 0 255 ECU_ADDRESS 0x7000A239 /end MEASUREMENT
/begin MEASUREMENT FaultTableFuncTypeCounter1[66] "FaultTableFuncTypeCounter1[66]" UBYTE I_1 1 2 0 255 ECU_ADDRESS 0x7000A23A /end MEASUREMENT
/begin MEASUREMENT FaultTableFuncTypeCounter1[67] "FaultTableFuncTypeCounter1[67]" UBYTE I_1 1 2 0 255 ECU_ADDRESS 0x7000A23B /end MEASUREMENT
/begin MEASUREMENT FaultTableFuncTypeCounter1[68] "FaultTableFuncTypeCounter1[68]" UBYTE I_1 1 2 0 255 ECU_ADDRESS 0x7000A23C /end MEASUREMENT
/begin MEASUREMENT FaultTableFuncTypeCounter1[69] "FaultTableFuncTypeCounter1[69]" UBYTE I_1 1 2 0 255 ECU_ADDRESS 0x7000A23D /end MEASUREMENT
/begin MEASUREMENT FaultTableFuncTypeCounter1[6] "FaultTableFuncTypeCounter1[6]" UBYTE I_1 1 2 0 255 ECU_ADDRESS 0x7000A1FE /end MEASUREMENT
/begin MEASUREMENT FaultTableFuncTypeCounter1[70] "FaultTableFuncTypeCounter1[70]" UBYTE I_1 1 2 0 255 ECU_ADDRESS 0x7000A23E /end MEASUREMENT
/begin MEASUREMENT FaultTableFuncTypeCounter1[71] "FaultTableFuncTypeCounter1[71]" UBYTE I_1 1 2 0 255 ECU_ADDRESS 0x7000A23F /end MEASUREMENT
/begin MEASUREMENT FaultTableFuncTypeCounter1[72] "FaultTableFuncTypeCounter1[72]" UBYTE I_1 1 2 0 255 ECU_ADDRESS 0x7000A240 /end MEASUREMENT
/begin MEASUREMENT FaultTableFuncTypeCounter1[73] "FaultTableFuncTypeCounter1[73]" UBYTE I_1 1 2 0 255 ECU_ADDRESS 0x7000A241 /end MEASUREMENT
/begin MEASUREMENT FaultTableFuncTypeCounter1[74] "FaultTableFuncTypeCounter1[74]" UBYTE I_1 1 2 0 255 ECU_ADDRESS 0x7000A242 /end MEASUREMENT
/begin MEASUREMENT FaultTableFuncTypeCounter1[75] "FaultTableFuncTypeCounter1[75]" UBYTE I_1 1 2 0 255 ECU_ADDRESS 0x7000A243 /end MEASUREMENT
/begin MEASUREMENT FaultTableFuncTypeCounter1[76] "FaultTableFuncTypeCounter1[76]" UBYTE I_1 1 2 0 255 ECU_ADDRESS 0x7000A244 /end MEASUREMENT
/begin MEASUREMENT FaultTableFuncTypeCounter1[77] "FaultTableFuncTypeCounter1[77]" UBYTE I_1 1 2 0 255 ECU_ADDRESS 0x7000A245 /end MEASUREMENT
/begin MEASUREMENT FaultTableFuncTypeCounter1[78] "FaultTableFuncTypeCounter1[78]" UBYTE I_1 1 2 0 255 ECU_ADDRESS 0x7000A246 /end MEASUREMENT
/begin MEASUREMENT FaultTableFuncTypeCounter1[79] "FaultTableFuncTypeCounter1[79]" UBYTE I_1 1 2 0 255 ECU_ADDRESS 0x7000A247 /end MEASUREMENT
/begin MEASUREMENT FaultTableFuncTypeCounter1[7] "FaultTableFuncTypeCounter1[7]" UBYTE I_1 1 2 0 255 ECU_ADDRESS 0x7000A1FF /end MEASUREMENT
/begin MEASUREMENT FaultTableFuncTypeCounter1[80] "FaultTableFuncTypeCounter1[80]" UBYTE I_1 1 2 0 255 ECU_ADDRESS 0x7000A248 /end MEASUREMENT
/begin MEASUREMENT FaultTableFuncTypeCounter1[81] "FaultTableFuncTypeCounter1[81]" UBYTE I_1 1 2 0 255 ECU_ADDRESS 0x7000A249 /end MEASUREMENT
/begin MEASUREMENT FaultTableFuncTypeCounter1[82] "FaultTableFuncTypeCounter1[82]" UBYTE I_1 1 2 0 255 ECU_ADDRESS 0x7000A24A /end MEASUREMENT
/begin MEASUREMENT FaultTableFuncTypeCounter1[83] "FaultTableFuncTypeCounter1[83]" UBYTE I_1 1 2 0 255 ECU_ADDRESS 0x7000A24B /end MEASUREMENT
/begin MEASUREMENT FaultTableFuncTypeCounter1[84] "FaultTableFuncTypeCounter1[84]" UBYTE I_1 1 2 0 255 ECU_ADDRESS 0x7000A24C /end MEASUREMENT
/begin MEASUREMENT FaultTableFuncTypeCounter1[85] "FaultTableFuncTypeCounter1[85]" UBYTE I_1 1 2 0 255 ECU_ADDRESS 0x7000A24D /end MEASUREMENT
/begin MEASUREMENT FaultTableFuncTypeCounter1[86] "FaultTableFuncTypeCounter1[86]" UBYTE I_1 1 2 0 255 ECU_ADDRESS 0x7000A24E /end MEASUREMENT
/begin MEASUREMENT FaultTableFuncTypeCounter1[87] "FaultTableFuncTypeCounter1[87]" UBYTE I_1 1 2 0 255 ECU_ADDRESS 0x7000A24F /end MEASUREMENT
/begin MEASUREMENT FaultTableFuncTypeCounter1[88] "FaultTableFuncTypeCounter1[88]" UBYTE I_1 1 2 0 255 ECU_ADDRESS 0x7000A250 /end MEASUREMENT
/begin MEASUREMENT FaultTableFuncTypeCounter1[89] "FaultTableFuncTypeCounter1[89]" UBYTE I_1 1 2 0 255 ECU_ADDRESS 0x7000A251 /end MEASUREMENT
/begin MEASUREMENT FaultTableFuncTypeCounter1[8] "FaultTableFuncTypeCounter1[8]" UBYTE I_1 1 2 0 255 ECU_ADDRESS 0x7000A200 /end MEASUREMENT
/begin MEASUREMENT FaultTableFuncTypeCounter1[90] "FaultTableFuncTypeCounter1[90]" UBYTE I_1 1 2 0 255 ECU_ADDRESS 0x7000A252 /end MEASUREMENT
/begin MEASUREMENT FaultTableFuncTypeCounter1[91] "FaultTableFuncTypeCounter1[91]" UBYTE I_1 1 2 0 255 ECU_ADDRESS 0x7000A253 /end MEASUREMENT
/begin MEASUREMENT FaultTableFuncTypeCounter1[92] "FaultTableFuncTypeCounter1[92]" UBYTE I_1 1 2 0 255 ECU_ADDRESS 0x7000A254 /end MEASUREMENT
/begin MEASUREMENT FaultTableFuncTypeCounter1[93] "FaultTableFuncTypeCounter1[93]" UBYTE I_1 1 2 0 255 ECU_ADDRESS 0x7000A255 /end MEASUREMENT
/begin MEASUREMENT FaultTableFuncTypeCounter1[94] "FaultTableFuncTypeCounter1[94]" UBYTE I_1 1 2 0 255 ECU_ADDRESS 0x7000A256 /end MEASUREMENT
/begin MEASUREMENT FaultTableFuncTypeCounter1[95] "FaultTableFuncTypeCounter1[95]" UBYTE I_1 1 2 0 255 ECU_ADDRESS 0x7000A257 /end MEASUREMENT
/begin MEASUREMENT FaultTableFuncTypeCounter1[96] "FaultTableFuncTypeCounter1[96]" UBYTE I_1 1 2 0 255 ECU_ADDRESS 0x7000A258 /end MEASUREMENT
/begin MEASUREMENT FaultTableFuncTypeCounter1[97] "FaultTableFuncTypeCounter1[97]" UBYTE I_1 1 2 0 255 ECU_ADDRESS 0x7000A259 /end MEASUREMENT
/begin MEASUREMENT FaultTableFuncTypeCounter1[98] "FaultTableFuncTypeCounter1[98]" UBYTE I_1 1 2 0 255 ECU_ADDRESS 0x7000A25A /end MEASUREMENT
/begin MEASUREMENT FaultTableFuncTypeCounter1[99] "FaultTableFuncTypeCounter1[99]" UBYTE I_1 1 2 0 255 ECU_ADDRESS 0x7000A25B /end MEASUREMENT
/begin MEASUREMENT FaultTableFuncTypeCounter1[9] "FaultTableFuncTypeCounter1[9]" UBYTE I_1 1 2 0 255 ECU_ADDRESS 0x7000A201 /end MEASUREMENT
/begin MEASUREMENT Frecord_bFaultRecoverPermission "..." UBYTE Bool_ON_OFF 1 2 0 1 BIT_MASK 0x01 ECU_ADDRESS 0x7000A362 /end MEASUREMENT
/begin MEASUREMENT HARD_ESM_FT_STATE_FT_SHUTDOWN "HARD_ESM_FT_STATE_FT_SHUTDOWN" UBYTE Bool_ON_OFF 1 2 0 1 BIT_MASK 0x08 ECU_ADDRESS 0x7001643A /end MEASUREMENT
/begin MEASUREMENT HARD_ESM_FT_STATE_IDLE "HARD_ESM_FT_STATE_IDLE" UBYTE Bool_ON_OFF 1 2 0 1 BIT_MASK 0x40 ECU_ADDRESS 0x7001643A /end MEASUREMENT
/begin MEASUREMENT HARD_ESM_FT_STATE_PWM_DIRECT "HARD_ESM_FT_STATE_PWM_DIRECT" UBYTE Bool_ON_OFF 1 2 0 1 BIT_MASK 0x01 ECU_ADDRESS 0x7001643A /end MEASUREMENT
/begin MEASUREMENT HARD_ESM_FT_STATE_PWM_HARD "HARD_ESM_FT_STATE_PWM_HARD" UBYTE Bool_ON_OFF 1 2 0 1 BIT_MASK 0x02 ECU_ADDRESS 0x7001643A /end MEASUREMENT
/begin MEASUREMENT HARD_ESM_FT_STATE_PWM_OFF "HARD_ESM_FT_STATE_PWM_OFF" UBYTE Bool_ON_OFF 1 2 0 1 BIT_MASK 0x04 ECU_ADDRESS 0x7001643A /end MEASUREMENT
/begin MEASUREMENT HARD_ESM_NF_STATE_FT_START "HARD_ESM_NF_STATE_FT_START" UBYTE Bool_ON_OFF 1 2 0 1 BIT_MASK 0x01 ECU_ADDRESS 0x70016438 /end MEASUREMENT
/begin MEASUREMENT HARD_ESM_NF_STATE_IDLE "HARD_ESM_NF_STATE_IDLE" UBYTE Bool_ON_OFF 1 2 0 1 BIT_MASK 0x40 ECU_ADDRESS 0x70016438 /end MEASUREMENT
/begin MEASUREMENT HARD_ESM_NF_STATE_PWM_HARD "HARD_ESM_NF_STATE_PWM_HARD" UBYTE Bool_ON_OFF 1 2 0 1 BIT_MASK 0x08 ECU_ADDRESS 0x70016438 /end MEASUREMENT
/begin MEASUREMENT HARD_ESM_NF_STATE_PWM_OFF "HARD_ESM_NF_STATE_PWM_OFF" UBYTE Bool_ON_OFF 1 2 0 1 BIT_MASK 0x10 ECU_ADDRESS 0x70016438 /end MEASUREMENT
/begin MEASUREMENT HARD_ESM_NF_STATE_SW_SHUTDOWN "HARD_ESM_NF_STATE_SW_SHUTDOWN" UBYTE Bool_ON_OFF 1 2 0 1 BIT_MASK 0x04 ECU_ADDRESS 0x70016438 /end MEASUREMENT
/begin MEASUREMENT HARD_EsmFtState "HARD_EsmFtState" UWORD HARD_EsmFtState_conv 1 2 1 64 ECU_ADDRESS 0x7001643A /end MEASUREMENT
/begin MEASUREMENT HARD_EsmFtStateAut "HARD_EsmFtStateAut" UBYTE Bool_ON_OFF 1 2 0 1 BIT_MASK 0x01 ECU_ADDRESS 0x700163FD /end MEASUREMENT
/begin MEASUREMENT HARD_EsmNfState "HARD_EsmNfState" UWORD HARD_EsmNfState_conv 1 2 1 64 ECU_ADDRESS 0x70016438 /end MEASUREMENT
/begin MEASUREMENT HARD_EsmNfStateAut "HARD_EsmNfStateAut" UBYTE Bool_ON_OFF 1 2 0 1 BIT_MASK 0x01 ECU_ADDRESS 0x700163FC /end MEASUREMENT
/begin MEASUREMENT HARD_PTG_CONTINUOUS_MODE "HARD_PTG_CONTINUOUS_MODE" UBYTE Bool_ON_OFF 1 2 0 1 BIT_MASK 0x10 ECU_ADDRESS 0x70016436 /end MEASUREMENT
/begin MEASUREMENT HARD_PTG_DISJUNCTION_MODE "HARD_PTG_DISJUNCTION_MODE" UBYTE Bool_ON_OFF 1 2 0 1 BIT_MASK 0x40 ECU_ADDRESS 0x70016436 /end MEASUREMENT
/begin MEASUREMENT HARD_PTG_LOOP_NB_MODE "HARD_PTG_LOOP_NB_MODE" UBYTE Bool_ON_OFF 1 2 0 1 BIT_MASK 0x80 ECU_ADDRESS 0x70016436 /end MEASUREMENT
/begin MEASUREMENT HARD_PTG_PROFIL_MODE "HARD_PTG_PROFIL_MODE" UBYTE Bool_ON_OFF 1 2 0 1 BIT_MASK 0x20 ECU_ADDRESS 0x70016436 /end MEASUREMENT
/begin MEASUREMENT HARD_PTG_PULSE_MODE "HARD_PTG_PULSE_MODE" UBYTE Bool_ON_OFF 1 2 0 1 BIT_MASK 0x01 ECU_ADDRESS 0x70016436 /end MEASUREMENT
/begin MEASUREMENT HARD_PTG_SINUS_MODE "HARD_PTG_SINUS_MODE" UBYTE Bool_ON_OFF 1 2 0 1 BIT_MASK 0x02 ECU_ADDRESS 0x70016436 /end MEASUREMENT
/begin MEASUREMENT HARD_PTG_SQUARE_MODE "HARD_PTG_SQUARE_MODE" UBYTE Bool_ON_OFF 1 2 0 1 BIT_MASK 0x08 ECU_ADDRESS 0x70016436 /end MEASUREMENT
/begin MEASUREMENT HARD_PTG_TRIANGLE_MODE "HARD_PTG_TRIANGLE_MODE" UBYTE Bool_ON_OFF 1 2 0 1 BIT_MASK 0x04 ECU_ADDRESS 0x70016436 /end MEASUREMENT
/begin MEASUREMENT HARD_PtgModeTest "HARD_PtgModeTest" UWORD HARD_PtgModeTest_conv 1 2 1 128 ECU_ADDRESS 0x70016436 /end MEASUREMENT
/begin MEASUREMENT HARD_bDio_M_AD2S_DOS "HARD_bDio_M_AD2S_DOS" UBYTE Bool_ON_OFF 1 2 0 1 BIT_MASK 0x01 ECU_ADDRESS 0x70016435 /end MEASUREMENT
/begin MEASUREMENT HARD_bDio_M_AD2S_LOT "HARD_bDio_M_AD2S_LOT" UBYTE Bool_ON_OFF 1 2 0 1 BIT_MASK 0x01 ECU_ADDRESS 0x70016434 /end MEASUREMENT
/begin MEASUREMENT HARD_bDio_M_ADUM_ENABLE_N "HARD_bDio_M_ADUM_ENABLE_N" UBYTE Bool_ON_OFF 1 2 0 1 BIT_MASK 0x01 ECU_ADDRESS 0x70016433 /end MEASUREMENT
/begin MEASUREMENT HARD_bDio_M_CPLD_ASC_STATE "HARD_bDio_M_CPLD_ASC_STATE" UBYTE Bool_ON_OFF 1 2 0 1 BIT_MASK 0x01 ECU_ADDRESS 0x70016432 /end MEASUREMENT
/begin MEASUREMENT HARD_bDio_M_DBG_1 "HARD_bDio_M_DBG_1" UBYTE Bool_ON_OFF 1 2 0 1 BIT_MASK 0x01 ECU_ADDRESS 0x70016431 /end MEASUREMENT
/begin MEASUREMENT HARD_bDio_M_DBG_4 "HARD_bDio_M_DBG_4" UBYTE Bool_ON_OFF 1 2 0 1 BIT_MASK 0x01 ECU_ADDRESS 0x70016430 /end MEASUREMENT
/begin MEASUREMENT HARD_bDio_M_DIAG_EXC "HARD_bDio_M_DIAG_EXC" UBYTE Bool_ON_OFF 1 2 0 1 BIT_MASK 0x01 ECU_ADDRESS 0x7001642F /end MEASUREMENT
/begin MEASUREMENT HARD_bDio_M_EEP_C_CS "HARD_bDio_M_EEP_C_CS" UBYTE Bool_ON_OFF 1 2 0 1 BIT_MASK 0x01 ECU_ADDRESS 0x7001642E /end MEASUREMENT
/begin MEASUREMENT HARD_bDio_M_EMGY_STOP_IN "HARD_bDio_M_EMGY_STOP_IN" UBYTE Bool_ON_OFF 1 2 0 1 BIT_MASK 0x01 ECU_ADDRESS 0x7001642D /end MEASUREMENT
/begin MEASUREMENT HARD_bDio_M_EMGY_STOP_OUT "HARD_bDio_M_EMGY_STOP_OUT" UBYTE Bool_ON_OFF 1 2 0 1 BIT_MASK 0x01 ECU_ADDRESS 0x7001642C /end MEASUREMENT
/begin MEASUREMENT HARD_bDio_M_ENA_HT_HS "HARD_bDio_M_ENA_HT_HS" UBYTE Bool_ON_OFF 1 2 0 1 BIT_MASK 0x01 ECU_ADDRESS 0x7001642B /end MEASUREMENT
/begin MEASUREMENT HARD_bDio_M_ENA_HT_LS "HARD_bDio_M_ENA_HT_LS" UBYTE Bool_ON_OFF 1 2 0 1 BIT_MASK 0x01 ECU_ADDRESS 0x7001642A /end MEASUREMENT
/begin MEASUREMENT HARD_bDio_M_EXCITATION_IN "HARD_bDio_M_EXCITATION_IN" UBYTE Bool_ON_OFF 1 2 0 1 BIT_MASK 0x01 ECU_ADDRESS 0x70016429 /end MEASUREMENT
/begin MEASUREMENT HARD_bDio_M_FLT_C_DCLINK_OC "HARD_bDio_M_FLT_C_DCLINK_OC" UBYTE Bool_ON_OFF 1 2 0 1 BIT_MASK 0x01 ECU_ADDRESS 0x70016428 /end MEASUREMENT
/begin MEASUREMENT HARD_bDio_M_FLT_C_DCLINK_OV "HARD_bDio_M_FLT_C_DCLINK_OV" UBYTE Bool_ON_OFF 1 2 0 1 BIT_MASK 0x01 ECU_ADDRESS 0x70016427 /end MEASUREMENT
/begin MEASUREMENT HARD_bDio_M_FLT_C_HW_OC_U "HARD_bDio_M_FLT_C_HW_OC_U" UBYTE Bool_ON_OFF 1 2 0 1 BIT_MASK 0x01 ECU_ADDRESS 0x70016426 /end MEASUREMENT
/begin MEASUREMENT HARD_bDio_M_FLT_C_HW_OC_V "HARD_bDio_M_FLT_C_HW_OC_V" UBYTE Bool_ON_OFF 1 2 0 1 BIT_MASK 0x01 ECU_ADDRESS 0x70016425 /end MEASUREMENT
/begin MEASUREMENT HARD_bDio_M_FLT_C_HW_OC_W "HARD_bDio_M_FLT_C_HW_OC_W" UBYTE Bool_ON_OFF 1 2 0 1 BIT_MASK 0x01 ECU_ADDRESS 0x70016424 /end MEASUREMENT
/begin MEASUREMENT HARD_bDio_M_FLT_C_IGBT_H "HARD_bDio_M_FLT_C_IGBT_H" UBYTE Bool_ON_OFF 1 2 0 1 BIT_MASK 0x01 ECU_ADDRESS 0x70016423 /end MEASUREMENT
/begin MEASUREMENT HARD_bDio_M_FLT_C_IGBT_L "HARD_bDio_M_FLT_C_IGBT_L" UBYTE Bool_ON_OFF 1 2 0 1 BIT_MASK 0x01 ECU_ADDRESS 0x70016422 /end MEASUREMENT
/begin MEASUREMENT HARD_bDio_M_FLT_C_IGBT_OT "HARD_bDio_M_FLT_C_IGBT_OT" UBYTE Bool_ON_OFF 1 2 0 1 BIT_MASK 0x01 ECU_ADDRESS 0x70016421 /end MEASUREMENT
/begin MEASUREMENT HARD_bDio_M_FLT_C_MPM_WD "HARD_bDio_M_FLT_C_MPM_WD" UBYTE Bool_ON_OFF 1 2 0 1 BIT_MASK 0x01 ECU_ADDRESS 0x70016420 /end MEASUREMENT
/begin MEASUREMENT HARD_bDio_M_KEY_ON "HARD_bDio_M_KEY_ON" UBYTE Bool_ON_OFF 1 2 0 1 BIT_MASK 0x01 ECU_ADDRESS 0x7001641F /end MEASUREMENT
/begin MEASUREMENT HARD_bDio_M_LED_R1 "HARD_bDio_M_LED_R1" UBYTE Bool_ON_OFF 1 2 0 1 BIT_MASK 0x01 ECU_ADDRESS 0x7001641E /end MEASUREMENT
/begin MEASUREMENT HARD_bDio_M_MCU_ASC_STATE "HARD_bDio_M_MCU_ASC_STATE" UBYTE Bool_ON_OFF 1 2 0 1 BIT_MASK 0x01 ECU_ADDRESS 0x7001641D /end MEASUREMENT
/begin MEASUREMENT HARD_bDio_M_PW_DOWN "HARD_bDio_M_PW_DOWN" UBYTE Bool_ON_OFF 1 2 0 1 BIT_MASK 0x01 ECU_ADDRESS 0x7001641C /end MEASUREMENT
/begin MEASUREMENT HARD_bDio_M_RGATE_CMD_HS "HARD_bDio_M_RGATE_CMD_HS" UBYTE Bool_ON_OFF 1 2 0 1 BIT_MASK 0x01 ECU_ADDRESS 0x7001641B /end MEASUREMENT
/begin MEASUREMENT HARD_bDio_M_RGATE_CMD_LS "HARD_bDio_M_RGATE_CMD_LS" UBYTE Bool_ON_OFF 1 2 0 1 BIT_MASK 0x01 ECU_ADDRESS 0x7001641A /end MEASUREMENT
/begin MEASUREMENT HARD_bDio_M_SPEED_READY "HARD_bDio_M_SPEED_READY" UBYTE Bool_ON_OFF 1 2 0 1 BIT_MASK 0x01 ECU_ADDRESS 0x70016419 /end MEASUREMENT
/begin MEASUREMENT HARD_bDio_M_SUPPLY_WDI "HARD_bDio_M_SUPPLY_WDI" UBYTE Bool_ON_OFF 1 2 0 1 BIT_MASK 0x01 ECU_ADDRESS 0x70016418 /end MEASUREMENT
/begin MEASUREMENT HARD_bESMCmdFtShutdownReq "HARD_bESMCmdFtShutdownReq" UBYTE Bool_ON_OFF 1 2 0 1 BIT_MASK 0x01 ECU_ADDRESS 0x70016417 /end MEASUREMENT
/begin MEASUREMENT HARD_bESMCmdFtShutdownRes "HARD_bESMCmdFtShutdownRes" UBYTE Bool_ON_OFF 1 2 0 1 BIT_MASK 0x01 ECU_ADDRESS 0x70016416 /end MEASUREMENT
/begin MEASUREMENT HARD_bESMCmdFtStartReq "HARD_bESMCmdFtStartReq" UBYTE Bool_ON_OFF 1 2 0 1 BIT_MASK 0x01 ECU_ADDRESS 0x70016415 /end MEASUREMENT
/begin MEASUREMENT HARD_bESMCmdFtStartRes "HARD_bESMCmdFtStartRes" UBYTE Bool_ON_OFF 1 2 0 1 BIT_MASK 0x01 ECU_ADDRESS 0x70016414 /end MEASUREMENT
/begin MEASUREMENT HARD_bESMCmdPwmDirectReq "HARD_bESMCmdPwmDirectReq" UBYTE Bool_ON_OFF 1 2 0 1 BIT_MASK 0x01 ECU_ADDRESS 0x70016413 /end MEASUREMENT
/begin MEASUREMENT HARD_bESMCmdPwmDirectRes "HARD_bESMCmdPwmDirectRes" UBYTE Bool_ON_OFF 1 2 0 1 BIT_MASK 0x01 ECU_ADDRESS 0x70016412 /end MEASUREMENT
/begin MEASUREMENT HARD_bESMCmdPwmHardReq "HARD_bESMCmdPwmHardReq" UBYTE Bool_ON_OFF 1 2 0 1 BIT_MASK 0x01 ECU_ADDRESS 0x70016411 /end MEASUREMENT
/begin MEASUREMENT HARD_bESMCmdPwmHardRes "HARD_bESMCmdPwmHardRes" UBYTE Bool_ON_OFF 1 2 0 1 BIT_MASK 0x01 ECU_ADDRESS 0x70016410 /end MEASUREMENT
/begin MEASUREMENT HARD_bESMCmdPwmOffReq "HARD_bESMCmdPwmOffReq" UBYTE Bool_ON_OFF 1 2 0 1 BIT_MASK 0x01 ECU_ADDRESS 0x7001640F /end MEASUREMENT
/begin MEASUREMENT HARD_bESMCmdPwmOffRes "HARD_bESMCmdPwmOffRes" UBYTE Bool_ON_OFF 1 2 0 1 BIT_MASK 0x01 ECU_ADDRESS 0x7001640E /end MEASUREMENT
/begin MEASUREMENT HARD_bESMCmdSwShutdownReq "HARD_bESMCmdSwShutdownReq" UBYTE Bool_ON_OFF 1 2 0 1 BIT_MASK 0x01 ECU_ADDRESS 0x7001640D /end MEASUREMENT
/begin MEASUREMENT HARD_bESMCmdSwShutdownRes "HARD_bESMCmdSwShutdownRes" UBYTE Bool_ON_OFF 1 2 0 1 BIT_MASK 0x01 ECU_ADDRESS 0x7001640C /end MEASUREMENT
/begin MEASUREMENT HARD_bESMCmdSwStartReq "HARD_bESMCmdSwStartReq" UBYTE Bool_ON_OFF 1 2 0 1 BIT_MASK 0x01 ECU_ADDRESS 0x7001640B /end MEASUREMENT
/begin MEASUREMENT HARD_bESMCmdSwStartRes "HARD_bESMCmdSwStartRes" UBYTE Bool_ON_OFF 1 2 0 1 BIT_MASK 0x01 ECU_ADDRESS 0x7001640A /end MEASUREMENT
/begin MEASUREMENT HARD_bModSeq1FuncOn "Mode fonctionnel Hard mode #1: Functional stage: Test CEM traction (20/10/2015)" UBYTE Bool_ON_OFF 1 2 0 1 BIT_MASK 0x01 ECU_ADDRESS 0x70016409 /end MEASUREMENT
/begin MEASUREMENT HARD_bModSeq1InitOn "Mode fonctionnel Hard mode #1: Initialization stage : Test CEM traction (20/10/2015)" UBYTE Bool_ON_OFF 1 2 0 1 BIT_MASK 0x01 ECU_ADDRESS 0x70016408 /end MEASUREMENT
/begin MEASUREMENT HARD_bModSeq2FuncOn "Mode fonctionnel Hard mode #2: Functional stage: Test xx (xx/xx/xxxx)" UBYTE Bool_ON_OFF 1 2 0 1 BIT_MASK 0x01 ECU_ADDRESS 0x70016407 /end MEASUREMENT
/begin MEASUREMENT HARD_bModSeq2InitOn "Mode fonctionnel Hard mode #2: Initialization stage : Test xx (xx/xx/xxxx)" UBYTE Bool_ON_OFF 1 2 0 1 BIT_MASK 0x01 ECU_ADDRESS 0x70016406 /end MEASUREMENT
/begin MEASUREMENT HARD_bNMTestOn "Nm Test on" UBYTE Bool_ON_OFF 1 2 0 1 BIT_MASK 0x01 ECU_ADDRESS 0x70016404 /end MEASUREMENT
/begin MEASUREMENT HARD_bNmRxRepeatMsgReq "Nm Test on" UBYTE Bool_ON_OFF 1 2 0 1 BIT_MASK 0x01 ECU_ADDRESS 0x70016405 /end MEASUREMENT
/begin MEASUREMENT HARD_bNmTxRepeatMsgReq "Nm Test on" UBYTE Bool_ON_OFF 1 2 0 1 BIT_MASK 0x01 ECU_ADDRESS 0x70016403 /end MEASUREMENT
/begin MEASUREMENT HARD_bPtgEnable "HARD_bPtgEnable" UBYTE Bool_ON_OFF 1 2 0 1 BIT_MASK 0x01 ECU_ADDRESS 0x70016402 /end MEASUREMENT
/begin MEASUREMENT HARD_bPtgSignalsShiftControl "HARD_bPtgSignalsShiftControl" UBYTE Bool_ON_OFF 1 2 0 1 BIT_MASK 0x01 ECU_ADDRESS 0x70016401 /end MEASUREMENT
/begin MEASUREMENT HARD_bPtgUSignalEnable "HARD_bPtgUSignalEnable" UBYTE Bool_ON_OFF 1 2 0 1 BIT_MASK 0x01 ECU_ADDRESS 0x70016400 /end MEASUREMENT
/begin MEASUREMENT HARD_bPtgVSignalEnable "HARD_bPtgVSignalEnable" UBYTE Bool_ON_OFF 1 2 0 1 BIT_MASK 0x01 ECU_ADDRESS 0x700163FF /end MEASUREMENT
/begin MEASUREMENT HARD_bPtgWSignalEnable "HARD_bPtgWSignalEnable" UBYTE Bool_ON_OFF 1 2 0 1 BIT_MASK 0x01 ECU_ADDRESS 0x700163FE /end MEASUREMENT
/begin MEASUREMENT HARD_s16PtgRefSignalValue "HARD_s16PtgRefSignalValue" SWORD I_1 1 2 -32768 32767 ECU_ADDRESS 0x700163D8 /end MEASUREMENT
/begin MEASUREMENT HARD_s16PtgUSignalValue "HARD_s16PtgUSignalValue" SWORD I_1 1 2 -32768 32767 ECU_ADDRESS 0x700163D6 /end MEASUREMENT
/begin MEASUREMENT HARD_s16PtgVSignalValue "HARD_s16PtgVSignalValue" SWORD I_1 1 2 -32768 32767 ECU_ADDRESS 0x700163D4 /end MEASUREMENT
/begin MEASUREMENT HARD_s16PtgWSignalValue "HARD_s16PtgWSignalValue" SWORD I_1 1 2 -32768 32767 ECU_ADDRESS 0x700163D2 /end MEASUREMENT
/begin MEASUREMENT HARD_u16Adc0An10_CTN_BOARD2Phys "HARD_u16Adc0An10_CTN_BOARD2Phys" UBYTE F_1_m40_83 1 2 -40 215 ECU_ADDRESS 0x700163FA /end MEASUREMENT
/begin MEASUREMENT HARD_u16Adc_15V_RDC "HARD_u16Adc_15V_RDC" UWORD I_1 1 2 0 65535 ECU_ADDRESS 0x70016370 /end MEASUREMENT
/begin MEASUREMENT HARD_u16Adc_9180_V01 "HARD_u16Adc_9180_V01" UWORD I_1 1 2 0 65535 ECU_ADDRESS 0x700163C4 /end MEASUREMENT
/begin MEASUREMENT HARD_u16Adc_9180_VR0 "HARD_u16Adc_9180_VR0" UWORD I_1 1 2 0 65535 ECU_ADDRESS 0x700163C6 /end MEASUREMENT
/begin MEASUREMENT HARD_u16Adc_CTN_BOARD1 "HARD_u16Adc_CTN_BOARD1" UWORD I_1 1 2 0 65535 ECU_ADDRESS 0x70016376 /end MEASUREMENT
/begin MEASUREMENT HARD_u16Adc_CTP_COOLING "HARD_u16Adc_CTP_COOLING" UWORD I_1 1 2 0 65535 ECU_ADDRESS 0x700163A4 /end MEASUREMENT
/begin MEASUREMENT HARD_u16Adc_CTP_MOT1_N "HARD_u16Adc_CTP_MOT1_N" UWORD I_1 1 2 0 65535 ECU_ADDRESS 0x700163AE /end MEASUREMENT
/begin MEASUREMENT HARD_u16Adc_CTP_MOT1_P "HARD_u16Adc_CTP_MOT1_P" UWORD I_1 1 2 0 65535 ECU_ADDRESS 0x700163B2 /end MEASUREMENT
/begin MEASUREMENT HARD_u16Adc_CURR_DC "HARD_u16Adc_CURR_DC" UWORD I_1 1 2 0 65535 ECU_ADDRESS 0x7001638C /end MEASUREMENT
/begin MEASUREMENT HARD_u16Adc_Current_U "HARD_u16Adc_Current_U" UWORD I_1 1 2 0 65535 ECU_ADDRESS 0x700163D0 /end MEASUREMENT
/begin MEASUREMENT HARD_u16Adc_Current_V "HARD_u16Adc_Current_V" UWORD I_1 1 2 0 65535 ECU_ADDRESS 0x700163CE /end MEASUREMENT
/begin MEASUREMENT HARD_u16Adc_Current_W "HARD_u16Adc_Current_W" UWORD I_1 1 2 0 65535 ECU_ADDRESS 0x700163CC /end MEASUREMENT
/begin MEASUREMENT HARD_u16Adc_DELTA_COS_NEG "HARD_u16Adc_DELTA_COS_NEG" UWORD I_1 1 2 0 65535 ECU_ADDRESS 0x70016390 /end MEASUREMENT
/begin MEASUREMENT HARD_u16Adc_DELTA_COS_POS "HARD_u16Adc_DELTA_COS_POS" UWORD I_1 1 2 0 65535 ECU_ADDRESS 0x70016392 /end MEASUREMENT
/begin MEASUREMENT HARD_u16Adc_DELTA_SIN_NEG "HARD_u16Adc_DELTA_SIN_NEG" UWORD I_1 1 2 0 65535 ECU_ADDRESS 0x700163C8 /end MEASUREMENT
/begin MEASUREMENT HARD_u16Adc_DELTA_SIN_POS "HARD_u16Adc_DELTA_SIN_POS" UWORD I_1 1 2 0 65535 ECU_ADDRESS 0x700163CA /end MEASUREMENT
/begin MEASUREMENT HARD_u16Adc_DIAG_CONS_EXC "HARD_u16Adc_DIAG_CONS_EXC" UWORD I_1 1 2 0 65535 ECU_ADDRESS 0x700163A6 /end MEASUREMENT
/begin MEASUREMENT HARD_u16Adc_DIAG_COS_H "HARD_u16Adc_DIAG_COS_H" UWORD I_1 1 2 0 65535 ECU_ADDRESS 0x7001637E /end MEASUREMENT
/begin MEASUREMENT HARD_u16Adc_DIAG_COS_L "HARD_u16Adc_DIAG_COS_L" UWORD I_1 1 2 0 65535 ECU_ADDRESS 0x7001637C /end MEASUREMENT
/begin MEASUREMENT HARD_u16Adc_DIAG_SIN_H "HARD_u16Adc_DIAG_SIN_H" UWORD I_1 1 2 0 65535 ECU_ADDRESS 0x7001637A /end MEASUREMENT
/begin MEASUREMENT HARD_u16Adc_DIAG_SIN_L "HARD_u16Adc_DIAG_SIN_L" UWORD I_1 1 2 0 65535 ECU_ADDRESS 0x70016378 /end MEASUREMENT
/begin MEASUREMENT HARD_u16Adc_IgbtTemp_2 "HARD_u16Adc_IgbtTemp_2" UWORD I_1 1 2 0 65535 ECU_ADDRESS 0x7001639C /end MEASUREMENT
/begin MEASUREMENT HARD_u16Adc_IgbtTemp_3 "HARD_u16Adc_IgbtTemp_3" UWORD I_1 1 2 0 65535 ECU_ADDRESS 0x7001639E /end MEASUREMENT
/begin MEASUREMENT HARD_u16Adc_MOT_COS "HARD_u16Adc_MOT_COS" UWORD I_1 1 2 0 65535 ECU_ADDRESS 0x700163B8 /end MEASUREMENT
/begin MEASUREMENT HARD_u16Adc_MOT_SIN "HARD_u16Adc_MOT_SIN" UWORD I_1 1 2 0 65535 ECU_ADDRESS 0x70016398 /end MEASUREMENT
/begin MEASUREMENT HARD_u16Adc_MOT_SIN_SAFE "HARD_u16Adc_MOT_SIN_SAFE" UWORD I_1 1 2 0 65535 ECU_ADDRESS 0x70016382 /end MEASUREMENT
/begin MEASUREMENT HARD_u16Adc_MonCurrOcpH "HARD_u16Adc_MonCurrOcpH" UWORD I_1 1 2 0 65535 ECU_ADDRESS 0x70016386 /end MEASUREMENT
/begin MEASUREMENT HARD_u16Adc_MonCurrOcpL "HARD_u16Adc_MonCurrOcpL" UWORD I_1 1 2 0 65535 ECU_ADDRESS 0x70016384 /end MEASUREMENT
/begin MEASUREMENT HARD_u16Adc_MonDcOvpSele "HARD_u16Adc_MonDcOvpSele" UWORD I_1 1 2 0 65535 ECU_ADDRESS 0x7001636E /end MEASUREMENT
/begin MEASUREMENT HARD_u16Adc_MonP5VRef "HARD_u16Adc_MonP5VRef" UWORD I_1 1 2 0 65535 ECU_ADDRESS 0x700163AA /end MEASUREMENT
/begin MEASUREMENT HARD_u16Adc_Oil_Pressure "HARD_u16Adc_Oil_Pressure" UWORD I_1 1 2 0 65535 ECU_ADDRESS 0x700163C2 /end MEASUREMENT
/begin MEASUREMENT HARD_u16Adc_Oil_Temp_N "HARD_u16Adc_Oil_Temp_N" UWORD I_1 1 2 0 65535 ECU_ADDRESS 0x700163BE /end MEASUREMENT
/begin MEASUREMENT HARD_u16Adc_Oil_Temp_P "HARD_u16Adc_Oil_Temp_P" UWORD I_1 1 2 0 65535 ECU_ADDRESS 0x700163C0 /end MEASUREMENT
/begin MEASUREMENT HARD_u16Adc_P12V_BATT_F "HARD_u16Adc_P12V_BATT_F" UWORD I_1 1 2 0 65535 ECU_ADDRESS 0x70016394 /end MEASUREMENT
/begin MEASUREMENT HARD_u16Adc_P12_BLDC "HARD_u16Adc_P12_BLDC" UWORD I_1 1 2 0 65535 ECU_ADDRESS 0x700163BC /end MEASUREMENT
/begin MEASUREMENT HARD_u16Adc_P16VMult "HARD_u16Adc_P16VMult" UWORD I_1 1 2 0 65535 ECU_ADDRESS 0x700163B4 /end MEASUREMENT
/begin MEASUREMENT HARD_u16Adc_P5VHS_REF "HARD_u16Adc_P5VHS_REF" UWORD I_1 1 2 0 65535 ECU_ADDRESS 0x700163B6 /end MEASUREMENT
/begin MEASUREMENT HARD_u16Adc_P5_Gateway "HARD_u16Adc_P5_Gateway" UWORD I_1 1 2 0 65535 ECU_ADDRESS 0x700163BA /end MEASUREMENT
/begin MEASUREMENT HARD_u16Adc_P5vLsRef "HARD_u16Adc_P5vLsRef" UWORD I_1 1 2 0 65535 ECU_ADDRESS 0x700163A8 /end MEASUREMENT
/begin MEASUREMENT HARD_u16Adc_PSU_P5V_HS "HARD_u16Adc_PSU_P5V_HS" UWORD I_1 1 2 0 65535 ECU_ADDRESS 0x7001638A /end MEASUREMENT
/begin MEASUREMENT HARD_u16Adc_PSU_P5V_LS "HARD_u16Adc_PSU_P5V_LS" UWORD I_1 1 2 0 65535 ECU_ADDRESS 0x7001638E /end MEASUREMENT
/begin MEASUREMENT HARD_u16Adc_TempDrv "HARD_u16Adc_TempDrv" UWORD I_1 1 2 0 65535 ECU_ADDRESS 0x70016380 /end MEASUREMENT
/begin MEASUREMENT HARD_u16Adc_TempIgbt "HARD_u16Adc_TempIgbt" UWORD I_1 1 2 0 65535 ECU_ADDRESS 0x7001636C /end MEASUREMENT
/begin MEASUREMENT HARD_u16Adc_VolDcLinkDrv "HARD_u16Adc_VolDcLinkDrv" UWORD I_1 1 2 0 65535 ECU_ADDRESS 0x70016396 /end MEASUREMENT
/begin MEASUREMENT HARD_u16Adc_VolDcLinkFil "HARD_u16Adc_VolDcLinkFil" UWORD I_1 1 2 0 65535 ECU_ADDRESS 0x70016372 /end MEASUREMENT
/begin MEASUREMENT HARD_u16PtgRefSignalNbPeriode "HARD_u16PtgRefSignalNbPeriode" UWORD I_1 1 2 0 65535 ECU_ADDRESS 0x70016366 /end MEASUREMENT
/begin MEASUREMENT HARD_u16PtgRefSignalTime "HARD_u16PtgRefSignalTime" UWORD I_1 1 2 0 65535 ECU_ADDRESS 0x70016364 /end MEASUREMENT
/begin MEASUREMENT HARD_u16PtgUSignalNbPeriode "HARD_u16PtgUSignalNbPeriode" UWORD I_1 1 2 0 65535 ECU_ADDRESS 0x70016362 /end MEASUREMENT
/begin MEASUREMENT HARD_u16PtgUSignalTime "HARD_u16PtgUSignalTime" UWORD I_1 1 2 0 65535 ECU_ADDRESS 0x70016360 /end MEASUREMENT
/begin MEASUREMENT HARD_u16PtgVSignalNbPeriode "HARD_u16PtgVSignalNbPeriode" UWORD I_1 1 2 0 65535 ECU_ADDRESS 0x7001635E /end MEASUREMENT
/begin MEASUREMENT HARD_u16PtgVSignalTime "HARD_u16PtgVSignalTime" UWORD I_1 1 2 0 65535 ECU_ADDRESS 0x7001635C /end MEASUREMENT
/begin MEASUREMENT HARD_u16PtgWSignalNbPeriode "HARD_u16PtgWSignalNbPeriode" UWORD I_1 1 2 0 65535 ECU_ADDRESS 0x7001635A /end MEASUREMENT
/begin MEASUREMENT HARD_u16PtgWSignalTime "HARD_u16PtgWSignalTime" UWORD I_1 1 2 0 65535 ECU_ADDRESS 0x70016358 /end MEASUREMENT
/begin MEASUREMENT HARD_u8CanIfCtrlMode "Test Number of Nm Test" UBYTE I_1 1 2 0 255 ECU_ADDRESS 0x700163F9 /end MEASUREMENT
/begin MEASUREMENT HARD_u8CanIfCtrlModeReq "Test Number of Nm Test" UBYTE I_1 1 2 0 255 ECU_ADDRESS 0x700163F8 /end MEASUREMENT
/begin MEASUREMENT HARD_u8CanIfPduMode "Test Number of Nm Test" UBYTE I_1 1 2 0 255 ECU_ADDRESS 0x700163F7 /end MEASUREMENT
/begin MEASUREMENT HARD_u8CanIfPduModeReq "Test Number of Nm Test" UBYTE I_1 1 2 0 255 ECU_ADDRESS 0x700163F6 /end MEASUREMENT
/begin MEASUREMENT HARD_u8CanNmLocalNodeId "Test Number of Nm Test" UBYTE I_1 1 2 0 255 ECU_ADDRESS 0x700163F5 /end MEASUREMENT
/begin MEASUREMENT HARD_u8CanNmMode "Test Number of Nm Test" UBYTE I_1 1 2 0 255 ECU_ADDRESS 0x700163F4 /end MEASUREMENT
/begin MEASUREMENT HARD_u8CanNmNodeId "Test Number of Nm Test" UBYTE I_1 1 2 0 255 ECU_ADDRESS 0x700163F3 /end MEASUREMENT
/begin MEASUREMENT HARD_u8CanNmState "Test Number of Nm Test" UBYTE I_1 1 2 0 255 ECU_ADDRESS 0x700163F2 /end MEASUREMENT
/begin MEASUREMENT HARD_u8CanSmMode "Test Number of Nm Test" UBYTE Id_0x00 1 2 0 255 ECU_ADDRESS 0x700163F1 /end MEASUREMENT
/begin MEASUREMENT HARD_u8CanSmModeReq "Test Number of Nm Test" UBYTE I_1 1 2 0 255 ECU_ADDRESS 0x700163F0 /end MEASUREMENT
/begin MEASUREMENT HARD_u8ComMMode "Test Number of Nm Test" UBYTE I_1 1 2 0 255 ECU_ADDRESS 0x700163EF /end MEASUREMENT
/begin MEASUREMENT HARD_u8ComMState "Test Number of Nm Test" UBYTE I_1 1 2 0 255 ECU_ADDRESS 0x700163EE /end MEASUREMENT
/begin MEASUREMENT HARD_u8ComMStatus "Test Number of Nm Test" UBYTE I_1 1 2 0 255 ECU_ADDRESS 0x700163ED /end MEASUREMENT
/begin MEASUREMENT HARD_u8NmMode "Test Number of Nm Test" UBYTE I_1 1 2 0 255 ECU_ADDRESS 0x700163EC /end MEASUREMENT
/begin MEASUREMENT HARD_u8NmState "Test Number of Nm Test" UBYTE I_1 1 2 0 255 ECU_ADDRESS 0x700163EB /end MEASUREMENT
/begin MEASUREMENT HARD_u8NmTestNum "Test Number of Nm Test" UBYTE I_1 1 2 0 255 ECU_ADDRESS 0x700163EA /end MEASUREMENT
/begin MEASUREMENT HARD_u8NmUserDataRx "Test Number of Nm Test" UBYTE I_1 1 2 0 255 MATRIX_DIM 6 1 1 ECU_ADDRESS 0x700163E4 /end MEASUREMENT
/begin MEASUREMENT HARD_u8NmUserDataRx[0] "HARD_u8NmUserDataRx[0]" UBYTE I_1 1 2 0 255 ECU_ADDRESS 0x700163E4 /end MEASUREMENT
/begin MEASUREMENT HARD_u8NmUserDataRx[1] "HARD_u8NmUserDataRx[1]" UBYTE I_1 1 2 0 255 ECU_ADDRESS 0x700163E5 /end MEASUREMENT
/begin MEASUREMENT HARD_u8NmUserDataRx[2] "HARD_u8NmUserDataRx[2]" UBYTE I_1 1 2 0 255 ECU_ADDRESS 0x700163E6 /end MEASUREMENT
/begin MEASUREMENT HARD_u8NmUserDataRx[3] "HARD_u8NmUserDataRx[3]" UBYTE I_1 1 2 0 255 ECU_ADDRESS 0x700163E7 /end MEASUREMENT
/begin MEASUREMENT HARD_u8NmUserDataRx[4] "HARD_u8NmUserDataRx[4]" UBYTE I_1 1 2 0 255 ECU_ADDRESS 0x700163E8 /end MEASUREMENT
/begin MEASUREMENT HARD_u8NmUserDataRx[5] "HARD_u8NmUserDataRx[5]" UBYTE I_1 1 2 0 255 ECU_ADDRESS 0x700163E9 /end MEASUREMENT
/begin MEASUREMENT HARD_u8NmUserDataTx "Test Number of Nm Test" UBYTE I_1 1 2 0 255 MATRIX_DIM 6 1 1 ECU_ADDRESS 0x700163DE /end MEASUREMENT
/begin MEASUREMENT HARD_u8NmUserDataTx[0] "HARD_u8NmUserDataTx[0]" UBYTE I_1 1 2 0 255 ECU_ADDRESS 0x700163DE /end MEASUREMENT
/begin MEASUREMENT HARD_u8NmUserDataTx[1] "HARD_u8NmUserDataTx[1]" UBYTE I_1 1 2 0 255 ECU_ADDRESS 0x700163DF /end MEASUREMENT
/begin MEASUREMENT HARD_u8NmUserDataTx[2] "HARD_u8NmUserDataTx[2]" UBYTE I_1 1 2 0 255 ECU_ADDRESS 0x700163E0 /end MEASUREMENT
/begin MEASUREMENT HARD_u8NmUserDataTx[3] "HARD_u8NmUserDataTx[3]" UBYTE I_1 1 2 0 255 ECU_ADDRESS 0x700163E1 /end MEASUREMENT
/begin MEASUREMENT HARD_u8NmUserDataTx[4] "HARD_u8NmUserDataTx[4]" UBYTE I_1 1 2 0 255 ECU_ADDRESS 0x700163E2 /end MEASUREMENT
/begin MEASUREMENT HARD_u8NmUserDataTx[5] "HARD_u8NmUserDataTx[5]" UBYTE I_1 1 2 0 255 ECU_ADDRESS 0x700163E3 /end MEASUREMENT
/begin MEASUREMENT HARD_u8NmWakeupReason "Test Number of Nm Test" UBYTE I_1 1 2 0 255 ECU_ADDRESS 0x700163DD /end MEASUREMENT
/begin MEASUREMENT HARD_u8VSIRxaTempCtrlBdPhys "Physical value of MAIN_VSIRxaTempCtrlBd" UBYTE F_1_m40_83 1 2 -40 215 ECU_ADDRESS 0x700163DC /end MEASUREMENT
/begin MEASUREMENT HARD_u8VSIRxaTempDrvBdPhys "Physical value of MAIN_VSIRxaTempDrvBd (MAJ OC140)" UBYTE F_1_m40_83 1 2 -40 215 ECU_ADDRESS 0x700163DB /end MEASUREMENT
/begin MEASUREMENT HARD_u8VSIRxaTempIgbtPhys "Physical value of MAIN_VSIRxaTempIgbt (MAJ OC140)" UBYTE F_1_m40_83 1 2 -40 215 ECU_ADDRESS 0x700163DA /end MEASUREMENT
/begin COMPU_METHOD I_1 "" RAT_FUNC "%9.2" "-" COEFFS 0 1 0 0 0 1 /end COMPU_METHOD
/begin COMPU_METHOD F_1_p0_4 "" RAT_FUNC "%9.2" "-" COEFFS 0 1 0 0 0 1 /end COMPU_METHOD
/begin COMPU_METHOD F_1_m20000_33 "" RAT_FUNC "%9.2" "-" COEFFS 0 1 20000 0 0 1 /end COMPU_METHOD
/begin COMPU_METHOD F_0v0030518044_p0_80 "" RAT_FUNC "%9.3" "%" COEFFS 0 1 0 0 0 0.0030518 /end COMPU_METHOD
/begin COMPU_METHOD F_0v0015259022_p0_81 "" RAT_FUNC "%9.3" "%" COEFFS 0 1 0 0 0 0.0015259 /end COMPU_METHOD
/begin COMPU_METHOD D_2_0v01_p0_82 "" RAT_FUNC "%9.2" "%" COEFFS 0 0 1 0 0.01 0 /end COMPU_METHOD
/begin COMPU_METHOD F_1_m40_83 "" RAT_FUNC "%9.2" "°C" COEFFS 0 1 40 0 0 1 /end COMPU_METHOD
/begin COMPU_METHOD F_0v0000305176_p0_84 "" RAT_FUNC "%9.5" "PI/RAD" COEFFS 0 1 0 0 0 3.05176e-005 /end COMPU_METHOD
/begin COMPU_METHOD Id_0x00 "" RAT_FUNC "%9.2" "." COEFFS 0 1 0 0 0 1 /end COMPU_METHOD
/begin COMPU_METHOD Bool_ON_OFF "" TAB_VERB "%8.4" "." COMPU_TAB_REF Bool_ON_OFF_table /end COMPU_METHOD
/begin COMPU_VTAB Bool_ON_OFF_table "" TAB_VERB 2 0 "OFF" 1 "ON" /end COMPU_VTAB
/begin FUNCTION FAULT ""
 /begin DEF_CHARACTERISTIC FaultBSW_COM_BusOff_CAN1Dec FaultBSW_COM_BusOff_CAN1FailMod FaultBSW_COM_BusOff_CAN1Inc FaultBSW_COM_ChecksumErrVCUDec FaultBSW_COM_ChecksumErrVCUFailMod FaultBSW_COM_ChecksumErrVCUInc FaultBSW_COM_InterFaultVCUDec FaultBSW_COM_InterFaultVCUFailMod FaultBSW_COM_InterFaultVCUInc FaultBSW_COM_RollCntErrVCUDec FaultBSW_COM_RollCntErrVCUFailMod FaultBSW_COM_RollCntErrVCUInc FaultBSW_COM_TimoutRxBCMDec FaultBSW_COM_TimoutRxBCMFailMod FaultBSW_COM_TimoutRxBCMInc FaultBSW_COM_TimoutRxBMSHDec FaultBSW_COM_TimoutRxBMSHFailMod FaultBSW_COM_TimoutRxBMSHInc FaultBSW_COM_TimoutRxEMSDec FaultBSW_COM_TimoutRxEMSFailMod FaultBSW_COM_TimoutRxEMSInc FaultBSW_COM_TimoutRxGCUDec FaultBSW_COM_TimoutRxGCUFailMod FaultBSW_COM_TimoutRxGCUInc FaultBSW_COM_TimoutRxIPCDec FaultBSW_COM_TimoutRxIPCFailMod FaultBSW_COM_TimoutRxIPCInc FaultBSW_COM_TimoutRxTBOXDec FaultBSW_COM_TimoutRxTBOXFailMod FaultBSW_COM_TimoutRxTBOXInc FaultBSW_COM_TimoutRxVCUDec FaultBSW_COM_TimoutRxVCUFailMod FaultBSW_COM_TimoutRxVCUInc FaultBSW_HW2_FPGA_OverVoltVBatDec FaultBSW_HW2_FPGA_OverVoltVBatFailMod FaultBSW_HW2_FPGA_OverVoltVBatInc FaultBSW_HW2_SafeTlib_PreRunDec FaultBSW_HW2_SafeTlib_PreRunFailMod FaultBSW_HW2_SafeTlib_PreRunInc FaultBSW_HW_EasAckFailDec FaultBSW_HW_EasAckFailFailMod FaultBSW_HW_EasAckFailInc FaultBSW_HW_FPGA_IGBT_HDec FaultBSW_HW_FPGA_IGBT_HFailMod FaultBSW_HW_FPGA_IGBT_HInc FaultBSW_HW_FPGA_IGBT_LDec FaultBSW_HW_FPGA_IGBT_LFailMod FaultBSW_HW_FPGA_IGBT_LInc FaultBSW_HW_FPGA_OverUnderCurUIDec FaultBSW_HW_FPGA_OverUnderCurUIFailMod FaultBSW_HW_FPGA_OverUnderCurUIInc FaultBSW_HW_FPGA_OverUnderCurVIDec FaultBSW_HW_FPGA_OverUnderCurVIFailMod FaultBSW_HW_FPGA_OverUnderCurVIInc FaultBSW_HW_FPGA_OverUnderCurWIDec FaultBSW_HW_FPGA_OverUnderCurWIFailMod FaultBSW_HW_FPGA_OverUnderCurWIInc FaultBSW_HW_OCDataNotRationalDec FaultBSW_HW_OCDataNotRationalFailMod FaultBSW_HW_OCDataNotRationalInc FaultBSW_SYS_RstHotDec FaultBSW_SYS_RstHotFailMod FaultBSW_SYS_RstHotInc FaultBSW_SYS_StackOverflowDec FaultBSW_SYS_StackOverflowFailMod FaultBSW_SYS_StackOverflowInc FaultBSW_VSI_TimeoutTCalcDec FaultBSW_VSI_TimeoutTCalcFailMod FaultBSW_VSI_TimeoutTCalcInc FaultFSEVBHV_OverVoltageDec FaultFSEVBHV_OverVoltageFailMod FaultFSEVBHV_OverVoltageInc FaultFSEVBHV_SampleVolOutRngHDec FaultFSEVBHV_SampleVolOutRngHFailMod FaultFSEVBHV_SampleVolOutRngHInc FaultFSEVBHV_SampleVolOutRngLDec FaultFSEVBHV_SampleVolOutRngLFailMod FaultFSEVBHV_SampleVolOutRngLInc FaultFSEVBHV_UnderVoltageDec FaultFSEVBHV_UnderVoltageFailMod FaultFSEVBHV_UnderVoltageInc FaultFSEVBHV_UnderVoltageWarnDec FaultFSEVBHV_UnderVoltageWarnFailMod FaultFSEVBHV_UnderVoltageWarnInc FaultFSEVBHV_VolNotRationalDec FaultFSEVBHV_VolNotRationalFailMod FaultFSEVBHV_VolNotRationalInc FaultFSEVBHV_VoltageGndDec FaultFSEVBHV_VoltageGndFailMod FaultFSEVBHV_VoltageGndInc FaultFSEVBHV_VoltageVccDec FaultFSEVBHV_VoltageVccFailMod FaultFSEVBHV_VoltageVccInc FaultFSEVBLV_OverVoltageDec FaultFSEVBLV_OverVoltageFailMod FaultFSEVBLV_OverVoltageInc FaultFSEVBLV_P5VRefADCFltDec FaultFSEVBLV_P5VRefADCFltFailMod FaultFSEVBLV_P5VRefADCFltInc FaultFSEVBLV_UnderVoltageDec FaultFSEVBLV_UnderVoltageFailMod FaultFSEVBLV_UnderVoltageInc FaultFSEVBLV_UnderVoltageWarnDec FaultFSEVBLV_UnderVoltageWarnFailMod FaultFSEVBLV_UnderVoltageWarnInc FaultFSEVBLV_VoltageGndDec FaultFSEVBLV_VoltageGndFailMod FaultFSEVBLV_VoltageGndInc FaultFSEVBLV_VoltageVccDec FaultFSEVBLV_VoltageVccFailMod FaultFSEVBLV_VoltageVccInc FaultFSEVETA_DrvTempRationDec FaultFSEVETA_DrvTempRationFailMod FaultFSEVETA_DrvTempRationInc FaultFSEVETA_IgbtTempRationalDec FaultFSEVETA_IgbtTempRationalFailMod FaultFSEVETA_IgbtTempRationalInc FaultFSEVETA_OverTempDrvLeftDec FaultFSEVETA_OverTempDrvLeftFailMod FaultFSEVETA_OverTempDrvLeftInc FaultFSEVETA_OverTempIgbtLeftDec FaultFSEVETA_OverTempIgbtLeftFailMod FaultFSEVETA_OverTempIgbtLeftInc FaultFSEVETA_OverTempNTC1CmdBoardDec FaultFSEVETA_OverTempNTC1CmdBoardFailMod FaultFSEVETA_OverTempNTC1CmdBoardInc FaultFSEVETA_SampleIgbtTempOutRngHDec FaultFSEVETA_SampleIgbtTempOutRngHFailMod FaultFSEVETA_SampleIgbtTempOutRngHInc FaultFSEVETA_SampleIgbtTempOutRngLDec FaultFSEVETA_SampleIgbtTempOutRngLFailMod FaultFSEVETA_SampleIgbtTempOutRngLInc FaultFSEVETA_TempDrvBoardLeftGndDec FaultFSEVETA_TempDrvBoardLeftGndFailMod FaultFSEVETA_TempDrvBoardLeftGndInc FaultFSEVETA_TempDrvBoardLeftVccDec FaultFSEVETA_TempDrvBoardLeftVccFailMod FaultFSEVETA_TempDrvBoardLeftVccInc FaultFSEVETA_TempIgbtLeftGndDec FaultFSEVETA_TempIgbtLeftGndFailMod FaultFSEVETA_TempIgbtLeftGndInc FaultFSEVETA_TempIgbtLeftVccDec FaultFSEVETA_TempIgbtLeftVccFailMod FaultFSEVETA_TempIgbtLeftVccInc FaultFSEVETA_TempNTC1CmdBoardGndDec FaultFSEVETA_TempNTC1CmdBoardGndFailMod FaultFSEVETA_TempNTC1CmdBoardGndInc FaultFSEVETA_TempNTC1CmdBoardVccDec FaultFSEVETA_TempNTC1CmdBoardVccFailMod FaultFSEVETA_TempNTC1CmdBoardVccInc FaultFSEVETA_UnderTempDrvLeftDec FaultFSEVETA_UnderTempDrvLeftFailMod FaultFSEVETA_UnderTempDrvLeftInc FaultFSEVETA_UnderTempIgbtLeftDec FaultFSEVETA_UnderTempIgbtLeftFailMod FaultFSEVETA_UnderTempIgbtLeftInc FaultFSEVETA_UnderTempNTC1CmdBoardDec FaultFSEVETA_UnderTempNTC1CmdBoardFailMod FaultFSEVETA_UnderTempNTC1CmdBoardInc FaultFSMTMTA_OverTempWdgHead1Dec FaultFSMTMTA_OverTempWdgHead1FailMod FaultFSMTMTA_OverTempWdgHead1Inc FaultFSMTMTA_TempWindHead1OutRngHDec FaultFSMTMTA_TempWindHead1OutRngHFailMod FaultFSMTMTA_TempWindHead1OutRngHInc FaultFSMTMTA_TempWindHead1OutRngLDec FaultFSMTMTA_TempWindHead1OutRngLFailMod FaultFSMTMTA_TempWindHead1OutRngLInc FaultFSMTMTA_TempWindingHead1GndDec FaultFSMTMTA_TempWindingHead1GndFailMod FaultFSMTMTA_TempWindingHead1GndInc FaultFSMTMTA_TempWindingHead1VccDec FaultFSMTMTA_TempWindingHead1VccFailMod FaultFSMTMTA_TempWindingHead1VccInc FaultFSMTMTA_UnderTempWdgHead1Dec FaultFSMTMTA_UnderTempWdgHead1FailMod FaultFSMTMTA_UnderTempWdgHead1Inc FaultFSMTRDG_ExcGenerationDec FaultFSMTRDG_ExcGenerationFailMod FaultFSMTRDG_ExcGenerationInc FaultFSMTRDG_ExcSignalGNDDec FaultFSMTRDG_ExcSignalGNDFailMod FaultFSMTRDG_ExcSignalGNDInc FaultFSMTRDG_ExcSignalVCCDec FaultFSMTRDG_ExcSignalVCCFailMod FaultFSMTRDG_ExcSignalVCCInc FaultFSMTRDG_SinCosHLGndDec FaultFSMTRDG_SinCosHLGndFailMod FaultFSMTRDG_SinCosHLGndInc FaultFSMTRDG_SinCosHLOpenDec FaultFSMTRDG_SinCosHLOpenFailMod FaultFSMTRDG_SinCosHLOpenInc FaultFSMTRDG_SinCosHLVccDec FaultFSMTRDG_SinCosHLVccFailMod FaultFSMTRDG_SinCosHLVccInc FaultFSSMACS_AkdFailFlagDec FaultFSSMACS_AkdFailFlagFailMod FaultFSSMACS_AkdFailFlagInc FaultFTASBDS_BattVoltDeratingActDec FaultFTASBDS_BattVoltDeratingActFailMod FaultFTASBDS_BattVoltDeratingActInc FaultFTASETP_EstPmDeratingActDec FaultFTASETP_EstPmDeratingActFailMod FaultFTASETP_EstPmDeratingActInc FaultFTASETP_PmDeratingActDec FaultFTASETP_PmDeratingActFailMod FaultFTASETP_PmDeratingActInc FaultFTASMTP_Wndg1DeratingActDec FaultFTASMTP_Wndg1DeratingActFailMod FaultFTASMTP_Wndg1DeratingActInc FaultFTASOSP_MotorSpdDeratingActDec FaultFTASOSP_MotorSpdDeratingActFailMod FaultFTASOSP_MotorSpdDeratingActInc FaultFTCMSCS_CtrlSatTimoutDec FaultFTCMSCS_CtrlSatTimoutFailMod FaultFTCMSCS_CtrlSatTimoutInc FaultFTCMSCS_SpdOvershootDec FaultFTCMSCS_SpdOvershootFailMod FaultFTCMSCS_SpdOvershootInc FaultFTCMSCS_ZeroSpeedTimoutDec FaultFTCMSCS_ZeroSpeedTimoutFailMod FaultFTCMSCS_ZeroSpeedTimoutInc FaultFTCMTCS_VoltageMarginLowDec FaultFTCMTCS_VoltageMarginLowFailMod FaultFTCMTCS_VoltageMarginLowInc FaultFTEVEIT_EstOverTempDec FaultFTEVEIT_EstOverTempFailMod FaultFTEVEIT_EstOverTempInc FaultFTMTLCS_CurrentSumErrorDec FaultFTMTLCS_CurrentSumErrorFailMod FaultFTMTLCS_CurrentSumErrorInc FaultFTMTLCS_CurSenrPhaU_GNDDec FaultFTMTLCS_CurSenrPhaU_GNDFailMod FaultFTMTLCS_CurSenrPhaU_GNDInc FaultFTMTLCS_CurSenrPhaU_OutRngHDec FaultFTMTLCS_CurSenrPhaU_OutRngHFailMod FaultFTMTLCS_CurSenrPhaU_OutRngHInc FaultFTMTLCS_CurSenrPhaU_OutRngLDec FaultFTMTLCS_CurSenrPhaU_OutRngLFailMod FaultFTMTLCS_CurSenrPhaU_OutRngLInc FaultFTMTLCS_CurSenrPhaU_VCCDec FaultFTMTLCS_CurSenrPhaU_VCCFailMod FaultFTMTLCS_CurSenrPhaU_VCCInc FaultFTMTLCS_CurSenrPhaV_GNDDec FaultFTMTLCS_CurSenrPhaV_GNDFailMod FaultFTMTLCS_CurSenrPhaV_GNDInc FaultFTMTLCS_CurSenrPhaV_OutRngHDec FaultFTMTLCS_CurSenrPhaV_OutRngHFailMod FaultFTMTLCS_CurSenrPhaV_OutRngHInc FaultFTMTLCS_CurSenrPhaV_OutRngLDec FaultFTMTLCS_CurSenrPhaV_OutRngLFailMod FaultFTMTLCS_CurSenrPhaV_OutRngLInc FaultFTMTLCS_CurSenrPhaV_VCCDec FaultFTMTLCS_CurSenrPhaV_VCCFailMod FaultFTMTLCS_CurSenrPhaV_VCCInc FaultFTMTLCS_CurSenrPhaW_GNDDec FaultFTMTLCS_CurSenrPhaW_GNDFailMod FaultFTMTLCS_CurSenrPhaW_GNDInc FaultFTMTLCS_CurSenrPhaW_OutRngHDec FaultFTMTLCS_CurSenrPhaW_OutRngHFailMod FaultFTMTLCS_CurSenrPhaW_OutRngHInc FaultFTMTLCS_CurSenrPhaW_OutRngLDec FaultFTMTLCS_CurSenrPhaW_OutRngLFailMod FaultFTMTLCS_CurSenrPhaW_OutRngLInc FaultFTMTLCS_CurSenrPhaW_VCCDec FaultFTMTLCS_CurSenrPhaW_VCCFailMod FaultFTMTLCS_CurSenrPhaW_VCCInc FaultSDMTMEP_CosGndDec FaultSDMTMEP_CosGndFailMod FaultSDMTMEP_CosGndInc FaultSDMTMEP_CosOutRangeHighDec FaultSDMTMEP_CosOutRangeHighFailMod FaultSDMTMEP_CosOutRangeHighInc FaultSDMTMEP_CosOutRangeLowDec FaultSDMTMEP_CosOutRangeLowFailMod FaultSDMTMEP_CosOutRangeLowInc FaultSDMTMEP_CosVccDec FaultSDMTMEP_CosVccFailMod FaultSDMTMEP_CosVccInc FaultSDMTMEP_OverSpeedDec FaultSDMTMEP_OverSpeedFailMod FaultSDMTMEP_OverSpeedInc FaultSDMTMEP_ResSquaSumErrByFTDec FaultSDMTMEP_ResSquaSumErrByFTFailMod FaultSDMTMEP_ResSquaSumErrByFTInc FaultSDMTMEP_SinGndDec FaultSDMTMEP_SinGndFailMod FaultSDMTMEP_SinGndInc FaultSDMTMEP_SinOutRangeHighDec FaultSDMTMEP_SinOutRangeHighFailMod FaultSDMTMEP_SinOutRangeHighInc FaultSDMTMEP_SinOutRangeLowDec FaultSDMTMEP_SinOutRangeLowFailMod FaultSDMTMEP_SinOutRangeLowInc FaultSDMTMEP_SinVccDec FaultSDMTMEP_SinVccFailMod FaultSDMTMEP_SinVccInc FaultSDMTMEP_UnderSpeedDec FaultSDMTMEP_UnderSpeedFailMod FaultSDMTMEP_UnderSpeedInc FaultTCUCAP0_CAPPressureHDec FaultTCUCAP0_CAPPressureHFailMod FaultTCUCAP0_CAPPressureHInc FaultTCUCAP0_CAPPressureLDec FaultTCUCAP0_CAPPressureLFailMod FaultTCUCAP0_CAPPressureLInc FaultTCUCAP0_CAPPressureOverHDec FaultTCUCAP0_CAPPressureOverHFailMod FaultTCUCAP0_CAPPressureOverHInc FaultTCUCAP0_CAPSlipDec FaultTCUCAP0_CAPSlipFailMod FaultTCUCAP0_CAPSlipInc FaultTCUCAP0_DragMomentHDec FaultTCUCAP0_DragMomentHFailMod FaultTCUCAP0_DragMomentHInc FaultTCUCAP0_HLSinInvalidDec FaultTCUCAP0_HLSinInvalidFailMod FaultTCUCAP0_HLSinInvalidInc FaultTCUCAP0_HLSinUndefineDec FaultTCUCAP0_HLSinUndefineFailMod FaultTCUCAP0_HLSinUndefineInc FaultTCUCAP0_HLSupplyHDec FaultTCUCAP0_HLSupplyHFailMod FaultTCUCAP0_HLSupplyHInc FaultTCUCAP0_HLSupplyLDec FaultTCUCAP0_HLSupplyLFailMod FaultTCUCAP0_HLSupplyLInc FaultTCUCAP0_MotorPhaseVolHDec FaultTCUCAP0_MotorPhaseVolHFailMod FaultTCUCAP0_MotorPhaseVolHInc FaultTCUCAP0_PressureRationalDec FaultTCUCAP0_PressureRationalFailMod FaultTCUCAP0_PressureRationalInc FaultTCUCAP0_SenSigOpenOrGNDDec FaultTCUCAP0_SenSigOpenOrGNDFailMod FaultTCUCAP0_SenSigOpenOrGNDInc FaultTCUCAP0_SenSigVCCDec FaultTCUCAP0_SenSigVCCFailMod FaultTCUCAP0_SenSigVCCInc FaultTCUCAP0_SensorPerforErrDec FaultTCUCAP0_SensorPerforErrFailMod FaultTCUCAP0_SensorPerforErrInc FaultTCUCAP1_COM_GCUDec FaultTCUCAP1_COM_GCUFailMod FaultTCUCAP1_COM_GCUInc FaultTCUCAP1_DriverTempHDec FaultTCUCAP1_DriverTempHFailMod FaultTCUCAP1_DriverTempHInc FaultTCUCAP1_FETShortDec FaultTCUCAP1_FETShortFailMod FaultTCUCAP1_FETShortInc FaultTCUCAP1_HWOverCurDec FaultTCUCAP1_HWOverCurFailMod FaultTCUCAP1_HWOverCurInc FaultTCUCAP1_MotorPhaseDriveErrDec FaultTCUCAP1_MotorPhaseDriveErrFailMod FaultTCUCAP1_MotorPhaseDriveErrInc FaultTCUCAP1_MotorStallDec FaultTCUCAP1_MotorStallFailMod FaultTCUCAP1_MotorStallInc FaultTCUCAP1_OverVoltageDec FaultTCUCAP1_OverVoltageFailMod FaultTCUCAP1_OverVoltageInc FaultTCUCAP1_PhaseDetectGNDDec FaultTCUCAP1_PhaseDetectGNDFailMod FaultTCUCAP1_PhaseDetectGNDInc FaultTCUCAP1_PhaseDetectVCCDec FaultTCUCAP1_PhaseDetectVCCFailMod FaultTCUCAP1_PhaseDetectVCCInc FaultTCUCAP1_SWOverCurDec FaultTCUCAP1_SWOverCurFailMod FaultTCUCAP1_SWOverCurInc FaultTCUCAP1_ThermalShutDownDec FaultTCUCAP1_ThermalShutDownFailMod FaultTCUCAP1_ThermalShutDownInc FaultTCUCAP1_ThermalWarningDec FaultTCUCAP1_ThermalWarningFailMod FaultTCUCAP1_ThermalWarningInc FaultTCUCAP1_UnderVoltageDec FaultTCUCAP1_UnderVoltageFailMod FaultTCUCAP1_UnderVoltageInc FaultTCUCCP_OilMotorRationalDec FaultTCUCCP_OilMotorRationalFailMod FaultTCUCCP_OilMotorRationalInc FaultTCUCCP_OilMotorStallDec FaultTCUCCP_OilMotorStallFailMod FaultTCUCCP_OilMotorStallInc FaultTCUCCP_OilSenRationalL1Dec FaultTCUCCP_OilSenRationalL1FailMod FaultTCUCCP_OilSenRationalL1Inc FaultTCUCCP_OilSenRationalL2Dec FaultTCUCCP_OilSenRationalL2FailMod FaultTCUCCP_OilSenRationalL2Inc FaultTCUCCP_OilTempRationalHDec FaultTCUCCP_OilTempRationalHFailMod FaultTCUCCP_OilTempRationalHInc FaultTCUCCP_OilTempRationalLDec FaultTCUCCP_OilTempRationalLFailMod FaultTCUCCP_OilTempRationalLInc /end DEF_CHARACTERISTIC
 /begin OUT_MEASUREMENT FaultTableFuncTypeCounter1[120] FaultTableFuncTypeCounter1[121] FaultTableFuncTypeCounter1[122] FaultTableFuncTypeCounter1[123] FaultTableFuncTypeCounter1[124] FaultTableFuncTypeCounter1[125] FaultTableFuncTypeCounter1[126] FaultTableFuncTypeCounter1[127] FaultTableFuncTypeCounter1[128] FaultTableFuncTypeCounter1[129] FaultTableFuncTypeCounter1[12] FaultTableFuncTypeCounter1[130] FaultTableFuncTypeCounter1[131] FaultTableFuncTypeCounter1[132] FaultTableFuncTypeCounter1[13] FaultTableFuncTypeCounter1[14] FaultTableFuncTypeCounter1[15] FaultTableFuncTypeCounter1[16] FaultTableFuncTypeCounter1[17] FaultTableFuncTypeCounter1[18] FaultTableFuncTypeCounter1[19] FaultTableFuncTypeCounter1[1] FaultTableFuncTypeCounter1[20] FaultTableFuncTypeCounter1[21] FaultTableFuncTypeCounter1[22] FaultTableFuncTypeCounter1[23] FaultTableFuncTypeCounter1[24] FaultTableFuncTypeCounter1[25] FaultTableFuncTypeCounter1[26] FaultTableFuncTypeCounter1[27] FaultTableFuncTypeCounter1[28] FaultTableFuncTypeCounter1[29] FaultTableFuncTypeCounter1[2] FaultTableFuncTypeCounter1[30] FaultTableFuncTypeCounter1[31] FaultTableFuncTypeCounter1[32] FaultTableFuncTypeCounter1[33] FaultTableFuncTypeCounter1[34] FaultTableFuncTypeCounter1[35] FaultTableFuncTypeCounter1[36] FaultTableFuncTypeCounter1[37] FaultTableFuncTypeCounter1[38] FaultTableFuncTypeCounter1[39] FaultTableFuncTypeCounter1[3] FaultTableFuncTypeCounter1[40] FaultTableFuncTypeCounter1[41] FaultTableFuncTypeCounter1[42] FaultTableFuncTypeCounter1[43] FaultTableFuncTypeCounter1[44] FaultTableFuncTypeCounter1[45] FaultTableFuncTypeCounter1[46] FaultTableFuncTypeCounter1[47] FaultTableFuncTypeCounter1[48] FaultTableFuncTypeCounter1[49] FaultTableFuncTypeCounter1[4] FaultTableFuncTypeCounter1[50] FaultTableFuncTypeCounter1[51] FaultTableFuncTypeCounter1[52] FaultTableFuncTypeCounter1[53] FaultTableFuncTypeCounter1[54] FaultTableFuncTypeCounter1[55] FaultTableFuncTypeCounter1[56] FaultTableFuncTypeCounter1[57] FaultTableFuncTypeCounter1[58] FaultTableFuncTypeCounter1[59] FaultTableFuncTypeCounter1[5] FaultTableFuncTypeCounter1[60] FaultTableFuncTypeCounter1[61] FaultTableFuncTypeCounter1[62] FaultTableFuncTypeCounter1[63] FaultTableFuncTypeCounter1[64] FaultTableFuncTypeCounter1[65] FaultTableFuncTypeCounter1[66] FaultTableFuncTypeCounter1[67] FaultTableFuncTypeCounter1[68] FaultTableFuncTypeCounter1[69] FaultTableFuncTypeCounter1[6] FaultTableFuncTypeCounter1[70] FaultTableFuncTypeCounter1[71] FaultTableFuncTypeCounter1[72] FaultTableFuncTypeCounter1[73] FaultTableFuncTypeCounter1[74] FaultTableFuncTypeCounter1[75] FaultTableFuncTypeCounter1[76] FaultTableFuncTypeCounter1[77] FaultTableFuncTypeCounter1[78] FaultTableFuncTypeCounter1[79] FaultTableFuncTypeCounter1[7] FaultTableFuncTypeCounter1[80] FaultTableFuncTypeCounter1[81] FaultTableFuncTypeCounter1[82] FaultTableFuncTypeCounter1[83] FaultTableFuncTypeCounter1[84] FaultTableFuncTypeCounter1[85] FaultTableFuncTypeCounter1[86] FaultTableFuncTypeCounter1[87] FaultTableFuncTypeCounter1[88] FaultTableFuncTypeCounter1[89] FaultTableFuncTypeCounter1[8] FaultTableFuncTypeCounter1[90] FaultTableFuncTypeCounter1[91] FaultTableFuncTypeCounter1[92] FaultTableFuncTypeCounter1[93] FaultTableFuncTypeCounter1[94] FaultTableFuncTypeCounter1[95] FaultTableFuncTypeCounter1[96] FaultTableFuncTypeCounter1[97] FaultTableFuncTypeCounter1[98] FaultTableFuncTypeCounter1[99] FaultTableFuncTypeCounter1[9] FaultTCUCAP0_CAPPressureHAut FaultTCUCAP0_CAPPressureHDetected FaultTCUCAP0_CAPPressureHLogged FaultTCUCAP0_CAPPressureLAut FaultTCUCAP0_CAPPressureLDetected FaultTCUCAP0_CAPPressureLLogged FaultTCUCAP0_CAPPressureOverHAut FaultTCUCAP0_CAPPressureOverHDetected FaultTCUCAP0_CAPPressureOverHLogged FaultTCUCAP0_CAPSlipAut FaultTCUCAP0_CAPSlipDetected FaultTCUCAP0_CAPSlipLogged FaultTCUCAP0_Detected FaultTCUCAP0_DragMomentHAut FaultTCUCAP0_DragMomentHDetected FaultTCUCAP0_DragMomentHLogged FaultTCUCAP0_HLSinInvalidAut FaultTCUCAP0_HLSinInvalidDetected FaultTCUCAP0_HLSinInvalidLogged FaultTCUCAP0_HLSinUndefineAut FaultTCUCAP0_HLSinUndefineDetected FaultTCUCAP0_HLSinUndefineLogged FaultTCUCAP0_HLSupplyHAut FaultTCUCAP0_HLSupplyHDetected FaultTCUCAP0_HLSupplyHLogged FaultTCUCAP0_HLSupplyLAut FaultTCUCAP0_HLSupplyLDetected FaultTCUCAP0_HLSupplyLLogged FaultTCUCAP0_Logged FaultTCUCAP0_MotorPhaseVolHAut FaultTCUCAP0_MotorPhaseVolHDetected FaultTCUCAP0_MotorPhaseVolHLogged FaultTCUCAP0_PressureRationalAut FaultTCUCAP0_PressureRationalDetected FaultTCUCAP0_PressureRationalLogged FaultTCUCAP0_SenSigOpenOrGNDAut FaultTCUCAP0_SenSigOpenOrGNDDetected FaultTCUCAP0_SenSigOpenOrGNDLogged FaultTCUCAP0_SenSigVCCAut FaultTCUCAP0_SenSigVCCDetected FaultTCUCAP0_SenSigVCCLogged FaultTCUCAP0_SensorPerforErrAut FaultTCUCAP0_SensorPerforErrDetected FaultTCUCAP0_SensorPerforErrLogged FaultTCUCAP1_COM_GCUAut FaultTCUCAP1_COM_GCUDetected FaultTCUCAP1_COM_GCULogged FaultTCUCAP1_Detected FaultTCUCAP1_DriverTempHAut FaultTCUCAP1_DriverTempHDetected FaultTCUCAP1_DriverTempHLogged FaultTCUCAP1_FETShortAut FaultTCUCAP1_FETShortDetected FaultTCUCAP1_FETShortLogged FaultTCUCAP1_HWOverCurAut FaultTCUCAP1_HWOverCurDetected FaultTCUCAP1_HWOverCurLogged FaultTCUCAP1_Logged FaultTCUCAP1_MotorPhaseDriveErrAut FaultTCUCAP1_MotorPhaseDriveErrDetected FaultTCUCAP1_MotorPhaseDriveErrLogged FaultTCUCAP1_MotorStallAut FaultTCUCAP1_MotorStallDetected FaultTCUCAP1_MotorStallLogged FaultTCUCAP1_OverVoltageAut FaultTCUCAP1_OverVoltageDetected FaultTCUCAP1_OverVoltageLogged FaultTCUCAP1_PhaseDetectGNDAut FaultTCUCAP1_PhaseDetectGNDDetected FaultTCUCAP1_PhaseDetectGNDLogged FaultTCUCAP1_PhaseDetectVCCAut FaultTCUCAP1_PhaseDetectVCCDetected FaultTCUCAP1_PhaseDetectVCCLogged FaultTCUCAP1_SWOverCurAut FaultTCUCAP1_SWOverCurDetected FaultTCUCAP1_SWOverCurLogged FaultTCUCAP1_ThermalShutDownAut FaultTCUCAP1_ThermalShutDownDetected FaultTCUCAP1_ThermalShutDownLogged FaultTCUCAP1_ThermalWarningAut FaultTCUCAP1_ThermalWarningDetected FaultTCUCAP1_ThermalWarningLogged FaultTCUCAP1_UnderVoltageAut FaultTCUCAP1_UnderVoltageDetected FaultTCUCAP1_UnderVoltageLogged FaultTCUCCP_Detected FaultTCUCCP_Logged FaultTCUCCP_OilMotorRationalAut FaultTCUCCP_OilMotorRationalDetected FaultTCUCCP_OilMotorRationalLogged FaultTCUCCP_OilMotorStallAut FaultTCUCCP_OilMotorStallDetected FaultTCUCCP_OilMotorStallLogged FaultTCUCCP_OilSenRationalL1Aut FaultTCUCCP_OilSenRationalL1Detected FaultTCUCCP_OilSenRationalL1Logged FaultTCUCCP_OilSenRationalL2Aut FaultTCUCCP_OilSenRationalL2Detected FaultTCUCCP_OilSenRationalL2Logged FaultTCUCCP_OilTempRationalHAut FaultTCUCCP_OilTempRationalHDetected FaultTCUCCP_OilTempRationalHLogged FaultTCUCCP_OilTempRationalLAut FaultTCUCCP_OilTempRationalLDetected FaultTCUCCP_OilTempRationalLLogged /end OUT_MEASUREMENT
/end FUNCTION
/begin FUNCTION FAULT_FF ""
 /begin OUT_MEASUREMENT FAULT_FF_bFrameLock_FF1 FF_FF1_BatteryVoltage FF_FF1_BMS_HVBusVolt FF_FF1_CosScaled FF_FF1_DC_Current FF_FF1_DrivingPermission FF_FF1_EngineSpeed FF_FF1_EstimTempSecFild FF_FF1_ExcitationDiag FF_FF1_ExcVoltageFild FF_FF1_FPGA_FaultA FF_FF1_FPGA_FaultB FF_FF1_FT_AclState FF_FF1_FTModeReq FF_FF1_GlbRealTimeDay FF_FF1_GlbRealTimeHour FF_FF1_GlbRealTimeMinute FF_FF1_GlbRealTimeMonth FF_FF1_GlbRealTimeSec FF_FF1_GlbRealTimeYear FF_FF1_HV_VoltageFild FF_FF1_I0dq3_1 FF_FF1_I0dq3_2 FF_FF1_i0dqTgt3_1 FF_FF1_i0dqTgt3_2 FF_FF1_idCorTgt FF_FF1_idLutTgt FF_FF1_IGBTStatus FF_FF1_IgnitionSwSig FF_FF1_IPUMode FF_FF1_iqLutTgt FF_FF1_ISGCurrentTorq FF_FF1_Iu FF_FF1_Iv FF_FF1_Iw FF_FF1_MaxMinTorqueDrtVect FF_FF1_MCU_HVBusVolt FF_FF1_MecaSpeedRpm FF_FF1_MecaTorqueMaxMin FF_FF1_MotTemp FF_FF1_ParkVoltageTgt FF_FF1_ResolNext2ThetaRdByPi FF_FF1_RMS_Cur_U FF_FF1_RMS_Cur_V FF_FF1_RMS_Cur_W FF_FF1_RstStartUpCnt FF_FF1_SinScaled FF_FF1_SOC FF_FF1_TempCmdBoard FF_FF1_TempCoolingFild FF_FF1_TempDrvBoard FF_FF1_TempIgbt FF_FF1_TimestampIgn FF_FF1_TimestampLife_H FF_FF1_TimestampLife_L FF_FF1_TotalMiles_H FF_FF1_TotalMiles_L FF_FF1_UM1dTgt FF_FF1_UM1qTgt FF_FF1_VCU_AllowTorq FF_FF1_VCU_DCU_ModeReq FF_FF1_VCU_DCU_TorqSet FF_FF1_VehicleSpd /end OUT_MEASUREMENT
/end FUNCTION
/begin FUNCTION FRecord "" /begin DEF_CHARACTERISTIC FRecord_ku32TimeBeforeFaultOccurC /end DEF_CHARACTERISTIC
 /begin OUT_MEASUREMENT Frecord_bFaultRecoverPermission FRecord_u8ClearReq FRecord_u8EventWriteState FRecord_u8FRLockedStatus FRecord_u8FRStoreState FRecord_u8HeadWriteState /end OUT_MEASUREMENT
/end FUNCTION
/begin FUNCTION HARD ""
 /begin DEF_CHARACTERISTIC HARD_bPtgEnablePhaseShiftingC HARD_u16PtgUSignalShiftC HARD_u16PtgVSignalShiftC HARD_u16PtgWSignalShiftC HARDPTG_s16AmplitudeC HARDPTG_s16ContinuousRequestC HARDPTG_s16OffsetC HARDPTG_s16SlewRateC HARDPTG_u16PulseDutyCycleC HARDPTG_u32FrequenceC /end DEF_CHARACTERISTIC
 /begin OUT_MEASUREMENT HARD_bDio_M_AD2S_DOS HARD_bDio_M_AD2S_LOT HARD_bDio_M_ADUM_ENABLE_N HARD_bDio_M_CPLD_ASC_STATE HARD_bDio_M_DBG_1 HARD_bDio_M_DBG_4 HARD_bDio_M_DIAG_EXC HARD_bDio_M_EEP_C_CS HARD_bDio_M_EMGY_STOP_IN HARD_bDio_M_EMGY_STOP_OUT HARD_bDio_M_ENA_HT_HS HARD_bDio_M_ENA_HT_LS HARD_bDio_M_EXCITATION_IN HARD_bDio_M_FLT_C_DCLINK_OC HARD_bDio_M_FLT_C_DCLINK_OV HARD_bDio_M_FLT_C_HW_OC_U HARD_bDio_M_FLT_C_HW_OC_V HARD_bDio_M_FLT_C_HW_OC_W HARD_bDio_M_FLT_C_IGBT_H HARD_bDio_M_FLT_C_IGBT_L HARD_bDio_M_FLT_C_IGBT_OT HARD_bDio_M_FLT_C_MPM_WD HARD_bDio_M_KEY_ON HARD_bDio_M_LED_R1 HARD_bDio_M_MCU_ASC_STATE HARD_bDio_M_PW_DOWN HARD_bDio_M_RGATE_CMD_HS HARD_bDio_M_RGATE_CMD_LS HARD_bDio_M_SPEED_READY HARD_bDio_M_SUPPLY_WDI HARD_bESMCmdFtShutdownReq HARD_bESMCmdFtShutdownRes HARD_bESMCmdFtStartReq HARD_bESMCmdFtStartRes HARD_bESMCmdPwmDirectReq HARD_bESMCmdPwmDirectRes HARD_bESMCmdPwmHardReq HARD_bESMCmdPwmHardRes HARD_bESMCmdPwmOffReq HARD_bESMCmdPwmOffRes HARD_bESMCmdSwShutdownReq HARD_bESMCmdSwShutdownRes HARD_bESMCmdSwStartReq HARD_bESMCmdSwStartRes HARD_bModSeq1FuncOn HARD_bModSeq1InitOn HARD_bModSeq2FuncOn HARD_bModSeq2InitOn HARD_bNmRxRepeatMsgReq HARD_bNMTestOn HARD_bNmTxRepeatMsgReq HARD_bPtgEnable HARD_bPtgSignalsShiftControl HARD_bPtgUSignalEnable HARD_bPtgVSignalEnable HARD_bPtgWSignalEnable HARD_ESM_FT_STATE_FT_SHUTDOWN HARD_ESM_FT_STATE_IDLE HARD_ESM_FT_STATE_PWM_DIRECT HARD_ESM_FT_STATE_PWM_HARD HARD_ESM_FT_STATE_PWM_OFF HARD_ESM_NF_STATE_FT_START HARD_ESM_NF_STATE_IDLE HARD_ESM_NF_STATE_PWM_HARD HARD_ESM_NF_STATE_PWM_OFF HARD_ESM_NF_STATE_SW_SHUTDOWN HARD_EsmFtState HARD_EsmFtStateAut HARD_EsmNfState HARD_EsmNfStateAut HARD_PTG_CONTINUOUS_MODE HARD_PTG_DISJUNCTION_MODE HARD_PTG_LOOP_NB_MODE HARD_PTG_PROFIL_MODE HARD_PTG_PULSE_MODE HARD_PTG_SINUS_MODE HARD_PTG_SQUARE_MODE HARD_PTG_TRIANGLE_MODE HARD_PtgModeTest HARD_s16PtgRefSignalValue HARD_s16PtgUSignalValue HARD_s16PtgVSignalValue HARD_s16PtgWSignalValue HARD_u16Adc0An10_CTN_BOARD2Phys HARD_u16Adc_15V_RDC HARD_u16Adc_9180_V01 HARD_u16Adc_9180_VR0 HARD_u16Adc_CTN_BOARD1 HARD_u16Adc_CTP_COOLING HARD_u16Adc_CTP_MOT1_N HARD_u16Adc_CTP_MOT1_P HARD_u16Adc_CURR_DC HARD_u16Adc_Current_U HARD_u16Adc_Current_V HARD_u16Adc_Current_W HARD_u16Adc_DELTA_COS_NEG HARD_u16Adc_DELTA_COS_POS HARD_u16Adc_DELTA_SIN_NEG HARD_u16Adc_DELTA_SIN_POS HARD_u16Adc_DIAG_CONS_EXC HARD_u16Adc_DIAG_COS_H HARD_u16Adc_DIAG_COS_L HARD_u16Adc_DIAG_SIN_H HARD_u16Adc_DIAG_SIN_L HARD_u16Adc_IgbtTemp_2 HARD_u16Adc_IgbtTemp_3 HARD_u16Adc_MonCurrOcpH HARD_u16Adc_MonCurrOcpL HARD_u16Adc_MonDcOvpSele HARD_u16Adc_MonP5VRef HARD_u16Adc_MOT_COS HARD_u16Adc_MOT_SIN HARD_u16Adc_MOT_SIN_SAFE HARD_u16Adc_Oil_Pressure HARD_u16Adc_Oil_Temp_N HARD_u16Adc_Oil_Temp_P HARD_u16Adc_P12_BLDC HARD_u16Adc_P12V_BATT_F HARD_u16Adc_P16VMult HARD_u16Adc_P5_Gateway HARD_u16Adc_P5VHS_REF HARD_u16Adc_P5vLsRef HARD_u16Adc_PSU_P5V_HS HARD_u16Adc_PSU_P5V_LS HARD_u16Adc_TempDrv HARD_u16Adc_TempIgbt HARD_u16Adc_VolDcLinkDrv HARD_u16Adc_VolDcLinkFil HARD_u16PtgRefSignalNbPeriode HARD_u16PtgRefSignalTime HARD_u16PtgUSignalNbPeriode HARD_u16PtgUSignalTime HARD_u16PtgVSignalNbPeriode HARD_u16PtgVSignalTime HARD_u16PtgWSignalNbPeriode HARD_u16PtgWSignalTime HARD_u8CanIfCtrlMode HARD_u8CanIfCtrlModeReq HARD_u8CanIfPduMode HARD_u8CanIfPduModeReq HARD_u8CanNmLocalNodeId HARD_u8CanNmMode HARD_u8CanNmNodeId HARD_u8CanNmState HARD_u8CanSmMode HARD_u8CanSmModeReq HARD_u8ComMMode HARD_u8ComMState HARD_u8ComMStatus HARD_u8NmMode HARD_u8NmState HARD_u8NmTestNum HARD_u8NmUserDataRx HARD_u8NmUserDataRx[0] HARD_u8NmUserDataRx[1] HARD_u8NmUserDataRx[2] HARD_u8NmUserDataRx[3] HARD_u8NmUserDataRx[4] HARD_u8NmUserDataRx[5] HARD_u8NmUserDataTx HARD_u8NmUserDataTx[0] HARD_u8NmUserDataTx[1] HARD_u8NmUserDataTx[2] HARD_u8NmUserDataTx[3] HARD_u8NmUserDataTx[4] HARD_u8NmUserDataTx[5] HARD_u8NmWakeupReason HARD_u8VSIRxaTempCtrlBdPhys HARD_u8VSIRxaTempDrvBdPhys HARD_u8VSIRxaTempIgbtPhys /end OUT_MEASUREMENT
/end FUNCTION
/begin COMPU_METHOD HARD_EsmFtState_conv "" TAB_VERB "%8.4" "." COMPU_TAB_REF HARD_EsmFtState_table /end COMPU_METHOD
/begin COMPU_VTAB HARD_EsmFtState_table "" TAB_VERB 5 1 "HARD_ESM_FT_STATE_PWM_DIRECT" 2 "HARD_ESM_FT_STATE_PWM_HARD" 4 "HARD_ESM_FT_STATE_PWM_OFF" 8 "HARD_ESM_FT_STATE_FT_SHUTDOWN" 64 "HARD_ESM_FT_STATE_IDLE" /end COMPU_VTAB
/begin COMPU_METHOD HARD_EsmNfState_conv "" TAB_VERB "%8.4" "." COMPU_TAB_REF HARD_EsmNfState_table /end COMPU_METHOD
/begin COMPU_VTAB HARD_EsmNfState_table "" TAB_VERB 5 1 "HARD_ESM_NF_STATE_FT_START" 4 "HARD_ESM_NF_STATE_SW_SHUTDOWN" 8 "HARD_ESM_NF_STATE_PWM_HARD" 16 "HARD_ESM_NF_STATE_PWM_OFF" 64 "HARD_ESM_NF_STATE_IDLE" /end COMPU_VTAB
/begin COMPU_METHOD HARD_PtgModeTest_conv "" TAB_VERB "%8.4" "." COMPU_TAB_REF HARD_PtgModeTest_table /end COMPU_METHOD
/begin COMPU_VTAB HARD_PtgModeTest_table "" TAB_VERB 8 1 "HARD_PTG_PULSE_MODE" 2 "HARD_PTG_SINUS_MODE" 4 "HARD_PTG_TRIANGLE_MODE" 8 "HARD_PTG_SQUARE_MODE" 16 "HARD_PTG_CONTINUOUS_MODE" 32 "HARD_PTG_PROFIL_MODE" 64 "HARD_PTG_DISJUNCTION_MODE" 128 "HARD_PTG_LOOP_NB_MODE" /end COMPU_VTAB
/end MODULE
/end PROJECT
