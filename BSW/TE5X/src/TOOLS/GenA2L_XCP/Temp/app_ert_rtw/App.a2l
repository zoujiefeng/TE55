ASAP2_VERSION 1 31
/begin PROJECT ProjectName "Project Comment Goes Here"
/begin HEADER "Header Comments go here" /end HEADER
/begin MODULE ModuleName "Module Comment Goes Here"
/begin MOD_COMMON "Mod Common Comment Here" BYTE_ORDER MSB_FIRST /end MOD_COMMON
/* EOF PORS.a2l */
/begin RECORD_LAYOUT DATA_RECORD_UBYTE FNC_VALUES 1 UBYTE ROW_DIR DIRECT /end RECORD_LAYOUT
/begin RECORD_LAYOUT DATA_RECORD_UWORD FNC_VALUES 1 UWORD ROW_DIR DIRECT /end RECORD_LAYOUT
/begin RECORD_LAYOUT DATA_RECORD_SWORD FNC_VALUES 1 SWORD ROW_DIR DIRECT /end RECORD_LAYOUT
/begin RECORD_LAYOUT DATA_RECORD_ULONG FNC_VALUES 1 ULONG ROW_DIR DIRECT /end RECORD_LAYOUT
/begin RECORD_LAYOUT DATA_RECORD_FLOAT32_IEEE FNC_VALUES 1 FLOAT32_IEEE ROW_DIR DIRECT /end RECORD_LAYOUT
/begin CHARACTERISTIC FSEVBHV_A2DOffsetVoltageC "Parameter used to correct an sensor offset error." VALUE 0x80060E3C DATA_RECORD_FLOAT32_IEEE 8190 F_1_p0_34 -4095 4095 /end CHARACTERISTIC
/begin CHARACTERISTIC FSEVBHV_A2dMaxValueC "Maximal value of the ADC." VALUE 0x80060E38 DATA_RECORD_FLOAT32_IEEE 4095 F_1_p0_34 0 4095 /end CHARACTERISTIC
/begin CHARACTERISTIC FSEVBHV_A2dMinValueC "Minimal value of the ADC." VALUE 0x80060E34 DATA_RECORD_FLOAT32_IEEE 4095 F_1_p0_34 0 4095 /end CHARACTERISTIC
/begin CHARACTERISTIC FSEVBHV_CutOffFrequencyC "Filter parameter." VALUE 0x80060E30 DATA_RECORD_FLOAT32_IEEE 2000000 F_1_p0_35 -1000000 1000000 /end CHARACTERISTIC
/begin CHARACTERISTIC FSEVBHV_GainCorrnC "Gain used to correct a sensor linearity error." VALUE 0x80060E2C DATA_RECORD_FLOAT32_IEEE 2000000 F_1_p0_36 -1000000 1000000 /end CHARACTERISTIC
/begin CHARACTERISTIC FSEVBHV_GainScalingC "Gain used to convert ADC result into real battery voltage." VALUE 0x80060E28 DATA_RECORD_FLOAT32_IEEE 2000000 F_1_p0_37 -1000000 1000000 /end CHARACTERISTIC
/begin CHARACTERISTIC FSEVBHV_HighVoltRdyThrC "FSEVBHV_HighVoltRdyThrC" VALUE 0x80060E24 DATA_RECORD_FLOAT32_IEEE 3.402823466E+038 F_1_p0_4 -3.402823466E+038 3.402823466E+038 /end CHARACTERISTIC
/begin CHARACTERISTIC FSEVBHV_HighVoltageThrC "Maximal acceptable value of the battery voltage." VALUE 0x80060E20 DATA_RECORD_FLOAT32_IEEE 4095 F_1_p0_34 0 4095 /end CHARACTERISTIC
/begin CHARACTERISTIC FSEVBHV_LowHysteresisRangeC "FSEVBHV_LowHysteresisRangeC" VALUE 0x80060E1C DATA_RECORD_FLOAT32_IEEE 3.402823466E+038 F_1_p0_38 -3.402823466E+038 3.402823466E+038 /end CHARACTERISTIC
/begin CHARACTERISTIC FSEVBHV_LowVoltageThrC "Maximal acceptable value of the battery voltage." VALUE 0x80060E18 DATA_RECORD_FLOAT32_IEEE 4095 F_1_p0_34 0 4095 /end CHARACTERISTIC
/begin CHARACTERISTIC FSEVBHV_LowVoltageWarnThrC "FSEVBHV_LowVoltageWarnThrC" VALUE 0x80060E14 DATA_RECORD_FLOAT32_IEEE 3.402823466E+038 F_1_p0_38 -3.402823466E+038 3.402823466E+038 /end CHARACTERISTIC
/begin CHARACTERISTIC FSEVBHV_SampleVolOutRngHHC "FSEVBHV_SampleVolOutRngHHC" VALUE 0x80060E10 DATA_RECORD_UWORD 65535 F_1_p0_4 0 65535 /end CHARACTERISTIC
/begin CHARACTERISTIC FSEVBHV_SampleVolOutRngHLC "FSEVBHV_SampleVolOutRngHLC" VALUE 0x80060E0C DATA_RECORD_UWORD 65535 F_1_p0_4 0 65535 /end CHARACTERISTIC
/begin CHARACTERISTIC FSEVBHV_SampleVolOutRngLHC "FSEVBHV_SampleVolOutRngLHC" VALUE 0x80060E08 DATA_RECORD_UWORD 65535 F_1_p0_4 0 65535 /end CHARACTERISTIC
/begin CHARACTERISTIC FSEVBHV_SampleVolOutRngLLC "FSEVBHV_SampleVolOutRngLLC" VALUE 0x80060E04 DATA_RECORD_UWORD 65535 F_1_p0_4 0 65535 /end CHARACTERISTIC
/begin CHARACTERISTIC FSEVBHV_ShortCircuitGndC "FSEVBHV_ShortCircuitGndC" VALUE 0x80060E00 DATA_RECORD_UWORD 65535 F_1_p0_4 0 65535 /end CHARACTERISTIC
/begin CHARACTERISTIC FSEVBHV_ShortCircuitVccC "FSEVBHV_ShortCircuitVccC" VALUE 0x80060DFC DATA_RECORD_UWORD 65535 F_1_p0_4 0 65535 /end CHARACTERISTIC
/begin CHARACTERISTIC FSEVBHV_VisuAdUbatC "FSEVBHV_VisuAdUbatC" VALUE 0x80060DF8 DATA_RECORD_FLOAT32_IEEE 3.402823466E+038 F_1_p0_38 -3.402823466E+038 3.402823466E+038 /end CHARACTERISTIC
/begin CHARACTERISTIC FSEVBHV_VisuAdUbatEnC "FSEVBHV_VisuAdUbatEnC" VALUE 0x80060DF4 DATA_RECORD_UBYTE 1 Bool_ON_OFF 0 1 BIT_MASK 0x01 /end CHARACTERISTIC
/begin CHARACTERISTIC FSEVBHV_VolNotRationalEnC "FSEVBHV_VolNotRationalEnC" VALUE 0x80060DF0 DATA_RECORD_UBYTE 1 Bool_ON_OFF 0 1 BIT_MASK 0x01 /end CHARACTERISTIC
/begin CHARACTERISTIC FSEVBHV_VolNotRationalNumC "FSEVBHV_VolNotRationalNumC" VALUE 0x80060DEC DATA_RECORD_FLOAT32_IEEE 3.402823466E+038 F_1_p0_38 -3.402823466E+038 3.402823466E+038 /end CHARACTERISTIC
/begin CHARACTERISTIC FSEVBLV_A2DOffsetBkpVolC "Gain used to correct a sensor linearity error." VALUE 0x80060E8C DATA_RECORD_FLOAT32_IEEE 2000000 F_1_p0_36 -1000000 1000000 /end CHARACTERISTIC
/begin CHARACTERISTIC FSEVBLV_A2DOffsetVoltageC "Parameter used to correct an sensor offset error." VALUE 0x80060E88 DATA_RECORD_FLOAT32_IEEE 8190 F_1_p0_34 -4095 4095 /end CHARACTERISTIC
/begin CHARACTERISTIC FSEVBLV_A2dMaxValueC "Maximal value of the ADC." VALUE 0x80060E84 DATA_RECORD_FLOAT32_IEEE 4095 F_1_p0_34 0 4095 /end CHARACTERISTIC
/begin CHARACTERISTIC FSEVBLV_A2dMinValueC "Minimal value of the ADC." VALUE 0x80060E80 DATA_RECORD_FLOAT32_IEEE 4095 F_1_p0_34 0 4095 /end CHARACTERISTIC
/begin CHARACTERISTIC FSEVBLV_BkpMinVolThrC "Maximal acceptable value of the battery voltage." VALUE 0x80060E7C DATA_RECORD_FLOAT32_IEEE 3.402823466E+038 F_1_p0_40 -3.402823466E+038 3.402823466E+038 /end CHARACTERISTIC
/begin CHARACTERISTIC FSEVBLV_BlvMinVolThrC "Maximal acceptable value of the battery voltage." VALUE 0x80060E78 DATA_RECORD_FLOAT32_IEEE 3.402823466E+038 F_1_p0_40 -3.402823466E+038 3.402823466E+038 /end CHARACTERISTIC
/begin CHARACTERISTIC FSEVBLV_CutOffFrequencyC "Filter parameter." VALUE 0x80060E74 DATA_RECORD_FLOAT32_IEEE 2000000 F_1_p0_35 -1000000 1000000 /end CHARACTERISTIC
/begin CHARACTERISTIC FSEVBLV_GainCorrnBkpC "Gain used to correct a sensor linearity error." VALUE 0x80060E70 DATA_RECORD_FLOAT32_IEEE 2000000 F_1_p0_36 -1000000 1000000 /end CHARACTERISTIC
/begin CHARACTERISTIC FSEVBLV_GainCorrnC "Gain used to correct a sensor linearity error." VALUE 0x80060E6C DATA_RECORD_FLOAT32_IEEE 2000000 F_1_p0_36 -1000000 1000000 /end CHARACTERISTIC
/begin CHARACTERISTIC FSEVBLV_GainScalingBkpC "Maximal acceptable value of the battery voltage." VALUE 0x80060E68 DATA_RECORD_FLOAT32_IEEE 4095 F_1_p0_34 0 4095 /end CHARACTERISTIC
/begin CHARACTERISTIC FSEVBLV_GainScalingC "Gain used to convert ADC result into real battery voltage." VALUE 0x80060E64 DATA_RECORD_FLOAT32_IEEE 2000000 F_1_p0_37 -1000000 1000000 /end CHARACTERISTIC
/begin CHARACTERISTIC FSEVBLV_HighVoltageThrC "Maximal acceptable value of the battery voltage." VALUE 0x80060E60 DATA_RECORD_FLOAT32_IEEE 4095 F_1_p0_34 0 4095 /end CHARACTERISTIC
/begin CHARACTERISTIC FSEVBLV_LowHysteresisRangeC "FSEVBLV_LowHysteresisRangeC" VALUE 0x80060E5C DATA_RECORD_FLOAT32_IEEE 3.402823466E+038 F_1_p0_38 -3.402823466E+038 3.402823466E+038 /end CHARACTERISTIC
/begin CHARACTERISTIC FSEVBLV_LowVoltageThrC "Maximal acceptable value of the battery voltage." VALUE 0x80060E58 DATA_RECORD_FLOAT32_IEEE 4095 F_1_p0_34 0 4095 /end CHARACTERISTIC
/begin CHARACTERISTIC FSEVBLV_LowVoltageWarnThrC "FSEVBLV_LowVoltageWarnThrC" VALUE 0x80060E54 DATA_RECORD_FLOAT32_IEEE 3.402823466E+038 F_1_p0_38 -3.402823466E+038 3.402823466E+038 /end CHARACTERISTIC
/begin CHARACTERISTIC FSEVBLV_P5VAD2VoltC "Maximal acceptable value of the battery voltage." VALUE 0x80060E50 DATA_RECORD_FLOAT32_IEEE 4095 F_1_p0_34 0 4095 /end CHARACTERISTIC
/begin CHARACTERISTIC FSEVBLV_P5VRefC "Maximal acceptable value of the battery voltage." VALUE 0x80060E4C DATA_RECORD_FLOAT32_IEEE 4095 F_1_p0_34 0 4095 /end CHARACTERISTIC
/begin CHARACTERISTIC FSEVBLV_P5VRefErrBurstC "Maximal acceptable value of the battery voltage." VALUE 0x80060E48 DATA_RECORD_FLOAT32_IEEE 4095 F_1_p0_34 0 4095 /end CHARACTERISTIC
/begin CHARACTERISTIC FSEVBLV_ShortCircuitGndC "FSEVBLV_ShortCircuitGndC" VALUE 0x80060E44 DATA_RECORD_UWORD 65535 F_1_p0_4 0 65535 /end CHARACTERISTIC
/begin CHARACTERISTIC FSEVBLV_ShortCircuitVccC "FSEVBLV_ShortCircuitVccC" VALUE 0x80060E40 DATA_RECORD_UWORD 65535 F_1_p0_4 0 65535 /end CHARACTERISTIC
/begin CHARACTERISTIC FSEVETA_A2dMaxValueC "FSEVETA_A2dMaxValueC" VALUE 0x800611AC DATA_RECORD_FLOAT32_IEEE 3.402823466E+038 F_1_p0_4 -3.402823466E+038 3.402823466E+038 /end CHARACTERISTIC
/begin CHARACTERISTIC FSEVETA_A2dMinValueC "FSEVETA_A2dMinValueC" VALUE 0x800611A8 DATA_RECORD_FLOAT32_IEEE 3.402823466E+038 F_1_p0_4 -3.402823466E+038 3.402823466E+038 /end CHARACTERISTIC
/begin CHARACTERISTIC FSEVETA_ADTTIgbt25C "FSEVETA_ADTTIgbt25C" VALUE 0x800611A4 DATA_RECORD_UWORD 65535 F_1_p0_4 0 65535 /end CHARACTERISTIC
/begin CHARACTERISTIC FSEVETA_CmdShortCircuitGndC "FSEVETA_CmdShortCircuitGndC" VALUE 0x800611A0 DATA_RECORD_UWORD 65535 F_1_p0_4 0 65535 /end CHARACTERISTIC
/begin CHARACTERISTIC FSEVETA_CmdShortCircuitVccC "FSEVETA_CmdShortCircuitVccC" VALUE 0x8006119C DATA_RECORD_UWORD 65535 F_1_p0_4 0 65535 /end CHARACTERISTIC
/begin CHARACTERISTIC FSEVETA_CutOffFrequencyC "FSEVETA_CutOffFrequencyC" VALUE 0x80061198 DATA_RECORD_FLOAT32_IEEE 10 F_1_p0_43 0 10 /end CHARACTERISTIC
/begin CHARACTERISTIC FSEVETA_DrvShortCircuitGndC "FSEVETA_DrvShortCircuitGndC" VALUE 0x80061194 DATA_RECORD_UWORD 65535 F_1_p0_4 0 65535 /end CHARACTERISTIC
/begin CHARACTERISTIC FSEVETA_DrvShortCircuitVccC "FSEVETA_DrvShortCircuitVccC" VALUE 0x80061190 DATA_RECORD_UWORD 65535 F_1_p0_4 0 65535 /end CHARACTERISTIC
/begin CHARACTERISTIC FSEVETA_FaultPeriodCounterC "FSEVETA_FaultPeriodCounterC" VALUE 0x8006118C DATA_RECORD_UWORD 65535 F_1_p0_4 0 65535 /end CHARACTERISTIC
/begin CHARACTERISTIC FSEVETA_GainTempCoolingC "FSEVETA_GainTempCoolingC" VALUE 0x80061188 DATA_RECORD_FLOAT32_IEEE 2000 F_1_p0_43 -1000 1000 /end CHARACTERISTIC
/begin CHARACTERISTIC FSEVETA_GainTempDrvBoardLeftC "FSEVETA_GainTempDrvBoardLeftC" VALUE 0x80061184 DATA_RECORD_FLOAT32_IEEE 2000 F_1_p0_43 -1000 1000 /end CHARACTERISTIC
/begin CHARACTERISTIC FSEVETA_GainTempIgbtLeftC "FSEVETA_GainTempIgbtLeftC" VALUE 0x80061180 DATA_RECORD_FLOAT32_IEEE 2000 F_1_p0_43 -1000 1000 /end CHARACTERISTIC
/begin CHARACTERISTIC FSEVETA_GainTempLVCmdBoardC "FSEVETA_GainTempLVCmdBoardC" VALUE 0x8006117C DATA_RECORD_FLOAT32_IEEE 1 F_1_p0_4 0 1 /end CHARACTERISTIC
/begin CHARACTERISTIC FSEVETA_HighTempCmdBoard2ThdC "FSEVETA_HighTempCmdBoard2ThdC" VALUE 0x80061178 DATA_RECORD_FLOAT32_IEEE 3.402823466E+038 F_1_p0_4 -3.402823466E+038 3.402823466E+038 /end CHARACTERISTIC
/begin CHARACTERISTIC FSEVETA_HighTempCmdBoardThdC "FSEVETA_HighTempCmdBoardThdC" VALUE 0x80061174 DATA_RECORD_FLOAT32_IEEE 3.402823466E+038 F_1_p0_4 -3.402823466E+038 3.402823466E+038 /end CHARACTERISTIC
/begin CHARACTERISTIC FSEVETA_HighTempDrvLeftThdC "FSEVETA_HighTempDrvLeftThdC" VALUE 0x80061170 DATA_RECORD_FLOAT32_IEEE 3.402823466E+038 F_1_p0_4 -3.402823466E+038 3.402823466E+038 /end CHARACTERISTIC
/begin CHARACTERISTIC FSEVETA_HighTempIgbtLeftThdC "FSEVETA_HighTempIgbtLeftThdC" VALUE 0x8006116C DATA_RECORD_FLOAT32_IEEE 3.402823466E+038 F_1_p0_4 -3.402823466E+038 3.402823466E+038 /end CHARACTERISTIC
/begin CHARACTERISTIC FSEVETA_IgbtRationalThdC "FSEVETA_IgbtRationalThdC" VALUE 0x80061168 DATA_RECORD_FLOAT32_IEEE 100 F_1_p0_43 0 100 /end CHARACTERISTIC
/begin CHARACTERISTIC FSEVETA_IgbtTableTT2VP2C "FSEVETA_IgbtTableTT2VP2C" VALUE 0x80061164 DATA_RECORD_UBYTE 1 Bool_ON_OFF 0 1 BIT_MASK 0x01 /end CHARACTERISTIC
/begin CHARACTERISTIC FSEVETA_IgbtTempSlopDetnEnC "FSEVETA_IgbtTempSlopDetnEnC" VALUE 0x80061160 DATA_RECORD_UBYTE 1 Bool_ON_OFF 0 1 BIT_MASK 0x01 /end CHARACTERISTIC
/begin CHARACTERISTIC FSEVETA_IgbtTempSlopMaxC "FSEVETA_IgbtTempSlopMaxC" VALUE 0x8006115C DATA_RECORD_FLOAT32_IEEE 3.402823466E+038 F_1_p0_4 -3.402823466E+038 3.402823466E+038 /end CHARACTERISTIC
/begin CHARACTERISTIC FSEVETA_InterSampleIgbtHOutRngHC "FSEVETA_InterSampleIgbtHOutRngHC" VALUE 0x80061158 DATA_RECORD_UWORD 65535 F_1_p0_4 0 65535 /end CHARACTERISTIC
/begin CHARACTERISTIC FSEVETA_InterSampleIgbtHOutRngLC "FSEVETA_InterSampleIgbtHOutRngLC" VALUE 0x80061154 DATA_RECORD_UWORD 65535 F_1_p0_4 0 65535 /end CHARACTERISTIC
/begin CHARACTERISTIC FSEVETA_InterSampleIgbtLOutRngHC "FSEVETA_InterSampleIgbtLOutRngHC" VALUE 0x80061150 DATA_RECORD_UWORD 65535 F_1_p0_4 0 65535 /end CHARACTERISTIC
/begin CHARACTERISTIC FSEVETA_InterSampleIgbtLOutRngLC "FSEVETA_InterSampleIgbtLOutRngLC" VALUE 0x8006114C DATA_RECORD_UWORD 65535 F_1_p0_4 0 65535 /end CHARACTERISTIC
/begin CHARACTERISTIC FSEVETA_InterShortCircuitGndC "FSEVETA_InterShortCircuitGndC" VALUE 0x80061148 DATA_RECORD_UWORD 65535 F_1_p0_4 0 65535 /end CHARACTERISTIC
/begin CHARACTERISTIC FSEVETA_InterShortCircuitVccC "FSEVETA_InterShortCircuitVccC" VALUE 0x80061144 DATA_RECORD_UWORD 65535 F_1_p0_4 0 65535 /end CHARACTERISTIC
/begin CHARACTERISTIC FSEVETA_LowTempCmdBoard2ThdC "FSEVETA_LowTempCmdBoard2ThdC" VALUE 0x80061140 DATA_RECORD_FLOAT32_IEEE 3.402823466E+038 F_1_p0_4 -3.402823466E+038 3.402823466E+038 /end CHARACTERISTIC
/begin CHARACTERISTIC FSEVETA_LowTempCmdBoardThdC "FSEVETA_LowTempCmdBoardThdC" VALUE 0x8006113C DATA_RECORD_FLOAT32_IEEE 3.402823466E+038 F_1_p0_4 -3.402823466E+038 3.402823466E+038 /end CHARACTERISTIC
/begin CHARACTERISTIC FSEVETA_LowTempDrvLeftThdC "FSEVETA_LowTempDrvLeftThdC" VALUE 0x80061138 DATA_RECORD_FLOAT32_IEEE 3.402823466E+038 F_1_p0_4 -3.402823466E+038 3.402823466E+038 /end CHARACTERISTIC
/begin CHARACTERISTIC FSEVETA_LowTempIgbtLeftThdC "FSEVETA_LowTempIgbtLeftThdC" VALUE 0x80061134 DATA_RECORD_FLOAT32_IEEE 3.402823466E+038 F_1_p0_4 -3.402823466E+038 3.402823466E+038 /end CHARACTERISTIC
/begin CHARACTERISTIC FSEVETA_LutInTempCmdBoardC "FSEVETA_LutInTempCmdBoardC" CURVE 0x80061098 DATA_RECORD_FLOAT32_IEEE 3.402823466E+038 F_1_p0_4 -3.402823466E+038 3.402823466E+038
 /begin AXIS_DESCR FIX_AXIS NO_INPUT_QUANTITY Id_0x00 39 0 38 MAX_GRAD 100.0 FIX_AXIS_PAR_DIST 0 1 39 /end AXIS_DESCR
/end CHARACTERISTIC
/begin CHARACTERISTIC FSEVETA_LutInTempDrvBoardC "FSEVETA_LutInTempDrvBoardC" CURVE 0x80060FFC DATA_RECORD_FLOAT32_IEEE 3.402823466E+038 F_1_p0_4 -3.402823466E+038 3.402823466E+038
 /begin AXIS_DESCR FIX_AXIS NO_INPUT_QUANTITY Id_0x00 39 0 38 MAX_GRAD 100.0 FIX_AXIS_PAR_DIST 0 1 39 /end AXIS_DESCR
/end CHARACTERISTIC
/begin CHARACTERISTIC FSEVETA_LutInTempIgbtCU "FSEVETA_LutInTempIgbtCU" CURVE 0x8008EA38 DATA_RECORD_FLOAT32_IEEE 3.402823466E+038 F_1_p0_4 -3.402823466E+038 3.402823466E+038
 /begin AXIS_DESCR FIX_AXIS NO_INPUT_QUANTITY Id_0x00 53 0 52 MAX_GRAD 100.0 FIX_AXIS_PAR_DIST 0 1 53 /end AXIS_DESCR
/end CHARACTERISTIC
/begin CHARACTERISTIC FSEVETA_LutInTempIgbtCV "FSEVETA_LutInTempIgbtCV" CURVE 0x8008E964 DATA_RECORD_FLOAT32_IEEE 3.402823466E+038 F_1_p0_4 -3.402823466E+038 3.402823466E+038
 /begin AXIS_DESCR FIX_AXIS NO_INPUT_QUANTITY Id_0x00 53 0 52 MAX_GRAD 100.0 FIX_AXIS_PAR_DIST 0 1 53 /end AXIS_DESCR
/end CHARACTERISTIC
/begin CHARACTERISTIC FSEVETA_LutInTempIgbtCW "FSEVETA_LutInTempIgbtCW" CURVE 0x8008E890 DATA_RECORD_FLOAT32_IEEE 3.402823466E+038 F_1_p0_4 -3.402823466E+038 3.402823466E+038
 /begin AXIS_DESCR FIX_AXIS NO_INPUT_QUANTITY Id_0x00 53 0 52 MAX_GRAD 100.0 FIX_AXIS_PAR_DIST 0 1 53 /end AXIS_DESCR
/end CHARACTERISTIC
/begin CHARACTERISTIC FSEVETA_LutInTempPt100C "FSEVETA_LutInTempPt100C" CURVE 0x8008E7E4 DATA_RECORD_FLOAT32_IEEE 3.402823466E+038 F_1_p0_4 -3.402823466E+038 3.402823466E+038
 /begin AXIS_DESCR FIX_AXIS NO_INPUT_QUANTITY Id_0x00 43 0 42 MAX_GRAD 100.0 FIX_AXIS_PAR_DIST 0 1 43 /end AXIS_DESCR
/end CHARACTERISTIC
/begin CHARACTERISTIC FSEVETA_LutOutTempCmdBoardC "FSEVETA_LutOutTempCmdBoardC" CURVE 0x80060F60 DATA_RECORD_FLOAT32_IEEE 3.402823466E+038 F_1_p0_4 -3.402823466E+038 3.402823466E+038
 /begin AXIS_DESCR FIX_AXIS NO_INPUT_QUANTITY Id_0x00 39 0 38 MAX_GRAD 100.0 FIX_AXIS_PAR_DIST 0 1 39 /end AXIS_DESCR
/end CHARACTERISTIC
/begin CHARACTERISTIC FSEVETA_LutOutTempDrvBoardC "FSEVETA_LutOutTempDrvBoardC" CURVE 0x80060EC4 DATA_RECORD_FLOAT32_IEEE 3.402823466E+038 F_1_p0_4 -3.402823466E+038 3.402823466E+038
 /begin AXIS_DESCR FIX_AXIS NO_INPUT_QUANTITY Id_0x00 39 0 38 MAX_GRAD 100.0 FIX_AXIS_PAR_DIST 0 1 39 /end AXIS_DESCR
/end CHARACTERISTIC
/begin CHARACTERISTIC FSEVETA_LutOutTempIgbtCU "FSEVETA_LutOutTempIgbtCU" CURVE 0x8008E710 DATA_RECORD_FLOAT32_IEEE 3.402823466E+038 F_1_p0_4 -3.402823466E+038 3.402823466E+038
 /begin AXIS_DESCR FIX_AXIS NO_INPUT_QUANTITY Id_0x00 53 0 52 MAX_GRAD 100.0 FIX_AXIS_PAR_DIST 0 1 53 /end AXIS_DESCR
/end CHARACTERISTIC
/begin CHARACTERISTIC FSEVETA_LutOutTempIgbtCV "FSEVETA_LutOutTempIgbtCV" CURVE 0x8008E63C DATA_RECORD_FLOAT32_IEEE 3.402823466E+038 F_1_p0_4 -3.402823466E+038 3.402823466E+038
 /begin AXIS_DESCR FIX_AXIS NO_INPUT_QUANTITY Id_0x00 53 0 52 MAX_GRAD 100.0 FIX_AXIS_PAR_DIST 0 1 53 /end AXIS_DESCR
/end CHARACTERISTIC
/begin CHARACTERISTIC FSEVETA_LutOutTempIgbtCW "FSEVETA_LutOutTempIgbtCW" CURVE 0x8008E568 DATA_RECORD_FLOAT32_IEEE 3.402823466E+038 F_1_p0_4 -3.402823466E+038 3.402823466E+038
 /begin AXIS_DESCR FIX_AXIS NO_INPUT_QUANTITY Id_0x00 53 0 52 MAX_GRAD 100.0 FIX_AXIS_PAR_DIST 0 1 53 /end AXIS_DESCR
/end CHARACTERISTIC
/begin CHARACTERISTIC FSEVETA_LutOutTempPt100C "FSEVETA_LutOutTempPt100C" CURVE 0x8008E4BC DATA_RECORD_FLOAT32_IEEE 3.402823466E+038 F_1_p0_4 -3.402823466E+038 3.402823466E+038
 /begin AXIS_DESCR FIX_AXIS NO_INPUT_QUANTITY Id_0x00 43 0 42 MAX_GRAD 100.0 FIX_AXIS_PAR_DIST 0 1 43 /end AXIS_DESCR
/end CHARACTERISTIC
/begin CHARACTERISTIC FSEVETA_MotorSpeedC "FSEVETA_MotorSpeedC" VALUE 0x80060EC0 DATA_RECORD_FLOAT32_IEEE 13000 F_1_p0_43 0 13000 /end CHARACTERISTIC
/begin CHARACTERISTIC FSEVETA_OffsetTempCoolingC "FSEVETA_OffsetTempCoolingC" VALUE 0x80060EBC DATA_RECORD_FLOAT32_IEEE 3.402823466E+038 F_1_p0_4 -3.402823466E+038 3.402823466E+038 /end CHARACTERISTIC
/begin CHARACTERISTIC FSEVETA_OffsetTempDrvBoardLeftC "FSEVETA_OffsetTempDrvBoardLeftC" VALUE 0x80060EB8 DATA_RECORD_FLOAT32_IEEE 3.402823466E+038 F_1_p0_4 -3.402823466E+038 3.402823466E+038 /end CHARACTERISTIC
/begin CHARACTERISTIC FSEVETA_OffsetTempIgbtLeftC "FSEVETA_OffsetTempIgbtLeftC" VALUE 0x80060EB4 DATA_RECORD_FLOAT32_IEEE 3.402823466E+038 F_1_p0_4 -3.402823466E+038 3.402823466E+038 /end CHARACTERISTIC
/begin CHARACTERISTIC FSEVETA_OffsetTempLVCmdBoardC "FSEVETA_OffsetTempLVCmdBoardC" VALUE 0x80060EB0 DATA_RECORD_FLOAT32_IEEE 3.402823466E+038 F_1_p0_4 -3.402823466E+038 3.402823466E+038 /end CHARACTERISTIC
/begin CHARACTERISTIC FSEVETA_OperationalC "FSEVETA_OperationalC" VALUE 0x80060EAC DATA_RECORD_FLOAT32_IEEE 100 F_1_p0_43 0 100 /end CHARACTERISTIC
/begin CHARACTERISTIC FSEVETA_SampleIgbtHOutRngHC "FSEVETA_SampleIgbtHOutRngHC" VALUE 0x80060EA8 DATA_RECORD_UWORD 65535 F_1_p0_4 0 65535 /end CHARACTERISTIC
/begin CHARACTERISTIC FSEVETA_SampleIgbtHOutRngLC "FSEVETA_SampleIgbtHOutRngLC" VALUE 0x80060EA4 DATA_RECORD_UWORD 65535 F_1_p0_4 0 65535 /end CHARACTERISTIC
/begin CHARACTERISTIC FSEVETA_SampleIgbtLOutRngHC "FSEVETA_SampleIgbtLOutRngHC" VALUE 0x80060EA0 DATA_RECORD_UWORD 65535 F_1_p0_4 0 65535 /end CHARACTERISTIC
/begin CHARACTERISTIC FSEVETA_SampleIgbtLOutRngLC "FSEVETA_SampleIgbtLOutRngLC" VALUE 0x80060E9C DATA_RECORD_UWORD 65535 F_1_p0_4 0 65535 /end CHARACTERISTIC
/begin CHARACTERISTIC FSEVETA_ShortCircuitGndC "FSEVETA_ShortCircuitGndC" VALUE 0x80060E98 DATA_RECORD_UWORD 65535 F_1_p0_4 0 65535 /end CHARACTERISTIC
/begin CHARACTERISTIC FSEVETA_ShortCircuitVccC "FSEVETA_ShortCircuitVccC" VALUE 0x80060E94 DATA_RECORD_UWORD 65535 F_1_p0_4 0 65535 /end CHARACTERISTIC
/begin CHARACTERISTIC FSEVETA_TempRationalEnC "FSEVETA_TempRationalEnC" VALUE 0x80060E90 DATA_RECORD_FLOAT32_IEEE 10 F_1_p0_43 0 10 /end CHARACTERISTIC
/begin CHARACTERISTIC FSEVIBT_A2DGainIbatHVC "FSEVIBT_A2DGainIbatHVC" VALUE 0x80061264 DATA_RECORD_FLOAT32_IEEE 3.402823466E+038 F_1_p0_4 -3.402823466E+038 3.402823466E+038 /end CHARACTERISTIC
/begin CHARACTERISTIC FSEVIBT_A2DOutRngHThresholdHC "FSEVIBT_A2DOutRngHThresholdHC" VALUE 0x80061260 DATA_RECORD_UWORD 65535 F_1_p0_43 0 65535 /end CHARACTERISTIC
/begin CHARACTERISTIC FSEVIBT_A2DOutRngHThresholdLC "FSEVIBT_A2DOutRngHThresholdLC" VALUE 0x8006125C DATA_RECORD_UWORD 65535 F_1_p0_43 0 65535 /end CHARACTERISTIC
/begin CHARACTERISTIC FSEVIBT_A2DOutRngLThresholdHC "FSEVIBT_A2DOutRngLThresholdHC" VALUE 0x80061258 DATA_RECORD_UWORD 65535 F_1_p0_43 0 65535 /end CHARACTERISTIC
/begin CHARACTERISTIC FSEVIBT_A2DOutRngLThresholdLC "FSEVIBT_A2DOutRngLThresholdLC" VALUE 0x80061254 DATA_RECORD_UWORD 65535 F_1_p0_43 0 65535 /end CHARACTERISTIC
/begin CHARACTERISTIC FSEVIBT_A2dMaxValueC "FSEVIBT_A2dMaxValueC" VALUE 0x80061250 DATA_RECORD_FLOAT32_IEEE 0 F_1_p0_43 4095 4095 /end CHARACTERISTIC
/begin CHARACTERISTIC FSEVIBT_A2dMinValueC "FSEVIBT_A2dMinValueC" VALUE 0x8006124C DATA_RECORD_FLOAT32_IEEE 3.402823466E+038 F_1_p0_43 -3.402823466E+038 3.402823466E+038 /end CHARACTERISTIC
/begin CHARACTERISTIC FSEVIBT_ALutInIbatAdC "FSEVIBT_ALutInIbatAdC" CURVE 0x80061238 DATA_RECORD_FLOAT32_IEEE 3.402823466E+038 F_1_p0_4 -3.402823466E+038 3.402823466E+038
 /begin AXIS_DESCR FIX_AXIS NO_INPUT_QUANTITY Id_0x00 5 0 4 MAX_GRAD 100.0 FIX_AXIS_PAR_DIST 0 1 5 /end AXIS_DESCR
/end CHARACTERISTIC
/begin CHARACTERISTIC FSEVIBT_ALutOutIbatC "FSEVIBT_ALutOutIbatC" CURVE 0x80061224 DATA_RECORD_FLOAT32_IEEE 3.402823466E+038 F_1_p0_4 -3.402823466E+038 3.402823466E+038
 /begin AXIS_DESCR FIX_AXIS NO_INPUT_QUANTITY Id_0x00 5 0 4 MAX_GRAD 100.0 FIX_AXIS_PAR_DIST 0 1 5 /end AXIS_DESCR
/end CHARACTERISTIC
/begin CHARACTERISTIC FSEVIBT_AccumulatorC "FSEVIBT_AccumulatorC" VALUE 0x80061220 DATA_RECORD_ULONG 4294967295 F_1_p0_4 0 4294967295 /end CHARACTERISTIC
/begin CHARACTERISTIC FSEVIBT_CurrenCalEnalbeC "FSEVIBT_CurrenCalEnalbeC" VALUE 0x8006121C DATA_RECORD_UBYTE 1 Bool_ON_OFF 0 1 BIT_MASK 0x01 /end CHARACTERISTIC
/begin CHARACTERISTIC FSEVIBT_CurrenOffsetInitC "FSEVIBT_CurrenOffsetInitC" VALUE 0x80061218 DATA_RECORD_FLOAT32_IEEE 3.402823466E+038 F_1_p0_45 -3.402823466E+038 3.402823466E+038 /end CHARACTERISTIC
/begin CHARACTERISTIC FSEVIBT_CutOffFrequencyC "FSEVIBT_CutOffFrequencyC" VALUE 0x80061214 DATA_RECORD_FLOAT32_IEEE 3.402823466E+038 F_1_p0_4 -3.402823466E+038 3.402823466E+038 /end CHARACTERISTIC
/begin CHARACTERISTIC FSEVIBT_GainDec2AmpsC "FSEVIBT_GainDec2AmpsC" VALUE 0x80061210 DATA_RECORD_FLOAT32_IEEE 3.402823466E+038 F_1_p0_4 -3.402823466E+038 3.402823466E+038 /end CHARACTERISTIC
/begin CHARACTERISTIC FSEVIBT_HighCurrentThrC "FSEVIBT_HighCurrentThrC" VALUE 0x8006120C DATA_RECORD_FLOAT32_IEEE 3.402823466E+038 F_1_p0_4 -3.402823466E+038 3.402823466E+038 /end CHARACTERISTIC
/begin CHARACTERISTIC FSEVIBT_IbatFaultEnaC "FSEVIBT_IbatFaultEnaC" VALUE 0x80061208 DATA_RECORD_UBYTE 1 Bool_ON_OFF 0 1 BIT_MASK 0x01 /end CHARACTERISTIC
/begin CHARACTERISTIC FSEVIBT_IbatRmsGainC "FSEVIBT_IbatRmsGainC" VALUE 0x80061204 DATA_RECORD_FLOAT32_IEEE 3.402823466E+038 F_1_p0_4 -3.402823466E+038 3.402823466E+038 /end CHARACTERISTIC
/begin CHARACTERISTIC FSEVIBT_Init2DurationC "FSEVIBT_Init2DurationC" VALUE 0x80061200 DATA_RECORD_FLOAT32_IEEE 3.402823466E+038 F_1_p0_4 -3.402823466E+038 3.402823466E+038 /end CHARACTERISTIC
/begin CHARACTERISTIC FSEVIBT_Init2FreqC "FSEVIBT_Init2FreqC" VALUE 0x800611FC DATA_RECORD_FLOAT32_IEEE 3.402823466E+038 F_1_p0_4 -3.402823466E+038 3.402823466E+038 /end CHARACTERISTIC
/begin CHARACTERISTIC FSEVIBT_K2TableC "FSEVIBT_K2TableC" VALUE 0x800611F8 DATA_RECORD_UBYTE 1 Bool_ON_OFF 0 1 BIT_MASK 0x01 /end CHARACTERISTIC
/begin CHARACTERISTIC FSEVIBT_LowCurrentThrC "FSEVIBT_LowCurrentThrC" VALUE 0x800611F4 DATA_RECORD_FLOAT32_IEEE 3.402823466E+038 F_1_p0_4 -3.402823466E+038 3.402823466E+038 /end CHARACTERISTIC
/begin CHARACTERISTIC FSEVIBT_LutIbatRmsC "FSEVIBT_LutIbatRmsC" CURVE 0x800611D8 DATA_RECORD_FLOAT32_IEEE 3.402823466E+038 F_1_p0_4 -3.402823466E+038 3.402823466E+038
 /begin AXIS_DESCR FIX_AXIS NO_INPUT_QUANTITY Id_0x00 7 0 6 MAX_GRAD 100.0 FIX_AXIS_PAR_DIST 0 1 7 /end AXIS_DESCR
/end CHARACTERISTIC
/begin CHARACTERISTIC FSEVIBT_LutIbatRmsGainC "FSEVIBT_LutIbatRmsGainC" CURVE 0x800611BC DATA_RECORD_FLOAT32_IEEE 3.402823466E+038 F_1_p0_4 -3.402823466E+038 3.402823466E+038
 /begin AXIS_DESCR FIX_AXIS NO_INPUT_QUANTITY Id_0x00 7 0 6 MAX_GRAD 100.0 FIX_AXIS_PAR_DIST 0 1 7 /end AXIS_DESCR
/end CHARACTERISTIC
/begin CHARACTERISTIC FSEVIBT_RmsCalculationCounterC "FSEVIBT_RmsCalculationCounterC" VALUE 0x800611B8 DATA_RECORD_SWORD 65535 F_1_p0_4 -32768 32767 /end CHARACTERISTIC
/begin CHARACTERISTIC FSEVIBT_ShortCircuitGndC "FSEVIBT_ShortCircuitGndC" VALUE 0x800611B4 DATA_RECORD_UWORD 65535 F_1_p0_4 0 65535 /end CHARACTERISTIC
/begin CHARACTERISTIC FSEVIBT_ShortCircuitVccC "FSEVIBT_ShortCircuitVccC" VALUE 0x800611B0 DATA_RECORD_UWORD 65535 F_1_p0_4 0 65535 /end CHARACTERISTIC
/begin CHARACTERISTIC FSEXCTX_AdLowerLimitC "FSEXCTX_AdLowerLimitC" VALUE 0x80061298 DATA_RECORD_FLOAT32_IEEE 3.402823466E+038 F_1_p0_4 -3.402823466E+038 3.402823466E+038 /end CHARACTERISTIC
/begin CHARACTERISTIC FSEXCTX_AdUpperLimitC "FSEXCTX_AdUpperLimitC" VALUE 0x80061294 DATA_RECORD_FLOAT32_IEEE 3.402823466E+038 F_1_p0_4 -3.402823466E+038 3.402823466E+038 /end CHARACTERISTIC
/begin CHARACTERISTIC FSEXCTX_DrtGainC "FSEXCTX_DrtGainC" VALUE 0x80061290 DATA_RECORD_FLOAT32_IEEE 1 F_1_p0_48 0 1 /end CHARACTERISTIC
/begin CHARACTERISTIC FSEXCTX_HalfADRangeC "FSEXCTX_HalfADRangeC" VALUE 0x8006128C DATA_RECORD_FLOAT32_IEEE 3.402823466E+038 F_1_p0_4 -3.402823466E+038 3.402823466E+038 /end CHARACTERISTIC
/begin CHARACTERISTIC FSEXCTX_IbatRmsGainC "FSEXCTX_IbatRmsGainC" VALUE 0x80061288 DATA_RECORD_FLOAT32_IEEE 3.402823466E+038 F_1_p0_4 -3.402823466E+038 3.402823466E+038 /end CHARACTERISTIC
/begin CHARACTERISTIC FSEXCTX_PwrThr2C "FSEXCTX_PwrThr2C" VALUE 0x80061284 DATA_RECORD_FLOAT32_IEEE 3.402823466E+038 F_1_p0_48 -3.402823466E+038 3.402823466E+038 /end CHARACTERISTIC
/begin CHARACTERISTIC FSEXCTX_RmsCalculationCounterC "FSEXCTX_RmsCalculationCounterC" VALUE 0x80061280 DATA_RECORD_SWORD 65535 F_1_p0_4 -32768 32767 /end CHARACTERISTIC
/begin CHARACTERISTIC FSEXCTX_SpdCutOffFreqC "FSEXCTX_SpdCutOffFreqC" VALUE 0x8006127C DATA_RECORD_FLOAT32_IEEE 3.402823466E+038 F_1_p0_4 -3.402823466E+038 3.402823466E+038 /end CHARACTERISTIC
/begin CHARACTERISTIC FSEXCTX_SpdRangeThrC "FSEXCTX_SpdRangeThrC" VALUE 0x80061278 DATA_RECORD_FLOAT32_IEEE 3.402823466E+038 F_1_p0_48 -3.402823466E+038 3.402823466E+038 /end CHARACTERISTIC
/begin CHARACTERISTIC FSEXCTX_SpdThrC "FSEXCTX_SpdThrC" VALUE 0x80061274 DATA_RECORD_FLOAT32_IEEE 3.402823466E+038 F_1_p0_48 -3.402823466E+038 3.402823466E+038 /end CHARACTERISTIC
/begin CHARACTERISTIC FSEXCTX_TolTqrLmtEnC "FSEXCTX_TolTqrLmtEnC" VALUE 0x80061270 DATA_RECORD_UBYTE 1 Bool_ON_OFF 0 1 BIT_MASK 0x01 /end CHARACTERISTIC
/begin CHARACTERISTIC FSEXCTX_TorComFreqC "FSEXCTX_TorComFreqC" VALUE 0x8006126C DATA_RECORD_FLOAT32_IEEE 3.402823466E+038 F_1_p0_48 -3.402823466E+038 3.402823466E+038 /end CHARACTERISTIC
/begin CHARACTERISTIC FSEXCTX_TqrThrC "FSEXCTX_TqrThrC" VALUE 0x80061268 DATA_RECORD_FLOAT32_IEEE 1 F_1_p0_48 0 1 /end CHARACTERISTIC
/begin CHARACTERISTIC FSMTMTA_A2DOutRngHThresholdHC "FSMTMTA_A2DOutRngHThresholdHC" VALUE 0x8006145C DATA_RECORD_FLOAT32_IEEE 3.402823466E+038 F_1_p0_4 -3.402823466E+038 3.402823466E+038 /end CHARACTERISTIC
/begin CHARACTERISTIC FSMTMTA_A2DOutRngHThresholdLC "FSMTMTA_A2DOutRngHThresholdLC" VALUE 0x80061458 DATA_RECORD_FLOAT32_IEEE 3.402823466E+038 F_1_p0_4 -3.402823466E+038 3.402823466E+038 /end CHARACTERISTIC
/begin CHARACTERISTIC FSMTMTA_A2DOutRngLThresholdHC "FSMTMTA_A2DOutRngLThresholdHC" VALUE 0x80061454 DATA_RECORD_FLOAT32_IEEE 3.402823466E+038 F_1_p0_4 -3.402823466E+038 3.402823466E+038 /end CHARACTERISTIC
/begin CHARACTERISTIC FSMTMTA_A2DOutRngLThresholdLC "FSMTMTA_A2DOutRngLThresholdLC" VALUE 0x80061450 DATA_RECORD_FLOAT32_IEEE 3.402823466E+038 F_1_p0_4 -3.402823466E+038 3.402823466E+038 /end CHARACTERISTIC
/begin CHARACTERISTIC FSMTMTA_A2dMaxValueC "FSMTMTA_A2dMaxValueC" VALUE 0x8006144C DATA_RECORD_FLOAT32_IEEE 3.402823466E+038 F_1_p0_4 -3.402823466E+038 3.402823466E+038 /end CHARACTERISTIC
/begin CHARACTERISTIC FSMTMTA_A2dMinValueC "FSMTMTA_A2dMinValueC" VALUE 0x80061448 DATA_RECORD_FLOAT32_IEEE 3.402823466E+038 F_1_p0_4 -3.402823466E+038 3.402823466E+038 /end CHARACTERISTIC
/begin CHARACTERISTIC FSMTMTA_AbnoramlWdgTempC "FSMTMTA_AbnoramlWdgTempC" VALUE 0x80061444 DATA_RECORD_FLOAT32_IEEE 3.402823466E+038 F_1_p0_4 -3.402823466E+038 3.402823466E+038 /end CHARACTERISTIC
/begin CHARACTERISTIC FSMTMTA_CutOffFrequencyC "FSMTMTA_CutOffFrequencyC" VALUE 0x80061440 DATA_RECORD_FLOAT32_IEEE 3.402823466E+038 F_1_p0_4 -3.402823466E+038 3.402823466E+038 /end CHARACTERISTIC
/begin CHARACTERISTIC FSMTMTA_GainTempWindingHead1C "FSMTMTA_GainTempWindingHead1C" VALUE 0x8006143C DATA_RECORD_FLOAT32_IEEE 3.402823466E+038 F_1_p0_4 -3.402823466E+038 3.402823466E+038 /end CHARACTERISTIC
/begin CHARACTERISTIC FSMTMTA_GainTempWindingHead2C "FSMTMTA_GainTempWindingHead2C" VALUE 0x80061438 DATA_RECORD_FLOAT32_IEEE 3.402823466E+038 F_1_p0_4 -3.402823466E+038 3.402823466E+038 /end CHARACTERISTIC
/begin CHARACTERISTIC FSMTMTA_HighTempWdgHead1ThdC "FSMTMTA_HighTempWdgHead1ThdC" VALUE 0x80061434 DATA_RECORD_FLOAT32_IEEE 3.402823466E+038 F_1_p0_4 -3.402823466E+038 3.402823466E+038 /end CHARACTERISTIC
/begin CHARACTERISTIC FSMTMTA_HighTempWdgHead2ThdC "FSMTMTA_HighTempWdgHead2ThdC" VALUE 0x80061430 DATA_RECORD_FLOAT32_IEEE 3.402823466E+038 F_1_p0_4 -3.402823466E+038 3.402823466E+038 /end CHARACTERISTIC
/begin CHARACTERISTIC FSMTMTA_LowTempWindingHead1ThdC "FSMTMTA_LowTempWindingHead1ThdC" VALUE 0x8006142C DATA_RECORD_FLOAT32_IEEE 3.402823466E+038 F_1_p0_4 -3.402823466E+038 3.402823466E+038 /end CHARACTERISTIC
/begin CHARACTERISTIC FSMTMTA_LowTempWindingHead2ThdC "FSMTMTA_LowTempWindingHead2ThdC" VALUE 0x80061428 DATA_RECORD_FLOAT32_IEEE 3.402823466E+038 F_1_p0_4 -3.402823466E+038 3.402823466E+038 /end CHARACTERISTIC
/begin CHARACTERISTIC FSMTMTA_LutInTempMotorC "FSMTMTA_LutInTempMotorC" CURVE 0x8006136C DATA_RECORD_FLOAT32_IEEE 3.402823466E+038 F_1_p0_4 -3.402823466E+038 3.402823466E+038
 /begin AXIS_DESCR FIX_AXIS NO_INPUT_QUANTITY Id_0x00 47 0 46 MAX_GRAD 100.0 FIX_AXIS_PAR_DIST 0 1 47 /end AXIS_DESCR
/end CHARACTERISTIC
/begin CHARACTERISTIC FSMTMTA_LutOutTempMotorC "FSMTMTA_LutOutTempMotorC" CURVE 0x800612B0 DATA_RECORD_FLOAT32_IEEE 3.402823466E+038 F_1_p0_4 -3.402823466E+038 3.402823466E+038
 /begin AXIS_DESCR FIX_AXIS NO_INPUT_QUANTITY Id_0x00 47 0 46 MAX_GRAD 100.0 FIX_AXIS_PAR_DIST 0 1 47 /end AXIS_DESCR
/end CHARACTERISTIC
/begin CHARACTERISTIC FSMTMTA_OffsetTempWindingHead1C "FSMTMTA_OffsetTempWindingHead1C" VALUE 0x800612AC DATA_RECORD_FLOAT32_IEEE 3.402823466E+038 F_1_p0_4 -3.402823466E+038 3.402823466E+038 /end CHARACTERISTIC
/begin CHARACTERISTIC FSMTMTA_OffsetTempWindingHead2C "FSMTMTA_OffsetTempWindingHead2C" VALUE 0x800612A8 DATA_RECORD_FLOAT32_IEEE 3.402823466E+038 F_1_p0_4 -3.402823466E+038 3.402823466E+038 /end CHARACTERISTIC
/begin CHARACTERISTIC FSMTMTA_OilTempNormalC "FSMTMTA_OilTempNormalC" VALUE 0x800612A4 DATA_RECORD_FLOAT32_IEEE 3.402823466E+038 F_1_p0_4 -3.402823466E+038 3.402823466E+038 /end CHARACTERISTIC
/begin CHARACTERISTIC FSMTMTA_ShortCircuitGndC "FSMTMTA_ShortCircuitGndC" VALUE 0x800612A0 DATA_RECORD_UWORD 65535 F_1_p0_4 0 65535 /end CHARACTERISTIC
/begin CHARACTERISTIC FSMTMTA_ShortCircuitVccC "FSMTMTA_ShortCircuitVccC" VALUE 0x8006129C DATA_RECORD_UWORD 65535 F_1_p0_4 0 65535 /end CHARACTERISTIC
/begin CHARACTERISTIC FSMTRDG_A2DOffsetCosHC "FSMTRDG_A2DOffsetCosHC" VALUE 0x800614A8 DATA_RECORD_UWORD 65535 F_1_p0_4 0 65535 /end CHARACTERISTIC
/begin CHARACTERISTIC FSMTRDG_A2DOffsetCosLC "FSMTRDG_A2DOffsetCosLC" VALUE 0x800614A4 DATA_RECORD_UWORD 65535 F_1_p0_4 0 65535 /end CHARACTERISTIC
/begin CHARACTERISTIC FSMTRDG_A2DOffsetExtationC "FSMTRDG_A2DOffsetExtationC" VALUE 0x800614A0 DATA_RECORD_UWORD 65535 F_1_p0_4 0 65535 /end CHARACTERISTIC
/begin CHARACTERISTIC FSMTRDG_A2DOffsetSinHC "FSMTRDG_A2DOffsetSinHC" VALUE 0x8006149C DATA_RECORD_UWORD 65535 F_1_p0_4 0 65535 /end CHARACTERISTIC
/begin CHARACTERISTIC FSMTRDG_A2DOffsetSinLC "FSMTRDG_A2DOffsetSinLC" VALUE 0x80061498 DATA_RECORD_UWORD 65535 F_1_p0_4 0 65535 /end CHARACTERISTIC
/begin CHARACTERISTIC FSMTRDG_A2dMaxValueC "Maximal value of the ADC." VALUE 0x80061494 DATA_RECORD_FLOAT32_IEEE 4095 F_1_p0_34 0 4095 /end CHARACTERISTIC
/begin CHARACTERISTIC FSMTRDG_A2dMinValueC "Minimal value of the ADC." VALUE 0x80061490 DATA_RECORD_FLOAT32_IEEE 4095 F_1_p0_34 0 4095 /end CHARACTERISTIC
/begin CHARACTERISTIC FSMTRDG_CosHScalingC "FSMTRDG_CosHScalingC" VALUE 0x8006148C DATA_RECORD_FLOAT32_IEEE 3.402823466E+038 F_1_p0_4 -3.402823466E+038 3.402823466E+038 /end CHARACTERISTIC
/begin CHARACTERISTIC FSMTRDG_CosLScalingC "FSMTRDG_CosLScalingC" VALUE 0x80061488 DATA_RECORD_FLOAT32_IEEE 3.402823466E+038 F_1_p0_4 -3.402823466E+038 3.402823466E+038 /end CHARACTERISTIC
/begin CHARACTERISTIC FSMTRDG_CutOffFrequencyC "Filter parameter." VALUE 0x80061484 DATA_RECORD_FLOAT32_IEEE 2000000 F_1_p0_35 -1000000 1000000 /end CHARACTERISTIC
/begin CHARACTERISTIC FSMTRDG_ExitationScalingC "FSMTRDG_ExitationScalingC" VALUE 0x80061480 DATA_RECORD_FLOAT32_IEEE 3.402823466E+038 F_1_p0_4 -3.402823466E+038 3.402823466E+038 /end CHARACTERISTIC
/begin CHARACTERISTIC FSMTRDG_GainCosHC "FSMTRDG_GainCosHC" VALUE 0x8006147C DATA_RECORD_FLOAT32_IEEE 3.402823466E+038 F_1_p0_4 -3.402823466E+038 3.402823466E+038 /end CHARACTERISTIC
/begin CHARACTERISTIC FSMTRDG_GainCosLC "FSMTRDG_GainCosLC" VALUE 0x80061478 DATA_RECORD_FLOAT32_IEEE 3.402823466E+038 F_1_p0_4 -3.402823466E+038 3.402823466E+038 /end CHARACTERISTIC
/begin CHARACTERISTIC FSMTRDG_GainExitationVoltC "FSMTRDG_GainExitationVoltC" VALUE 0x80061474 DATA_RECORD_FLOAT32_IEEE 3.402823466E+038 F_1_p0_4 -3.402823466E+038 3.402823466E+038 /end CHARACTERISTIC
/begin CHARACTERISTIC FSMTRDG_GainSinHC "FSMTRDG_GainSinHC" VALUE 0x80061470 DATA_RECORD_FLOAT32_IEEE 3.402823466E+038 F_1_p0_4 -3.402823466E+038 3.402823466E+038 /end CHARACTERISTIC
/begin CHARACTERISTIC FSMTRDG_GainSinLC "FSMTRDG_GainSinLC" VALUE 0x8006146C DATA_RECORD_FLOAT32_IEEE 3.402823466E+038 F_1_p0_4 -3.402823466E+038 3.402823466E+038 /end CHARACTERISTIC
/begin CHARACTERISTIC FSMTRDG_IOFilterC "FSMTRDG_IOFilterC" VALUE 0x80061468 DATA_RECORD_UWORD 65535 F_1_p0_45 0 65535 /end CHARACTERISTIC
/begin CHARACTERISTIC FSMTRDG_SinHScalingC "FSMTRDG_SinHScalingC" VALUE 0x80061464 DATA_RECORD_FLOAT32_IEEE 3.402823466E+038 F_1_p0_4 -3.402823466E+038 3.402823466E+038 /end CHARACTERISTIC
/begin CHARACTERISTIC FSMTRDG_SinLScalingC "FSMTRDG_SinLScalingC" VALUE 0x80061460 DATA_RECORD_FLOAT32_IEEE 3.402823466E+038 F_1_p0_4 -3.402823466E+038 3.402823466E+038 /end CHARACTERISTIC
/begin CHARACTERISTIC FSSMACS_AbsMecaSpeedTrC "FSSMACS_AbsMecaSpeedTrC" VALUE 0x80060C14 DATA_RECORD_FLOAT32_IEEE 3.402823466E+038 F_1_p0_53 -3.402823466E+038 3.402823466E+038 /end CHARACTERISTIC
/begin CHARACTERISTIC FSSMACS_AkdStartVoltageC "FSSMACS_AkdStartVoltageC" VALUE 0x80060C10 DATA_RECORD_FLOAT32_IEEE 1000 F_1_p0_38 0 1000 /end CHARACTERISTIC
/begin CHARACTERISTIC FSSMACS_AkdStopVoltageC "FSSMACS_AkdStopVoltageC" VALUE 0x80060C0C DATA_RECORD_FLOAT32_IEEE 1000 F_1_p0_38 0 1000 /end CHARACTERISTIC
/begin CHARACTERISTIC FSSMACS_BenchKL15EnaC "FSSMACS_BenchKL15EnaC" VALUE 0x80060C08 DATA_RECORD_UBYTE 1 Bool_ON_OFF 0 1 BIT_MASK 0x01 /end CHARACTERISTIC
/begin CHARACTERISTIC FSSMACS_BenchModeC "FSSMACS_BenchModeC" VALUE 0x80060C04 DATA_RECORD_UBYTE 1 Bool_ON_OFF 0 1 BIT_MASK 0x01 /end CHARACTERISTIC
/begin CHARACTERISTIC FSSMACS_HiPwrRdyVoltC "220v is the low level to enter the ready, traction mode" VALUE 0x80060C00 DATA_RECORD_FLOAT32_IEEE 3.402823466E+038 F_1_p0_4 -3.402823466E+038 3.402823466E+038 /end CHARACTERISTIC
/begin CHARACTERISTIC FSSMACS_HiPwrStbVoltC "FSSMACS_HiPwrStbVoltC" VALUE 0x80060BFC DATA_RECORD_FLOAT32_IEEE 3.402823466E+038 F_1_p0_4 -3.402823466E+038 3.402823466E+038 /end CHARACTERISTIC
/begin CHARACTERISTIC FSSMACS_KL15FilterC "FSSMACS_KL15FilterC" VALUE 0x80060BF8 DATA_RECORD_UWORD 65535 F_1_p0_4 0 65535 /end CHARACTERISTIC
/begin CHARACTERISTIC FSSMACS_OcCntMaxValueC "FSSMACS_OcCntMaxValueC" VALUE 0x80060BF4 DATA_RECORD_UWORD 65535 F_1_p0_4 0 65535 /end CHARACTERISTIC
/begin CHARACTERISTIC FSSMACS_OcLowVolMaxC "FSSMACS_OcLowVolMaxC" VALUE 0x80060BF0 DATA_RECORD_FLOAT32_IEEE 3.402823466E+038 F_1_p0_4 -3.402823466E+038 3.402823466E+038 /end CHARACTERISTIC
/begin CHARACTERISTIC FSSMACS_OcLowVolMinC "FSSMACS_OcLowVolMinC" VALUE 0x80060BEC DATA_RECORD_FLOAT32_IEEE 3.402823466E+038 F_1_p0_4 -3.402823466E+038 3.402823466E+038 /end CHARACTERISTIC
/begin CHARACTERISTIC FSSMACS_PreCharFinVoltC "FSSMACS_PreCharFinVoltC" VALUE 0x80060BE8 DATA_RECORD_FLOAT32_IEEE 3.402823466E+038 F_1_p0_38 -3.402823466E+038 3.402823466E+038 /end CHARACTERISTIC
/begin CHARACTERISTIC FSSMACS_ReverseKL15EnaC "FSSMACS_ReverseKL15EnaC" VALUE 0x80060BE4 DATA_RECORD_UBYTE 1 Bool_ON_OFF 0 1 BIT_MASK 0x01 /end CHARACTERISTIC
/begin CHARACTERISTIC FSSMACS_SpeedReadyFilterC "FSSMACS_SpeedReadyFilterC" VALUE 0x80060BE0 DATA_RECORD_UWORD 65535 F_1_p0_4 0 65535 /end CHARACTERISTIC
/begin CHARACTERISTIC FSSMACS_SpeedReadyThresholdC "FSSMACS_SpeedReadyThresholdC" VALUE 0x80060BDC DATA_RECORD_FLOAT32_IEEE 3.402823466E+038 F_1_p0_52 -3.402823466E+038 3.402823466E+038 /end CHARACTERISTIC
/begin CHARACTERISTIC FSSMACS_TorqueExitSpdThrdC "FSSMACS_TorqueExitSpdThrdC" VALUE 0x80060BD8 DATA_RECORD_FLOAT32_IEEE 3.402823466E+038 F_1_p0_52 -3.402823466E+038 3.402823466E+038 /end CHARACTERISTIC
/begin CHARACTERISTIC FSSMACS_UdsOCBenchModeOnOffC "FSSMACS_UdsOCBenchModeOnOffC" VALUE 0x80060BD4 DATA_RECORD_UBYTE 1 Bool_ON_OFF 0 1 BIT_MASK 0x01 /end CHARACTERISTIC
/begin CHARACTERISTIC FSSMACS_UdsOcEnableC "FSSMACS_UdsOcEnableC" VALUE 0x80060BD0 DATA_RECORD_UBYTE 1 Bool_ON_OFF 0 1 BIT_MASK 0x01 /end CHARACTERISTIC
/begin CHARACTERISTIC FSSMACS_UdsOcRdResFlagC "FSSMACS_UdsOcRdResFlagC" VALUE 0x80060BCC DATA_RECORD_UBYTE 1 Bool_ON_OFF 0 1 BIT_MASK 0x01 /end CHARACTERISTIC
/begin CHARACTERISTIC FSSMACS_UdsOcStartReqC "FSSMACS_UdsOcStartReqC" VALUE 0x80060BC8 DATA_RECORD_UBYTE 1 Bool_ON_OFF 0 1 BIT_MASK 0x01 /end CHARACTERISTIC
/begin CHARACTERISTIC FSSMACS_ZeroTorqCounterC "FSSMACS_ZeroTorqCounterC" VALUE 0x80060BC4 DATA_RECORD_UWORD 65535 F_1_p0_4 0 65535 /end CHARACTERISTIC
/begin CHARACTERISTIC FSSMMAM_AclStateBypassOnOffC "bypass activation boolean" VALUE 0x80060C1C DATA_RECORD_UBYTE 1 Bool_ON_OFF 0 1 BIT_MASK 0x01 /end CHARACTERISTIC
/begin CHARACTERISTIC FSSMMAM_AclStateBypassValueC "Mcu State value when bypass is activated" VALUE 0x80060C18 DATA_RECORD_UWORD 65535 F_1_p0_55 0 65535 /end CHARACTERISTIC
/begin CHARACTERISTIC FSTCGTC_AbsSpdFildTrC "FSTCGTC_AbsSpdFildTrC" VALUE 0x80060DE8 DATA_RECORD_FLOAT32_IEEE 100 F_1_p0_53 0 100 /end CHARACTERISTIC
/begin CHARACTERISTIC FSTCGTC_AccPedPosLowC "FSTCGTC_AccPedPosLowC" VALUE 0x80060DE4 DATA_RECORD_FLOAT32_IEEE 3.402823466E+038 F_1_p0_4 -3.402823466E+038 3.402823466E+038 /end CHARACTERISTIC
/begin CHARACTERISTIC FSTCGTC_CounterInitU16C "FSTCGTC_CounterInitU16C" VALUE 0x80060DE0 DATA_RECORD_UWORD 65535 F_1_p0_4 0 65535 /end CHARACTERISTIC
/begin CHARACTERISTIC FSTCGTC_CtrlTrC "FSTCGTC_CtrlTrC" VALUE 0x80060DDC DATA_RECORD_FLOAT32_IEEE 100 F_1_p0_53 0 100 /end CHARACTERISTIC
/begin CHARACTERISTIC FSTCGTC_CurLoadTqrC "FSTCGTC_CurLoadTqrC" VALUE 0x80060DD8 DATA_RECORD_FLOAT32_IEEE 3.402823466E+038 F_1_p0_4 -3.402823466E+038 3.402823466E+038 /end CHARACTERISTIC
/begin CHARACTERISTIC FSTCGTC_DividC "FSTCGTC_DividC" VALUE 0x80060DD4 DATA_RECORD_FLOAT32_IEEE 3.402823466E+038 F_1_p0_40 -3.402823466E+038 3.402823466E+038 /end CHARACTERISTIC
/begin CHARACTERISTIC FSTCGTC_GearCtrlEnaC "FSTCGTC_GearCtrlEnaC" VALUE 0x80060DD0 DATA_RECORD_UBYTE 1 Bool_ON_OFF 0 1 BIT_MASK 0x01 /end CHARACTERISTIC
/begin CHARACTERISTIC FSTCGTC_HacCounter0C "FSTCGTC_HacCounter0C" VALUE 0x80060DCC DATA_RECORD_UWORD 65535 F_1_p0_4 0 65535 /end CHARACTERISTIC
/begin CHARACTERISTIC FSTCGTC_HacCounterC "FSTCGTC_HacCounterC" VALUE 0x80060DC8 DATA_RECORD_UWORD 65535 F_1_p0_4 0 65535 /end CHARACTERISTIC
/begin CHARACTERISTIC FSTCGTC_HacEnSpeedThrdC "FSTCGTC_HacEnSpeedThrdC" VALUE 0x80060DC4 DATA_RECORD_FLOAT32_IEEE 3.402823466E+038 F_1_p0_52 -3.402823466E+038 3.402823466E+038 /end CHARACTERISTIC
/begin CHARACTERISTIC FSTCGTC_HacExitSpeedThrdC "FSTCGTC_HacExitSpeedThrdC" VALUE 0x80060DC0 DATA_RECORD_FLOAT32_IEEE 3.402823466E+038 F_1_p0_52 -3.402823466E+038 3.402823466E+038 /end CHARACTERISTIC
/begin CHARACTERISTIC FSTCGTC_HacExitTorqDiffC "FSTCGTC_HacExitTorqDiffC" VALUE 0x80060DBC DATA_RECORD_FLOAT32_IEEE 3.402823466E+038 F_1_p0_4 -3.402823466E+038 3.402823466E+038 /end CHARACTERISTIC
/begin CHARACTERISTIC FSTCGTC_HacModeEnaC "FSTCGTC_HacModeEnaC" VALUE 0x80060DB8 DATA_RECORD_UBYTE 255 F_1_p0_4 0 255 /end CHARACTERISTIC
/begin CHARACTERISTIC FSTCGTC_HacOpenLoopTrqFildTrC "First filter response time at 95 pct." VALUE 0x80060DB4 DATA_RECORD_FLOAT32_IEEE 10 F_1_p0_53 0 10 /end CHARACTERISTIC
/begin CHARACTERISTIC FSTCGTC_HacTorqueFildTrC "First filter response time at 95 pct." VALUE 0x80060DB0 DATA_RECORD_FLOAT32_IEEE 10 F_1_p0_53 0 10 /end CHARACTERISTIC
/begin CHARACTERISTIC FSTCGTC_I0dqTgtC "[i0, id, iq]" CURVE 0x80060DA4 DATA_RECORD_FLOAT32_IEEE 3.402823466E+038 F_1_p0_4 -3.402823466E+038 3.402823466E+038
 /begin AXIS_DESCR FIX_AXIS NO_INPUT_QUANTITY Id_0x00 3 0 2 MAX_GRAD 100.0 FIX_AXIS_PAR_DIST 0 1 3 /end AXIS_DESCR
/end CHARACTERISTIC
/begin CHARACTERISTIC FSTCGTC_LcRotSpdThrC "FSTCGTC_LcRotSpdThrC" VALUE 0x80060DA0 DATA_RECORD_FLOAT32_IEEE 3.402823466E+038 F_1_p0_4 -3.402823466E+038 3.402823466E+038 /end CHARACTERISTIC
/begin CHARACTERISTIC FSTCGTC_LcRotTqrC "FSTCGTC_LcRotTqrC" VALUE 0x80060D9C DATA_RECORD_FLOAT32_IEEE 3.402823466E+038 F_1_p0_4 -3.402823466E+038 3.402823466E+038 /end CHARACTERISTIC
/begin CHARACTERISTIC FSTCGTC_LutInCtrlIntC "FSTCGTC_LutInCtrlIntC" CURVE 0x80060D80 DATA_RECORD_FLOAT32_IEEE 3.402823466E+038 F_1_p0_43 -3.402823466E+038 3.402823466E+038
 /begin AXIS_DESCR FIX_AXIS NO_INPUT_QUANTITY Id_0x00 7 0 6 MAX_GRAD 100.0 FIX_AXIS_PAR_DIST 0 1 7 /end AXIS_DESCR
/end CHARACTERISTIC
/begin CHARACTERISTIC FSTCGTC_LutInTrqCompSpdC "FSTCGTC_LutInTrqCompSpdC" CURVE 0x80060D68 DATA_RECORD_FLOAT32_IEEE 3.402823466E+038 F_1_p0_52 -3.402823466E+038 3.402823466E+038
 /begin AXIS_DESCR FIX_AXIS NO_INPUT_QUANTITY Id_0x00 6 0 5 MAX_GRAD 100.0 FIX_AXIS_PAR_DIST 0 1 6 /end AXIS_DESCR
/end CHARACTERISTIC
/begin CHARACTERISTIC FSTCGTC_LutOutOpLpTrqTgtC "FSTCGTC_LutOutOpLpTrqTgtC" CURVE 0x80060D4C DATA_RECORD_FLOAT32_IEEE 3.402823466E+038 F_1_p0_43 -3.402823466E+038 3.402823466E+038
 /begin AXIS_DESCR FIX_AXIS NO_INPUT_QUANTITY Id_0x00 7 0 6 MAX_GRAD 100.0 FIX_AXIS_PAR_DIST 0 1 7 /end AXIS_DESCR
/end CHARACTERISTIC
/begin CHARACTERISTIC FSTCGTC_LutOutTrqCompTorqC "FSTCGTC_LutOutTrqCompTorqC" CURVE 0x80060D34 DATA_RECORD_FLOAT32_IEEE 3.402823466E+038 F_1_p0_49 -3.402823466E+038 3.402823466E+038
 /begin AXIS_DESCR FIX_AXIS NO_INPUT_QUANTITY Id_0x00 6 0 5 MAX_GRAD 100.0 FIX_AXIS_PAR_DIST 0 1 6 /end AXIS_DESCR
/end CHARACTERISTIC
/begin CHARACTERISTIC FSTCGTC_MaxOpenTorqueC "FSTCGTC_MaxOpenTorqueC" VALUE 0x80060D30 DATA_RECORD_FLOAT32_IEEE 3.402823466E+038 F_1_p0_49 -3.402823466E+038 3.402823466E+038 /end CHARACTERISTIC
/begin CHARACTERISTIC FSTCGTC_MecaSpdOffsetC "FSTCGTC_MecaSpdOffsetC" VALUE 0x80060D2C DATA_RECORD_FLOAT32_IEEE 20 F_1_p0_52 -10 10 /end CHARACTERISTIC
/begin CHARACTERISTIC FSTCGTC_MotorMaxTorqueC "FSTCGTC_MotorMaxTorqueC" VALUE 0x80060D28 DATA_RECORD_FLOAT32_IEEE 3.402823466E+038 F_1_p0_49 -3.402823466E+038 3.402823466E+038 /end CHARACTERISTIC
/begin CHARACTERISTIC FSTCGTC_OutSlewRateActC "FSTCGTC_OutSlewRateActC" VALUE 0x80060D24 DATA_RECORD_UBYTE 1 Bool_ON_OFF 0 1 BIT_MASK 0x01 /end CHARACTERISTIC
/begin CHARACTERISTIC FSTCGTC_RelayLowC "FSTCGTC_RelayLowC" VALUE 0x80060D20 DATA_RECORD_FLOAT32_IEEE 3.402823466E+038 F_1_p0_49 -3.402823466E+038 3.402823466E+038 /end CHARACTERISTIC
/begin CHARACTERISTIC FSTCGTC_RelayUpC "FSTCGTC_RelayUpC" VALUE 0x80060D1C DATA_RECORD_FLOAT32_IEEE 3.402823466E+038 F_1_p0_49 -3.402823466E+038 3.402823466E+038 /end CHARACTERISTIC
/begin CHARACTERISTIC FSTCGTC_SpdCutOffFreqC "FSTCGTC_SpdCutOffFreqC" VALUE 0x80060D18 DATA_RECORD_FLOAT32_IEEE 3.402823466E+038 F_1_p0_4 -3.402823466E+038 3.402823466E+038 /end CHARACTERISTIC
/begin CHARACTERISTIC FSTCGTC_SpdFiltEnC "FSTCGTC_SpdFiltEnC" VALUE 0x80060D14 DATA_RECORD_UBYTE 1 Bool_ON_OFF 0 1 BIT_MASK 0x01 /end CHARACTERISTIC
/begin CHARACTERISTIC FSTCGTC_StandbyFilterC "FSTCGTC_StandbyFilterC" VALUE 0x80060D10 DATA_RECORD_UWORD 65535 F_1_p0_52 0 65535 /end CHARACTERISTIC
/begin CHARACTERISTIC FSTCGTC_TorqTranCounterC "FSTCGTC_TorqTranCounterC" VALUE 0x80060D0C DATA_RECORD_UWORD 65535 F_1_p0_52 0 65535 /end CHARACTERISTIC
/begin CHARACTERISTIC FSTCGTC_TorqueFirstFildTrC "First filter response time at 95 pct." VALUE 0x80060D08 DATA_RECORD_FLOAT32_IEEE 10 F_1_p0_53 0 10 /end CHARACTERISTIC
/begin CHARACTERISTIC FSTCGTC_TorquePreFildTrC "FSTCGTC_TorquePreFildTrC" VALUE 0x80060D04 DATA_RECORD_FLOAT32_IEEE 3.402823466E+038 F_1_p0_53 -3.402823466E+038 3.402823466E+038 /end CHARACTERISTIC
/begin CHARACTERISTIC FSTCGTC_TorqueTgtC "FSTCGTC_TorqueTgtC" VALUE 0x80060D00 DATA_RECORD_FLOAT32_IEEE 3.402823466E+038 F_1_p0_49 -3.402823466E+038 3.402823466E+038 /end CHARACTERISTIC
/begin CHARACTERISTIC FSTCGTC_TorqueTgtModeC "FSTCGTC_TorqueTgtModeC" VALUE 0x80060CFC DATA_RECORD_UBYTE 1 Bool_ON_OFF 0 1 BIT_MASK 0x01 /end CHARACTERISTIC
/begin CHARACTERISTIC FSTCGTC_TrqSatThrdC "FSTCGTC_TrqSatThrdC" VALUE 0x80060CF8 DATA_RECORD_FLOAT32_IEEE 3.402823466E+038 F_1_p0_49 -3.402823466E+038 3.402823466E+038 /end CHARACTERISTIC
/begin CHARACTERISTIC FSTCGTC_TrqSlewRateLutInBatC "FSTCGTC_TrqSlewRateLutInBatC" CURVE 0x80060CF0 DATA_RECORD_FLOAT32_IEEE 3.402823466E+038 F_1_p0_38 -3.402823466E+038 3.402823466E+038
 /begin AXIS_DESCR FIX_AXIS NO_INPUT_QUANTITY Id_0x00 2 0 1 MAX_GRAD 100.0 FIX_AXIS_PAR_DIST 0 1 2 /end AXIS_DESCR
/end CHARACTERISTIC
/begin CHARACTERISTIC FSTCGTC_TrqSlewRateLutInSpdRpmC "FSTCGTC_TrqSlewRateLutInSpdRpmC" CURVE 0x80060CB8 DATA_RECORD_FLOAT32_IEEE 3.402823466E+038 F_1_p0_38 -3.402823466E+038 3.402823466E+038
 /begin AXIS_DESCR FIX_AXIS NO_INPUT_QUANTITY Id_0x00 14 0 13 MAX_GRAD 100.0 FIX_AXIS_PAR_DIST 0 1 14 /end AXIS_DESCR
/end CHARACTERISTIC
/begin CHARACTERISTIC FSTCGTC_TrqSlewRateLutOutC "FSTCGTC_TrqSlewRateLutOutC" MAP 0x80060C48 DATA_RECORD_FLOAT32_IEEE 3.402823466E+038 F_1_p0_38 -3.402823466E+038 3.402823466E+038
 /begin AXIS_DESCR FIX_AXIS NO_INPUT_QUANTITY Id_0x00 2 0 1 MAX_GRAD 100.0 FIX_AXIS_PAR_DIST 0 1 2 /end AXIS_DESCR
 /begin AXIS_DESCR FIX_AXIS NO_INPUT_QUANTITY Id_0x00 14 0 13 MAX_GRAD 100.0 FIX_AXIS_PAR_DIST 0 1 14 /end AXIS_DESCR
/end CHARACTERISTIC
/begin CHARACTERISTIC FSTCGTC_U0dqTgtC "FSTCGTC_U0dqTgtC" CURVE 0x80060C3C DATA_RECORD_FLOAT32_IEEE 3.402823466E+038 F_1_p0_4 -3.402823466E+038 3.402823466E+038
 /begin AXIS_DESCR FIX_AXIS NO_INPUT_QUANTITY Id_0x00 3 0 2 MAX_GRAD 100.0 FIX_AXIS_PAR_DIST 0 1 3 /end AXIS_DESCR
/end CHARACTERISTIC
/begin CHARACTERISTIC FSTCGTC_ZeroSpdOffC "FSTCGTC_ZeroSpdOffC" VALUE 0x80060C38 DATA_RECORD_FLOAT32_IEEE 3.402823466E+038 F_1_p0_4 -3.402823466E+038 3.402823466E+038 /end CHARACTERISTIC
/begin CHARACTERISTIC FSTCGTC_ZeroSpdOnC "FSTCGTC_ZeroSpdOnC" VALUE 0x80060C34 DATA_RECORD_FLOAT32_IEEE 3.402823466E+038 F_1_p0_4 -3.402823466E+038 3.402823466E+038 /end CHARACTERISTIC
/begin CHARACTERISTIC FSTCGTC_ZeroToqueLowSpeedThrdC "FSTCGTC_ZeroToqueLowSpeedThrdC" VALUE 0x80060C30 DATA_RECORD_FLOAT32_IEEE 2000 F_1_p0_52 -1000 1000 /end CHARACTERISTIC
/begin CHARACTERISTIC FSTCGTC_ZeroTorqueCompTgtC "torque compensation allowed when zero torque set" VALUE 0x80060C2C DATA_RECORD_FLOAT32_IEEE 3.402823466E+038 F_1_p0_49 -3.402823466E+038 3.402823466E+038 /end CHARACTERISTIC
/begin CHARACTERISTIC FSTCGTC_ZeroTorqueOffsetEnableC "FSTCGTC_ZeroTorqueOffsetEnableC" VALUE 0x80060C28 DATA_RECORD_UBYTE 1 Bool_ON_OFF 0 1 BIT_MASK 0x01 /end CHARACTERISTIC
/begin CHARACTERISTIC FSTCGTC_fC "FSTCGTC_fC" VALUE 0x80060C24 DATA_RECORD_FLOAT32_IEEE 3.402823466E+038 F_1_p0_4 -3.402823466E+038 3.402823466E+038 /end CHARACTERISTIC
/begin CHARACTERISTIC FSTCGTC_jC "FSTCGTC_jC" VALUE 0x80060C20 DATA_RECORD_FLOAT32_IEEE 3.402823466E+038 F_1_p0_4 -3.402823466E+038 3.402823466E+038 /end CHARACTERISTIC
/begin CHARACTERISTIC SAASITV_ADMaxValueC "SAASITV_ADMaxValueC" VALUE 0x800614EC DATA_RECORD_FLOAT32_IEEE 4095 F_1_p0_36 0 4095 /end CHARACTERISTIC
/begin CHARACTERISTIC SAASITV_ADMinValueC "SAASITV_ADMinValueC" VALUE 0x800614E8 DATA_RECORD_FLOAT32_IEEE 4095 F_1_p0_36 0 4095 /end CHARACTERISTIC
/begin CHARACTERISTIC SAASITV_MainSup1ScalGainC "SAASITV_MainSup1ScalGainC" VALUE 0x800614E4 DATA_RECORD_FLOAT32_IEEE 3.402823466E+038 F_1_p0_36 -3.402823466E+038 3.402823466E+038 /end CHARACTERISTIC
/begin CHARACTERISTIC SAASITV_MainSup1ScalOffsetC "SAASITV_MainSup1ScalOffsetC" VALUE 0x800614E0 DATA_RECORD_FLOAT32_IEEE 3.402823466E+038 F_1_p0_36 -3.402823466E+038 3.402823466E+038 /end CHARACTERISTIC
/begin CHARACTERISTIC SAASITV_MaxANVolC "SAASITV_MaxANVolC" VALUE 0x800614DC DATA_RECORD_FLOAT32_IEEE 3.402823466E+038 F_1_p0_38 -3.402823466E+038 3.402823466E+038 /end CHARACTERISTIC
/begin CHARACTERISTIC SAASITV_MinANVolC "SAASITV_MinANVolC" VALUE 0x800614D8 DATA_RECORD_FLOAT32_IEEE 3.402823466E+038 F_1_p0_38 -3.402823466E+038 3.402823466E+038 /end CHARACTERISTIC
/begin CHARACTERISTIC SAASITV_SnsSup1ScalGainC "SAASITV_SnsSup1ScalGainC" VALUE 0x800614D4 DATA_RECORD_FLOAT32_IEEE 3.402823466E+038 F_1_p0_36 -3.402823466E+038 3.402823466E+038 /end CHARACTERISTIC
/begin CHARACTERISTIC SAASITV_SnsSup1ScalOffsetC "SAASITV_SnsSup1ScalOffsetC" VALUE 0x800614D0 DATA_RECORD_FLOAT32_IEEE 3.402823466E+038 F_1_p0_36 -3.402823466E+038 3.402823466E+038 /end CHARACTERISTIC
/begin CHARACTERISTIC SAASITV_SnsSup2ScalGainC "SAASITV_SnsSup2ScalGainC" VALUE 0x800614CC DATA_RECORD_FLOAT32_IEEE 3.402823466E+038 F_1_p0_36 -3.402823466E+038 3.402823466E+038 /end CHARACTERISTIC
/begin CHARACTERISTIC SAASITV_SnsSup2ScalOffsetC "SAASITV_SnsSup2ScalOffsetC" VALUE 0x800614C8 DATA_RECORD_FLOAT32_IEEE 3.402823466E+038 F_1_p0_36 -3.402823466E+038 3.402823466E+038 /end CHARACTERISTIC
/begin CHARACTERISTIC SAASITV_SupVolCutOffFreqC "SAASITV_SupVolCutOffFreqC" VALUE 0x800614C4 DATA_RECORD_FLOAT32_IEEE 3.402823466E+038 F_1_p0_36 -3.402823466E+038 3.402823466E+038 /end CHARACTERISTIC
/begin CHARACTERISTIC SABKPV_ADBkpVolGainC "SABKPV_ADBkpVolGainC" VALUE 0x80061514 DATA_RECORD_FLOAT32_IEEE 1000 F_1_p0_36 -500 500 /end CHARACTERISTIC
/begin CHARACTERISTIC SABKPV_ADBkpVolOffsetC "SABKPV_ADBkpVolOffsetC" VALUE 0x80061510 DATA_RECORD_FLOAT32_IEEE 8190 F_1_p0_36 -4095 4095 /end CHARACTERISTIC
/begin CHARACTERISTIC SABKPV_BkpVScalGainC "SABKPV_BkpVScalGainC" VALUE 0x8006150C DATA_RECORD_FLOAT32_IEEE 3.402823466E+038 F_1_p0_36 -3.402823466E+038 3.402823466E+038 /end CHARACTERISTIC
/begin CHARACTERISTIC SABKPV_BkpVScalOffsetC "SABKPV_BkpVScalOffsetC" VALUE 0x80061508 DATA_RECORD_FLOAT32_IEEE 3.402823466E+038 F_1_p0_36 -3.402823466E+038 3.402823466E+038 /end CHARACTERISTIC
/begin CHARACTERISTIC SABKPV_BkpVolCutOffFreqC "SABKPV_BkpVolCutOffFreqC" VALUE 0x80061504 DATA_RECORD_FLOAT32_IEEE 3.402823466E+038 F_1_p0_36 -3.402823466E+038 3.402823466E+038 /end CHARACTERISTIC
/begin CHARACTERISTIC SABKPV_MaxBkpVolC "SABKPV_MaxBkpVolC" VALUE 0x80061500 DATA_RECORD_FLOAT32_IEEE 3.402823466E+038 F_1_p0_36 -3.402823466E+038 3.402823466E+038 /end CHARACTERISTIC
/begin CHARACTERISTIC SABKPV_MinBkpVolC "SABKPV_MinBkpVolC" VALUE 0x800614FC DATA_RECORD_FLOAT32_IEEE 3.402823466E+038 F_1_p0_36 -3.402823466E+038 3.402823466E+038 /end CHARACTERISTIC
/begin CHARACTERISTIC SABKPV_VolThrC "SABKPV_VolThrC" VALUE 0x800614F8 DATA_RECORD_FLOAT32_IEEE 3.402823466E+038 F_1_p0_36 -3.402823466E+038 3.402823466E+038 /end CHARACTERISTIC
/begin CHARACTERISTIC SABKP_ADMaxValueC "SABKP_ADMaxValueC" VALUE 0x800614F4 DATA_RECORD_FLOAT32_IEEE 4095 F_1_p0_36 0 4095 /end CHARACTERISTIC
/begin CHARACTERISTIC SABKP_ADMinValueC "SABKP_ADMinValueC" VALUE 0x800614F0 DATA_RECORD_FLOAT32_IEEE 4095 F_1_p0_36 0 4095 /end CHARACTERISTIC
/begin CHARACTERISTIC SADDV_ADMaxValueC "SADDV_ADMaxValueC" VALUE 0x8006153C DATA_RECORD_FLOAT32_IEEE 4095 F_1_p0_36 0 4095 /end CHARACTERISTIC
/begin CHARACTERISTIC SADDV_ADMinValueC "SADDV_ADMinValueC" VALUE 0x80061538 DATA_RECORD_FLOAT32_IEEE 4095 F_1_p0_36 0 4095 /end CHARACTERISTIC
/begin CHARACTERISTIC SADDV_ADP5VolHSGainC "SADDV_ADP5VolHSGainC" VALUE 0x80061534 DATA_RECORD_FLOAT32_IEEE 1000 F_1_p0_36 -500 500 /end CHARACTERISTIC
/begin CHARACTERISTIC SADDV_ADP5VolHSOffsetC "SADDV_ADP5VolHSOffsetC" VALUE 0x80061530 DATA_RECORD_FLOAT32_IEEE 8190 F_1_p0_36 -4095 4095 /end CHARACTERISTIC
/begin CHARACTERISTIC SADDV_ADP5VolLSGainC "SADDV_ADP5VolLSGainC" VALUE 0x8006152C DATA_RECORD_FLOAT32_IEEE 1000 F_1_p0_36 -500 500 /end CHARACTERISTIC
/begin CHARACTERISTIC SADDV_ADP5VolLSOffsetC "SADDV_ADP5VolLSOffsetC" VALUE 0x80061528 DATA_RECORD_FLOAT32_IEEE 8190 F_1_p0_36 -4095 4095 /end CHARACTERISTIC
/begin CHARACTERISTIC SADDV_MaxP5VolC "SADDV_MaxP5VolC" VALUE 0x80061524 DATA_RECORD_FLOAT32_IEEE 3.402823466E+038 F_1_p0_38 -3.402823466E+038 3.402823466E+038 /end CHARACTERISTIC
/begin CHARACTERISTIC SADDV_MinP5VolC "SADDV_MinP5VolC" VALUE 0x80061520 DATA_RECORD_FLOAT32_IEEE 3.402823466E+038 F_1_p0_38 -3.402823466E+038 3.402823466E+038 /end CHARACTERISTIC
/begin CHARACTERISTIC SADDV_P5VScalGainC "SADDV_P5VScalGainC" VALUE 0x8006151C DATA_RECORD_FLOAT32_IEEE 3.402823466E+038 F_1_p0_36 -3.402823466E+038 3.402823466E+038 /end CHARACTERISTIC
/begin CHARACTERISTIC SADDV_P5VolCutOffFreqC "SADDV_P5VolCutOffFreqC" VALUE 0x80061518 DATA_RECORD_FLOAT32_IEEE 3.402823466E+038 F_1_p0_36 -3.402823466E+038 3.402823466E+038 /end CHARACTERISTIC
/begin CHARACTERISTIC SAFSSM_AclStateBypassOnOffC "SAFSSM_AclStateBypassOnOffC" VALUE 0x800614B0 DATA_RECORD_UWORD 65535 F_1_p0_36 0 65535 /end CHARACTERISTIC
/begin CHARACTERISTIC SAFSSM_AclStateBypassValueC "SAFSSM_AclStateBypassValueC" VALUE 0x800614AC DATA_RECORD_UWORD 65535 F_1_p0_36 0 65535 /end CHARACTERISTIC
/begin CHARACTERISTIC SAFTSM_AclStateBypassOnOffC "SAFTSM_AclStateBypassOnOffC" VALUE 0x800614C0 DATA_RECORD_UWORD 65535 F_1_p0_36 0 65535 /end CHARACTERISTIC
/begin CHARACTERISTIC SAFTSM_AclStateBypassValueC "SAFTSM_AclStateBypassValueC" VALUE 0x800614BC DATA_RECORD_UWORD 65535 F_1_p0_36 0 65535 /end CHARACTERISTIC
/begin CHARACTERISTIC SAFTSM_FtModeReqBypassOnOffC "SAFTSM_FtModeReqBypassOnOffC" VALUE 0x800614B8 DATA_RECORD_UWORD 65535 F_1_p0_36 0 65535 /end CHARACTERISTIC
/begin CHARACTERISTIC SAFTSM_FtModeReqBypassValueC "SAFTSM_FtModeReqBypassValueC" VALUE 0x800614B4 DATA_RECORD_UWORD 65535 F_1_p0_36 0 65535 /end CHARACTERISTIC
/begin CHARACTERISTIC SAMTEPD_ErrAngleThdC "SAMTEPD_ErrAngleThdC" VALUE 0x80061540 DATA_RECORD_FLOAT32_IEEE 3.402823466E+038 F_1_p0_36 -3.402823466E+038 3.402823466E+038 /end CHARACTERISTIC
/begin CHARACTERISTIC SATDETD_AddC "SATDETD_AddC" VALUE 0x80061560 DATA_RECORD_FLOAT32_IEEE 3.402823466E+038 F_1_p0_36 -3.402823466E+038 3.402823466E+038 /end CHARACTERISTIC
/begin CHARACTERISTIC SATDETD_LowLmtC "SATDETD_LowLmtC" VALUE 0x8006155C DATA_RECORD_FLOAT32_IEEE 3.402823466E+038 F_1_p0_36 -3.402823466E+038 3.402823466E+038 /end CHARACTERISTIC
/begin CHARACTERISTIC SATDETD_MinusC "SATDETD_MinusC" VALUE 0x80061558 DATA_RECORD_FLOAT32_IEEE 3.402823466E+038 F_1_p0_36 -3.402823466E+038 3.402823466E+038 /end CHARACTERISTIC
/begin CHARACTERISTIC SATDETD_PnC "SATDETD_PnC" VALUE 0x80061554 DATA_RECORD_FLOAT32_IEEE 3.402823466E+038 F_1_p0_36 -3.402823466E+038 3.402823466E+038 /end CHARACTERISTIC
/begin CHARACTERISTIC SATDETD_Te_FreqCutOffC "SATDETD_Te_FreqCutOffC" VALUE 0x80061550 DATA_RECORD_FLOAT32_IEEE 3.402823466E+038 F_1_p0_36 -3.402823466E+038 3.402823466E+038 /end CHARACTERISTIC
/begin CHARACTERISTIC SATDETD_TorqueChangeRateThC "SATDETD_TorqueChangeRateThC" VALUE 0x8006154C DATA_RECORD_FLOAT32_IEEE 3.402823466E+038 F_1_p0_36 -3.402823466E+038 3.402823466E+038 /end CHARACTERISTIC
/begin CHARACTERISTIC SATDETD_TorqueRef2Eor "SATDETD_TorqueRef2Eor" VALUE 0x80061548 DATA_RECORD_FLOAT32_IEEE 3.402823466E+038 F_1_p0_36 -3.402823466E+038 3.402823466E+038 /end CHARACTERISTIC
/begin CHARACTERISTIC SATDETD_UpLmtC "SATDETD_UpLmtC" VALUE 0x80061544 DATA_RECORD_FLOAT32_IEEE 3.402823466E+038 F_1_p0_36 -3.402823466E+038 3.402823466E+038 /end CHARACTERISTIC
/begin CHARACTERISTIC TCCMCCS_BenchIdcTgtEnC "TCCMCCS_BenchIdcTgtEnC" VALUE 0x80061584 DATA_RECORD_FLOAT32_IEEE 3.402823466E+038 F_1_p0_36 -3.402823466E+038 3.402823466E+038 /end CHARACTERISTIC
/begin CHARACTERISTIC TCCMCCS_BenchMotorDirRevEnC "TCCMCCS_BenchMotorDirRevEnC" VALUE 0x80061580 DATA_RECORD_FLOAT32_IEEE 3.402823466E+038 F_1_p0_36 -3.402823466E+038 3.402823466E+038 /end CHARACTERISTIC
/begin CHARACTERISTIC TCCMCCS_CurCtrlKiC "TCCMCCS_CurCtrlKiC" VALUE 0x8006157C DATA_RECORD_FLOAT32_IEEE 3.402823466E+038 F_1_p0_36 -3.402823466E+038 3.402823466E+038 /end CHARACTERISTIC
/begin CHARACTERISTIC TCCMCCS_CurCtrlKpC "TCCMCCS_CurCtrlKpC" VALUE 0x80061578 DATA_RECORD_FLOAT32_IEEE 3.402823466E+038 F_1_p0_36 -3.402823466E+038 3.402823466E+038 /end CHARACTERISTIC
/begin CHARACTERISTIC TCCMCCS_IdcFirstFildTrC "TCCMCCS_IdcFirstFildTrC" VALUE 0x80061574 DATA_RECORD_FLOAT32_IEEE 3.402823466E+038 F_1_p0_36 -3.402823466E+038 3.402823466E+038 /end CHARACTERISTIC
/begin CHARACTERISTIC TCCMCCS_IdcTargetSlewRateC "TCCMCCS_IdcTargetSlewRateC" VALUE 0x80061570 DATA_RECORD_FLOAT32_IEEE 3.402823466E+038 F_1_p0_36 -3.402823466E+038 3.402823466E+038 /end CHARACTERISTIC
/begin CHARACTERISTIC TCCMCCS_OutSlewRateActC "TCCMCCS_OutSlewRateActC" VALUE 0x8006156C DATA_RECORD_FLOAT32_IEEE 3.402823466E+038 F_1_p0_36 -3.402823466E+038 3.402823466E+038 /end CHARACTERISTIC
/begin CHARACTERISTIC TCCMSPC_BenchSpdLoopBypassEnC "TCCMSPC_BenchSpdLoopBypassEnC" VALUE 0x800615AC DATA_RECORD_FLOAT32_IEEE 3.402823466E+038 F_1_p0_36 -3.402823466E+038 3.402823466E+038 /end CHARACTERISTIC
/begin CHARACTERISTIC TCCMSPC_BenchSpeedMergeEnC "TCCMSPC_BenchSpeedMergeEnC" VALUE 0x800615A8 DATA_RECORD_FLOAT32_IEEE 3.402823466E+038 F_1_p0_36 -3.402823466E+038 3.402823466E+038 /end CHARACTERISTIC
/begin CHARACTERISTIC TCCMSPC_BenchSpeedRpmTgtC "TCCMSPC_BenchSpeedRpmTgtC" VALUE 0x800615A4 DATA_RECORD_FLOAT32_IEEE 3.402823466E+038 F_1_p0_36 -3.402823466E+038 3.402823466E+038 /end CHARACTERISTIC
/begin CHARACTERISTIC TCCMSPC_BenchSpeedRpmTgtEnC "TCCMSPC_BenchSpeedRpmTgtEnC" VALUE 0x800615A0 DATA_RECORD_FLOAT32_IEEE 3.402823466E+038 F_1_p0_36 -3.402823466E+038 3.402823466E+038 /end CHARACTERISTIC
/begin CHARACTERISTIC TCCMSPC_OutSlewRateActC "TCCMSPC_OutSlewRateActC" VALUE 0x8006159C DATA_RECORD_FLOAT32_IEEE 3.402823466E+038 F_1_p0_36 -3.402823466E+038 3.402823466E+038 /end CHARACTERISTIC
/begin CHARACTERISTIC TCCMSPC_SpdCtrlKiC "TCCMSPC_SpdCtrlKiC" VALUE 0x80061598 DATA_RECORD_FLOAT32_IEEE 3.402823466E+038 F_1_p0_36 -3.402823466E+038 3.402823466E+038 /end CHARACTERISTIC
/begin CHARACTERISTIC TCCMSPC_SpdCtrlKpC "TCCMSPC_SpdCtrlKpC" VALUE 0x80061594 DATA_RECORD_FLOAT32_IEEE 3.402823466E+038 F_1_p0_36 -3.402823466E+038 3.402823466E+038 /end CHARACTERISTIC
/begin CHARACTERISTIC TCCMSPC_SpdMergeRangeC "TCCMSPC_SpdMergeRangeC" VALUE 0x80061590 DATA_RECORD_FLOAT32_IEEE 3.402823466E+038 F_1_p0_36 -3.402823466E+038 3.402823466E+038 /end CHARACTERISTIC
/begin CHARACTERISTIC TCCMSPC_SpeedFirstFildTrC "TCCMSPC_SpeedFirstFildTrC" VALUE 0x8006158C DATA_RECORD_FLOAT32_IEEE 3.402823466E+038 F_1_p0_36 -3.402823466E+038 3.402823466E+038 /end CHARACTERISTIC
/begin CHARACTERISTIC TCCMSPC_SpeedTargetSlewRateC "TCCMSPC_SpeedTargetSlewRateC" VALUE 0x80061588 DATA_RECORD_FLOAT32_IEEE 3.402823466E+038 F_1_p0_36 -3.402823466E+038 3.402823466E+038 /end CHARACTERISTIC
/begin CHARACTERISTIC TCEVBLV_FreqCutOffC "TCEVBLV_FreqCutOffC" VALUE 0x800615D4 DATA_RECORD_FLOAT32_IEEE 3.402823466E+038 F_1_p0_36 -3.402823466E+038 3.402823466E+038 /end CHARACTERISTIC
/begin CHARACTERISTIC TCEVBLV_GainScalingC "TCEVBLV_GainScalingC" VALUE 0x800615D0 DATA_RECORD_FLOAT32_IEEE 3.402823466E+038 F_1_p0_36 -3.402823466E+038 3.402823466E+038 /end CHARACTERISTIC
/begin CHARACTERISTIC TCEVBLV_HighVoltageThr18C "TCEVBLV_HighVoltageThr18C" VALUE 0x800615CC DATA_RECORD_FLOAT32_IEEE 3.402823466E+038 F_1_p0_36 -3.402823466E+038 3.402823466E+038 /end CHARACTERISTIC
/begin CHARACTERISTIC TCEVBLV_HighVoltageThr24C "TCEVBLV_HighVoltageThr24C" VALUE 0x800615C8 DATA_RECORD_FLOAT32_IEEE 3.402823466E+038 F_1_p0_36 -3.402823466E+038 3.402823466E+038 /end CHARACTERISTIC
/begin CHARACTERISTIC TCEVBLV_HighVoltageThr28C "TCEVBLV_HighVoltageThr28C" VALUE 0x800615C4 DATA_RECORD_FLOAT32_IEEE 3.402823466E+038 F_1_p0_36 -3.402823466E+038 3.402823466E+038 /end CHARACTERISTIC
/begin CHARACTERISTIC TCEVBLV_UnderVoltageThrC "TCEVBLV_UnderVoltageThrC" VALUE 0x800615C0 DATA_RECORD_FLOAT32_IEEE 3.402823466E+038 F_1_p0_36 -3.402823466E+038 3.402823466E+038 /end CHARACTERISTIC
/begin CHARACTERISTIC TCEVOPR_FreqCutOffC "TCEVOPR_FreqCutOffC" VALUE 0x800615D8 DATA_RECORD_FLOAT32_IEEE 3.402823466E+038 F_1_p0_36 -3.402823466E+038 3.402823466E+038 /end CHARACTERISTIC
/begin CHARACTERISTIC TCEVOTM_A2dMaxValueC "TCEVOTM_A2dMaxValueC" VALUE 0x8006172C DATA_RECORD_FLOAT32_IEEE 3.402823466E+038 F_1_p0_36 -3.402823466E+038 3.402823466E+038 /end CHARACTERISTIC
/begin CHARACTERISTIC TCEVOTM_A2dMinValueC "TCEVOTM_A2dMinValueC" VALUE 0x80061728 DATA_RECORD_FLOAT32_IEEE 3.402823466E+038 F_1_p0_36 -3.402823466E+038 3.402823466E+038 /end CHARACTERISTIC
/begin CHARACTERISTIC TCEVOTM_FreqCutOffC "TCEVOTM_FreqCutOffC" VALUE 0x80061724 DATA_RECORD_FLOAT32_IEEE 3.402823466E+038 F_1_p0_36 -3.402823466E+038 3.402823466E+038 /end CHARACTERISTIC
/begin CHARACTERISTIC TCEVOTM_GainTempCoolingC "TCEVOTM_GainTempCoolingC" VALUE 0x80061720 DATA_RECORD_FLOAT32_IEEE 3.402823466E+038 F_1_p0_36 -3.402823466E+038 3.402823466E+038 /end CHARACTERISTIC
/begin CHARACTERISTIC TCEVOTM_LutInTempPt100C "TCEVOTM_LutInTempPt100C" CURVE 0x80061684 DATA_RECORD_FLOAT32_IEEE 3.402823466E+038 F_1_p0_36 -3.402823466E+038 3.402823466E+038
 /begin AXIS_DESCR FIX_AXIS NO_INPUT_QUANTITY Id_0x00 39 0 38 MAX_GRAD 100.0 FIX_AXIS_PAR_DIST 0 1 39 /end AXIS_DESCR
/end CHARACTERISTIC
/begin CHARACTERISTIC TCEVOTM_LutOutTempPt100C "TCEVOTM_LutOutTempPt100C" CURVE 0x800615E8 DATA_RECORD_FLOAT32_IEEE 3.402823466E+038 F_1_p0_36 -3.402823466E+038 3.402823466E+038
 /begin AXIS_DESCR FIX_AXIS NO_INPUT_QUANTITY Id_0x00 39 0 38 MAX_GRAD 100.0 FIX_AXIS_PAR_DIST 0 1 39 /end AXIS_DESCR
/end CHARACTERISTIC
/begin CHARACTERISTIC TCEVOTM_OffsetTempCoolingC "TCEVOTM_OffsetTempCoolingC" VALUE 0x800615E4 DATA_RECORD_FLOAT32_IEEE 3.402823466E+038 F_1_p0_36 -3.402823466E+038 3.402823466E+038 /end CHARACTERISTIC
/begin CHARACTERISTIC TCEVOTM_OverTemp120C "TCEVOTM_OverTemp120C" VALUE 0x800615E0 DATA_RECORD_FLOAT32_IEEE 3.402823466E+038 F_1_p0_36 -3.402823466E+038 3.402823466E+038 /end CHARACTERISTIC
/begin CHARACTERISTIC TCEVOTM_OverTemp140C "TCEVOTM_OverTemp140C" VALUE 0x800615DC DATA_RECORD_FLOAT32_IEEE 3.402823466E+038 F_1_p0_36 -3.402823466E+038 3.402823466E+038 /end CHARACTERISTIC
/begin CHARACTERISTIC TCMTCUR_A2DCurrentLutInC "TCMTCUR_A2DCurrentLutInC" CURVE 0x800617B0 DATA_RECORD_FLOAT32_IEEE 3.402823466E+038 F_1_p0_36 -3.402823466E+038 3.402823466E+038
 /begin AXIS_DESCR FIX_AXIS NO_INPUT_QUANTITY Id_0x00 13 0 12 MAX_GRAD 100.0 FIX_AXIS_PAR_DIST 0 1 13 /end AXIS_DESCR
/end CHARACTERISTIC
/begin CHARACTERISTIC TCMTCUR_CurContinueC "TCMTCUR_CurContinueC" VALUE 0x800617AC DATA_RECORD_FLOAT32_IEEE 3.402823466E+038 F_1_p0_36 -3.402823466E+038 3.402823466E+038 /end CHARACTERISTIC
/begin CHARACTERISTIC TCMTCUR_CurLoadRatioFcutoffC "TCMTCUR_CurLoadRatioFcutoffC" VALUE 0x800617A8 DATA_RECORD_FLOAT32_IEEE 3.402823466E+038 F_1_p0_36 -3.402823466E+038 3.402823466E+038 /end CHARACTERISTIC
/begin CHARACTERISTIC TCMTCUR_CurrentLoadThrC "TCMTCUR_CurrentLoadThrC" VALUE 0x800617A4 DATA_RECORD_FLOAT32_IEEE 3.402823466E+038 F_1_p0_36 -3.402823466E+038 3.402823466E+038 /end CHARACTERISTIC
/begin CHARACTERISTIC TCMTCUR_DcCurFreqCutoffC "TCMTCUR_DcCurFreqCutoffC" VALUE 0x800617A0 DATA_RECORD_FLOAT32_IEEE 3.402823466E+038 F_1_p0_36 -3.402823466E+038 3.402823466E+038 /end CHARACTERISTIC
/begin CHARACTERISTIC TCMTCUR_FreqCutOffC "TCMTCUR_FreqCutOffC" VALUE 0x8006179C DATA_RECORD_FLOAT32_IEEE 3.402823466E+038 F_1_p0_36 -3.402823466E+038 3.402823466E+038 /end CHARACTERISTIC
/begin CHARACTERISTIC TCMTCUR_IdcOutC "TCMTCUR_IdcOutC" CURVE 0x80061768 DATA_RECORD_FLOAT32_IEEE 3.402823466E+038 F_1_p0_36 -3.402823466E+038 3.402823466E+038
 /begin AXIS_DESCR FIX_AXIS NO_INPUT_QUANTITY Id_0x00 13 0 12 MAX_GRAD 100.0 FIX_AXIS_PAR_DIST 0 1 13 /end AXIS_DESCR
/end CHARACTERISTIC
/begin CHARACTERISTIC TCMTCUR_IrmsOutC "TCMTCUR_IrmsOutC" CURVE 0x80061734 DATA_RECORD_FLOAT32_IEEE 3.402823466E+038 F_1_p0_36 -3.402823466E+038 3.402823466E+038
 /begin AXIS_DESCR FIX_AXIS NO_INPUT_QUANTITY Id_0x00 13 0 12 MAX_GRAD 100.0 FIX_AXIS_PAR_DIST 0 1 13 /end AXIS_DESCR
/end CHARACTERISTIC
/begin CHARACTERISTIC TCMTCUR_OverCurResetLoadThrC "TCMTCUR_OverCurResetLoadThrC" VALUE 0x80061730 DATA_RECORD_FLOAT32_IEEE 3.402823466E+038 F_1_p0_36 -3.402823466E+038 3.402823466E+038 /end CHARACTERISTIC
/begin CHARACTERISTIC TCMTHAL_FreqCutOffC "TCMTHAL_FreqCutOffC" VALUE 0x800617EC DATA_RECORD_FLOAT32_IEEE 3.402823466E+038 F_1_p0_36 -3.402823466E+038 3.402823466E+038 /end CHARACTERISTIC
/begin CHARACTERISTIC TCMTHAL_OverSpeedThrC "TCMTHAL_OverSpeedThrC" VALUE 0x800617E8 DATA_RECORD_FLOAT32_IEEE 3.402823466E+038 F_1_p0_36 -3.402823466E+038 3.402823466E+038 /end CHARACTERISTIC
/begin CHARACTERISTIC TCMTHAL_TcHallFaultTimeOutC "TCMTHAL_TcHallFaultTimeOutC" VALUE 0x800617E4 DATA_RECORD_FLOAT32_IEEE 3.402823466E+038 F_1_p0_36 -3.402823466E+038 3.402823466E+038 /end CHARACTERISTIC
/begin CHARACTERISTIC TCSMMAM_AclStateBypassOnOffC "TCSMMAM_AclStateBypassOnOffC" VALUE 0x800615BC DATA_RECORD_UBYTE 1 Bool_ON_OFF 0 1 BIT_MASK 0x01 /end CHARACTERISTIC
/begin CHARACTERISTIC TCSMMAM_AclStateBypassValueC "TCSMMAM_AclStateBypassValueC" VALUE 0x800615B8 DATA_RECORD_UWORD 65535 F_1_p0_36 0 65535 /end CHARACTERISTIC
/begin CHARACTERISTIC TCSMMAM_TcModeReqBypassOnOffC "TCSMMAM_TcModeReqBypassOnOffC" VALUE 0x800615B4 DATA_RECORD_UBYTE 1 Bool_ON_OFF 0 1 BIT_MASK 0x01 /end CHARACTERISTIC
/begin CHARACTERISTIC TCSMMAM_TcModeReqBypassValueC "TCSMMAM_TcModeReqBypassValueC" VALUE 0x800615B0 DATA_RECORD_UWORD 65535 F_1_p0_36 0 65535 /end CHARACTERISTIC
/begin MEASUREMENT FSEVBHV_A2DResCorrdVoltage "Corrected ADC value of the battery voltage." FLOAT32_IEEE F_1_p0_34 1 2 0 4095 ECU_ADDRESS 0x70003980 /end MEASUREMENT
/begin MEASUREMENT FSEVBHV_HighVoltReady "FSEVBHV_HighVoltReady" UBYTE Bool_ON_OFF 1 2 0 1 BIT_MASK 0x01 ECU_ADDRESS 0x7000397E /end MEASUREMENT
/begin MEASUREMENT FSEVBHV_LowVoltageWarnDetnZ "FSEVBHV_LowVoltageWarnDetnZ" UBYTE Bool_ON_OFF 1 2 0 1 BIT_MASK 0x01 ECU_ADDRESS 0x7000397D /end MEASUREMENT
/begin MEASUREMENT FSEVBHV_SampleVolOutRngHDetn "FSEVBHV_SampleVolOutRngHDetn" UBYTE Bool_ON_OFF 1 2 0 1 BIT_MASK 0x01 ECU_ADDRESS 0x7000397C /end MEASUREMENT
/begin MEASUREMENT FSEVBHV_SampleVolOutRngLDetn "FSEVBHV_SampleVolOutRngLDetn" UBYTE Bool_ON_OFF 1 2 0 1 BIT_MASK 0x01 ECU_ADDRESS 0x7000397B /end MEASUREMENT
/begin MEASUREMENT FSEVBHV_UnderVoltageWarnDetn "FSEVBHV_UnderVoltageWarnDetn" UBYTE Bool_ON_OFF 1 2 0 1 BIT_MASK 0x01 ECU_ADDRESS 0x7000397A /end MEASUREMENT
/begin MEASUREMENT FSEVBHV_VolNotRationalDetn "Fault on the battery voltage measure detection." UBYTE Bool_ON_OFF 1 2 0 1 BIT_MASK 0x01 ECU_ADDRESS 0x70003979 /end MEASUREMENT
/begin MEASUREMENT FSEVBHV_VolNotRationalErr "Fault on the battery voltage measure detection." UBYTE Bool_ON_OFF 1 2 0 1 BIT_MASK 0x01 ECU_ADDRESS 0x70003978 /end MEASUREMENT
/begin MEASUREMENT FSEVBHV_Voltage "Current value of the HV battery scaled voltage." FLOAT32_IEEE F_1_p0_39 1 2 0 605 ECU_ADDRESS 0x70003974 /end MEASUREMENT
/begin MEASUREMENT FSEVBHV_VoltageFild "Filtered value of the battery voltage." FLOAT32_IEEE F_1_p0_39 1 2 0 605 ECU_ADDRESS 0x70003970 /end MEASUREMENT
/begin MEASUREMENT FSEVBHV_VoltageFildZ "Filtered value of the battery voltage with 1 time delay." FLOAT32_IEEE F_1_p0_39 1 2 0 605 ECU_ADDRESS 0x7000396C /end MEASUREMENT
/begin MEASUREMENT FSEVBHV_VoltageGndDetn "FSEVBHV_VoltageGndDetn" UBYTE Bool_ON_OFF 1 2 0 1 BIT_MASK 0x01 ECU_ADDRESS 0x70003968 /end MEASUREMENT
/begin MEASUREMENT FSEVBHV_VoltageInv "FSEVBHV_VoltageInv" FLOAT32_IEEE F_1_p0_4 1 2 -3.402823466E+038 3.402823466E+038 ECU_ADDRESS 0x70003964 /end MEASUREMENT
/begin MEASUREMENT FSEVBHV_VoltageVccDetn "FSEVBHV_VoltageVccDetn" UBYTE Bool_ON_OFF 1 2 0 1 BIT_MASK 0x01 ECU_ADDRESS 0x70003962 /end MEASUREMENT
/begin MEASUREMENT FSEVBLV_A2DResCorrdBkpVolt "Corrected ADC value of the battery voltage." FLOAT32_IEEE F_1_p0_34 1 2 0 4095 ECU_ADDRESS 0x700039A0 /end MEASUREMENT
/begin MEASUREMENT FSEVBLV_A2DResCorrdVoltage "Corrected ADC value of the battery voltage." FLOAT32_IEEE F_1_p0_34 1 2 0 4095 ECU_ADDRESS 0x7000399C /end MEASUREMENT
/begin MEASUREMENT FSEVBLV_BkpVolt "Corrected ADC value of the battery voltage." FLOAT32_IEEE F_1_p0_38 1 2 -3.402823466E+038 3.402823466E+038 ECU_ADDRESS 0x70003998 /end MEASUREMENT
/begin MEASUREMENT FSEVBLV_LowVoltageWarnDetnZ "FSEVBLV_LowVoltageWarnDetnZ" UBYTE Bool_ON_OFF 1 2 0 1 BIT_MASK 0x01 ECU_ADDRESS 0x70003996 /end MEASUREMENT
/begin MEASUREMENT FSEVBLV_UnderVolFlag "FSEVBLV_UnderVolFlag" UBYTE Bool_ON_OFF 1 2 0 1 BIT_MASK 0x01 ECU_ADDRESS 0x70003995 /end MEASUREMENT
/begin MEASUREMENT FSEVBLV_UnderVoltageWarnDetn "FSEVBLV_UnderVoltageWarnDetn" UBYTE Bool_ON_OFF 1 2 0 1 BIT_MASK 0x01 ECU_ADDRESS 0x70003994 /end MEASUREMENT
/begin MEASUREMENT FSEVBLV_Voltage "Current value of the HV battery scaled voltage." FLOAT32_IEEE F_1_p0_39 1 2 0 605 ECU_ADDRESS 0x70003990 /end MEASUREMENT
/begin MEASUREMENT FSEVBLV_VoltageFild "Filtered value of the battery voltage." FLOAT32_IEEE F_1_p0_39 1 2 0 605 ECU_ADDRESS 0x7000398C /end MEASUREMENT
/begin MEASUREMENT FSEVBLV_VoltageFildZ "Filtered value of the battery voltage with 1 time delay." FLOAT32_IEEE F_1_p0_39 1 2 0 605 ECU_ADDRESS 0x70003988 /end MEASUREMENT
/begin MEASUREMENT FSEVBLV_VoltageGndDetn "FSEVBLV_VoltageGndDetn" UBYTE Bool_ON_OFF 1 2 0 1 BIT_MASK 0x01 ECU_ADDRESS 0x70003985 /end MEASUREMENT
/begin MEASUREMENT FSEVBLV_VoltageVccDetn "FSEVBLV_VoltageVccDetn" UBYTE Bool_ON_OFF 1 2 0 1 BIT_MASK 0x01 ECU_ADDRESS 0x70003984 /end MEASUREMENT
/begin MEASUREMENT FSEVETA_CoolingRationalDetn "FSEVETA_CoolingRationalDetn" UBYTE Bool_ON_OFF 1 2 0 1 BIT_MASK 0x01 ECU_ADDRESS 0x70003A40 /end MEASUREMENT
/begin MEASUREMENT FSEVETA_CorrdTempCooling "FSEVETA_CorrdTempCooling" FLOAT32_IEEE F_1_p0_41 1 2 -1000 1000 ECU_ADDRESS 0x70003A3C /end MEASUREMENT
/begin MEASUREMENT FSEVETA_CorrdTempDrvBoardLeft "FSEVETA_CorrdTempDrvBoardLeft" FLOAT32_IEEE F_1_p0_41 1 2 -1000 1000 ECU_ADDRESS 0x70003A38 /end MEASUREMENT
/begin MEASUREMENT FSEVETA_CorrdTempIgbtLeftU "FSEVETA_CorrdTempIgbtLeftU" FLOAT32_IEEE F_1_p0_42 1 2 -1000 1000 ECU_ADDRESS 0x70003A34 /end MEASUREMENT
/begin MEASUREMENT FSEVETA_CorrdTempIgbtLeftV "FSEVETA_CorrdTempIgbtLeftV" FLOAT32_IEEE F_1_p0_42 1 2 -1000 1000 ECU_ADDRESS 0x70003A30 /end MEASUREMENT
/begin MEASUREMENT FSEVETA_CorrdTempIgbtLeftW "FSEVETA_CorrdTempIgbtLeftW" FLOAT32_IEEE F_1_p0_42 1 2 -1000 1000 ECU_ADDRESS 0x70003A2C /end MEASUREMENT
/begin MEASUREMENT FSEVETA_CorrdTempLVCmdBoard "FSEVETA_CorrdTempLVCmdBoard" FLOAT32_IEEE F_1_p0_4 1 2 -3.402823466E+038 3.402823466E+038 ECU_ADDRESS 0x70003A28 /end MEASUREMENT
/begin MEASUREMENT FSEVETA_CorrdTempLVCmdBoard2 "FSEVETA_CorrdTempLVCmdBoard2" FLOAT32_IEEE F_1_p0_4 1 2 -3.402823466E+038 3.402823466E+038 ECU_ADDRESS 0x70003A24 /end MEASUREMENT
/begin MEASUREMENT FSEVETA_CounterNumberZ "FSEVETA_CounterNumberZ" UWORD F_1_p0_4 1 2 0 65535 ECU_ADDRESS 0x70003A20 /end MEASUREMENT
/begin MEASUREMENT FSEVETA_CtlBdTempRationalDetn "FSEVETA_CtlBdTempRationalDetn" UBYTE Bool_ON_OFF 1 2 0 1 BIT_MASK 0x01 ECU_ADDRESS 0x70003A1F /end MEASUREMENT
/begin MEASUREMENT FSEVETA_DrvTempRationDetn "FSEVETA_DrvTempRationDetn" UBYTE Bool_ON_OFF 1 2 0 1 BIT_MASK 0x01 ECU_ADDRESS 0x70003A1E /end MEASUREMENT
/begin MEASUREMENT FSEVETA_IgbtTempRationa "FSEVETA_IgbtTempRationa" UBYTE Bool_ON_OFF 1 2 0 1 BIT_MASK 0x01 ECU_ADDRESS 0x70003A1D /end MEASUREMENT
/begin MEASUREMENT FSEVETA_IgbtTempSlopOver "FSEVETA_IgbtTempSlopOver" UBYTE Bool_ON_OFF 1 2 0 1 BIT_MASK 0x01 ECU_ADDRESS 0x70003A1C /end MEASUREMENT
/begin MEASUREMENT FSEVETA_IgbtTempZ "FSEVETA_IgbtTempZ" FLOAT32_IEEE F_1_p0_44 1 2 -3.402823466E+038 3.402823466E+038 ECU_ADDRESS 0x70003A18 /end MEASUREMENT
/begin MEASUREMENT FSEVETA_OverTempNTC1CmdBoardDetn "FSEVETA_OverTempNTC1CmdBoardDetn" UBYTE Bool_ON_OFF 1 2 0 1 BIT_MASK 0x01 ECU_ADDRESS 0x70003A17 /end MEASUREMENT
/begin MEASUREMENT FSEVETA_OverTempNTC2CmdBoardDetn "FSEVETA_OverTempNTC2CmdBoardDetn" UBYTE Bool_ON_OFF 1 2 0 1 BIT_MASK 0x01 ECU_ADDRESS 0x70003A16 /end MEASUREMENT
/begin MEASUREMENT FSEVETA_SampleIgbtTempOutRngHDetn "FSEVETA_SampleIgbtTempOutRngHDetn" UBYTE Bool_ON_OFF 1 2 0 1 BIT_MASK 0x01 ECU_ADDRESS 0x70003A15 /end MEASUREMENT
/begin MEASUREMENT FSEVETA_SampleIgbtTempOutRngLDetn "FSEVETA_SampleIgbtTempOutRngLDetn" UBYTE Bool_ON_OFF 1 2 0 1 BIT_MASK 0x01 ECU_ADDRESS 0x70003A14 /end MEASUREMENT
/begin MEASUREMENT FSEVETA_TempCmdBoard "FSEVETA_TempCmdBoard" FLOAT32_IEEE F_1_p0_4 1 2 -3.402823466E+038 3.402823466E+038 ECU_ADDRESS 0x70003A10 /end MEASUREMENT
/begin MEASUREMENT FSEVETA_TempCooling "FSEVETA_TempCooling" FLOAT32_IEEE F_1_p0_42 1 2 -1000 1000 ECU_ADDRESS 0x70003A0C /end MEASUREMENT
/begin MEASUREMENT FSEVETA_TempCoolingFild "FSEVETA_TempCoolingFild" FLOAT32_IEEE F_1_p0_42 1 2 -1000 1000 ECU_ADDRESS 0x70003A08 /end MEASUREMENT
/begin MEASUREMENT FSEVETA_TempCoolingFildZ "FSEVETA_TempCoolingFildZ" FLOAT32_IEEE F_1_p0_41 1 2 -1000 1000 ECU_ADDRESS 0x70003A04 /end MEASUREMENT
/begin MEASUREMENT FSEVETA_TempDrvBoard "FSEVETA_TempDrvBoard" FLOAT32_IEEE F_1_p0_41 1 2 -1000 1000 ECU_ADDRESS 0x70003A00 /end MEASUREMENT
/begin MEASUREMENT FSEVETA_TempDrvBoardLeft "FSEVETA_TempDrvBoardLeft" FLOAT32_IEEE F_1_p0_42 1 2 -1000 1000 ECU_ADDRESS 0x700039FC /end MEASUREMENT
/begin MEASUREMENT FSEVETA_TempDrvBoardLeftFild "FSEVETA_TempDrvBoardLeftFild" FLOAT32_IEEE F_1_p0_41 1 2 -1000 1000 ECU_ADDRESS 0x700039F8 /end MEASUREMENT
/begin MEASUREMENT FSEVETA_TempDrvBoardLeftFildZ "FSEVETA_TempDrvBoardLeftFildZ" FLOAT32_IEEE F_1_p0_41 1 2 -1000 1000 ECU_ADDRESS 0x700039F4 /end MEASUREMENT
/begin MEASUREMENT FSEVETA_TempDrvBoardLeftGndDetn "FSEVETA_TempDrvBoardLeftGndDetn" UBYTE Bool_ON_OFF 1 2 0 1 BIT_MASK 0x01 ECU_ADDRESS 0x700039F1 /end MEASUREMENT
/begin MEASUREMENT FSEVETA_TempDrvBoardLeftVccDetn "FSEVETA_TempDrvBoardLeftVccDetn" UBYTE Bool_ON_OFF 1 2 0 1 BIT_MASK 0x01 ECU_ADDRESS 0x700039F0 /end MEASUREMENT
/begin MEASUREMENT FSEVETA_TempIgbt "FSEVETA_TempIgbt" FLOAT32_IEEE F_1_p0_42 1 2 -1000 1000 ECU_ADDRESS 0x700039EC /end MEASUREMENT
/begin MEASUREMENT FSEVETA_TempIgbtLeftFild "FSEVETA_TempIgbtLeftFild" FLOAT32_IEEE F_1_p0_42 1 2 -1000 1000 ECU_ADDRESS 0x700039E8 /end MEASUREMENT
/begin MEASUREMENT FSEVETA_TempIgbtLeftFildU "FSEVETA_TempIgbtLeftFildU" FLOAT32_IEEE F_1_p0_42 1 2 -1000 1000 ECU_ADDRESS 0x700039E4 /end MEASUREMENT
/begin MEASUREMENT FSEVETA_TempIgbtLeftFildV "FSEVETA_TempIgbtLeftFildV" FLOAT32_IEEE F_1_p0_42 1 2 -1000 1000 ECU_ADDRESS 0x700039E0 /end MEASUREMENT
/begin MEASUREMENT FSEVETA_TempIgbtLeftFildW "FSEVETA_TempIgbtLeftFildW" FLOAT32_IEEE F_1_p0_42 1 2 -1000 1000 ECU_ADDRESS 0x700039DC /end MEASUREMENT
/begin MEASUREMENT FSEVETA_TempIgbtLeftFildZU "FSEVETA_TempIgbtLeftFildZU" FLOAT32_IEEE F_1_p0_42 1 2 -1000 1000 ECU_ADDRESS 0x700039D8 /end MEASUREMENT
/begin MEASUREMENT FSEVETA_TempIgbtLeftFildZV "FSEVETA_TempIgbtLeftFildZV" FLOAT32_IEEE F_1_p0_42 1 2 -1000 1000 ECU_ADDRESS 0x700039D4 /end MEASUREMENT
/begin MEASUREMENT FSEVETA_TempIgbtLeftFildZW "FSEVETA_TempIgbtLeftFildZW" FLOAT32_IEEE F_1_p0_42 1 2 -1000 1000 ECU_ADDRESS 0x700039D0 /end MEASUREMENT
/begin MEASUREMENT FSEVETA_TempIgbtLeftU "FSEVETA_TempIgbtLeftU" FLOAT32_IEEE F_1_p0_42 1 2 -1000 1000 ECU_ADDRESS 0x700039CC /end MEASUREMENT
/begin MEASUREMENT FSEVETA_TempIgbtLeftV "FSEVETA_TempIgbtLeftV" FLOAT32_IEEE F_1_p0_42 1 2 -1000 1000 ECU_ADDRESS 0x700039C8 /end MEASUREMENT
/begin MEASUREMENT FSEVETA_TempIgbtLeftW "FSEVETA_TempIgbtLeftW" FLOAT32_IEEE F_1_p0_42 1 2 -1000 1000 ECU_ADDRESS 0x700039C4 /end MEASUREMENT
/begin MEASUREMENT FSEVETA_TempLVCmdBoard "FSEVETA_TempLVCmdBoard" FLOAT32_IEEE F_1_p0_4 1 2 -3.402823466E+038 3.402823466E+038 ECU_ADDRESS 0x700039C0 /end MEASUREMENT
/begin MEASUREMENT FSEVETA_TempLVCmdBoard2 "FSEVETA_TempLVCmdBoard2" FLOAT32_IEEE F_1_p0_4 1 2 -3.402823466E+038 3.402823466E+038 ECU_ADDRESS 0x700039BC /end MEASUREMENT
/begin MEASUREMENT FSEVETA_TempLVCmdBoard2Fild "FSEVETA_TempLVCmdBoard2Fild" FLOAT32_IEEE F_1_p0_4 1 2 -100 500 ECU_ADDRESS 0x700039B8 /end MEASUREMENT
/begin MEASUREMENT FSEVETA_TempLVCmdBoard2FildZ "FSEVETA_TempLVCmdBoard2FildZ" FLOAT32_IEEE F_1_p0_4 1 2 -3.402823466E+038 3.402823466E+038 ECU_ADDRESS 0x700039B4 /end MEASUREMENT
/begin MEASUREMENT FSEVETA_TempLVCmdBoardFild "FSEVETA_TempLVCmdBoardFild" FLOAT32_IEEE F_1_p0_4 1 2 -100 500 ECU_ADDRESS 0x700039B0 /end MEASUREMENT
/begin MEASUREMENT FSEVETA_TempLVCmdBoardFildZ "FSEVETA_TempLVCmdBoardFildZ" FLOAT32_IEEE F_1_p0_4 1 2 -3.402823466E+038 3.402823466E+038 ECU_ADDRESS 0x700039AC /end MEASUREMENT
/begin MEASUREMENT FSEVETA_TempNTC1CmdBoardGndDetn "FSEVETA_TempNTC1CmdBoardGndDetn" UBYTE Bool_ON_OFF 1 2 0 1 BIT_MASK 0x01 ECU_ADDRESS 0x700039AB /end MEASUREMENT
/begin MEASUREMENT FSEVETA_TempNTC1CmdBoardVccDetn "FSEVETA_TempNTC1CmdBoardVccDetn" UBYTE Bool_ON_OFF 1 2 0 1 BIT_MASK 0x01 ECU_ADDRESS 0x700039AA /end MEASUREMENT
/begin MEASUREMENT FSEVETA_TempNTC2CmdBoardDetn "FSEVETA_TempNTC2CmdBoardDetn" UBYTE Bool_ON_OFF 1 2 0 1 BIT_MASK 0x01 ECU_ADDRESS 0x70003B70 /end MEASUREMENT
/begin MEASUREMENT FSEVETA_TempNTC2CmdBoardGndDetn "FSEVETA_TempNTC2CmdBoardGndDetn" UBYTE Bool_ON_OFF 1 2 0 1 BIT_MASK 0x01 ECU_ADDRESS 0x700039A9 /end MEASUREMENT
/begin MEASUREMENT FSEVETA_TempNTC2CmdBoardVccDetn "FSEVETA_TempNTC2CmdBoardVccDetn" UBYTE Bool_ON_OFF 1 2 0 1 BIT_MASK 0x01 ECU_ADDRESS 0x700039A8 /end MEASUREMENT
/begin MEASUREMENT FSEVETA_UnderTempDrvLeftDetn "FSEVETA_UnderTempDrvLeftDetn" UBYTE Bool_ON_OFF 1 2 0 1 BIT_MASK 0x01 ECU_ADDRESS 0x700039A7 /end MEASUREMENT
/begin MEASUREMENT FSEVETA_UnderTempIgbtLeftDetn "FSEVETA_UnderTempIgbtLeftDetn" UBYTE Bool_ON_OFF 1 2 0 1 BIT_MASK 0x01 ECU_ADDRESS 0x700039A6 /end MEASUREMENT
/begin MEASUREMENT FSEVETA_UnderTempNTC1CmdBoardDetn "FSEVETA_UnderTempNTC1CmdBoardDetn" UBYTE Bool_ON_OFF 1 2 0 1 BIT_MASK 0x01 ECU_ADDRESS 0x700039A5 /end MEASUREMENT
/begin MEASUREMENT FSEVETA_UnderTempNTC2CmdBoardDetn "FSEVETA_UnderTempNTC2CmdBoardDetn" UBYTE Bool_ON_OFF 1 2 0 1 BIT_MASK 0x01 ECU_ADDRESS 0x700039A4 /end MEASUREMENT
/begin MEASUREMENT FSEVIBT_1ByAccumulator "FSEVIBT_1ByAccumulator" FLOAT32_IEEE F_1_p0_4 1 2 -3.402823466E+038 3.402823466E+038 ECU_ADDRESS 0x70003A90 /end MEASUREMENT
/begin MEASUREMENT FSEVIBT_A2DOffsetIbatHV "FSEVIBT_A2DOffsetIbatHV" FLOAT32_IEEE F_1_p0_4 1 2 -3.402823466E+038 3.402823466E+038 ECU_ADDRESS 0x70003A8C /end MEASUREMENT
/begin MEASUREMENT FSEVIBT_A2DOffsetSumIbatHVZ "FSEVIBT_A2DOffsetSumIbatHVZ" FLOAT32_IEEE F_1_p0_4 1 2 -3.402823466E+038 3.402823466E+038 ECU_ADDRESS 0x70003A88 /end MEASUREMENT
/begin MEASUREMENT FSEVIBT_A2DResCorrdIbatHV "FSEVIBT_A2DResCorrdIbatHV" FLOAT32_IEEE F_1_p0_4 1 2 -3.402823466E+038 3.402823466E+038 ECU_ADDRESS 0x70003A84 /end MEASUREMENT
/begin MEASUREMENT FSEVIBT_A2DResCorrdIbatRmsHV "FSEVIBT_A2DResCorrdIbatRmsHV" FLOAT32_IEEE F_1_p0_4 1 2 -3.402823466E+038 3.402823466E+038 ECU_ADDRESS 0x70003A80 /end MEASUREMENT
/begin MEASUREMENT FSEVIBT_AD2Phys "FSEVIBT_AD2Phys" FLOAT32_IEEE F_1_p0_4 1 2 -3.402823466E+038 3.402823466E+038 ECU_ADDRESS 0x70003A7C /end MEASUREMENT
/begin MEASUREMENT FSEVIBT_CurrentGndDetn "FSEVIBT_CurrentGndDetn" UBYTE Bool_ON_OFF 1 2 0 1 BIT_MASK 0x01 ECU_ADDRESS 0x70003A79 /end MEASUREMENT
/begin MEASUREMENT FSEVIBT_CurrentVccDetn "FSEVIBT_CurrentVccDetn" UBYTE Bool_ON_OFF 1 2 0 1 BIT_MASK 0x01 ECU_ADDRESS 0x70003A78 /end MEASUREMENT
/begin MEASUREMENT FSEVIBT_IbatHV "FSEVIBT_IbatHV" FLOAT32_IEEE F_1_p0_46 1 2 -1000 1000 ECU_ADDRESS 0x70003A74 /end MEASUREMENT
/begin MEASUREMENT FSEVIBT_IbatHVFild "FSEVIBT_IbatHVFild" FLOAT32_IEEE F_1_p0_46 1 2 -1000 1000 ECU_ADDRESS 0x70003A70 /end MEASUREMENT
/begin MEASUREMENT FSEVIBT_IbatHVFildZ "FSEVIBT_IbatHVFildZ" FLOAT32_IEEE F_1_p0_46 1 2 -1000 1000 ECU_ADDRESS 0x70003A6C /end MEASUREMENT
/begin MEASUREMENT FSEVIBT_IbatRmsCalcEnable "FSEVIBT_IbatRmsCalcEnable" UBYTE Bool_ON_OFF 1 2 0 1 BIT_MASK 0x01 ECU_ADDRESS 0x70003A68 /end MEASUREMENT
/begin MEASUREMENT FSEVIBT_IbatRmsHV "FSEVIBT_IbatRmsHV" FLOAT32_IEEE F_1_p0_46 1 2 -1000 1000 ECU_ADDRESS 0x70003A64 /end MEASUREMENT
/begin MEASUREMENT FSEVIBT_IbatRmsHV1 "FSEVIBT_IbatRmsHV1" FLOAT32_IEEE F_1_p0_46 1 2 -1000 1000 ECU_ADDRESS 0x70003A60 /end MEASUREMENT
/begin MEASUREMENT FSEVIBT_OverCurrentDetn "FSEVIBT_OverCurrentDetn" UBYTE Bool_ON_OFF 1 2 0 1 BIT_MASK 0x01 ECU_ADDRESS 0x70003A5E /end MEASUREMENT
/begin MEASUREMENT FSEVIBT_RmsCalculationCounter "FSEVIBT_RmsCalculationCounter" SWORD F_1_p0_4 1 2 -32768 32767 ECU_ADDRESS 0x70003A5C /end MEASUREMENT
/begin MEASUREMENT FSEVIBT_RmsOffset "FSEVIBT_RmsOffset" FLOAT32_IEEE F_1_p0_4 1 2 -3.402823466E+038 3.402823466E+038 ECU_ADDRESS 0x70003A58 /end MEASUREMENT
/begin MEASUREMENT FSEVIBT_SampleNumberZ "FSEVIBT_SampleNumberZ" ULONG F_1_p0_4 1 2 0 4294967295 ECU_ADDRESS 0x70003A54 /end MEASUREMENT
/begin MEASUREMENT FSEVIBT_SampleVolOutRngHDetn "FSEVIBT_SampleVolOutRngHDetn" UBYTE Bool_ON_OFF 1 2 0 1 BIT_MASK 0x01 ECU_ADDRESS 0x70003A51 /end MEASUREMENT
/begin MEASUREMENT FSEVIBT_SampleVolOutRngLDetn "FSEVIBT_SampleVolOutRngLDetn" UBYTE Bool_ON_OFF 1 2 0 1 BIT_MASK 0x01 ECU_ADDRESS 0x70003A50 /end MEASUREMENT
/begin MEASUREMENT FSEVIBT_SumSquareIbatRms "FSEVIBT_SumSquareIbatRms" FLOAT32_IEEE F_1_p0_4 1 2 -3.402823466E+038 3.402823466E+038 ECU_ADDRESS 0x70003A4C /end MEASUREMENT
/begin MEASUREMENT FSEVIBT_SumSquareIbatRmsLatch "FSEVIBT_SumSquareIbatRmsLatch" FLOAT32_IEEE F_1_p0_4 1 2 -3.402823466E+038 3.402823466E+038 ECU_ADDRESS 0x70003A48 /end MEASUREMENT
/begin MEASUREMENT FSEVIBT_SumSquareIbatRmsOld "FSEVIBT_SumSquareIbatRmsOld" FLOAT32_IEEE F_1_p0_4 1 2 -3.402823466E+038 3.402823466E+038 ECU_ADDRESS 0x70003A44 /end MEASUREMENT
/begin MEASUREMENT FSEVIBT_UnderCurrentDetn "FSEVIBT_UnderCurrentDetn" UBYTE Bool_ON_OFF 1 2 0 1 BIT_MASK 0x01 ECU_ADDRESS 0x70003A41 /end MEASUREMENT
/begin MEASUREMENT FSEXCTX_9550MultiTorque "FSEXCTX_9550MultiTorque" FLOAT32_IEEE F_1_p0_47 1 2 -3.402823466E+038 3.402823466E+038 ECU_ADDRESS 0x70003B30 /end MEASUREMENT
/begin MEASUREMENT FSEXCTX_DCcurrentActual "FSEXCTX_DCcurrentActual" FLOAT32_IEEE F_1_p0_46 1 2 -1000 1000 ECU_ADDRESS 0x70003B2C /end MEASUREMENT
/begin MEASUREMENT FSEXCTX_DCvoltActual "FSEXCTX_DCvoltActual" FLOAT32_IEEE F_1_p0_4 1 2 -3.402823466E+038 3.402823466E+038 ECU_ADDRESS 0x70003B28 /end MEASUREMENT
/begin MEASUREMENT FSEXCTX_DeratingStatus "FSEXCTX_DeratingStatus" UWORD F_1_p0_43 1 2 0 65535 ECU_ADDRESS 0x70003B24 /end MEASUREMENT
/begin MEASUREMENT FSEXCTX_ElectricPower "FSEXCTX_ElectricPower" FLOAT32_IEEE F_1_p0_49 1 2 -500 500 ECU_ADDRESS 0x70003B20 /end MEASUREMENT
/begin MEASUREMENT FSEXCTX_ErrorLevel "FSEXCTX_ErrorLevel" UWORD F_1_p0_43 1 2 0 65535 ECU_ADDRESS 0x70003B1C /end MEASUREMENT
/begin MEASUREMENT FSEXCTX_EstiHvDcPower "FSEXCTX_EstiHvDcPower" FLOAT32_IEEE F_1_p0_49 1 2 -500 500 ECU_ADDRESS 0x70003B18 /end MEASUREMENT
/begin MEASUREMENT FSEXCTX_EstiIbatHv "FSEXCTX_EstiIbatHv" FLOAT32_IEEE F_1_p0_42 1 2 -3.402823466E+038 3.402823466E+038 ECU_ADDRESS 0x70003B14 /end MEASUREMENT
/begin MEASUREMENT FSEXCTX_EstiIbatHvRms "FSEXCTX_EstiIbatHvRms" FLOAT32_IEEE F_1_p0_42 1 2 -3.402823466E+038 3.402823466E+038 ECU_ADDRESS 0x70003B10 /end MEASUREMENT
/begin MEASUREMENT FSEXCTX_Fault1 "FSEXCTX_Fault1" UWORD F_1_p0_43 1 2 0 65535 ECU_ADDRESS 0x70003B0E /end MEASUREMENT
/begin MEASUREMENT FSEXCTX_Fault2 "FSEXCTX_Fault2" UWORD F_1_p0_43 1 2 0 65535 ECU_ADDRESS 0x70003B0C /end MEASUREMENT
/begin MEASUREMENT FSEXCTX_Fault3 "FSEXCTX_Fault3" UWORD F_1_p0_43 1 2 0 65535 ECU_ADDRESS 0x70003B0A /end MEASUREMENT
/begin MEASUREMENT FSEXCTX_FaultLampInd "FSEXCTX_FaultLampInd" UWORD F_1_p0_43 1 2 0 1 ECU_ADDRESS 0x70003B08 /end MEASUREMENT
/begin MEASUREMENT FSEXCTX_GateDrvState "FSEXCTX_GateDrvState" UWORD F_1_p0_43 1 2 0 65535 ECU_ADDRESS 0x70003B06 /end MEASUREMENT
/begin MEASUREMENT FSEXCTX_HVReadyStatus "FSEXCTX_HVReadyStatus" UBYTE Bool_ON_OFF 1 2 0 1 BIT_MASK 0x01 ECU_ADDRESS 0x70003B04 /end MEASUREMENT
/begin MEASUREMENT FSEXCTX_Idirect "FSEXCTX_Idirect" FLOAT32_IEEE F_1_p0_46 1 2 -1000 1000 ECU_ADDRESS 0x70003B00 /end MEASUREMENT
/begin MEASUREMENT FSEXCTX_InverterTemp "FSEXCTX_InverterTemp" FLOAT32_IEEE F_1_p0_46 1 2 -1000 1000 ECU_ADDRESS 0x70003AFC /end MEASUREMENT
/begin MEASUREMENT FSEXCTX_Iquadra "FSEXCTX_Iquadra" FLOAT32_IEEE F_1_p0_46 1 2 -1000 1000 ECU_ADDRESS 0x70003AF8 /end MEASUREMENT
/begin MEASUREMENT FSEXCTX_MCURepairInd "FSEXCTX_MCURepairInd" UBYTE Bool_ON_OFF 1 2 0 1 BIT_MASK 0x01 ECU_ADDRESS 0x70003AF4 /end MEASUREMENT
/begin MEASUREMENT FSEXCTX_MaxAvailableTorque "maximal available torque." FLOAT32_IEEE F_1_p0_49 1 2 -500 500 ECU_ADDRESS 0x70003AF0 /end MEASUREMENT
/begin MEASUREMENT FSEXCTX_MaxAvailableTorqueRed "FSEXCTX_MaxAvailableTorqueRed" FLOAT32_IEEE F_1_p0_49 1 2 -500 500 ECU_ADDRESS 0x70003AEC /end MEASUREMENT
/begin MEASUREMENT FSEXCTX_Meca2DcPower "FSEXCTX_Meca2DcPower" FLOAT32_IEEE F_1_p0_49 1 2 -500 500 ECU_ADDRESS 0x70003AE8 /end MEASUREMENT
/begin MEASUREMENT FSEXCTX_MecaPowerSign "FSEXCTX_MecaPowerSign" FLOAT32_IEEE F_1_p0_47 1 2 -3.402823466E+038 3.402823466E+038 ECU_ADDRESS 0x70003AE4 /end MEASUREMENT
/begin MEASUREMENT FSEXCTX_MinAvailableTorque "FSEXCTX_MinAvailableTorque" FLOAT32_IEEE F_1_p0_49 1 2 -500 500 ECU_ADDRESS 0x70003AE0 /end MEASUREMENT
/begin MEASUREMENT FSEXCTX_MinAvailableTorqueRed "FSEXCTX_MinAvailableTorqueRed" FLOAT32_IEEE F_1_p0_49 1 2 -500 500 ECU_ADDRESS 0x70003ADC /end MEASUREMENT
/begin MEASUREMENT FSEXCTX_MotorAppliedTorque "Current value of applied torque." FLOAT32_IEEE F_1_p0_49 1 2 -500 500 ECU_ADDRESS 0x70003AD8 /end MEASUREMENT
/begin MEASUREMENT FSEXCTX_MotorAppliedTorqueRed "FSEXCTX_MotorAppliedTorqueRed" FLOAT32_IEEE F_1_p0_49 1 2 -500 500 ECU_ADDRESS 0x70003AD4 /end MEASUREMENT
/begin MEASUREMENT FSEXCTX_MotorSpeed "Current value of  motor speed." FLOAT32_IEEE F_1_p0_21 1 2 -1000000 1000000 ECU_ADDRESS 0x70003AD0 /end MEASUREMENT
/begin MEASUREMENT FSEXCTX_MotorSpeedFildZ "FSEXCTX_MotorSpeedFildZ" FLOAT32_IEEE F_1_p0_46 1 2 -3.402823466E+038 3.402823466E+038 ECU_ADDRESS 0x70003ACC /end MEASUREMENT
/begin MEASUREMENT FSEXCTX_MotorSpeedRed "FSEXCTX_MotorSpeedRed" FLOAT32_IEEE F_1_p0_50 1 2 -1000000 1000000 ECU_ADDRESS 0x70003AC8 /end MEASUREMENT
/begin MEASUREMENT FSEXCTX_MotorState "Current value of motor state" UWORD F_1_p0_43 1 2 0 65535 ECU_ADDRESS 0x70003AC4 /end MEASUREMENT
/begin MEASUREMENT FSEXCTX_MotorTemp "FSEXCTX_MotorTemp" FLOAT32_IEEE F_1_p0_42 1 2 -1000 1000 ECU_ADDRESS 0x70003AC0 /end MEASUREMENT
/begin MEASUREMENT FSEXCTX_OffsetCalInd "FSEXCTX_OffsetCalInd" UBYTE Bool_ON_OFF 1 2 0 1 BIT_MASK 0x01 ECU_ADDRESS 0x70003ABD /end MEASUREMENT
/begin MEASUREMENT FSEXCTX_OffsetCalReq "FSEXCTX_OffsetCalReq" UBYTE Bool_ON_OFF 1 2 0 1 BIT_MASK 0x01 ECU_ADDRESS 0x70003ABC /end MEASUREMENT
/begin MEASUREMENT FSEXCTX_ProofSysEfficiency "FSEXCTX_ProofSysEfficiency" FLOAT32_IEEE F_1_p0_47 1 2 -500 500 ECU_ADDRESS 0x70003AB8 /end MEASUREMENT
/begin MEASUREMENT FSEXCTX_ResolverOffsetAngle "FSEXCTX_ResolverOffsetAngle" UWORD F_1_p0_51 1 2 0 4095 ECU_ADDRESS 0x70003AB4 /end MEASUREMENT
/begin MEASUREMENT FSEXCTX_RotorTemp "FSEXCTX_RotorTemp" FLOAT32_IEEE F_1_p0_42 1 2 -1000 1000 ECU_ADDRESS 0x70003AB0 /end MEASUREMENT
/begin MEASUREMENT FSEXCTX_SumSquareIbatRmsOld "FSEXCTX_SumSquareIbatRmsOld" FLOAT32_IEEE F_1_p0_46 1 2 -3.402823466E+038 3.402823466E+038 ECU_ADDRESS 0x70003AAC /end MEASUREMENT
/begin MEASUREMENT FSEXCTX_SwVerNum1 "FSEXCTX_SwVerNum1" UWORD F_1_p0_43 1 2 0 31 ECU_ADDRESS 0x70003AAA /end MEASUREMENT
/begin MEASUREMENT FSEXCTX_SwVerNum2 "FSEXCTX_SwVerNum2" UWORD F_1_p0_43 1 2 0 31 ECU_ADDRESS 0x70003AA8 /end MEASUREMENT
/begin MEASUREMENT FSEXCTX_SwVerNum3 "FSEXCTX_SwVerNum3" UWORD F_1_p0_43 1 2 0 31 ECU_ADDRESS 0x70003AA6 /end MEASUREMENT
/begin MEASUREMENT FSEXCTX_SwVerNum4 "FSEXCTX_SwVerNum4" UWORD F_1_p0_43 1 2 0 31 ECU_ADDRESS 0x70003AA4 /end MEASUREMENT
/begin MEASUREMENT FSEXCTX_SysEfficiency "FSEXCTX_SysEfficiency" FLOAT32_IEEE F_1_p0_47 1 2 -3.402823466E+038 3.402823466E+038 ECU_ADDRESS 0x70003AA0 /end MEASUREMENT
/begin MEASUREMENT FSEXCTX_SysTempOvrInd "FSEXCTX_SysTempOvrInd" UBYTE Bool_ON_OFF 1 2 0 1 BIT_MASK 0x01 ECU_ADDRESS 0x70003A9C /end MEASUREMENT
/begin MEASUREMENT FSEXCTX_SystemEfficiency "FSEXCTX_SystemEfficiency" FLOAT32_IEEE F_1_p0_47 1 2 -500 500 ECU_ADDRESS 0x70003A98 /end MEASUREMENT
/begin MEASUREMENT FSEXCTX_TorqueCompFildZ "FSEXCTX_TorqueCompFildZ" FLOAT32_IEEE F_1_p0_47 1 2 -500 500 ECU_ADDRESS 0x70003A94 /end MEASUREMENT
/begin MEASUREMENT FSMTMTA_CorrdTempWindingHead1 "FSMTMTA_CorrdTempWindingHead1" FLOAT32_IEEE F_1_p0_4 1 2 -3.402823466E+038 3.402823466E+038 ECU_ADDRESS 0x70003B6C /end MEASUREMENT
/begin MEASUREMENT FSMTMTA_CorrdTempWindingHead2 "FSMTMTA_CorrdTempWindingHead2" FLOAT32_IEEE F_1_p0_4 1 2 -3.402823466E+038 3.402823466E+038 ECU_ADDRESS 0x70003B68 /end MEASUREMENT
/begin MEASUREMENT FSMTMTA_OverTempWdgHead2Detn "FSMTMTA_OverTempWdgHead2Detn" UBYTE Bool_ON_OFF 1 2 0 1 BIT_MASK 0x01 ECU_ADDRESS 0x70003B65 /end MEASUREMENT
/begin MEASUREMENT FSMTMTA_TempWindHead1OutRngHDetn "FSMTMTA_TempWindHead1OutRngHDetn" UBYTE Bool_ON_OFF 1 2 0 1 BIT_MASK 0x01 ECU_ADDRESS 0x70003B64 /end MEASUREMENT
/begin MEASUREMENT FSMTMTA_TempWindHead1OutRngLDetn "FSMTMTA_TempWindHead1OutRngLDetn" UBYTE Bool_ON_OFF 1 2 0 1 BIT_MASK 0x01 ECU_ADDRESS 0x70003B63 /end MEASUREMENT
/begin MEASUREMENT FSMTMTA_TempWindHead2OutRngHDetn "FSMTMTA_TempWindHead2OutRngHDetn" UBYTE Bool_ON_OFF 1 2 0 1 BIT_MASK 0x01 ECU_ADDRESS 0x70003B62 /end MEASUREMENT
/begin MEASUREMENT FSMTMTA_TempWindHead2OutRngLDetn "FSMTMTA_TempWindHead2OutRngLDetn" UBYTE Bool_ON_OFF 1 2 0 1 BIT_MASK 0x01 ECU_ADDRESS 0x70003B61 /end MEASUREMENT
/begin MEASUREMENT FSMTMTA_TempWindHeadRationalDetn "FSMTMTA_TempWindHeadRationalDetn" UBYTE Bool_ON_OFF 1 2 0 1 BIT_MASK 0x01 ECU_ADDRESS 0x70003B60 /end MEASUREMENT
/begin MEASUREMENT FSMTMTA_TempWindingHead1 "FSMTMTA_TempWindingHead1" FLOAT32_IEEE F_1_p0_4 1 2 -3.402823466E+038 3.402823466E+038 ECU_ADDRESS 0x70003B54 /end MEASUREMENT
/begin MEASUREMENT FSMTMTA_TempWindingHead1Fild "FSMTMTA_TempWindingHead1Fild" FLOAT32_IEEE F_1_p0_4 1 2 -3.402823466E+038 3.402823466E+038 ECU_ADDRESS 0x70003B50 /end MEASUREMENT
/begin MEASUREMENT FSMTMTA_TempWindingHead1FildZ "FSMTMTA_TempWindingHead1FildZ" FLOAT32_IEEE F_1_p0_4 1 2 -3.402823466E+038 3.402823466E+038 ECU_ADDRESS 0x70003B4C /end MEASUREMENT
/begin MEASUREMENT FSMTMTA_TempWindingHead2 "FSMTMTA_TempWindingHead2" FLOAT32_IEEE F_1_p0_4 1 2 -3.402823466E+038 3.402823466E+038 ECU_ADDRESS 0x70003B48 /end MEASUREMENT
/begin MEASUREMENT FSMTMTA_TempWindingHead2Fild "FSMTMTA_TempWindingHead2Fild" FLOAT32_IEEE F_1_p0_4 1 2 -3.402823466E+038 3.402823466E+038 ECU_ADDRESS 0x70003B44 /end MEASUREMENT
/begin MEASUREMENT FSMTMTA_TempWindingHead2FildZ "FSMTMTA_TempWindingHead2FildZ" FLOAT32_IEEE F_1_p0_4 1 2 -3.402823466E+038 3.402823466E+038 ECU_ADDRESS 0x70003B40 /end MEASUREMENT
/begin MEASUREMENT FSMTMTA_TempWindingHead2GndDetn "FSMTMTA_TempWindingHead2GndDetn" UBYTE Bool_ON_OFF 1 2 0 1 BIT_MASK 0x01 ECU_ADDRESS 0x70003B3D /end MEASUREMENT
/begin MEASUREMENT FSMTMTA_TempWindingHead2VccDetn "FSMTMTA_TempWindingHead2VccDetn" UBYTE Bool_ON_OFF 1 2 0 1 BIT_MASK 0x01 ECU_ADDRESS 0x70003B3C /end MEASUREMENT
/begin MEASUREMENT FSMTMTA_TempWindingMax "FSMTMTA_TempWindingMax" FLOAT32_IEEE F_1_p0_4 1 2 -3.402823466E+038 3.402823466E+038 ECU_ADDRESS 0x70003B38 /end MEASUREMENT
/begin MEASUREMENT FSMTMTA_TempWinding[0] "FSMTMTA_TempWinding" FLOAT32_IEEE F_1_p0_4 1 2 -3.402823466E+038 3.402823466E+038 ECU_ADDRESS 0x70003B58 /end MEASUREMENT
/begin MEASUREMENT FSMTMTA_TempWinding[1] "FSMTMTA_TempWinding" FLOAT32_IEEE F_1_p0_4 1 2 -3.402823466E+038 3.402823466E+038 ECU_ADDRESS 0x70003B5C /end MEASUREMENT
/begin MEASUREMENT FSMTMTA_UnderTempWdgHead1Detn "FSMTMTA_UnderTempWdgHead1Detn" UBYTE Bool_ON_OFF 1 2 0 1 BIT_MASK 0x01 ECU_ADDRESS 0x70003B35 /end MEASUREMENT
/begin MEASUREMENT FSMTMTA_UnderTempWdgHead2Detn "FSMTMTA_UnderTempWdgHead2Detn" UBYTE Bool_ON_OFF 1 2 0 1 BIT_MASK 0x01 ECU_ADDRESS 0x70003B34 /end MEASUREMENT
/begin MEASUREMENT FSMTRDG_A2DResCorrdCosH "FSMTRDG_A2DResCorrdCosH" FLOAT32_IEEE F_1_p0_4 1 2 -3.402823466E+038 3.402823466E+038 ECU_ADDRESS 0x70003BF8 /end MEASUREMENT
/begin MEASUREMENT FSMTRDG_A2DResCorrdCosL "FSMTRDG_A2DResCorrdCosL" FLOAT32_IEEE F_1_p0_4 1 2 -3.402823466E+038 3.402823466E+038 ECU_ADDRESS 0x70003BF4 /end MEASUREMENT
/begin MEASUREMENT FSMTRDG_A2DResCorrdExitation "FSMTRDG_A2DResCorrdExitation" FLOAT32_IEEE F_1_p0_4 1 2 -3.402823466E+038 3.402823466E+038 ECU_ADDRESS 0x70003BF0 /end MEASUREMENT
/begin MEASUREMENT FSMTRDG_A2DResCorrdSinH "FSMTRDG_A2DResCorrdSinH" FLOAT32_IEEE F_1_p0_4 1 2 -3.402823466E+038 3.402823466E+038 ECU_ADDRESS 0x70003BEC /end MEASUREMENT
/begin MEASUREMENT FSMTRDG_A2DResCorrdSinL "FSMTRDG_A2DResCorrdSinL" FLOAT32_IEEE F_1_p0_4 1 2 -3.402823466E+038 3.402823466E+038 ECU_ADDRESS 0x70003BE8 /end MEASUREMENT
/begin MEASUREMENT FSMTRDG_CosHGndDetn "FSMTRDG_CosHGndDetn" UBYTE Bool_ON_OFF 1 2 0 1 BIT_MASK 0x01 ECU_ADDRESS 0x70003BE5 /end MEASUREMENT
/begin MEASUREMENT FSMTRDG_CosHVccDetn "FSMTRDG_CosHVccDetn" UBYTE Bool_ON_OFF 1 2 0 1 BIT_MASK 0x01 ECU_ADDRESS 0x70003BE4 /end MEASUREMENT
/begin MEASUREMENT FSMTRDG_CosHVolt "FSMTRDG_CosHVolt" FLOAT32_IEEE F_1_p0_4 1 2 -3.402823466E+038 3.402823466E+038 ECU_ADDRESS 0x70003BE0 /end MEASUREMENT
/begin MEASUREMENT FSMTRDG_CosHVoltFild "FSMTRDG_CosHVoltFild" FLOAT32_IEEE F_1_p0_4 1 2 -3.402823466E+038 3.402823466E+038 ECU_ADDRESS 0x70003BDC /end MEASUREMENT
/begin MEASUREMENT FSMTRDG_CosHVoltFildZ "FSMTRDG_CosHVoltFildZ" FLOAT32_IEEE F_1_p0_4 1 2 -3.402823466E+038 3.402823466E+038 ECU_ADDRESS 0x70003BD8 /end MEASUREMENT
/begin MEASUREMENT FSMTRDG_CosLGndDetn "FSMTRDG_CosLGndDetn" UBYTE Bool_ON_OFF 1 2 0 1 BIT_MASK 0x01 ECU_ADDRESS 0x70003BD5 /end MEASUREMENT
/begin MEASUREMENT FSMTRDG_CosLVccDetn "FSMTRDG_CosLVccDetn" UBYTE Bool_ON_OFF 1 2 0 1 BIT_MASK 0x01 ECU_ADDRESS 0x70003BD4 /end MEASUREMENT
/begin MEASUREMENT FSMTRDG_CosLVolt "FSMTRDG_CosLVolt" FLOAT32_IEEE F_1_p0_4 1 2 -3.402823466E+038 3.402823466E+038 ECU_ADDRESS 0x70003BD0 /end MEASUREMENT
/begin MEASUREMENT FSMTRDG_CosLVoltFild "FSMTRDG_CosLVoltFild" FLOAT32_IEEE F_1_p0_4 1 2 -3.402823466E+038 3.402823466E+038 ECU_ADDRESS 0x70003BCC /end MEASUREMENT
/begin MEASUREMENT FSMTRDG_CosLVoltFildZ "FSMTRDG_CosLVoltFildZ" FLOAT32_IEEE F_1_p0_4 1 2 -3.402823466E+038 3.402823466E+038 ECU_ADDRESS 0x70003BC8 /end MEASUREMENT
/begin MEASUREMENT FSMTRDG_CosLegInternalFailDetn "FSMTRDG_CosLegInternalFailDetn" UBYTE Bool_ON_OFF 1 2 0 1 BIT_MASK 0x01 ECU_ADDRESS 0x70003BC6 /end MEASUREMENT
/begin MEASUREMENT FSMTRDG_CosLegNormal "FSMTRDG_CosLegNormal" UBYTE Bool_ON_OFF 1 2 0 1 BIT_MASK 0x01 ECU_ADDRESS 0x70003BC5 /end MEASUREMENT
/begin MEASUREMENT FSMTRDG_CosLegOpen "FSMTRDG_CosLegOpen" UBYTE Bool_ON_OFF 1 2 0 1 BIT_MASK 0x01 ECU_ADDRESS 0x70003BC4 /end MEASUREMENT
/begin MEASUREMENT FSMTRDG_CosLegOpenDetn "FSMTRDG_CosLegOpenDetn" UBYTE Bool_ON_OFF 1 2 0 1 BIT_MASK 0x01 ECU_ADDRESS 0x70003BC3 /end MEASUREMENT
/begin MEASUREMENT FSMTRDG_CosLegShortGnd "FSMTRDG_CosLegShortGnd" UBYTE Bool_ON_OFF 1 2 0 1 BIT_MASK 0x01 ECU_ADDRESS 0x70003BC2 /end MEASUREMENT
/begin MEASUREMENT FSMTRDG_CosLegShortGndDetn "FSMTRDG_CosLegShortGndDetn" UBYTE Bool_ON_OFF 1 2 0 1 BIT_MASK 0x01 ECU_ADDRESS 0x70003BC1 /end MEASUREMENT
/begin MEASUREMENT FSMTRDG_CosLegShortVcc "FSMTRDG_CosLegShortVcc" UBYTE Bool_ON_OFF 1 2 0 1 BIT_MASK 0x01 ECU_ADDRESS 0x70003BC0 /end MEASUREMENT
/begin MEASUREMENT FSMTRDG_CosLegShortVccDetn "FSMTRDG_CosLegShortVccDetn" UBYTE Bool_ON_OFF 1 2 0 1 BIT_MASK 0x01 ECU_ADDRESS 0x70003BBF /end MEASUREMENT
/begin MEASUREMENT FSMTRDG_ExcDutyCycleErrDetn "FSMTRDG_ExcDutyCycleErrDetn" UBYTE Bool_ON_OFF 1 2 0 1 BIT_MASK 0x01 ECU_ADDRESS 0x70003BBE /end MEASUREMENT
/begin MEASUREMENT FSMTRDG_ExcFreqErrDetn "FSMTRDG_ExcFreqErrDetn" UBYTE Bool_ON_OFF 1 2 0 1 BIT_MASK 0x01 ECU_ADDRESS 0x70003BBD /end MEASUREMENT
/begin MEASUREMENT FSMTRDG_ExcInternalFail "FSMTRDG_ExcInternalFail" UBYTE Bool_ON_OFF 1 2 0 1 BIT_MASK 0x01 ECU_ADDRESS 0x70003BBC /end MEASUREMENT
/begin MEASUREMENT FSMTRDG_ExcInternalFailDetn "FSMTRDG_ExcInternalFailDetn" UBYTE Bool_ON_OFF 1 2 0 1 BIT_MASK 0x01 ECU_ADDRESS 0x70003BBB /end MEASUREMENT
/begin MEASUREMENT FSMTRDG_ExcNormal "FSMTRDG_ExcNormal" UBYTE Bool_ON_OFF 1 2 0 1 BIT_MASK 0x01 ECU_ADDRESS 0x70003BBA /end MEASUREMENT
/begin MEASUREMENT FSMTRDG_ExcOpen "FSMTRDG_ExcOpen" UBYTE Bool_ON_OFF 1 2 0 1 BIT_MASK 0x01 ECU_ADDRESS 0x70003BB9 /end MEASUREMENT
/begin MEASUREMENT FSMTRDG_ExcOpenDetn "FSMTRDG_ExcOpenDetn" UBYTE Bool_ON_OFF 1 2 0 1 BIT_MASK 0x01 ECU_ADDRESS 0x70003BB8 /end MEASUREMENT
/begin MEASUREMENT FSMTRDG_ExcShortGnd "FSMTRDG_ExcShortGnd" UBYTE Bool_ON_OFF 1 2 0 1 BIT_MASK 0x01 ECU_ADDRESS 0x70003BB7 /end MEASUREMENT
/begin MEASUREMENT FSMTRDG_ExcShortVcc "FSMTRDG_ExcShortVcc" UBYTE Bool_ON_OFF 1 2 0 1 BIT_MASK 0x01 ECU_ADDRESS 0x70003BB6 /end MEASUREMENT
/begin MEASUREMENT FSMTRDG_ExcSignalGNDDetn "FSMTRDG_ExcSignalGNDDetn" UBYTE Bool_ON_OFF 1 2 0 1 BIT_MASK 0x01 ECU_ADDRESS 0x70003BB5 /end MEASUREMENT
/begin MEASUREMENT FSMTRDG_ExcSignalVCCDetn "FSMTRDG_ExcSignalVCCDetn" UBYTE Bool_ON_OFF 1 2 0 1 BIT_MASK 0x01 ECU_ADDRESS 0x70003BB4 /end MEASUREMENT
/begin MEASUREMENT FSMTRDG_ExcVoltageFild "FSMTRDG_ExcVoltageFild" FLOAT32_IEEE F_1_p0_4 1 2 -3.402823466E+038 3.402823466E+038 ECU_ADDRESS 0x70003BB0 /end MEASUREMENT
/begin MEASUREMENT FSMTRDG_ExcVoltageFildZ "FSMTRDG_ExcVoltageFildZ" FLOAT32_IEEE F_1_p0_4 1 2 -3.402823466E+038 3.402823466E+038 ECU_ADDRESS 0x70003BAC /end MEASUREMENT
/begin MEASUREMENT FSMTRDG_ExitationDiagIO "FSMTRDG_ExitationDiagIO" UBYTE Bool_ON_OFF 1 2 0 1 BIT_MASK 0x01 ECU_ADDRESS 0x70003BAA /end MEASUREMENT
/begin MEASUREMENT FSMTRDG_ExitationGndDetn "FSMTRDG_ExitationGndDetn" UBYTE Bool_ON_OFF 1 2 0 1 BIT_MASK 0x01 ECU_ADDRESS 0x70003BA9 /end MEASUREMENT
/begin MEASUREMENT FSMTRDG_ExitationVccDetn "FSMTRDG_ExitationVccDetn" UBYTE Bool_ON_OFF 1 2 0 1 BIT_MASK 0x01 ECU_ADDRESS 0x70003BA8 /end MEASUREMENT
/begin MEASUREMENT FSMTRDG_ExitationVolt "FSMTRDG_ExitationVolt" FLOAT32_IEEE F_1_p0_4 1 2 -3.402823466E+038 3.402823466E+038 ECU_ADDRESS 0x70003BA4 /end MEASUREMENT
/begin MEASUREMENT FSMTRDG_IOcounterZ "FSMTRDG_IOcounterZ" UWORD F_1_p0_4 1 2 0 65535 ECU_ADDRESS 0x70003BA0 /end MEASUREMENT
/begin MEASUREMENT FSMTRDG_IOinZ "FSMTRDG_IOinZ" UBYTE Bool_ON_OFF 1 2 0 1 BIT_MASK 0x01 ECU_ADDRESS 0x70003B9F /end MEASUREMENT
/begin MEASUREMENT FSMTRDG_IOoutZ "FSMTRDG_IOoutZ" UBYTE Bool_ON_OFF 1 2 0 1 BIT_MASK 0x01 ECU_ADDRESS 0x70003B9E /end MEASUREMENT
/begin MEASUREMENT FSMTRDG_OverVoltageDetn "Fault on the battery voltage measure detection." UBYTE Bool_ON_OFF 1 2 0 1 BIT_MASK 0x01 ECU_ADDRESS 0x70003B9D /end MEASUREMENT
/begin MEASUREMENT FSMTRDG_SinCosHLGnd "FSMTRDG_SinCosHLGnd" UBYTE Bool_ON_OFF 1 2 0 1 BIT_MASK 0x01 ECU_ADDRESS 0x70003B9C /end MEASUREMENT
/begin MEASUREMENT FSMTRDG_SinCosHLOpen "FSMTRDG_SinCosHLOpen" UBYTE Bool_ON_OFF 1 2 0 1 BIT_MASK 0x01 ECU_ADDRESS 0x70003B9B /end MEASUREMENT
/begin MEASUREMENT FSMTRDG_SinCosHLVcc "FSMTRDG_SinCosHLVcc" UBYTE Bool_ON_OFF 1 2 0 1 BIT_MASK 0x01 ECU_ADDRESS 0x70003B9A /end MEASUREMENT
/begin MEASUREMENT FSMTRDG_SinHGndDetn "FSMTRDG_SinHGndDetn" UBYTE Bool_ON_OFF 1 2 0 1 BIT_MASK 0x01 ECU_ADDRESS 0x70003B99 /end MEASUREMENT
/begin MEASUREMENT FSMTRDG_SinHVccDetn "FSMTRDG_SinHVccDetn" UBYTE Bool_ON_OFF 1 2 0 1 BIT_MASK 0x01 ECU_ADDRESS 0x70003B98 /end MEASUREMENT
/begin MEASUREMENT FSMTRDG_SinHVolt "FSMTRDG_SinHVolt" FLOAT32_IEEE F_1_p0_4 1 2 -3.402823466E+038 3.402823466E+038 ECU_ADDRESS 0x70003B94 /end MEASUREMENT
/begin MEASUREMENT FSMTRDG_SinHVoltFild "FSMTRDG_SinHVoltFild" FLOAT32_IEEE F_1_p0_4 1 2 -3.402823466E+038 3.402823466E+038 ECU_ADDRESS 0x70003B90 /end MEASUREMENT
/begin MEASUREMENT FSMTRDG_SinHVoltFildZ "FSMTRDG_SinHVoltFildZ" FLOAT32_IEEE F_1_p0_4 1 2 -3.402823466E+038 3.402823466E+038 ECU_ADDRESS 0x70003B8C /end MEASUREMENT
/begin MEASUREMENT FSMTRDG_SinLGndDetn "FSMTRDG_SinLGndDetn" UBYTE Bool_ON_OFF 1 2 0 1 BIT_MASK 0x01 ECU_ADDRESS 0x70003B89 /end MEASUREMENT
/begin MEASUREMENT FSMTRDG_SinLVccDetn "FSMTRDG_SinLVccDetn" UBYTE Bool_ON_OFF 1 2 0 1 BIT_MASK 0x01 ECU_ADDRESS 0x70003B88 /end MEASUREMENT
/begin MEASUREMENT FSMTRDG_SinLVolt "FSMTRDG_SinLVolt" FLOAT32_IEEE F_1_p0_4 1 2 -3.402823466E+038 3.402823466E+038 ECU_ADDRESS 0x70003B84 /end MEASUREMENT
/begin MEASUREMENT FSMTRDG_SinLVoltFild "FSMTRDG_SinLVoltFild" FLOAT32_IEEE F_1_p0_4 1 2 -3.402823466E+038 3.402823466E+038 ECU_ADDRESS 0x70003B80 /end MEASUREMENT
/begin MEASUREMENT FSMTRDG_SinLVoltFildZ "FSMTRDG_SinLVoltFildZ" FLOAT32_IEEE F_1_p0_4 1 2 -3.402823466E+038 3.402823466E+038 ECU_ADDRESS 0x70003B7C /end MEASUREMENT
/begin MEASUREMENT FSMTRDG_SinLegInternalFail "FSMTRDG_SinLegInternalFail" UBYTE Bool_ON_OFF 1 2 0 1 BIT_MASK 0x01 ECU_ADDRESS 0x70003B7A /end MEASUREMENT
/begin MEASUREMENT FSMTRDG_SinLegInternalFailDetn "FSMTRDG_SinLegInternalFailDetn" UBYTE Bool_ON_OFF 1 2 0 1 BIT_MASK 0x01 ECU_ADDRESS 0x70003B79 /end MEASUREMENT
/begin MEASUREMENT FSMTRDG_SinLegNormal "FSMTRDG_SinLegNormal" UBYTE Bool_ON_OFF 1 2 0 1 BIT_MASK 0x01 ECU_ADDRESS 0x70003B78 /end MEASUREMENT
/begin MEASUREMENT FSMTRDG_SinLegOpen "FSMTRDG_SinLegOpen" UBYTE Bool_ON_OFF 1 2 0 1 BIT_MASK 0x01 ECU_ADDRESS 0x70003B77 /end MEASUREMENT
/begin MEASUREMENT FSMTRDG_SinLegOpenDetn "FSMTRDG_SinLegOpenDetn" UBYTE Bool_ON_OFF 1 2 0 1 BIT_MASK 0x01 ECU_ADDRESS 0x70003B76 /end MEASUREMENT
/begin MEASUREMENT FSMTRDG_SinLegShortGnd "FSMTRDG_SinLegShortGnd" UBYTE Bool_ON_OFF 1 2 0 1 BIT_MASK 0x01 ECU_ADDRESS 0x70003B75 /end MEASUREMENT
/begin MEASUREMENT FSMTRDG_SinLegShortGndDetn "FSMTRDG_SinLegShortGndDetn" UBYTE Bool_ON_OFF 1 2 0 1 BIT_MASK 0x01 ECU_ADDRESS 0x70003B74 /end MEASUREMENT
/begin MEASUREMENT FSMTRDG_SinLegShortVcc "FSMTRDG_SinLegShortVcc" UBYTE Bool_ON_OFF 1 2 0 1 BIT_MASK 0x01 ECU_ADDRESS 0x70003B73 /end MEASUREMENT
/begin MEASUREMENT FSMTRDG_SinLegShortVccDetn "FSMTRDG_SinLegShortVccDetn" UBYTE Bool_ON_OFF 1 2 0 1 BIT_MASK 0x01 ECU_ADDRESS 0x70003B72 /end MEASUREMENT
/begin MEASUREMENT FSMTRDG_UnderVoltageDetn "Fault on the battery voltage measure detection." UBYTE Bool_ON_OFF 1 2 0 1 BIT_MASK 0x01 ECU_ADDRESS 0x70003B71 /end MEASUREMENT
/begin MEASUREMENT FSSMACS_AbsMecaSpeedRpmFild "FSSMACS_AbsMecaSpeedRpmFild" FLOAT32_IEEE F_1_p0_52 1 2 -3.402823466E+038 3.402823466E+038 ECU_ADDRESS 0x70003774 /end MEASUREMENT
/begin MEASUREMENT FSSMACS_AbsMecaSpeedRpmFildZ "FSSMACS_AbsMecaSpeedRpmFildZ" FLOAT32_IEEE F_1_p0_52 1 2 -3.402823466E+038 3.402823466E+038 ECU_ADDRESS 0x70003770 /end MEASUREMENT
/begin MEASUREMENT FSSMACS_AclState "FSSMACS_AclState" UWORD F_1_p0_43 1 2 0 65535 ECU_ADDRESS 0x7000376C /end MEASUREMENT
/begin MEASUREMENT FSSMACS_CmdAkdReq "FSSMACS_CmdAkdReq" UBYTE Bool_ON_OFF 1 2 0 1 BIT_MASK 0x01 ECU_ADDRESS 0x7000376B /end MEASUREMENT
/begin MEASUREMENT FSSMACS_CmdFtShutDownReq "FSSMACS_CmdFtShutDownReq" UBYTE Bool_ON_OFF 1 2 0 1 BIT_MASK 0x01 ECU_ADDRESS 0x7000376A /end MEASUREMENT
/begin MEASUREMENT FSSMACS_CmdFtStartReq "FSSMACS_CmdFtStartReq" UBYTE Bool_ON_OFF 1 2 0 1 BIT_MASK 0x01 ECU_ADDRESS 0x70003769 /end MEASUREMENT
/begin MEASUREMENT FSSMACS_CmdPwmOffReq "FSSMACS_CmdPwmOffReq" UBYTE Bool_ON_OFF 1 2 0 1 BIT_MASK 0x01 ECU_ADDRESS 0x70003768 /end MEASUREMENT
/begin MEASUREMENT FSSMACS_CmdSleepReq "FSSMACS_CmdSleepReq" UBYTE Bool_ON_OFF 1 2 0 1 BIT_MASK 0x01 ECU_ADDRESS 0x70003767 /end MEASUREMENT
/begin MEASUREMENT FSSMACS_CmdSwShutDownReq "FSSMACS_CmdSwShutDownReq" UBYTE Bool_ON_OFF 1 2 0 1 BIT_MASK 0x01 ECU_ADDRESS 0x70003766 /end MEASUREMENT
/begin MEASUREMENT FSSMACS_DCUMode "FSSMACS_DCUMode" UWORD F_1_p0_43 1 2 0 65535 ECU_ADDRESS 0x70003764 /end MEASUREMENT
/begin MEASUREMENT FSSMACS_DCUModeZ "FSSMACS_DCUModeZ" UWORD F_1_p0_43 1 2 0 65535 ECU_ADDRESS 0x70003762 /end MEASUREMENT
/begin MEASUREMENT FSSMACS_DisChargeStatus "FSSMACS_DisChargeStatus" UBYTE F_1_p0_4 1 2 0 255 ECU_ADDRESS 0x70003761 /end MEASUREMENT
/begin MEASUREMENT FSSMACS_DisChargeStatusZ "FSSMACS_DisChargeStatusZ" UBYTE F_1_p0_43 1 2 0 255 ECU_ADDRESS 0x70003760 /end MEASUREMENT
/begin MEASUREMENT FSSMACS_FTModeReq "FSSMACS_FTModeReq" UWORD F_1_p0_4 1 2 0 65535 ECU_ADDRESS 0x7000375E /end MEASUREMENT
/begin MEASUREMENT FSSMACS_Flag "FSSMACS_Flag" UBYTE Bool_ON_OFF 1 2 0 1 BIT_MASK 0x01 ECU_ADDRESS 0x7000375C /end MEASUREMENT
/begin MEASUREMENT FSSMACS_GateDrvSt "FSSMACS_GateDrvSt" UWORD F_1_p0_54 1 2 0 65535 ECU_ADDRESS 0x7000375A /end MEASUREMENT
/begin MEASUREMENT FSSMACS_KL15 "FSSMACS_KL15" UBYTE Bool_ON_OFF 1 2 0 1 BIT_MASK 0x01 ECU_ADDRESS 0x70003758 /end MEASUREMENT
/begin MEASUREMENT FSSMACS_KL15counterZ "FSSMACS_KL15counterZ" UWORD F_1_p0_4 1 2 0 65535 ECU_ADDRESS 0x70003756 /end MEASUREMENT
/begin MEASUREMENT FSSMACS_KL15in "FSSMACS_KL15in" UBYTE Bool_ON_OFF 1 2 0 1 BIT_MASK 0x01 ECU_ADDRESS 0x70003754 /end MEASUREMENT
/begin MEASUREMENT FSSMACS_KL15inZ "FSSMACS_KL15inZ" UBYTE Bool_ON_OFF 1 2 0 1 BIT_MASK 0x01 ECU_ADDRESS 0x70003753 /end MEASUREMENT
/begin MEASUREMENT FSSMACS_KL15outZ "FSSMACS_KL15outZ" UBYTE Bool_ON_OFF 1 2 0 1 BIT_MASK 0x01 ECU_ADDRESS 0x70003752 /end MEASUREMENT
/begin MEASUREMENT FSSMACS_McuCtrlMod "FSSMACS_McuCtrlMod" UWORD F_1_p0_4 1 2 0 65535 ECU_ADDRESS 0x70003750 /end MEASUREMENT
/begin MEASUREMENT FSSMACS_McuEnableSts "FSSMACS_McuEnableSts" UBYTE F_1_p0_4 1 2 0 255 ECU_ADDRESS 0x7000374F /end MEASUREMENT
/begin MEASUREMENT FSSMACS_McuWorkMod "FSSMACS_McuWorkMod" UBYTE F_1_p0_4 1 2 0 255 ECU_ADDRESS 0x7000374E /end MEASUREMENT
/begin MEASUREMENT FSSMACS_OcFailure "FSSMACS_OcFailure" UBYTE Bool_ON_OFF 1 2 0 1 BIT_MASK 0x01 ECU_ADDRESS 0x7000374D /end MEASUREMENT
/begin MEASUREMENT FSSMACS_OcFinish "FSSMACS_OcFinish" UBYTE Bool_ON_OFF 1 2 0 1 BIT_MASK 0x01 ECU_ADDRESS 0x7000374C /end MEASUREMENT
/begin MEASUREMENT FSSMACS_PrechargeFinish "FSSMACS_PrechargeFinish" UBYTE Bool_ON_OFF 1 2 0 1 BIT_MASK 0x01 ECU_ADDRESS 0x7000374B /end MEASUREMENT
/begin MEASUREMENT FSSMACS_SCSpeedReady "FSSMACS_SCSpeedReady" UBYTE Bool_ON_OFF 1 2 0 1 BIT_MASK 0x01 ECU_ADDRESS 0x7000374A /end MEASUREMENT
/begin MEASUREMENT FSSMACS_SCSpeedReadyinZ "FSSMACS_SCSpeedReadyinZ" UBYTE Bool_ON_OFF 1 2 0 1 BIT_MASK 0x01 ECU_ADDRESS 0x70003749 /end MEASUREMENT
/begin MEASUREMENT FSSMACS_SCSpeedReadyoutZ "FSSMACS_SCSpeedReadyoutZ" UBYTE Bool_ON_OFF 1 2 0 1 BIT_MASK 0x01 ECU_ADDRESS 0x70003748 /end MEASUREMENT
/begin MEASUREMENT FSSMACS_SpeedReadycounterZ "FSSMACS_SpeedReadycounterZ" UWORD F_1_p0_4 1 2 0 65535 ECU_ADDRESS 0x70003746 /end MEASUREMENT
/begin MEASUREMENT FSSMACS_TorqueEnable "FSSMACS_TorqueEnable" UBYTE Bool_ON_OFF 1 2 0 1 BIT_MASK 0x01 ECU_ADDRESS 0x70003744 /end MEASUREMENT
/begin MEASUREMENT FSSMMAM_AclState "value of McuState after bypass" UWORD F_1_p0_43 1 2 0 65535 ECU_ADDRESS 0x7000377E /end MEASUREMENT
/begin MEASUREMENT FSSMMAM_EVBHV_CheckEnable "FSSMMAM_EVBHV_CheckEnable" UBYTE Bool_ON_OFF 1 2 0 1 BIT_MASK 0x01 ECU_ADDRESS 0x7000377D /end MEASUREMENT
/begin MEASUREMENT FSSMMAM_EVBLV_CheckEnable "FSSMMAM_EVBLV_CheckEnable" UBYTE Bool_ON_OFF 1 2 0 1 BIT_MASK 0x01 ECU_ADDRESS 0x7000377C /end MEASUREMENT
/begin MEASUREMENT FSSMMAM_EVIBT_State "FSSMMAM_EVIBT_State" UWORD F_1_p0_43 1 2 0 65535 ECU_ADDRESS 0x7000377A /end MEASUREMENT
/begin MEASUREMENT FSSMMAM_MTRDG_CheckEnable "FSSMMAM_MTRDG_CheckEnable" UBYTE Bool_ON_OFF 1 2 0 1 BIT_MASK 0x01 ECU_ADDRESS 0x70003778 /end MEASUREMENT
/begin MEASUREMENT FSTCGTC_AccPedPosDisable "FSTCGTC_AccPedPosDisable" UBYTE Bool_ON_OFF 1 2 0 1 BIT_MASK 0x01 ECU_ADDRESS 0x70003844 /end MEASUREMENT
/begin MEASUREMENT FSTCGTC_AddCurZ "FSTCGTC_AddCurZ" FLOAT32_IEEE F_1_p0_4 1 2 -3.402823466E+038 3.402823466E+038 ECU_ADDRESS 0x70003840 /end MEASUREMENT
/begin MEASUREMENT FSTCGTC_CrashFlag "FSTCGTC_CrashFlag" UBYTE Bool_ON_OFF 1 2 0 1 BIT_MASK 0x01 ECU_ADDRESS 0x7000383C /end MEASUREMENT
/begin MEASUREMENT FSTCGTC_CtrlIntegratorZ "FSTCGTC_CtrlIntegratorZ" FLOAT32_IEEE F_1_p0_4 1 2 -3.402823466E+038 3.402823466E+038 ECU_ADDRESS 0x70003838 /end MEASUREMENT
/begin MEASUREMENT FSTCGTC_CtrlKi "FSTCGTC_CtrlKi" FLOAT32_IEEE F_1_p0_4 1 2 0 1 ECU_ADDRESS 0x70003834 /end MEASUREMENT
/begin MEASUREMENT FSTCGTC_CtrlKp "FSTCGTC_CtrlKp" FLOAT32_IEEE F_1_p0_4 1 2 0 1 ECU_ADDRESS 0x70003830 /end MEASUREMENT
/begin MEASUREMENT FSTCGTC_CtrlPropTgt "FSTCGTC_CtrlPropTgt" FLOAT32_IEEE F_1_p0_4 1 2 -3.402823466E+038 3.402823466E+038 ECU_ADDRESS 0x7000382C /end MEASUREMENT
/begin MEASUREMENT FSTCGTC_CtrlTgt "FSTCGTC_CtrlTgt" FLOAT32_IEEE F_1_p0_4 1 2 -3.402823466E+038 3.402823466E+038 ECU_ADDRESS 0x70003828 /end MEASUREMENT
/begin MEASUREMENT FSTCGTC_CurLoad "FSTCGTC_CurLoad" FLOAT32_IEEE F_1_p0_4 1 2 -3.402823466E+038 3.402823466E+038 ECU_ADDRESS 0x70003824 /end MEASUREMENT
/begin MEASUREMENT FSTCGTC_EpsilonCtrl "FSTCGTC_EpsilonCtrl" FLOAT32_IEEE F_1_p0_4 1 2 0 1 ECU_ADDRESS 0x70003820 /end MEASUREMENT
/begin MEASUREMENT FSTCGTC_FirstFildZ "Current value of the torque reference after the second filter." FLOAT32_IEEE F_1_p0_56 1 2 -500 500 ECU_ADDRESS 0x7000381C /end MEASUREMENT
/begin MEASUREMENT FSTCGTC_HacCtrlTrqTgt "Current value of the torque reference after the second filter." FLOAT32_IEEE F_1_p0_56 1 2 -500 500 ECU_ADDRESS 0x70003818 /end MEASUREMENT
/begin MEASUREMENT FSTCGTC_HacCtrlTrqTgtSatZ "FSTCGTC_HacCtrlTrqTgtSatZ" FLOAT32_IEEE F_1_p0_56 1 2 -500 500 ECU_ADDRESS 0x70003814 /end MEASUREMENT
/begin MEASUREMENT FSTCGTC_HacDisable "FSTCGTC_HacDisable" UBYTE Bool_ON_OFF 1 2 0 1 BIT_MASK 0x01 ECU_ADDRESS 0x70003811 /end MEASUREMENT
/begin MEASUREMENT FSTCGTC_HacEnable "FSTCGTC_HacEnable" UBYTE Bool_ON_OFF 1 2 0 1 BIT_MASK 0x01 ECU_ADDRESS 0x70003810 /end MEASUREMENT
/begin MEASUREMENT FSTCGTC_HacModeDetn "FSTCGTC_HacModeDetn" UBYTE Bool_ON_OFF 1 2 0 1 BIT_MASK 0x01 ECU_ADDRESS 0x7000380F /end MEASUREMENT
/begin MEASUREMENT FSTCGTC_HacModeDetnZ "FSTCGTC_HacModeDetnZ" UBYTE Bool_ON_OFF 1 2 0 1 BIT_MASK 0x01 ECU_ADDRESS 0x7000380E /end MEASUREMENT
/begin MEASUREMENT FSTCGTC_HacNumberZ "FSTCGTC_HacNumberZ" UWORD F_1_p0_43 1 2 0 65535 ECU_ADDRESS 0x7000380C /end MEASUREMENT
/begin MEASUREMENT FSTCGTC_HacSpdSREnable "FSTCGTC_HacSpdSREnable" UBYTE Bool_ON_OFF 1 2 0 1 BIT_MASK 0x01 ECU_ADDRESS 0x7000380B /end MEASUREMENT
/begin MEASUREMENT FSTCGTC_HacTimeOutZ "FSTCGTC_HacTimeOutZ" UBYTE Bool_ON_OFF 1 2 0 1 BIT_MASK 0x01 ECU_ADDRESS 0x7000380A /end MEASUREMENT
/begin MEASUREMENT FSTCGTC_HacTimeout "FSTCGTC_HacTimeout" UBYTE Bool_ON_OFF 1 2 0 1 BIT_MASK 0x01 ECU_ADDRESS 0x70003809 /end MEASUREMENT
/begin MEASUREMENT FSTCGTC_HacTrqAbsDisable "FSTCGTC_HacTrqAbsDisable" UBYTE Bool_ON_OFF 1 2 0 1 BIT_MASK 0x01 ECU_ADDRESS 0x70003808 /end MEASUREMENT
/begin MEASUREMENT FSTCGTC_I0dqTgt[0] "FSTCGTC_I0dqTgt" FLOAT32_IEEE F_1_p0_46 1 2 -3.402823466E+038 3.402823466E+038 ECU_ADDRESS 0x700037FC /end MEASUREMENT
/begin MEASUREMENT FSTCGTC_I0dqTgt[1] "FSTCGTC_I0dqTgt" FLOAT32_IEEE F_1_p0_46 1 2 -3.402823466E+038 3.402823466E+038 ECU_ADDRESS 0x70003800 /end MEASUREMENT
/begin MEASUREMENT FSTCGTC_I0dqTgt[2] "FSTCGTC_I0dqTgt" FLOAT32_IEEE F_1_p0_46 1 2 -3.402823466E+038 3.402823466E+038 ECU_ADDRESS 0x70003804 /end MEASUREMENT
/begin MEASUREMENT FSTCGTC_LutOutOpLpTrqTgt "FSTCGTC_LutOutOpLpTrqTgt" FLOAT32_IEEE F_1_p0_56 1 2 -500 500 ECU_ADDRESS 0x700037F8 /end MEASUREMENT
/begin MEASUREMENT FSTCGTC_LutOutOpLpTrqTgtZ "FSTCGTC_LutOutOpLpTrqTgtZ" FLOAT32_IEEE F_1_p0_56 1 2 -500 500 ECU_ADDRESS 0x700037F4 /end MEASUREMENT
/begin MEASUREMENT FSTCGTC_MaxPwrCalTqr "Previous value of the torque reference after the second filter." FLOAT32_IEEE F_1_p0_47 1 2 -3.402823466E+038 3.402823466E+038 ECU_ADDRESS 0x700037F0 /end MEASUREMENT
/begin MEASUREMENT FSTCGTC_MaxTqr "Previous value of the torque reference after the second filter." FLOAT32_IEEE F_1_p0_49 1 2 -3.402823466E+038 3.402823466E+038 ECU_ADDRESS 0x700037EC /end MEASUREMENT
/begin MEASUREMENT FSTCGTC_MaxTqrZ "Previous value of the torque reference after the second filter." FLOAT32_IEEE F_1_p0_49 1 2 -3.402823466E+038 3.402823466E+038 ECU_ADDRESS 0x700037E8 /end MEASUREMENT
/begin MEASUREMENT FSTCGTC_MecaSpeedRpmTgt "FSTCGTC_MecaSpeedRpmTgt" FLOAT32_IEEE F_1_p0_50 1 2 -1000000 1000000 ECU_ADDRESS 0x700037E4 /end MEASUREMENT
/begin MEASUREMENT FSTCGTC_MinPwrCalTqr "FSTCGTC_MinPwrCalTqr" FLOAT32_IEEE F_1_p0_4 1 2 -3.402823466E+038 3.402823466E+038 ECU_ADDRESS 0x700037E0 /end MEASUREMENT
/begin MEASUREMENT FSTCGTC_OpenLoopTrqTgtZ "FSTCGTC_OpenLoopTrqTgtZ" FLOAT32_IEEE F_1_p0_56 1 2 -500 500 ECU_ADDRESS 0x700037DC /end MEASUREMENT
/begin MEASUREMENT FSTCGTC_OpenLpSumTgt "FSTCGTC_OpenLpSumTgt" FLOAT32_IEEE F_1_p0_4 1 2 -3.402823466E+038 3.402823466E+038 ECU_ADDRESS 0x700037D8 /end MEASUREMENT
/begin MEASUREMENT FSTCGTC_PwrLmtMaxTqr "FSTCGTC_PwrLmtMaxTqr" FLOAT32_IEEE F_1_p0_38 1 2 -3.402823466E+038 3.402823466E+038 ECU_ADDRESS 0x700037D4 /end MEASUREMENT
/begin MEASUREMENT FSTCGTC_PwrLmtMinTqr "FSTCGTC_PwrLmtMinTqr" FLOAT32_IEEE F_1_p0_38 1 2 -3.402823466E+038 3.402823466E+038 ECU_ADDRESS 0x700037D0 /end MEASUREMENT
/begin MEASUREMENT FSTCGTC_SlewLimitTorqueTgt "FSTCGTC_SlewLimitTorqueTgt" FLOAT32_IEEE F_1_p0_4 1 2 -3.402823466E+038 3.402823466E+038 ECU_ADDRESS 0x700037CC /end MEASUREMENT
/begin MEASUREMENT FSTCGTC_SpeedAbsFildZ "FSTCGTC_SpeedAbsFildZ" FLOAT32_IEEE F_1_p0_4 1 2 0 1 ECU_ADDRESS 0x700037C8 /end MEASUREMENT
/begin MEASUREMENT FSTCGTC_SpeedFildZ "FSTCGTC_SpeedFildZ" FLOAT32_IEEE F_1_p0_38 1 2 -3.402823466E+038 3.402823466E+038 ECU_ADDRESS 0x700037C4 /end MEASUREMENT
/begin MEASUREMENT FSTCGTC_StandbyCounterZ "FSTCGTC_StandbyCounterZ" UWORD F_1_p0_4 1 2 0 65535 ECU_ADDRESS 0x700037C0 /end MEASUREMENT
/begin MEASUREMENT FSTCGTC_StandbyDetnZ "FSTCGTC_StandbyDetnZ" UBYTE Bool_ON_OFF 1 2 0 1 BIT_MASK 0x01 ECU_ADDRESS 0x700037BF /end MEASUREMENT
/begin MEASUREMENT FSTCGTC_StandbyDetninZ "FSTCGTC_StandbyDetninZ" UBYTE Bool_ON_OFF 1 2 0 1 BIT_MASK 0x01 ECU_ADDRESS 0x700037BE /end MEASUREMENT
/begin MEASUREMENT FSTCGTC_TorqTranNumberZ "FSTCGTC_TorqTranNumberZ" UWORD F_1_p0_4 1 2 0 65535 ECU_ADDRESS 0x700037BC /end MEASUREMENT
/begin MEASUREMENT FSTCGTC_TorqueOrgTgtPhy "FSTCGTC_TorqueOrgTgtPhy" FLOAT32_IEEE F_1_p0_4 1 2 -3.402823466E+038 3.402823466E+038 ECU_ADDRESS 0x700037B8 /end MEASUREMENT
/begin MEASUREMENT FSTCGTC_TorquePreTgtZ "FSTCGTC_TorquePreTgtZ" FLOAT32_IEEE F_1_p0_4 1 2 -3.402823466E+038 3.402823466E+038 ECU_ADDRESS 0x700037B4 /end MEASUREMENT
/begin MEASUREMENT FSTCGTC_TorqueRefLimMot "FSTCGTC_TorqueRefLimMot" FLOAT32_IEEE F_1_p0_56 1 2 -500 500 ECU_ADDRESS 0x700037B0 /end MEASUREMENT
/begin MEASUREMENT FSTCGTC_TorqueRefLimZ "FSTCGTC_TorqueRefLimZ" FLOAT32_IEEE F_1_p0_56 1 2 -500 500 ECU_ADDRESS 0x700037AC /end MEASUREMENT
/begin MEASUREMENT FSTCGTC_TorqueTgt "Current value of the torque reference after the second filter." FLOAT32_IEEE F_1_p0_56 1 2 -500 500 ECU_ADDRESS 0x700037A8 /end MEASUREMENT
/begin MEASUREMENT FSTCGTC_TorqueTgtPhy "Current value of the torque reference after the second filter." FLOAT32_IEEE F_1_p0_56 1 2 -500 500 ECU_ADDRESS 0x700037A4 /end MEASUREMENT
/begin MEASUREMENT FSTCGTC_TorqueTgtPhyComp "Current value of the torque reference after the second filter." FLOAT32_IEEE F_1_p0_56 1 2 -500 500 ECU_ADDRESS 0x700037A0 /end MEASUREMENT
/begin MEASUREMENT FSTCGTC_TorqueTgtPhyCompZ "FSTCGTC_TorqueTgtPhyCompZ" FLOAT32_IEEE F_1_p0_56 1 2 -500 500 ECU_ADDRESS 0x7000379C /end MEASUREMENT
/begin MEASUREMENT FSTCGTC_TorqueTgtPhyZ "Current value of the torque reference after the second filter." FLOAT32_IEEE F_1_p0_56 1 2 -500 500 ECU_ADDRESS 0x70003798 /end MEASUREMENT
/begin MEASUREMENT FSTCGTC_TorqueTgtZ "Previous value of the torque reference after the second filter." FLOAT32_IEEE F_1_p0_49 1 2 -500 500 ECU_ADDRESS 0x70003794 /end MEASUREMENT
/begin MEASUREMENT FSTCGTC_TorqueTranEn "FSTCGTC_TorqueTranEn" UBYTE Bool_ON_OFF 1 2 0 1 BIT_MASK 0x01 ECU_ADDRESS 0x70003792 /end MEASUREMENT
/begin MEASUREMENT FSTCGTC_TsatActv "FSTCGTC_TsatActv" UBYTE Bool_ON_OFF 1 2 0 1 BIT_MASK 0x01 ECU_ADDRESS 0x70003791 /end MEASUREMENT
/begin MEASUREMENT FSTCGTC_TsatActvZ "FSTCGTC_TsatActvZ" UBYTE Bool_ON_OFF 1 2 0 1 BIT_MASK 0x01 ECU_ADDRESS 0x70003790 /end MEASUREMENT
/begin MEASUREMENT FSTCGTC_U0dqTgt[0] "FSTCGTC_U0dqTgt" FLOAT32_IEEE F_1_p0_38 1 2 -3.402823466E+038 3.402823466E+038 ECU_ADDRESS 0x70003784 /end MEASUREMENT
/begin MEASUREMENT FSTCGTC_U0dqTgt[1] "FSTCGTC_U0dqTgt" FLOAT32_IEEE F_1_p0_38 1 2 -3.402823466E+038 3.402823466E+038 ECU_ADDRESS 0x70003788 /end MEASUREMENT
/begin MEASUREMENT FSTCGTC_U0dqTgt[2] "FSTCGTC_U0dqTgt" FLOAT32_IEEE F_1_p0_38 1 2 -3.402823466E+038 3.402823466E+038 ECU_ADDRESS 0x7000378C /end MEASUREMENT
/begin MEASUREMENT FSTCGTC_ZeroTorqueCompEnable "FSTCGTC_ZeroTorqueCompEnable" UBYTE Bool_ON_OFF 1 2 0 1 BIT_MASK 0x01 ECU_ADDRESS 0x70003780 /end MEASUREMENT
/begin MEASUREMENT FS_AN_ExitationDiag_U16 "FS_AN_ExitationDiag_U16" UWORD F_1_p0_4 1 2 0 65535 ECU_ADDRESS 0x70003960 /end MEASUREMENT
/begin MEASUREMENT FS_AccPedPos_F32 "FS_AccPedPos_F32" FLOAT32_IEEE F_1_p0_4 1 2 -3.402823466E+038 3.402823466E+038 ECU_ADDRESS 0x7000395C /end MEASUREMENT
/begin MEASUREMENT FS_ActualTorqueRef_F32 "FS_ActualTorqueRef_F32" FLOAT32_IEEE F_1_p0_4 1 2 -3.402823466E+038 3.402823466E+038 ECU_ADDRESS 0x70003958 /end MEASUREMENT
/begin MEASUREMENT FS_AkdAfterAsc_B "FS_AkdAfterAsc_B" UBYTE Bool_ON_OFF 1 2 0 1 BIT_MASK 0x01 ECU_ADDRESS 0x70003954 /end MEASUREMENT
/begin MEASUREMENT FS_AntiSsGapDrt_F32 "FS_AntiSsGapDrt_F32" FLOAT32_IEEE F_1_p0_4 1 2 -3.402823466E+038 3.402823466E+038 ECU_ADDRESS 0x70003950 /end MEASUREMENT
/begin MEASUREMENT FS_AutoPhasing_F32 "FS_AutoPhasing_F32" FLOAT32_IEEE F_1_p0_4 1 2 -3.402823466E+038 3.402823466E+038 ECU_ADDRESS 0x7000394C /end MEASUREMENT
/begin MEASUREMENT FS_BMS_BattSt_B "FS_BMS_BattSt_B" UBYTE Bool_ON_OFF 1 2 0 1 BIT_MASK 0x01 ECU_ADDRESS 0x70003948 /end MEASUREMENT
/begin MEASUREMENT FS_BMS_Ubms_F32 "FS_BMS_Ubms_F32" FLOAT32_IEEE F_1_p0_4 1 2 -3.402823466E+038 3.402823466E+038 ECU_ADDRESS 0x70003944 /end MEASUREMENT
/begin MEASUREMENT FS_BMS_stMain_Neg_B "FS_BMS_stMain_Neg_B" UBYTE Bool_ON_OFF 1 2 0 1 BIT_MASK 0x01 ECU_ADDRESS 0x70003942 /end MEASUREMENT
/begin MEASUREMENT FS_BMS_stMain_Pos_B "FS_BMS_stMain_Pos_B" UBYTE Bool_ON_OFF 1 2 0 1 BIT_MASK 0x01 ECU_ADDRESS 0x70003941 /end MEASUREMENT
/begin MEASUREMENT FS_BSWReadyStatus_B "FS_BSWReadyStatus_B" UBYTE Bool_ON_OFF 1 2 0 1 BIT_MASK 0x01 ECU_ADDRESS 0x70003940 /end MEASUREMENT
/begin MEASUREMENT FS_BackupVoltRaw_U16 "FS_BackupVoltRaw_U16" UWORD F_1_p0_4 1 2 0 65535 ECU_ADDRESS 0x7000393E /end MEASUREMENT
/begin MEASUREMENT FS_BatVotValidFlag_B "FS_BatVotValidFlag_B" UBYTE Bool_ON_OFF 1 2 0 1 BIT_MASK 0x01 ECU_ADDRESS 0x7000393C /end MEASUREMENT
/begin MEASUREMENT FS_BrakDerat_F32 "FS_BrakDerat_F32" FLOAT32_IEEE F_1_p0_4 1 2 -3.402823466E+038 3.402823466E+038 ECU_ADDRESS 0x70003938 /end MEASUREMENT
/begin MEASUREMENT FS_CmdAkdRes_B "FS_CmdAkdRes_B" UBYTE Bool_ON_OFF 1 2 0 1 BIT_MASK 0x01 ECU_ADDRESS 0x70003934 /end MEASUREMENT
/begin MEASUREMENT FS_CmdFtShutDownRes_B "FS_CmdFtShutDownRes_B" UBYTE Bool_ON_OFF 1 2 0 1 BIT_MASK 0x01 ECU_ADDRESS 0x70003933 /end MEASUREMENT
/begin MEASUREMENT FS_CmdFtStartRes_B "FS_CmdFtStartRes_B" UBYTE Bool_ON_OFF 1 2 0 1 BIT_MASK 0x01 ECU_ADDRESS 0x70003932 /end MEASUREMENT
/begin MEASUREMENT FS_CommandBoardTempHV_U16 "FS_CommandBoardTempHV_U16" UWORD F_1_p0_4 1 2 0 65535 ECU_ADDRESS 0x70003930 /end MEASUREMENT
/begin MEASUREMENT FS_CommandBoardTempLV2_U16 "FS_CommandBoardTempLV2_U16" UWORD F_1_p0_4 1 2 0 65535 ECU_ADDRESS 0x7000392E /end MEASUREMENT
/begin MEASUREMENT FS_CommandBoardTempLV_U16 "FS_CommandBoardTempLV_U16" UWORD F_1_p0_4 1 2 0 65535 ECU_ADDRESS 0x7000392C /end MEASUREMENT
/begin MEASUREMENT FS_CoolTempValidFlag_B "FS_CoolTempValidFlag_B" UBYTE Bool_ON_OFF 1 2 0 1 BIT_MASK 0x01 ECU_ADDRESS 0x7000392A /end MEASUREMENT
/begin MEASUREMENT FS_CoolingTemp_U16 "FS_CoolingTemp_U16" UWORD F_1_p0_4 1 2 0 65535 ECU_ADDRESS 0x70003928 /end MEASUREMENT
/begin MEASUREMENT FS_CosHDiag_U16 "FS_CosHDiag_U16" UWORD F_1_p0_4 1 2 0 65535 ECU_ADDRESS 0x70003926 /end MEASUREMENT
/begin MEASUREMENT FS_CosLDiag_U16 "FS_CosLDiag_U16" UWORD F_1_p0_4 1 2 0 65535 ECU_ADDRESS 0x70003924 /end MEASUREMENT
/begin MEASUREMENT FS_CurrentHvPhys_F32 "FS_CurrentHvPhys_F32" FLOAT32_IEEE F_1_p0_4 1 2 -3.402823466E+038 3.402823466E+038 ECU_ADDRESS 0x70003920 /end MEASUREMENT
/begin MEASUREMENT FS_DCDCCooling_F32 "FS_DCDCCooling_F32" FLOAT32_IEEE F_1_p0_4 1 2 -3.402823466E+038 3.402823466E+038 ECU_ADDRESS 0x7000391C /end MEASUREMENT
/begin MEASUREMENT FS_DampTorqueCompTgt_F32 "FS_DampTorqueCompTgt_F32" FLOAT32_IEEE F_1_p0_4 1 2 -3.402823466E+038 3.402823466E+038 ECU_ADDRESS 0x70003918 /end MEASUREMENT
/begin MEASUREMENT FS_DeratingStatus_B "FS_DeratingStatus_B" UBYTE Bool_ON_OFF 1 2 0 1 BIT_MASK 0x01 ECU_ADDRESS 0x70003915 /end MEASUREMENT
/begin MEASUREMENT FS_DischargeReq_U8 "FS_DischargeReq_U8" UBYTE F_1_p0_4 1 2 0 255 ECU_ADDRESS 0x70003914 /end MEASUREMENT
/begin MEASUREMENT FS_DriverBoardTemp_U16 "FS_DriverBoardTemp_U16" UWORD F_1_p0_4 1 2 0 65535 ECU_ADDRESS 0x70003912 /end MEASUREMENT
/begin MEASUREMENT FS_EXT_CrashOutSts_U8 "FS_EXT_CrashOutSts_U8" UBYTE F_1_p0_4 1 2 0 255 ECU_ADDRESS 0x70003911 /end MEASUREMENT
/begin MEASUREMENT FS_EmWorkModCmd_U8 "FS_EmWorkModCmd_U8" UBYTE F_1_p0_4 1 2 0 255 ECU_ADDRESS 0x70003910 /end MEASUREMENT
/begin MEASUREMENT FS_EstPowmdlDrtGain_F32 "FS_EstPowmdlDrtGain_F32" FLOAT32_IEEE F_1_p0_4 1 2 -3.402823466E+038 3.402823466E+038 ECU_ADDRESS 0x7000390C /end MEASUREMENT
/begin MEASUREMENT FS_ExcDutyCycle_F32 "FS_ExcDutyCycle_F32" FLOAT32_IEEE F_1_p0_4 1 2 -3.402823466E+038 3.402823466E+038 ECU_ADDRESS 0x70003908 /end MEASUREMENT
/begin MEASUREMENT FS_ExcFreq_F32 "FS_ExcFreq_F32" FLOAT32_IEEE F_1_p0_4 1 2 -3.402823466E+038 3.402823466E+038 ECU_ADDRESS 0x70003904 /end MEASUREMENT
/begin MEASUREMENT FS_FTAclState_U16 "FS_FTAclState_U16" UWORD F_1_p0_4 1 2 0 65535 ECU_ADDRESS 0x70003900 /end MEASUREMENT
/begin MEASUREMENT FS_FTResloverFault_B "FS_FTResloverFault_B" UBYTE Bool_ON_OFF 1 2 0 1 BIT_MASK 0x01 ECU_ADDRESS 0x700038FE /end MEASUREMENT
/begin MEASUREMENT FS_FaultLevel_U16 "FS_FaultLevel_U16" UWORD F_1_p0_4 1 2 0 65535 ECU_ADDRESS 0x700038FC /end MEASUREMENT
/begin MEASUREMENT FS_GCUCooling_F32 "FS_GCUCooling_F32" FLOAT32_IEEE F_1_p0_4 1 2 -3.402823466E+038 3.402823466E+038 ECU_ADDRESS 0x700038F8 /end MEASUREMENT
/begin MEASUREMENT FS_GateDrvState_U16 "FS_GateDrvState_U16" UWORD F_1_p0_4 1 2 0 65535 ECU_ADDRESS 0x700038F4 /end MEASUREMENT
/begin MEASUREMENT FS_HVnetworkActive_B "FS_HVnetworkActive_B" UBYTE Bool_ON_OFF 1 2 0 1 BIT_MASK 0x01 ECU_ADDRESS 0x700038F2 /end MEASUREMENT
/begin MEASUREMENT FS_HandBrake_B "FS_HandBrake_B" UBYTE Bool_ON_OFF 1 2 0 1 BIT_MASK 0x01 ECU_ADDRESS 0x700038F1 /end MEASUREMENT
/begin MEASUREMENT FS_IO_ExitationDiag_B "FS_IO_ExitationDiag_B" UBYTE Bool_ON_OFF 1 2 0 1 BIT_MASK 0x01 ECU_ADDRESS 0x700038F0 /end MEASUREMENT
/begin MEASUREMENT FS_IbatHV_U16 "FS_IbatHV_U16" UWORD F_1_p0_4 1 2 0 65535 ECU_ADDRESS 0x700038EE /end MEASUREMENT
/begin MEASUREMENT FS_IbatRmsHV_U16 "FS_IbatRmsHV_U16" UWORD F_1_p0_4 1 2 0 65535 ECU_ADDRESS 0x700038EC /end MEASUREMENT
/begin MEASUREMENT FS_Id_ref_F32 "FS_Id_ref_F32" FLOAT32_IEEE F_1_p0_4 1 2 -3.402823466E+038 3.402823466E+038 ECU_ADDRESS 0x700038E8 /end MEASUREMENT
/begin MEASUREMENT FS_Iq_ref_F32 "FS_Iq_ref_F32" FLOAT32_IEEE F_1_p0_4 1 2 -3.402823466E+038 3.402823466E+038 ECU_ADDRESS 0x700038E4 /end MEASUREMENT
/begin MEASUREMENT FS_Iuvw3_F32[0] "FS_Iuvw3_F32" FLOAT32_IEEE F_1_p0_4 1 2 -3.402823466E+038 3.402823466E+038 ECU_ADDRESS 0x700038D8 /end MEASUREMENT
/begin MEASUREMENT FS_Iuvw3_F32[1] "FS_Iuvw3_F32" FLOAT32_IEEE F_1_p0_4 1 2 -3.402823466E+038 3.402823466E+038 ECU_ADDRESS 0x700038DC /end MEASUREMENT
/begin MEASUREMENT FS_Iuvw3_F32[2] "FS_Iuvw3_F32" FLOAT32_IEEE F_1_p0_4 1 2 -3.402823466E+038 3.402823466E+038 ECU_ADDRESS 0x700038E0 /end MEASUREMENT
/begin MEASUREMENT FS_KEY_ON_B "FS_KEY_ON_B" UBYTE Bool_ON_OFF 1 2 0 1 BIT_MASK 0x01 ECU_ADDRESS 0x700038D4 /end MEASUREMENT
/begin MEASUREMENT FS_MaxMinTorqueAvailable_F32 "FS_MaxMinTorqueAvailable_F32" FLOAT32_IEEE F_1_p0_4 1 2 -3.402823466E+038 3.402823466E+038 ECU_ADDRESS 0x700038CC /end MEASUREMENT
/begin MEASUREMENT FS_MaxPowerD_F32 "FS_MaxPowerD_F32" FLOAT32_IEEE F_1_p0_38 1 2 0 605 ECU_ADDRESS 0x700038C8 /end MEASUREMENT
/begin MEASUREMENT FS_MecaSpeedRds_F32 "FS_MecaSpeedRds_F32" FLOAT32_IEEE F_1_p0_4 1 2 -3.402823466E+038 3.402823466E+038 ECU_ADDRESS 0x700038C4 /end MEASUREMENT
/begin MEASUREMENT FS_MecaSpeedRpm_F32 "FS_MecaSpeedRpm_F32" FLOAT32_IEEE F_1_p0_4 1 2 -3.402823466E+038 3.402823466E+038 ECU_ADDRESS 0x700038C0 /end MEASUREMENT
/begin MEASUREMENT FS_MinPowerG_F32 "FS_MinPowerG_F32" FLOAT32_IEEE F_1_p0_38 1 2 0 605 ECU_ADDRESS 0x700038BC /end MEASUREMENT
/begin MEASUREMENT FS_MotorAppliedTorque_F32 "FS_MotorAppliedTorque_F32" FLOAT32_IEEE F_1_p0_4 1 2 -3.402823466E+038 3.402823466E+038 ECU_ADDRESS 0x700038B8 /end MEASUREMENT
/begin MEASUREMENT FS_MotorMagnetDrtGain_F32 "FS_MotorMagnetDrtGain_F32" FLOAT32_IEEE F_1_p0_4 1 2 -3.402823466E+038 3.402823466E+038 ECU_ADDRESS 0x700038B4 /end MEASUREMENT
/begin MEASUREMENT FS_MotorWindingDrtGain_F32 "FS_MotorWindingDrtGain_F32" FLOAT32_IEEE F_1_p0_4 1 2 -3.402823466E+038 3.402823466E+038 ECU_ADDRESS 0x700038B0 /end MEASUREMENT
/begin MEASUREMENT FS_MotorWindingTemp1L_U16 "FS_MotorWindingTemp1L_U16" UWORD F_1_p0_4 1 2 0 65535 ECU_ADDRESS 0x700038AC /end MEASUREMENT
/begin MEASUREMENT FS_MotorWindingTemp1_U16 "FS_MotorWindingTemp1_U16" UWORD F_1_p0_4 1 2 0 65535 ECU_ADDRESS 0x700038AA /end MEASUREMENT
/begin MEASUREMENT FS_MotorWindingTemp2L_U16 "FS_MotorWindingTemp2L_U16" UWORD F_1_p0_4 1 2 0 65535 ECU_ADDRESS 0x700038A8 /end MEASUREMENT
/begin MEASUREMENT FS_MotorWindingTemp2_U16 "FS_MotorWindingTemp2_U16" UWORD F_1_p0_4 1 2 0 65535 ECU_ADDRESS 0x700038A6 /end MEASUREMENT
/begin MEASUREMENT FS_OcCycleFinish_B "FS_OcCycleFinish_B" UBYTE Bool_ON_OFF 1 2 0 1 BIT_MASK 0x01 ECU_ADDRESS 0x700038A5 /end MEASUREMENT
/begin MEASUREMENT FS_OcRotoringFailFlg_B "FS_OcRotoringFailFlg_B" UBYTE Bool_ON_OFF 1 2 0 1 BIT_MASK 0x01 ECU_ADDRESS 0x700038A4 /end MEASUREMENT
/begin MEASUREMENT FS_OilTemp_F32 "FS_OilTemp_F32" FLOAT32_IEEE F_1_p0_4 1 2 -3.402823466E+038 3.402823466E+038 ECU_ADDRESS 0x700038A0 /end MEASUREMENT
/begin MEASUREMENT FS_P5VPort_U16 "FS_P5VPort_U16" UWORD F_1_p0_4 1 2 0 65535 ECU_ADDRESS 0x7000389E /end MEASUREMENT
/begin MEASUREMENT FS_PowerModuleTemp_U_U16 "FS_PowerModuleTemp_U_U16" UWORD F_1_p0_4 1 2 0 65535 ECU_ADDRESS 0x7000389C /end MEASUREMENT
/begin MEASUREMENT FS_PowerModuleTemp_V_U16 "FS_PowerModuleTemp_V_U16" UWORD F_1_p0_4 1 2 0 65535 ECU_ADDRESS 0x7000389A /end MEASUREMENT
/begin MEASUREMENT FS_PowerModuleTemp_W_U16 "FS_PowerModuleTemp_W_U16" UWORD F_1_p0_4 1 2 0 65535 ECU_ADDRESS 0x70003898 /end MEASUREMENT
/begin MEASUREMENT FS_PowmdlDrtGain_F32 "FS_PowmdlDrtGain_F32" FLOAT32_IEEE F_1_p0_4 1 2 -3.402823466E+038 3.402823466E+038 ECU_ADDRESS 0x70003894 /end MEASUREMENT
/begin MEASUREMENT FS_SinHDiag_U16 "FS_SinHDiag_U16" UWORD F_1_p0_4 1 2 0 65535 ECU_ADDRESS 0x70003890 /end MEASUREMENT
/begin MEASUREMENT FS_SinLDiag_U16 "FS_SinLDiag_U16" UWORD F_1_p0_4 1 2 0 65535 ECU_ADDRESS 0x7000388E /end MEASUREMENT
/begin MEASUREMENT FS_SlideSlopReq_B "FS_SlideSlopReq_B" UBYTE Bool_ON_OFF 1 2 0 1 BIT_MASK 0x01 ECU_ADDRESS 0x7000388C /end MEASUREMENT
/begin MEASUREMENT FS_TorqueSlewRate_F32 "FS_TorqueSlewRate_F32" FLOAT32_IEEE F_1_p0_4 1 2 -3.402823466E+038 3.402823466E+038 ECU_ADDRESS 0x70003888 /end MEASUREMENT
/begin MEASUREMENT FS_UbatHV_U16 "FS_UbatHV_U16" UWORD F_1_p0_4 1 2 0 65535 ECU_ADDRESS 0x70003886 /end MEASUREMENT
/begin MEASUREMENT FS_UbatLV_U16 "FS_UbatLV_U16" UWORD F_1_p0_4 1 2 0 65535 ECU_ADDRESS 0x70003884 /end MEASUREMENT
/begin MEASUREMENT FS_UdsOcEnable_B "FS_UdsOcEnable_B" UBYTE Bool_ON_OFF 1 2 0 1 BIT_MASK 0x01 ECU_ADDRESS 0x70003883 /end MEASUREMENT
/begin MEASUREMENT FS_UdsOcRdResFlag_B "FS_UdsOcRdResFlag_B" UBYTE Bool_ON_OFF 1 2 0 1 BIT_MASK 0x01 ECU_ADDRESS 0x70003882 /end MEASUREMENT
/begin MEASUREMENT FS_UdsOcStartReq_B "FS_UdsOcStartReq_B" UBYTE Bool_ON_OFF 1 2 0 1 BIT_MASK 0x01 ECU_ADDRESS 0x70003881 /end MEASUREMENT
/begin MEASUREMENT FS_VCU_BMS_RlyClsReq_U8 "FS_VCU_BMS_RlyClsReq_U8" UBYTE F_1_p0_43 1 2 0 255 ECU_ADDRESS 0x70003880 /end MEASUREMENT
/begin MEASUREMENT FS_VCU_DCU_CurrMax_F32 "FS_VCU_DCU_CurrMax_F32" FLOAT32_IEEE F_1_p0_46 1 2 -1000 1000 ECU_ADDRESS 0x7000387C /end MEASUREMENT
/begin MEASUREMENT FS_VCU_DCU_CurrMin_F32 "FS_VCU_DCU_CurrMin_F32" FLOAT32_IEEE F_1_p0_46 1 2 -1000 1000 ECU_ADDRESS 0x70003878 /end MEASUREMENT
/begin MEASUREMENT FS_VCU_DCU_ModeReq_Inv_U8 "FS_VCU_DCU_ModeReq_Inv_U8" UBYTE F_1_p0_43 1 2 0 255 ECU_ADDRESS 0x70003875 /end MEASUREMENT
/begin MEASUREMENT FS_VCU_DCU_ModeReq_U8 "FS_VCU_DCU_ModeReq_U8" UBYTE F_1_p0_43 1 2 0 255 ECU_ADDRESS 0x70003874 /end MEASUREMENT
/begin MEASUREMENT FS_VCU_DCU_SpdSet_F32 "FS_VCU_DCU_SpdSet_F32" FLOAT32_IEEE F_1_p0_21 1 2 -1000000 1000000 ECU_ADDRESS 0x70003870 /end MEASUREMENT
/begin MEASUREMENT FS_VCU_DCU_TorqMax_F32 "FS_VCU_DCU_TorqMax_F32" FLOAT32_IEEE F_1_p0_49 1 2 -500 500 ECU_ADDRESS 0x7000386C /end MEASUREMENT
/begin MEASUREMENT FS_VCU_DCU_TorqMin_F32 "FS_VCU_DCU_TorqMin_F32" FLOAT32_IEEE F_1_p0_49 1 2 -500 500 ECU_ADDRESS 0x70003868 /end MEASUREMENT
/begin MEASUREMENT FS_VCU_DCU_TorqSet_F32 "FS_VCU_DCU_TorqSet_F32" FLOAT32_IEEE F_1_p0_49 1 2 -500 500 ECU_ADDRESS 0x70003864 /end MEASUREMENT
/begin MEASUREMENT FS_VCU_DCU_TorqSet_Rdd_F32 "redundant" FLOAT32_IEEE F_1_p0_49 1 2 -500 500 ECU_ADDRESS 0x70003860 /end MEASUREMENT
/begin MEASUREMENT FS_VCU_DCU_VoltMax_F32 "FS_VCU_DCU_VoltMax_F32" FLOAT32_IEEE F_1_p0_38 1 2 0 605 ECU_ADDRESS 0x7000385C /end MEASUREMENT
/begin MEASUREMENT FS_VCU_DCU_VoltMin_F32 "FS_VCU_DCU_VoltMin_F32" FLOAT32_IEEE F_1_p0_38 1 2 0 605 ECU_ADDRESS 0x70003858 /end MEASUREMENT
/begin MEASUREMENT FS_VCU_PreChargeRlySts_B "FS_VCU_PreChargeRlySts_B" UBYTE Bool_ON_OFF 1 2 0 1 BIT_MASK 0x01 ECU_ADDRESS 0x70003855 /end MEASUREMENT
/begin MEASUREMENT FS_VcuMcuEnableReq_U8 "FS_VcuMcuEnableReq_U8" UBYTE F_1_p0_4 1 2 0 255 ECU_ADDRESS 0x70003854 /end MEASUREMENT
/begin MEASUREMENT FS_VsiPwmDutyCycle3_F32[0] "FS_VsiPwmDutyCycle3_F32" FLOAT32_IEEE F_1_p0_4 1 2 -3.402823466E+038 3.402823466E+038 ECU_ADDRESS 0x70003848 /end MEASUREMENT
/begin MEASUREMENT FS_VsiPwmDutyCycle3_F32[1] "FS_VsiPwmDutyCycle3_F32" FLOAT32_IEEE F_1_p0_4 1 2 -3.402823466E+038 3.402823466E+038 ECU_ADDRESS 0x7000384C /end MEASUREMENT
/begin MEASUREMENT FS_VsiPwmDutyCycle3_F32[2] "FS_VsiPwmDutyCycle3_F32" FLOAT32_IEEE F_1_p0_4 1 2 -3.402823466E+038 3.402823466E+038 ECU_ADDRESS 0x70003850 /end MEASUREMENT
/begin MEASUREMENT FTASBDS_BattVoltDrtGainMax "FTASBDS_BattVoltDrtGainMax" FLOAT32_IEEE F_1_p0_55 1 2 0 1 ECU_ADDRESS 0x70003EB4 /end MEASUREMENT
/begin MEASUREMENT FTASBDS_BattVoltDrtGainMin "FTASBDS_BattVoltDrtGainMin" FLOAT32_IEEE F_1_p0_55 1 2 0 1 ECU_ADDRESS 0x70003EB0 /end MEASUREMENT
/begin MEASUREMENT FTASDPM_DeratingStatus "FTASDPM_DeratingStatus" UBYTE Bool_ON_OFF 1 2 0 1 BIT_MASK 0x01 ECU_ADDRESS 0x70003EF0 /end MEASUREMENT
/begin MEASUREMENT FT_AkdAfterAsc_B "FT_AkdAfterAsc_B" UBYTE Bool_ON_OFF 1 2 0 1 BIT_MASK 0x01 ECU_ADDRESS 0x70004442 /end MEASUREMENT
/begin MEASUREMENT FT_AntiShake_B "FT_AntiShake_B" UBYTE Bool_ON_OFF 1 2 0 1 BIT_MASK 0x01 ECU_ADDRESS 0x70004441 /end MEASUREMENT
/begin MEASUREMENT FT_BhvCheckEna_B "FT_BhvCheckEna_B" UBYTE Bool_ON_OFF 1 2 0 1 BIT_MASK 0x01 ECU_ADDRESS 0x70004440 /end MEASUREMENT
/begin MEASUREMENT FT_CmdFtShutDownReq_B "FT_CmdFtShutDownReq_B" UBYTE Bool_ON_OFF 1 2 0 1 BIT_MASK 0x01 ECU_ADDRESS 0x7000443F /end MEASUREMENT
/begin MEASUREMENT FT_CmdFtStartReq_B "FT_CmdFtStartReq_B" UBYTE Bool_ON_OFF 1 2 0 1 BIT_MASK 0x01 ECU_ADDRESS 0x7000443E /end MEASUREMENT
/begin MEASUREMENT FT_CmdPwmDirectRes_B "FT_CmdPwmDirectRes_B" UBYTE Bool_ON_OFF 1 2 0 1 BIT_MASK 0x01 ECU_ADDRESS 0x7000443D /end MEASUREMENT
/begin MEASUREMENT FT_CmdPwmOffRes_B "FT_CmdPwmOffRes_B" UBYTE Bool_ON_OFF 1 2 0 1 BIT_MASK 0x01 ECU_ADDRESS 0x7000443C /end MEASUREMENT
/begin MEASUREMENT FT_CoolingTemp_F32 "FT_CoolingTemp_F32" FLOAT32_IEEE F_1_p0_4 1 2 -3.402823466E+038 3.402823466E+038 ECU_ADDRESS 0x70004438 /end MEASUREMENT
/begin MEASUREMENT FT_DutyCycle3_F32[0] "FT_DutyCycle3_F32" FLOAT32_IEEE F_1_p0_4 1 2 -3.402823466E+038 3.402823466E+038 ECU_ADDRESS 0x7000442C /end MEASUREMENT
/begin MEASUREMENT FT_DutyCycle3_F32[1] "FT_DutyCycle3_F32" FLOAT32_IEEE F_1_p0_4 1 2 -3.402823466E+038 3.402823466E+038 ECU_ADDRESS 0x70004430 /end MEASUREMENT
/begin MEASUREMENT FT_DutyCycle3_F32[2] "FT_DutyCycle3_F32" FLOAT32_IEEE F_1_p0_4 1 2 -3.402823466E+038 3.402823466E+038 ECU_ADDRESS 0x70004434 /end MEASUREMENT
/begin MEASUREMENT FT_EXTAntiSlideEnable_B "FT_EXTAntiSlideEnable_B" UBYTE Bool_ON_OFF 1 2 0 1 BIT_MASK 0x01 ECU_ADDRESS 0x70004429 /end MEASUREMENT
/begin MEASUREMENT FT_EXTPrechargeFinish_B "FT_EXTPrechargeFinish_B" UBYTE Bool_ON_OFF 1 2 0 1 BIT_MASK 0x01 ECU_ADDRESS 0x70004428 /end MEASUREMENT
/begin MEASUREMENT FT_ElecSpeedRds_F32 "FT_ElecSpeedRds_F32" FLOAT32_IEEE F_1_p0_4 1 2 -3.402823466E+038 3.402823466E+038 ECU_ADDRESS 0x70004424 /end MEASUREMENT
/begin MEASUREMENT FT_ErrThetaRdSurPi_F32 "FT_ErrThetaRdSurPi_F32" FLOAT32_IEEE F_1_p0_4 1 2 -3.402823466E+038 3.402823466E+038 ECU_ADDRESS 0x70004420 /end MEASUREMENT
/begin MEASUREMENT FT_FTModeReq_U16 "FT_FTModeReq_U16" UWORD F_1_p0_4 1 2 0 65535 ECU_ADDRESS 0x7000441C /end MEASUREMENT
/begin MEASUREMENT FT_FaultLevel_U16 "FT_FaultLevel_U16" UWORD F_1_p0_4 1 2 0 65535 ECU_ADDRESS 0x7000441A /end MEASUREMENT
/begin MEASUREMENT FT_HacModeDetn_B "FT_HacModeDetn_B" UBYTE Bool_ON_OFF 1 2 0 1 BIT_MASK 0x01 ECU_ADDRESS 0x70004418 /end MEASUREMENT
/begin MEASUREMENT FT_I0dqTgt3_F32[0] "FT_I0dqTgt3_F32" FLOAT32_IEEE F_1_p0_4 1 2 -3.402823466E+038 3.402823466E+038 ECU_ADDRESS 0x7000440C /end MEASUREMENT
/begin MEASUREMENT FT_I0dqTgt3_F32[1] "FT_I0dqTgt3_F32" FLOAT32_IEEE F_1_p0_4 1 2 -3.402823466E+038 3.402823466E+038 ECU_ADDRESS 0x70004410 /end MEASUREMENT
/begin MEASUREMENT FT_I0dqTgt3_F32[2] "FT_I0dqTgt3_F32" FLOAT32_IEEE F_1_p0_4 1 2 -3.402823466E+038 3.402823466E+038 ECU_ADDRESS 0x70004414 /end MEASUREMENT
/begin MEASUREMENT FT_Iuvw3Rms_F32[0] "FT_Iuvw3Rms_F32" FLOAT32_IEEE F_1_p0_4 1 2 -3.402823466E+038 3.402823466E+038 ECU_ADDRESS 0x70004400 /end MEASUREMENT
/begin MEASUREMENT FT_Iuvw3Rms_F32[1] "FT_Iuvw3Rms_F32" FLOAT32_IEEE F_1_p0_4 1 2 -3.402823466E+038 3.402823466E+038 ECU_ADDRESS 0x70004404 /end MEASUREMENT
/begin MEASUREMENT FT_Iuvw3Rms_F32[2] "FT_Iuvw3Rms_F32" FLOAT32_IEEE F_1_p0_4 1 2 -3.402823466E+038 3.402823466E+038 ECU_ADDRESS 0x70004408 /end MEASUREMENT
/begin MEASUREMENT FT_Iuvw3_U16[0] "FT_Iuvw3_U16" UWORD F_1_p0_4 1 2 0 65535 ECU_ADDRESS 0x700043F8 /end MEASUREMENT
/begin MEASUREMENT FT_Iuvw3_U16[1] "FT_Iuvw3_U16" UWORD F_1_p0_4 1 2 0 65535 ECU_ADDRESS 0x700043FA /end MEASUREMENT
/begin MEASUREMENT FT_Iuvw3_U16[2] "FT_Iuvw3_U16" UWORD F_1_p0_4 1 2 0 65535 ECU_ADDRESS 0x700043FC /end MEASUREMENT
/begin MEASUREMENT FT_MecaSpeedRds_F32 "FT_MecaSpeedRds_F32" FLOAT32_IEEE F_1_p0_4 1 2 -3.402823466E+038 3.402823466E+038 ECU_ADDRESS 0x700043F4 /end MEASUREMENT
/begin MEASUREMENT FT_MecaSpeedRpmTgt_F32 "FT_MecaSpeedRpmTgt_F32" FLOAT32_IEEE F_1_p0_4 1 2 -3.402823466E+038 3.402823466E+038 ECU_ADDRESS 0x700043F0 /end MEASUREMENT
/begin MEASUREMENT FT_MecaSpeedRpm_F32 "FT_MecaSpeedRpm_F32" FLOAT32_IEEE F_1_p0_4 1 2 -3.402823466E+038 3.402823466E+038 ECU_ADDRESS 0x700043EC /end MEASUREMENT
/begin MEASUREMENT FT_MotorMagnetTemp_F32 "FT_MotorMagnetTemp_F32" FLOAT32_IEEE F_1_p0_4 1 2 -3.402823466E+038 3.402823466E+038 ECU_ADDRESS 0x700043E8 /end MEASUREMENT
/begin MEASUREMENT FT_MotorWindingTemp2_F32[0] "FT_MotorWindingTemp2_F32" FLOAT32_IEEE F_1_p0_4 1 2 -3.402823466E+038 3.402823466E+038 ECU_ADDRESS 0x700043E0 /end MEASUREMENT
/begin MEASUREMENT FT_MotorWindingTemp2_F32[1] "FT_MotorWindingTemp2_F32" FLOAT32_IEEE F_1_p0_4 1 2 -3.402823466E+038 3.402823466E+038 ECU_ADDRESS 0x700043E4 /end MEASUREMENT
/begin MEASUREMENT FT_PosiCurrentDelay_F32 "FT_PosiCurrentDelay_F32" FLOAT32_IEEE F_1_p0_4 1 2 -3.402823466E+038 3.402823466E+038 ECU_ADDRESS 0x700043DC /end MEASUREMENT
/begin MEASUREMENT FT_PowerModuleTemp_F32 "FT_PowerModuleTemp_F32" FLOAT32_IEEE F_1_p0_4 1 2 -3.402823466E+038 3.402823466E+038 ECU_ADDRESS 0x700043D8 /end MEASUREMENT
/begin MEASUREMENT FT_PwmZeroMatch_B "FT_PwmZeroMatch_B" UBYTE Bool_ON_OFF 1 2 0 1 BIT_MASK 0x01 ECU_ADDRESS 0x700043D4 /end MEASUREMENT
/begin MEASUREMENT FT_PwrLmtTqrMax_F32 "FT_PwrLmtTqrMax_F32" FLOAT32_IEEE F_1_p0_4 1 2 -3.402823466E+038 3.402823466E+038 ECU_ADDRESS 0x700043D0 /end MEASUREMENT
/begin MEASUREMENT FT_PwrLmtTqrMin_F32 "FT_PwrLmtTqrMin_F32" FLOAT32_IEEE F_1_p0_4 1 2 -3.402823466E+038 3.402823466E+038 ECU_ADDRESS 0x700043CC /end MEASUREMENT
/begin MEASUREMENT FT_PwrMaxMinTqr_F32[0] "FT_PwrMaxMinTqr_F32" FLOAT32_IEEE F_1_p0_4 1 2 -3.402823466E+038 3.402823466E+038 ECU_ADDRESS 0x700043C4 /end MEASUREMENT
/begin MEASUREMENT FT_PwrMaxMinTqr_F32[1] "FT_PwrMaxMinTqr_F32" FLOAT32_IEEE F_1_p0_4 1 2 -3.402823466E+038 3.402823466E+038 ECU_ADDRESS 0x700043C8 /end MEASUREMENT
/begin MEASUREMENT FT_RandomNum_U32 "FT_RandomNum_U32" ULONG F_1_p0_45 1 2 0 4294967295 ECU_ADDRESS 0x700043C0 /end MEASUREMENT
/begin MEASUREMENT FT_ResThetaRdSurPiOc_F32 "FT_ResThetaRdSurPiOc_F32" FLOAT32_IEEE F_1_p0_4 1 2 -3.402823466E+038 3.402823466E+038 ECU_ADDRESS 0x700043BC /end MEASUREMENT
/begin MEASUREMENT FT_ResloverThetaRdSuiPi_F32 "FT_ResloverThetaRdSuiPi_F32" FLOAT32_IEEE F_1_p0_4 1 2 -3.402823466E+038 3.402823466E+038 ECU_ADDRESS 0x700043B8 /end MEASUREMENT
/begin MEASUREMENT FT_SinCosNextThetaElec_F32[0] "FT_SinCosNextThetaElec_F32" FLOAT32_IEEE F_1_p0_4 1 2 -3.402823466E+038 3.402823466E+038 ECU_ADDRESS 0x700043B0 /end MEASUREMENT
/begin MEASUREMENT FT_SinCosNextThetaElec_F32[1] "FT_SinCosNextThetaElec_F32" FLOAT32_IEEE F_1_p0_4 1 2 -3.402823466E+038 3.402823466E+038 ECU_ADDRESS 0x700043B4 /end MEASUREMENT
/begin MEASUREMENT FT_SinCosThetaElec_F32[0] "FT_SinCosThetaElec_F32" FLOAT32_IEEE F_1_p0_4 1 2 -3.402823466E+038 3.402823466E+038 ECU_ADDRESS 0x700043A8 /end MEASUREMENT
/begin MEASUREMENT FT_SinCosThetaElec_F32[1] "FT_SinCosThetaElec_F32" FLOAT32_IEEE F_1_p0_4 1 2 -3.402823466E+038 3.402823466E+038 ECU_ADDRESS 0x700043AC /end MEASUREMENT
/begin MEASUREMENT FT_SpdInitialValue_F32 "FT_SpdInitialValue_F32" FLOAT32_IEEE F_1_p0_4 1 2 -3.402823466E+038 3.402823466E+038 ECU_ADDRESS 0x700043A4 /end MEASUREMENT
/begin MEASUREMENT FT_TorqueTgt_F32 "FT_TorqueTgt_F32" FLOAT32_IEEE F_1_p0_4 1 2 -3.402823466E+038 3.402823466E+038 ECU_ADDRESS 0x700043A0 /end MEASUREMENT
/begin MEASUREMENT FT_U0dqTgt3_F32[0] "FT_U0dqTgt3_F32" FLOAT32_IEEE F_1_p0_4 1 2 -3.402823466E+038 3.402823466E+038 ECU_ADDRESS 0x70004394 /end MEASUREMENT
/begin MEASUREMENT FT_U0dqTgt3_F32[1] "FT_U0dqTgt3_F32" FLOAT32_IEEE F_1_p0_4 1 2 -3.402823466E+038 3.402823466E+038 ECU_ADDRESS 0x70004398 /end MEASUREMENT
/begin MEASUREMENT FT_U0dqTgt3_F32[2] "FT_U0dqTgt3_F32" FLOAT32_IEEE F_1_p0_4 1 2 -3.402823466E+038 3.402823466E+038 ECU_ADDRESS 0x7000439C /end MEASUREMENT
/begin MEASUREMENT FT_UbatHV_F32 "FT_UbatHV_F32" FLOAT32_IEEE F_1_p0_4 1 2 -3.402823466E+038 3.402823466E+038 ECU_ADDRESS 0x70004390 /end MEASUREMENT
/begin MEASUREMENT FT_VcuDampEnable_B "FT_VcuDampEnable_B" UBYTE Bool_ON_OFF 1 2 0 1 BIT_MASK 0x01 ECU_ADDRESS 0x7000438C /end MEASUREMENT
/begin MEASUREMENT FT_VsiPwmPeriod_F32 "FT_VsiPwmPeriod_F32" FLOAT32_IEEE F_1_p0_4 1 2 -3.402823466E+038 3.402823466E+038 ECU_ADDRESS 0x70004388 /end MEASUREMENT
/begin MEASUREMENT FT_VsiPwmRatioRes_U8 "FT_VsiPwmRatioRes_U8" UBYTE F_1_p0_4 1 2 0 3 ECU_ADDRESS 0x70004384 /end MEASUREMENT
/begin MEASUREMENT SAASITV_ADMainSup1VCorred "SAASITV_ADMainSup1VCorred" FLOAT32_IEEE F_1_p0_36 1 2 -3.402823466E+038 3.402823466E+038 ECU_ADDRESS 0x70003CA8 /end MEASUREMENT
/begin MEASUREMENT SAASITV_ADSnsSup1VCorred "SAASITV_ADSnsSup1VCorred" FLOAT32_IEEE F_1_p0_36 1 2 -3.402823466E+038 3.402823466E+038 ECU_ADDRESS 0x70003CA4 /end MEASUREMENT
/begin MEASUREMENT SAASITV_ADSnsSup2VCorred "SAASITV_ADSnsSup2VCorred" FLOAT32_IEEE F_1_p0_36 1 2 -3.402823466E+038 3.402823466E+038 ECU_ADDRESS 0x70003CA0 /end MEASUREMENT
/begin MEASUREMENT SAASITV_CheckEnable "SAASITV_CheckEnable" UBYTE Bool_ON_OFF 1 2 0 1 BIT_MASK 0x01 ECU_ADDRESS 0x70003C08 /end MEASUREMENT
/begin MEASUREMENT SAASITV_MP5VRef1VolFildZ "SAASITV_MP5VRef1VolFildZ" FLOAT32_IEEE F_1_p0_38 1 2 -3.402823466E+038 3.402823466E+038 ECU_ADDRESS 0x70003C9C /end MEASUREMENT
/begin MEASUREMENT SAASITV_MainSup1Vol "SAASITV_MainSup1Vol" FLOAT32_IEEE F_1_p0_38 1 2 -3.402823466E+038 3.402823466E+038 ECU_ADDRESS 0x70003C98 /end MEASUREMENT
/begin MEASUREMENT SAASITV_MainSup1VolFildZ "SAASITV_MainSup1VolFildZ" FLOAT32_IEEE F_1_p0_38 1 2 -3.402823466E+038 3.402823466E+038 ECU_ADDRESS 0x70003C94 /end MEASUREMENT
/begin MEASUREMENT SAASITV_SnsSup1Vol "SAASITV_SnsSup1Vol" FLOAT32_IEEE F_1_p0_38 1 2 -3.402823466E+038 3.402823466E+038 ECU_ADDRESS 0x70003C90 /end MEASUREMENT
/begin MEASUREMENT SAASITV_SnsSup1VolFildZ "SAASITV_SnsSup1VolFildZ" FLOAT32_IEEE F_1_p0_38 1 2 -3.402823466E+038 3.402823466E+038 ECU_ADDRESS 0x70003C8C /end MEASUREMENT
/begin MEASUREMENT SAASITV_SnsSup2Vol "SAASITV_SnsSup2Vol" FLOAT32_IEEE F_1_p0_38 1 2 -3.402823466E+038 3.402823466E+038 ECU_ADDRESS 0x70003C88 /end MEASUREMENT
/begin MEASUREMENT SAASITV_SnsSup2VolFildZ "SAASITV_SnsSup2VolFildZ" FLOAT32_IEEE F_1_p0_38 1 2 -3.402823466E+038 3.402823466E+038 ECU_ADDRESS 0x70003C84 /end MEASUREMENT
/begin MEASUREMENT SABKPV_BkpVol "SABKPV_BkpVol" FLOAT32_IEEE F_1_p0_38 1 2 -3.402823466E+038 3.402823466E+038 ECU_ADDRESS 0x70003CB4 /end MEASUREMENT
/begin MEASUREMENT SABKPV_BkpVolFildZ "SABKPV_BkpVolFildZ" FLOAT32_IEEE F_1_p0_40 1 2 -3.402823466E+038 3.402823466E+038 ECU_ADDRESS 0x70003CB0 /end MEASUREMENT
/begin MEASUREMENT SABKPV_CheckEnable "SABKPV_CheckEnable" UBYTE Bool_ON_OFF 1 2 0 1 BIT_MASK 0x01 ECU_ADDRESS 0x70003C07 /end MEASUREMENT
/begin MEASUREMENT SABKP_ADBkpVolCorred "SABKP_ADBkpVolCorred" FLOAT32_IEEE F_1_p0_40 1 2 -3.402823466E+038 3.402823466E+038 ECU_ADDRESS 0x70003CAC /end MEASUREMENT
/begin MEASUREMENT SADDV_ADP5VolHSCorred "SADDV_ADP5VolHSCorred" FLOAT32_IEEE F_1_p0_36 1 2 -3.402823466E+038 3.402823466E+038 ECU_ADDRESS 0x70003CD4 /end MEASUREMENT
/begin MEASUREMENT SADDV_ADP5VolLSCorred "SADDV_ADP5VolLSCorred" FLOAT32_IEEE F_1_p0_36 1 2 -3.402823466E+038 3.402823466E+038 ECU_ADDRESS 0x70003CD0 /end MEASUREMENT
/begin MEASUREMENT SADDV_CheckEnable "SADDV_CheckEnable" UBYTE Bool_ON_OFF 1 2 0 1 BIT_MASK 0x01 ECU_ADDRESS 0x70003C06 /end MEASUREMENT
/begin MEASUREMENT SADDV_P5VolHS "SADDV_P5VolHS" FLOAT32_IEEE F_1_p0_38 1 2 -3.402823466E+038 3.402823466E+038 ECU_ADDRESS 0x70003CCC /end MEASUREMENT
/begin MEASUREMENT SADDV_P5VolHSFild "SADDV_P5VolHSFild" FLOAT32_IEEE F_1_p0_38 1 2 -3.402823466E+038 3.402823466E+038 ECU_ADDRESS 0x70003CC8 /end MEASUREMENT
/begin MEASUREMENT SADDV_P5VolHSFildZ "SADDV_P5VolHSFildZ" FLOAT32_IEEE F_1_p0_38 1 2 -3.402823466E+038 3.402823466E+038 ECU_ADDRESS 0x70003CC4 /end MEASUREMENT
/begin MEASUREMENT SADDV_P5VolLS "SADDV_P5VolLS" FLOAT32_IEEE F_1_p0_38 1 2 -3.402823466E+038 3.402823466E+038 ECU_ADDRESS 0x70003CC0 /end MEASUREMENT
/begin MEASUREMENT SADDV_P5VolLSFild "SADDV_P5VolLSFild" FLOAT32_IEEE F_1_p0_38 1 2 -3.402823466E+038 3.402823466E+038 ECU_ADDRESS 0x70003CBC /end MEASUREMENT
/begin MEASUREMENT SADDV_P5VolLSFildZ "SADDV_P5VolLSFildZ" FLOAT32_IEEE F_1_p0_38 1 2 -3.402823466E+038 3.402823466E+038 ECU_ADDRESS 0x70003CB8 /end MEASUREMENT
/begin MEASUREMENT SAFSSM_AclState "SAFSSM_AclState" UWORD F_1_p0_36 1 2 0 65535 ECU_ADDRESS 0x70003C04 /end MEASUREMENT
/begin MEASUREMENT SAFSSM_EVBHV_CheckEnable "SAFSSM_EVBHV_CheckEnable" UBYTE Bool_ON_OFF 1 2 0 1 BIT_MASK 0x01 ECU_ADDRESS 0x70003C03 /end MEASUREMENT
/begin MEASUREMENT SAFSSM_EVBLV_CheckEnable "SAFSSM_EVBLV_CheckEnable" UBYTE Bool_ON_OFF 1 2 0 1 BIT_MASK 0x01 ECU_ADDRESS 0x70003C02 /end MEASUREMENT
/begin MEASUREMENT SAFSSM_EVIBT_State "SAFSSM_EVIBT_State" UWORD F_1_p0_36 1 2 0 65535 ECU_ADDRESS 0x70003C00 /end MEASUREMENT
/begin MEASUREMENT SAFSSM_MTRDG_CheckEnable "SAFSSM_MTRDG_CheckEnable" UBYTE Bool_ON_OFF 1 2 0 1 BIT_MASK 0x01 ECU_ADDRESS 0x70003BFF /end MEASUREMENT
/begin MEASUREMENT SAFTSM_AclState "SAFTSM_AclState" UWORD F_1_p0_36 1 2 0 65535 ECU_ADDRESS 0x70003C1A /end MEASUREMENT
/begin MEASUREMENT SAFTSM_EVEIT_MainEnable "SAFTSM_EVEIT_MainEnable" UBYTE Bool_ON_OFF 1 2 0 1 BIT_MASK 0x01 ECU_ADDRESS 0x70003C18 /end MEASUREMENT
/begin MEASUREMENT SAFTSM_FTCIVDC_State "SAFTSM_FTCIVDC_State" UWORD F_1_p0_36 1 2 0 65535 ECU_ADDRESS 0x70003C16 /end MEASUREMENT
/begin MEASUREMENT SAFTSM_FTCMCCS_State "SAFTSM_FTCMCCS_State" UWORD F_1_p0_36 1 2 0 65535 ECU_ADDRESS 0x70003C14 /end MEASUREMENT
/begin MEASUREMENT SAFTSM_FTCMSCS_State "SAFTSM_FTCMSCS_State" UWORD F_1_p0_36 1 2 0 65535 ECU_ADDRESS 0x70003C12 /end MEASUREMENT
/begin MEASUREMENT SAFTSM_FTCMTCS_State "SAFTSM_FTCMTCS_State" UWORD F_1_p0_36 1 2 0 65535 ECU_ADDRESS 0x70003C10 /end MEASUREMENT
/begin MEASUREMENT SAFTSM_FtModeReq "SAFTSM_FtModeReq" UWORD F_1_p0_36 1 2 0 65535 ECU_ADDRESS 0x70003C0E /end MEASUREMENT
/begin MEASUREMENT SAFTSM_MTLCS_State "SAFTSM_MTLCS_State" UWORD F_1_p0_36 1 2 0 65535 ECU_ADDRESS 0x70003C0C /end MEASUREMENT
/begin MEASUREMENT SAFTSM_MTMEP_State "SAFTSM_MTMEP_State" UWORD F_1_p0_36 1 2 0 65535 ECU_ADDRESS 0x70003C0A /end MEASUREMENT
/begin MEASUREMENT SAMTEAL_AglRadError "SAMTEAL_AglRadError" FLOAT32_IEEE F_1_p0_36 1 2 -3.402823466E+038 3.402823466E+038 ECU_ADDRESS 0x70003CE4 /end MEASUREMENT
/begin MEASUREMENT SAMTEAL_EorAgldu "SAMTEAL_EorAgldu" FLOAT32_IEEE F_1_p0_36 1 2 -3.402823466E+038 3.402823466E+038 ECU_ADDRESS 0x70003CE0 /end MEASUREMENT
/begin MEASUREMENT SAMTEAL_EstAlg "SAMTEAL_EstAlg" FLOAT32_IEEE F_1_p0_36 1 2 -3.402823466E+038 3.402823466E+038 ECU_ADDRESS 0x70003CDC /end MEASUREMENT
/begin MEASUREMENT SAMTEAL_PllEstAglXPi "SAMTEAL_PllEstAglXPi" FLOAT32_IEEE F_1_p0_36 1 2 -3.402823466E+038 3.402823466E+038 ECU_ADDRESS 0x70003CD8 /end MEASUREMENT
/begin MEASUREMENT SAMTEPD_ErorAngle "SAMTEPD_ErorAngle" FLOAT32_IEEE F_1_p0_36 1 2 -3.402823466E+038 3.402823466E+038 ECU_ADDRESS 0x70003CE8 /end MEASUREMENT
/begin MEASUREMENT SATDETD_CheckEnable "SATDETD_CheckEnable" UBYTE Bool_ON_OFF 1 2 0 1 BIT_MASK 0x01 ECU_ADDRESS 0x70003BFE /end MEASUREMENT
/begin MEASUREMENT SATDETD_EstiamtedElecTorque "SATDETD_EstiamtedElecTorque" FLOAT32_IEEE F_1_p0_36 1 2 -3.402823466E+038 3.402823466E+038 ECU_ADDRESS 0x70003D00 /end MEASUREMENT
/begin MEASUREMENT SATDETD_FaultFlag "SATDETD_FaultFlag" UBYTE Bool_ON_OFF 1 2 0 1 BIT_MASK 0x01 ECU_ADDRESS 0x70003CFC /end MEASUREMENT
/begin MEASUREMENT SATDETD_SumZ "SATDETD_SumZ" FLOAT32_IEEE F_1_p0_36 1 2 -3.402823466E+038 3.402823466E+038 ECU_ADDRESS 0x70003CF8 /end MEASUREMENT
/begin MEASUREMENT SATDETD_TeFilteredZ "SATDETD_TeFilteredZ" FLOAT32_IEEE F_1_p0_36 1 2 -3.402823466E+038 3.402823466E+038 ECU_ADDRESS 0x70003CF4 /end MEASUREMENT
/begin MEASUREMENT SATDETD_TorqueActEorr "SATDETD_TorqueActEorr" FLOAT32_IEEE F_1_p0_36 1 2 -3.402823466E+038 3.402823466E+038 ECU_ADDRESS 0x70003CF0 /end MEASUREMENT
/begin MEASUREMENT SATDETD_TorqueChangeRateAbs "SATDETD_TorqueChangeRateAbs" FLOAT32_IEEE F_1_p0_36 1 2 -3.402823466E+038 3.402823466E+038 ECU_ADDRESS 0x70003CEC /end MEASUREMENT
/begin MEASUREMENT SATDTCD_CheckEnable "SATDTCD_CheckEnable" UBYTE Bool_ON_OFF 1 2 0 1 BIT_MASK 0x01 ECU_ADDRESS 0x70003BFD /end MEASUREMENT
/begin MEASUREMENT SATDTR_CheckEnable "SATDTR_CheckEnable" UBYTE Bool_ON_OFF 1 2 0 1 BIT_MASK 0x01 ECU_ADDRESS 0x70003BFC /end MEASUREMENT
/begin MEASUREMENT SA_A2DResCorrdVoltage_F32 "SA_A2DResCorrdVoltage_F32" FLOAT32_IEEE F_1_p0_36 1 2 -3.402823466E+038 3.402823466E+038 ECU_ADDRESS 0x70003C80 /end MEASUREMENT
/begin MEASUREMENT SA_ADBackupVol_U16 "SA_ADBackupVol_U16" UWORD F_1_p0_36 1 2 0 65535 ECU_ADDRESS 0x70003C7C /end MEASUREMENT
/begin MEASUREMENT SA_ADMP5VRef1_U16 "SA_ADMP5VRef1_U16" UWORD F_1_p0_36 1 2 0 65535 ECU_ADDRESS 0x70003C7A /end MEASUREMENT
/begin MEASUREMENT SA_ADMainSup1_U16 "SA_ADMainSup1_U16" UWORD F_1_p0_36 1 2 0 65535 ECU_ADDRESS 0x70003C78 /end MEASUREMENT
/begin MEASUREMENT SA_ADP5VoLS_U16 "SA_ADP5VoLS_U16" UWORD F_1_p0_36 1 2 0 65535 ECU_ADDRESS 0x70003C76 /end MEASUREMENT
/begin MEASUREMENT SA_ADP5VolHS_U16 "SA_ADP5VolHS_U16" UWORD F_1_p0_36 1 2 0 65535 ECU_ADDRESS 0x70003C74 /end MEASUREMENT
/begin MEASUREMENT SA_ADSnsSup1_U16 "SA_ADSnsSup1_U16" UWORD F_1_p0_36 1 2 0 65535 ECU_ADDRESS 0x70003C72 /end MEASUREMENT
/begin MEASUREMENT SA_ADSnsSup2_U16 "SA_ADSnsSup2_U16" UWORD F_1_p0_36 1 2 0 65535 ECU_ADDRESS 0x70003C70 /end MEASUREMENT
/begin MEASUREMENT SA_AutoPhase_F32 "SA_AutoPhase_F32" FLOAT32_IEEE F_1_p0_4 1 2 -3.402823466E+038 3.402823466E+038 ECU_ADDRESS 0x70003C6C /end MEASUREMENT
/begin MEASUREMENT SA_BMSDCCurrent_F32 "SA_BMSDCCurrent_F32" FLOAT32_IEEE F_1_p0_36 1 2 -3.402823466E+038 3.402823466E+038 ECU_ADDRESS 0x70003C68 /end MEASUREMENT
/begin MEASUREMENT SA_BatVotFlag_B "SA_BatVotFlag_B" UBYTE Bool_ON_OFF 1 2 0 1 BIT_MASK 0x01 ECU_ADDRESS 0x70003C64 /end MEASUREMENT
/begin MEASUREMENT SA_BmsVolt_F32 "SA_BmsVolt_F32" FLOAT32_IEEE F_1_p0_36 1 2 -3.402823466E+038 3.402823466E+038 ECU_ADDRESS 0x70003C60 /end MEASUREMENT
/begin MEASUREMENT SA_CosScaled_F32 "SA_CosScaled_F32" FLOAT32_IEEE F_1_p0_36 1 2 -3.402823466E+038 3.402823466E+038 ECU_ADDRESS 0x70003C5C /end MEASUREMENT
/begin MEASUREMENT SA_DeratingStatus_B "SA_DeratingStatus_B" UBYTE Bool_ON_OFF 1 2 0 1 BIT_MASK 0x01 ECU_ADDRESS 0x70003C59 /end MEASUREMENT
/begin MEASUREMENT SA_EntrySlideFlag_B "SA_EntrySlideFlag_B" UBYTE Bool_ON_OFF 1 2 0 1 BIT_MASK 0x01 ECU_ADDRESS 0x70003C58 /end MEASUREMENT
/begin MEASUREMENT SA_FSEVBHV_Voltage_F32 "SA_FSEVBHV_Voltage_F32" FLOAT32_IEEE F_1_p0_36 1 2 -3.402823466E+038 3.402823466E+038 ECU_ADDRESS 0x70003C54 /end MEASUREMENT
/begin MEASUREMENT SA_FTModeReq_U16 "SA_FTModeReq_U16" UWORD F_1_p0_36 1 2 0 65535 ECU_ADDRESS 0x70003C50 /end MEASUREMENT
/begin MEASUREMENT SA_Fai_F32 "SA_Fai_F32" FLOAT32_IEEE F_1_p0_36 1 2 -3.402823466E+038 3.402823466E+038 ECU_ADDRESS 0x70003C4C /end MEASUREMENT
/begin MEASUREMENT SA_FaultLevel_U16 "SA_FaultLevel_U16" UWORD F_1_p0_36 1 2 0 65535 ECU_ADDRESS 0x70003C48 /end MEASUREMENT
/begin MEASUREMENT SA_FsAclState_U16 "SA_FsAclState_U16" UWORD F_1_p0_36 1 2 0 65535 ECU_ADDRESS 0x70003C46 /end MEASUREMENT
/begin MEASUREMENT SA_FtAclState_U16 "SA_FtAclState_U16" UWORD F_1_p0_36 1 2 0 65535 ECU_ADDRESS 0x70003C44 /end MEASUREMENT
/begin MEASUREMENT SA_GeneratorDCCurrent_F32 "SA_GeneratorDCCurrent_F32" FLOAT32_IEEE F_1_p0_36 1 2 -3.402823466E+038 3.402823466E+038 ECU_ADDRESS 0x70003C40 /end MEASUREMENT
/begin MEASUREMENT SA_IdAct_F32 "SA_IdAct_F32" FLOAT32_IEEE F_1_p0_36 1 2 -3.402823466E+038 3.402823466E+038 ECU_ADDRESS 0x70003C3C /end MEASUREMENT
/begin MEASUREMENT SA_IqAct_F32 "SA_IqAct_F32" FLOAT32_IEEE F_1_p0_36 1 2 -3.402823466E+038 3.402823466E+038 ECU_ADDRESS 0x70003C38 /end MEASUREMENT
/begin MEASUREMENT SA_Ld_F32 "SA_Ld_F32" FLOAT32_IEEE F_1_p0_36 1 2 -3.402823466E+038 3.402823466E+038 ECU_ADDRESS 0x70003C34 /end MEASUREMENT
/begin MEASUREMENT SA_Lq_F32 "SA_Lq_F32" FLOAT32_IEEE F_1_p0_36 1 2 -3.402823466E+038 3.402823466E+038 ECU_ADDRESS 0x70003C30 /end MEASUREMENT
/begin MEASUREMENT SA_PllEstAgl_F32 "SA_PllEstAgl_F32" FLOAT32_IEEE F_1_p0_36 1 2 -3.402823466E+038 3.402823466E+038 ECU_ADDRESS 0x70003C2C /end MEASUREMENT
/begin MEASUREMENT SA_SinScaled_F32 "SA_SinScaled_F32" FLOAT32_IEEE F_1_p0_36 1 2 -3.402823466E+038 3.402823466E+038 ECU_ADDRESS 0x70003C28 /end MEASUREMENT
/begin MEASUREMENT SA_SpeedRpm_F32 "SA_SpeedRpm_F32" FLOAT32_IEEE F_1_p0_36 1 2 -3.402823466E+038 3.402823466E+038 ECU_ADDRESS 0x70003C24 /end MEASUREMENT
/begin MEASUREMENT SA_TorqueRef_F32 "SA_TorqueRef_F32" FLOAT32_IEEE F_1_p0_36 1 2 -3.402823466E+038 3.402823466E+038 ECU_ADDRESS 0x70003C20 /end MEASUREMENT
/begin MEASUREMENT SA_VcuMcuEnableReq_U8 "SA_VcuMcuEnableReq_U8" UBYTE F_1_p0_36 1 2 0 255 ECU_ADDRESS 0x70003C1C /end MEASUREMENT
/begin MEASUREMENT TCCMCCS_DirectionCmd "TCCMCCS_DirectionCmd" FLOAT32_IEEE F_1_p0_36 1 2 -3.402823466E+038 3.402823466E+038 ECU_ADDRESS 0x70003DC0 /end MEASUREMENT
/begin MEASUREMENT TCCMCCS_DutyCycle "TCCMCCS_DutyCycle" FLOAT32_IEEE F_1_p0_36 1 2 -3.402823466E+038 3.402823466E+038 ECU_ADDRESS 0x70003DBC /end MEASUREMENT
/begin MEASUREMENT TCCMCCS_IdcCtrlIntegratorZ "TCCMCCS_IdcCtrlIntegratorZ" FLOAT32_IEEE F_1_p0_36 1 2 -3.402823466E+038 3.402823466E+038 ECU_ADDRESS 0x70003DB8 /end MEASUREMENT
/begin MEASUREMENT TCCMCCS_IdcRef "TCCMCCS_IdcRef" FLOAT32_IEEE F_1_p0_34 1 2 -3.402823466E+038 3.402823466E+038 ECU_ADDRESS 0x70003DB4 /end MEASUREMENT
/begin MEASUREMENT TCCMCCS_IdcRefFiltZ "TCCMCCS_IdcRefFiltZ" FLOAT32_IEEE F_1_p0_36 1 2 -3.402823466E+038 3.402823466E+038 ECU_ADDRESS 0x70003DB0 /end MEASUREMENT
/begin MEASUREMENT TCCMCCS_IdcTgtRampZ "TCCMCCS_IdcTgtRampZ" FLOAT32_IEEE F_1_p0_36 1 2 -3.402823466E+038 3.402823466E+038 ECU_ADDRESS 0x70003DAC /end MEASUREMENT
/begin MEASUREMENT TCCMSPC_DirCmd "Corrected ADC value of the battery voltage." FLOAT32_IEEE F_1_p0_36 1 2 -3.402823466E+038 3.402823466E+038 ECU_ADDRESS 0x70003DDC /end MEASUREMENT
/begin MEASUREMENT TCCMSPC_IdcTarget "Corrected ADC value of the battery voltage." FLOAT32_IEEE F_1_p0_36 1 2 -3.402823466E+038 3.402823466E+038 ECU_ADDRESS 0x70003DD8 /end MEASUREMENT
/begin MEASUREMENT TCCMSPC_MergedSpeedFdb "TCCMSPC_MergedSpeedFdb" FLOAT32_IEEE F_1_p0_36 1 2 -3.402823466E+038 3.402823466E+038 ECU_ADDRESS 0x70003DD4 /end MEASUREMENT
/begin MEASUREMENT TCCMSPC_SpeedCtrlIntegratorZ "TCCMSPC_SpeedCtrlIntegratorZ" FLOAT32_IEEE F_1_p0_36 1 2 -3.402823466E+038 3.402823466E+038 ECU_ADDRESS 0x70003DD0 /end MEASUREMENT
/begin MEASUREMENT TCCMSPC_SpeedRef "TCCMSPC_SpeedRef" FLOAT32_IEEE F_1_p0_36 1 2 -3.402823466E+038 3.402823466E+038 ECU_ADDRESS 0x70003DCC /end MEASUREMENT
/begin MEASUREMENT TCCMSPC_SpeedTgtZ "TCCMSPC_SpeedTgtZ" FLOAT32_IEEE F_1_p0_36 1 2 -3.402823466E+038 3.402823466E+038 ECU_ADDRESS 0x70003DC8 /end MEASUREMENT
/begin MEASUREMENT TCCMSPC_TorqueRefLimZ "TCCMSPC_TorqueRefLimZ" FLOAT32_IEEE F_1_p0_36 1 2 -3.402823466E+038 3.402823466E+038 ECU_ADDRESS 0x70003DC4 /end MEASUREMENT
/begin MEASUREMENT TCEVBLV_FilterOut "TCEVBLV_FilterOut" FLOAT32_IEEE F_1_p0_36 1 2 -3.402823466E+038 3.402823466E+038 ECU_ADDRESS 0x70003E30 /end MEASUREMENT
/begin MEASUREMENT TCEVBLV_FilterOutZ "TCEVBLV_FilterOutZ" FLOAT32_IEEE F_1_p0_36 1 2 -3.402823466E+038 3.402823466E+038 ECU_ADDRESS 0x70003E2C /end MEASUREMENT
/begin MEASUREMENT TCEVBLV_TcOverVolHighFlg "TCEVBLV_TcOverVolHighFlg" UBYTE Bool_ON_OFF 1 2 0 1 BIT_MASK 0x01 ECU_ADDRESS 0x70003E2B /end MEASUREMENT
/begin MEASUREMENT TCEVBLV_TcOverVolLowFlg "TCEVBLV_TcOverVolLowFlg" UBYTE Bool_ON_OFF 1 2 0 1 BIT_MASK 0x01 ECU_ADDRESS 0x70003E2A /end MEASUREMENT
/begin MEASUREMENT TCEVBLV_TcOverVolMidFlg "TCEVBLV_TcOverVolMidFlg" UBYTE Bool_ON_OFF 1 2 0 1 BIT_MASK 0x01 ECU_ADDRESS 0x70003E29 /end MEASUREMENT
/begin MEASUREMENT TCEVBLV_TcUnderVolFlg "TCEVBLV_TcUnderVolFlg" UBYTE Bool_ON_OFF 1 2 0 1 BIT_MASK 0x01 ECU_ADDRESS 0x70003E28 /end MEASUREMENT
/begin MEASUREMENT TCEVOPR_FilterOutZ "TCEVOPR_FilterOutZ" FLOAT32_IEEE F_1_p0_36 1 2 -3.402823466E+038 3.402823466E+038 ECU_ADDRESS 0x70003E3C /end MEASUREMENT
/begin MEASUREMENT TCEVOPR_OilPressFilt "TCEVOPR_OilPressFilt" FLOAT32_IEEE F_1_p0_36 1 2 -3.402823466E+038 3.402823466E+038 ECU_ADDRESS 0x70003E38 /end MEASUREMENT
/begin MEASUREMENT TCEVOPR_RawOilPress "TCEVOPR_RawOilPress" FLOAT32_IEEE F_1_p0_36 1 2 -3.402823466E+038 3.402823466E+038 ECU_ADDRESS 0x70003E34 /end MEASUREMENT
/begin MEASUREMENT TCEVOTM_FilterOutZ "TCEVOTM_FilterOutZ" FLOAT32_IEEE F_1_p0_36 1 2 -3.402823466E+038 3.402823466E+038 ECU_ADDRESS 0x70003E58 /end MEASUREMENT
/begin MEASUREMENT TCEVOTM_OilOverTmpFaultFlg "TCEVOTM_OilOverTmpFaultFlg" UBYTE Bool_ON_OFF 1 2 0 1 BIT_MASK 0x01 ECU_ADDRESS 0x70003E55 /end MEASUREMENT
/begin MEASUREMENT TCEVOTM_OilPmpOverTmpWarFlg "TCEVOTM_OilPmpOverTmpWarFlg" UBYTE Bool_ON_OFF 1 2 0 1 BIT_MASK 0x01 ECU_ADDRESS 0x70003E54 /end MEASUREMENT
/begin MEASUREMENT TCEVOTM_OilTempAdc "TCEVOTM_OilTempAdc" FLOAT32_IEEE F_1_p0_36 1 2 -3.402823466E+038 3.402823466E+038 ECU_ADDRESS 0x70003E50 /end MEASUREMENT
/begin MEASUREMENT TCEVOTM_OilTempAdcFilt "TCEVOTM_OilTempAdcFilt" FLOAT32_IEEE F_1_p0_4 1 2 -3.402823466E+038 3.402823466E+038 ECU_ADDRESS 0x70003E4C /end MEASUREMENT
/begin MEASUREMENT TCEVOTM_OilTempAdcNoMinMaxFilt "TCEVOTM_OilTempAdcNoMinMaxFilt" FLOAT32_IEEE F_1_p0_4 1 2 -3.402823466E+038 3.402823466E+038 ECU_ADDRESS 0x70003E48 /end MEASUREMENT
/begin MEASUREMENT TCEVOTM_OilTempFilt "Corrected ADC value of the battery voltage." FLOAT32_IEEE F_1_p0_34 1 2 -3.402823466E+038 3.402823466E+038 ECU_ADDRESS 0x70003E44 /end MEASUREMENT
/begin MEASUREMENT TCEVOTM_RawOilTemp "TCEVOTM_RawOilTemp" FLOAT32_IEEE F_1_p0_36 1 2 -3.402823466E+038 3.402823466E+038 ECU_ADDRESS 0x70003E40 /end MEASUREMENT
/begin MEASUREMENT TCMTCUR_CurLoadRatio "TCMTCUR_CurLoadRatio" FLOAT32_IEEE F_1_p0_36 1 2 -3.402823466E+038 3.402823466E+038 ECU_ADDRESS 0x70003E90 /end MEASUREMENT
/begin MEASUREMENT TCMTCUR_CurLoadRatioFilterZ "TCMTCUR_CurLoadRatioFilterZ" FLOAT32_IEEE F_1_p0_36 1 2 -3.402823466E+038 3.402823466E+038 ECU_ADDRESS 0x70003E8C /end MEASUREMENT
/begin MEASUREMENT TCMTCUR_CurrentFaultZ "TCMTCUR_CurrentFaultZ" FLOAT32_IEEE F_1_p0_36 1 2 -3.402823466E+038 3.402823466E+038 ECU_ADDRESS 0x70003E88 /end MEASUREMENT
/begin MEASUREMENT TCMTCUR_CurrentFiltered "TCMTCUR_CurrentFiltered" FLOAT32_IEEE F_1_p0_36 1 2 -3.402823466E+038 3.402823466E+038 ECU_ADDRESS 0x70003E84 /end MEASUREMENT
/begin MEASUREMENT TCMTCUR_CurrentFilteredZ "TCMTCUR_CurrentFilteredZ" FLOAT32_IEEE F_1_p0_36 1 2 -3.402823466E+038 3.402823466E+038 ECU_ADDRESS 0x70003E80 /end MEASUREMENT
/begin MEASUREMENT TCMTCUR_CurrentLoad "TCMTCUR_CurrentLoad" FLOAT32_IEEE F_1_p0_36 1 2 -3.402823466E+038 3.402823466E+038 ECU_ADDRESS 0x70003E7C /end MEASUREMENT
/begin MEASUREMENT TCMTCUR_CurrentRms "TCMTCUR_CurrentRms" FLOAT32_IEEE F_1_p0_36 1 2 -3.402823466E+038 3.402823466E+038 ECU_ADDRESS 0x70003E78 /end MEASUREMENT
/begin MEASUREMENT TCMTCUR_DcCurFilt "TCMTCUR_DcCurFilt" FLOAT32_IEEE F_1_p0_36 1 2 -3.402823466E+038 3.402823466E+038 ECU_ADDRESS 0x70003E74 /end MEASUREMENT
/begin MEASUREMENT TCMTCUR_DcCurFilterZ "TCMTCUR_DcCurFilterZ" FLOAT32_IEEE F_1_p0_36 1 2 -3.402823466E+038 3.402823466E+038 ECU_ADDRESS 0x70003E70 /end MEASUREMENT
/begin MEASUREMENT TCMTCUR_RawDcCurFdb "TCMTCUR_RawDcCurFdb" FLOAT32_IEEE F_1_p0_36 1 2 -3.402823466E+038 3.402823466E+038 ECU_ADDRESS 0x70003E6C /end MEASUREMENT
/begin MEASUREMENT TCMTCUR_RealRawCurrent "TCMTCUR_RealRawCurrent" FLOAT32_IEEE F_1_p0_36 1 2 -3.402823466E+038 3.402823466E+038 ECU_ADDRESS 0x70003E68 /end MEASUREMENT
/begin MEASUREMENT TCMTCUR_TcOverCurFlg "TCMTCUR_TcOverCurFlg" UBYTE Bool_ON_OFF 1 2 0 1 BIT_MASK 0x01 ECU_ADDRESS 0x70003E64 /end MEASUREMENT
/begin MEASUREMENT TCMTHAL_FilterOutZ "TCMTHAL_FilterOutZ" FLOAT32_IEEE F_1_p0_36 1 2 -3.402823466E+038 3.402823466E+038 ECU_ADDRESS 0x70003EAC /end MEASUREMENT
/begin MEASUREMENT TCMTHAL_HallFaultTimeOutZ "TCMTHAL_HallFaultTimeOutZ" FLOAT32_IEEE F_1_p0_36 1 2 -3.402823466E+038 3.402823466E+038 ECU_ADDRESS 0x70003EA8 /end MEASUREMENT
/begin MEASUREMENT TCMTHAL_RotorStopFlag "TCMTHAL_RotorStopFlag" FLOAT32_IEEE F_1_p0_36 1 2 -3.402823466E+038 3.402823466E+038 ECU_ADDRESS 0x70003EA4 /end MEASUREMENT
/begin MEASUREMENT TCMTHAL_SpdFdb "TCMTHAL_SpdFdb" FLOAT32_IEEE F_1_p0_36 1 2 -3.402823466E+038 3.402823466E+038 ECU_ADDRESS 0x70003EA0 /end MEASUREMENT
/begin MEASUREMENT TCMTHAL_SpdFdbFilt "Corrected ADC value of the battery voltage." FLOAT32_IEEE F_1_p0_34 1 2 -3.402823466E+038 3.402823466E+038 ECU_ADDRESS 0x70003E9C /end MEASUREMENT
/begin MEASUREMENT TCMTHAL_StallCounterZ "TCMTHAL_StallCounterZ" FLOAT32_IEEE F_1_p0_36 1 2 -3.402823466E+038 3.402823466E+038 ECU_ADDRESS 0x70003E98 /end MEASUREMENT
/begin MEASUREMENT TCMTHAL_TcHallFaultFlg "TCMTHAL_TcHallFaultFlg" UBYTE Bool_ON_OFF 1 2 0 1 BIT_MASK 0x01 ECU_ADDRESS 0x70003E95 /end MEASUREMENT
/begin MEASUREMENT TCMTHAL_TcOverSpdFlg "TCMTHAL_TcOverSpdFlg" UBYTE Bool_ON_OFF 1 2 0 1 BIT_MASK 0x01 ECU_ADDRESS 0x70003E94 /end MEASUREMENT
/begin MEASUREMENT TCSALFM_OilOverTmpFaultDetn "TCSALFM_OilOverTmpFaultDetn" UBYTE Bool_ON_OFF 1 2 0 1 BIT_MASK 0x01 ECU_ADDRESS 0x70003E63 /end MEASUREMENT
/begin MEASUREMENT TCSALFM_OilPmpOverTmpWarDetn "TCSALFM_OilPmpOverTmpWarDetn" UBYTE Bool_ON_OFF 1 2 0 1 BIT_MASK 0x01 ECU_ADDRESS 0x70003E62 /end MEASUREMENT
/begin MEASUREMENT TCSALFM_TcOverCurDetn "TCSALFM_TcOverCurDetn" UBYTE Bool_ON_OFF 1 2 0 1 BIT_MASK 0x01 ECU_ADDRESS 0x70003E61 /end MEASUREMENT
/begin MEASUREMENT TCSALFM_TcOverSpdDetn "TCSALFM_TcOverSpdDetn" UBYTE Bool_ON_OFF 1 2 0 1 BIT_MASK 0x01 ECU_ADDRESS 0x70003E60 /end MEASUREMENT
/begin MEASUREMENT TCSALFM_TcOverVolHighDetn "TCSALFM_TcOverVolHighDetn" UBYTE Bool_ON_OFF 1 2 0 1 BIT_MASK 0x01 ECU_ADDRESS 0x70003E5F /end MEASUREMENT
/begin MEASUREMENT TCSALFM_TcOverVolLowDetn "TCSALFM_TcOverVolLowDetn" UBYTE Bool_ON_OFF 1 2 0 1 BIT_MASK 0x01 ECU_ADDRESS 0x70003E5E /end MEASUREMENT
/begin MEASUREMENT TCSALFM_TcOverVolMidDetn "TCSALFM_TcOverVolMidDetn" UBYTE Bool_ON_OFF 1 2 0 1 BIT_MASK 0x01 ECU_ADDRESS 0x70003E5D /end MEASUREMENT
/begin MEASUREMENT TCSALFM_TcUnderVolDetn "TCSALFM_TcUnderVolDetn" UBYTE Bool_ON_OFF 1 2 0 1 BIT_MASK 0x01 ECU_ADDRESS 0x70003E5C /end MEASUREMENT
/begin MEASUREMENT TCSMACS_AclPreState "TCSMACS_AclPreState" UWORD F_1_p0_36 1 2 0 65535 ECU_ADDRESS 0x70003DE8 /end MEASUREMENT
/begin MEASUREMENT TCSMACS_AclState "TCSMACS_AclState" UWORD F_1_p0_36 1 2 0 65535 ECU_ADDRESS 0x70003DE6 /end MEASUREMENT
/begin MEASUREMENT TCSMACS_CmdClearDutyReq "TCSMACS_CmdClearDutyReq" UBYTE Bool_ON_OFF 1 2 0 1 BIT_MASK 0x01 ECU_ADDRESS 0x70003DE5 /end MEASUREMENT
/begin MEASUREMENT TCSMACS_CmdPwmOffReq "TCSMACS_CmdPwmOffReq" UBYTE Bool_ON_OFF 1 2 0 1 BIT_MASK 0x01 ECU_ADDRESS 0x70003DE4 /end MEASUREMENT
/begin MEASUREMENT TCSMACS_CmdShutDownReq "TCSMACS_CmdShutDownReq" UBYTE Bool_ON_OFF 1 2 0 1 BIT_MASK 0x01 ECU_ADDRESS 0x70003DE3 /end MEASUREMENT
/begin MEASUREMENT TCSMACS_CmdStartReq "TCSMACS_CmdStartReq" UBYTE Bool_ON_OFF 1 2 0 1 BIT_MASK 0x01 ECU_ADDRESS 0x70003DE2 /end MEASUREMENT
/begin MEASUREMENT TCSMACS_ReadFlashDataFlg "TCSMACS_ReadFlashDataFlg" UBYTE Bool_ON_OFF 1 2 0 1 BIT_MASK 0x01 ECU_ADDRESS 0x70003DE1 /end MEASUREMENT
/begin MEASUREMENT TCSMACS_SaveData2FlashFlg "TCSMACS_SaveData2FlashFlg" UBYTE Bool_ON_OFF 1 2 0 1 BIT_MASK 0x01 ECU_ADDRESS 0x70003DE0 /end MEASUREMENT
/begin MEASUREMENT TCSMMAM_BldcWorkMode "TCSMMAM_BldcWorkMode" UWORD F_1_p0_36 1 2 0 65535 ECU_ADDRESS 0x70003DEA /end MEASUREMENT
/begin MEASUREMENT TC_A2DRawBusVoltage "TC_A2DRawBusVoltage" FLOAT32_IEEE F_1_p0_36 1 2 -3.402823466E+038 3.402823466E+038 ECU_ADDRESS 0x70003E24 /end MEASUREMENT
/begin MEASUREMENT TC_A2DRawCurrent "TC_A2DRawCurrent" FLOAT32_IEEE F_1_p0_36 1 2 -3.402823466E+038 3.402823466E+038 ECU_ADDRESS 0x70003E20 /end MEASUREMENT
/begin MEASUREMENT TC_A2DRawOilPressure "TC_A2DRawOilPressure" FLOAT32_IEEE F_1_p0_36 1 2 -3.402823466E+038 3.402823466E+038 ECU_ADDRESS 0x70003E1C /end MEASUREMENT
/begin MEASUREMENT TC_A2DRawOilTemp "TC_A2DRawOilTemp" FLOAT32_IEEE F_1_p0_36 1 2 -3.402823466E+038 3.402823466E+038 ECU_ADDRESS 0x70003E18 /end MEASUREMENT
/begin MEASUREMENT TC_A2DRawVoffset "TC_A2DRawVoffset" FLOAT32_IEEE F_1_p0_36 1 2 -3.402823466E+038 3.402823466E+038 ECU_ADDRESS 0x70003E14 /end MEASUREMENT
/begin MEASUREMENT TC_BldcWorkMode "TC_BldcWorkMode" FLOAT32_IEEE F_1_p0_36 1 2 -3.402823466E+038 3.402823466E+038 ECU_ADDRESS 0x70003E10 /end MEASUREMENT
/begin MEASUREMENT TC_ExtAdcCalibDoneFlg "TC_ExtAdcCalibDoneFlg" UBYTE Bool_ON_OFF 1 2 0 1 BIT_MASK 0x01 ECU_ADDRESS 0x70003E0C /end MEASUREMENT
/begin MEASUREMENT TC_ExtCmdShutDownReq "TC_ExtCmdShutDownReq" FLOAT32_IEEE F_1_p0_36 1 2 -3.402823466E+038 3.402823466E+038 ECU_ADDRESS 0x70003E08 /end MEASUREMENT
/begin MEASUREMENT TC_ExtCmdStartReq "TC_ExtCmdStartReq" FLOAT32_IEEE F_1_p0_36 1 2 -3.402823466E+038 3.402823466E+038 ECU_ADDRESS 0x70003E04 /end MEASUREMENT
/begin MEASUREMENT TC_ExtFaultLevel "TC_ExtFaultLevel" FLOAT32_IEEE F_1_p0_36 1 2 -3.402823466E+038 3.402823466E+038 ECU_ADDRESS 0x70003E00 /end MEASUREMENT
/begin MEASUREMENT TC_ExtHallStatus "TC_ExtHallStatus" FLOAT32_IEEE F_1_p0_4 1 2 -3.402823466E+038 3.402823466E+038 ECU_ADDRESS 0x70003DFC /end MEASUREMENT
/begin MEASUREMENT TC_ExtIdcTarget "TC_ExtIdcTarget" FLOAT32_IEEE F_1_p0_36 1 2 -3.402823466E+038 3.402823466E+038 ECU_ADDRESS 0x70003DF8 /end MEASUREMENT
/begin MEASUREMENT TC_ExtPwmDutyTarget "TC_ExtPwmDutyTarget" FLOAT32_IEEE F_1_p0_36 1 2 -3.402823466E+038 3.402823466E+038 ECU_ADDRESS 0x70003DF4 /end MEASUREMENT
/begin MEASUREMENT TC_HallRawCapCnt "TC_HallRawCapCnt" FLOAT32_IEEE F_1_p0_36 1 2 -3.402823466E+038 3.402823466E+038 ECU_ADDRESS 0x70003DF0 /end MEASUREMENT
/begin MEASUREMENT TC_SpeedTarget "TC_SpeedTarget" FLOAT32_IEEE F_1_p0_36 1 2 -3.402823466E+038 3.402823466E+038 ECU_ADDRESS 0x70003DEC /end MEASUREMENT
/begin COMPU_METHOD F_1_p0_4 "" RAT_FUNC "%9.2" "-" COEFFS 0 1 0 0 0 1 /end COMPU_METHOD
/begin COMPU_METHOD F_1_p0_21 "" RAT_FUNC "%9.2" "RPM" COEFFS 0 1 0 0 0 1 /end COMPU_METHOD
/begin COMPU_METHOD F_1_p0_34 "" RAT_FUNC "%9.2" "DEC." COEFFS 0 1 0 0 0 1 /end COMPU_METHOD
/begin COMPU_METHOD F_1_p0_35 "" RAT_FUNC "%9.2" "Hz" COEFFS 0 1 0 0 0 1 /end COMPU_METHOD
/begin COMPU_METHOD F_1_p0_36 "" RAT_FUNC "%9.2" "None." COEFFS 0 1 0 0 0 1 /end COMPU_METHOD
/begin COMPU_METHOD F_1_p0_37 "" RAT_FUNC "%9.2" "V/DEC." COEFFS 0 1 0 0 0 1 /end COMPU_METHOD
/begin COMPU_METHOD F_1_p0_38 "" RAT_FUNC "%9.2" "V" COEFFS 0 1 0 0 0 1 /end COMPU_METHOD
/begin COMPU_METHOD F_1_p0_39 "" RAT_FUNC "%9.2" "V." COEFFS 0 1 0 0 0 1 /end COMPU_METHOD
/begin COMPU_METHOD F_1_p0_40 "" RAT_FUNC "%9.2" "[]" COEFFS 0 1 0 0 0 1 /end COMPU_METHOD
/begin COMPU_METHOD F_1_p0_41 "" RAT_FUNC "%9.2" "C degree" COEFFS 0 1 0 0 0 1 /end COMPU_METHOD
/begin COMPU_METHOD F_1_p0_42 "" RAT_FUNC "%9.2" "C Degree" COEFFS 0 1 0 0 0 1 /end COMPU_METHOD
/begin COMPU_METHOD F_1_p0_43 "" RAT_FUNC "%9.2" "Nan." COEFFS 0 1 0 0 0 1 /end COMPU_METHOD
/begin COMPU_METHOD F_1_p0_44 "" RAT_FUNC "%9.2" "cesiuce" COEFFS 0 1 0 0 0 1 /end COMPU_METHOD
/begin COMPU_METHOD F_1_p0_45 "" RAT_FUNC "%9.2" "Nan" COEFFS 0 1 0 0 0 1 /end COMPU_METHOD
/begin COMPU_METHOD F_1_p0_46 "" RAT_FUNC "%9.2" "A" COEFFS 0 1 0 0 0 1 /end COMPU_METHOD
/begin COMPU_METHOD F_1_p0_47 "" RAT_FUNC "%9.2" "None" COEFFS 0 1 0 0 0 1 /end COMPU_METHOD
/begin COMPU_METHOD F_1_p0_48 "" RAT_FUNC "%9.2" "nan" COEFFS 0 1 0 0 0 1 /end COMPU_METHOD
/begin COMPU_METHOD F_1_p0_49 "" RAT_FUNC "%9.2" "Nm" COEFFS 0 1 0 0 0 1 /end COMPU_METHOD
/begin COMPU_METHOD F_1_p0_50 "" RAT_FUNC "%9.2" "Rpm" COEFFS 0 1 0 0 0 1 /end COMPU_METHOD
/begin COMPU_METHOD F_1_p0_51 "" RAT_FUNC "%9.2" "DEC" COEFFS 0 1 0 0 0 1 /end COMPU_METHOD
/begin COMPU_METHOD F_1_p0_52 "" RAT_FUNC "%9.2" "rpm" COEFFS 0 1 0 0 0 1 /end COMPU_METHOD
/begin COMPU_METHOD F_1_p0_53 "" RAT_FUNC "%9.2" "s" COEFFS 0 1 0 0 0 1 /end COMPU_METHOD
/begin COMPU_METHOD F_1_p0_54 "" RAT_FUNC "%9.2" "NaN" COEFFS 0 1 0 0 0 1 /end COMPU_METHOD
/begin COMPU_METHOD F_1_p0_55 "" RAT_FUNC "%9.2" "none" COEFFS 0 1 0 0 0 1 /end COMPU_METHOD
/begin COMPU_METHOD F_1_p0_56 "" RAT_FUNC "%9.2" "N.m" COEFFS 0 1 0 0 0 1 /end COMPU_METHOD
/begin COMPU_METHOD Id_0x00 "" RAT_FUNC "%9.2" "." COEFFS 0 1 0 0 0 1 /end COMPU_METHOD
/begin COMPU_METHOD Bool_ON_OFF "" TAB_VERB "%8.4" "." COMPU_TAB_REF Bool_ON_OFF_table /end COMPU_METHOD
/begin COMPU_VTAB Bool_ON_OFF_table "" TAB_VERB 2 0 "OFF" 1 "ON" /end COMPU_VTAB
/begin FUNCTION SWC_FS ""
 /begin DEF_CHARACTERISTIC FSEVBHV_A2dMaxValueC FSEVBHV_A2dMinValueC FSEVBHV_A2DOffsetVoltageC FSEVBHV_CutOffFrequencyC FSEVBHV_GainCorrnC FSEVBHV_GainScalingC FSEVBHV_HighVoltageThrC FSEVBHV_HighVoltRdyThrC FSEVBHV_LowHysteresisRangeC FSEVBHV_LowVoltageThrC FSEVBHV_LowVoltageWarnThrC FSEVBHV_SampleVolOutRngHHC FSEVBHV_SampleVolOutRngHLC FSEVBHV_SampleVolOutRngLHC FSEVBHV_SampleVolOutRngLLC FSEVBHV_ShortCircuitGndC FSEVBHV_ShortCircuitVccC FSEVBHV_VisuAdUbatC FSEVBHV_VisuAdUbatEnC FSEVBHV_VolNotRationalEnC FSEVBHV_VolNotRationalNumC FSEVBLV_A2dMaxValueC FSEVBLV_A2dMinValueC FSEVBLV_A2DOffsetBkpVolC FSEVBLV_A2DOffsetVoltageC FSEVBLV_BkpMinVolThrC FSEVBLV_BlvMinVolThrC FSEVBLV_CutOffFrequencyC FSEVBLV_GainCorrnBkpC FSEVBLV_GainCorrnC FSEVBLV_GainScalingBkpC FSEVBLV_GainScalingC FSEVBLV_HighVoltageThrC FSEVBLV_LowHysteresisRangeC FSEVBLV_LowVoltageThrC FSEVBLV_LowVoltageWarnThrC FSEVBLV_P5VAD2VoltC FSEVBLV_P5VRefC FSEVBLV_P5VRefErrBurstC FSEVBLV_ShortCircuitGndC FSEVBLV_ShortCircuitVccC FSEVETA_A2dMaxValueC FSEVETA_A2dMinValueC FSEVETA_ADTTIgbt25C FSEVETA_CmdShortCircuitGndC FSEVETA_CmdShortCircuitVccC FSEVETA_CutOffFrequencyC FSEVETA_DrvShortCircuitGndC FSEVETA_DrvShortCircuitVccC FSEVETA_FaultPeriodCounterC FSEVETA_GainTempCoolingC FSEVETA_GainTempDrvBoardLeftC FSEVETA_GainTempIgbtLeftC FSEVETA_GainTempLVCmdBoardC FSEVETA_HighTempCmdBoard2ThdC FSEVETA_HighTempCmdBoardThdC FSEVETA_HighTempDrvLeftThdC FSEVETA_HighTempIgbtLeftThdC FSEVETA_IgbtRationalThdC FSEVETA_IgbtTableTT2VP2C FSEVETA_IgbtTempSlopDetnEnC FSEVETA_IgbtTempSlopMaxC FSEVETA_InterSampleIgbtHOutRngHC FSEVETA_InterSampleIgbtHOutRngLC FSEVETA_InterSampleIgbtLOutRngHC FSEVETA_InterSampleIgbtLOutRngLC FSEVETA_InterShortCircuitGndC FSEVETA_InterShortCircuitVccC FSEVETA_LowTempCmdBoard2ThdC FSEVETA_LowTempCmdBoardThdC FSEVETA_LowTempDrvLeftThdC FSEVETA_LowTempIgbtLeftThdC FSEVETA_LutInTempCmdBoardC FSEVETA_LutInTempDrvBoardC FSEVETA_LutInTempIgbtCU FSEVETA_LutInTempIgbtCV FSEVETA_LutInTempIgbtCW FSEVETA_LutInTempPt100C FSEVETA_LutOutTempCmdBoardC FSEVETA_LutOutTempDrvBoardC FSEVETA_LutOutTempIgbtCU FSEVETA_LutOutTempIgbtCV FSEVETA_LutOutTempIgbtCW FSEVETA_LutOutTempPt100C FSEVETA_MotorSpeedC FSEVETA_OffsetTempCoolingC FSEVETA_OffsetTempDrvBoardLeftC FSEVETA_OffsetTempIgbtLeftC FSEVETA_OffsetTempLVCmdBoardC FSEVETA_OperationalC FSEVETA_SampleIgbtHOutRngHC FSEVETA_SampleIgbtHOutRngLC FSEVETA_SampleIgbtLOutRngHC FSEVETA_SampleIgbtLOutRngLC FSEVETA_ShortCircuitGndC FSEVETA_ShortCircuitVccC FSEVETA_TempRationalEnC FSEVIBT_A2DGainIbatHVC FSEVIBT_A2dMaxValueC FSEVIBT_A2dMinValueC FSEVIBT_A2DOutRngHThresholdHC FSEVIBT_A2DOutRngHThresholdLC FSEVIBT_A2DOutRngLThresholdHC FSEVIBT_A2DOutRngLThresholdLC FSEVIBT_AccumulatorC FSEVIBT_ALutInIbatAdC FSEVIBT_ALutOutIbatC FSEVIBT_CurrenCalEnalbeC FSEVIBT_CurrenOffsetInitC FSEVIBT_CutOffFrequencyC FSEVIBT_GainDec2AmpsC FSEVIBT_HighCurrentThrC FSEVIBT_IbatFaultEnaC FSEVIBT_IbatRmsGainC FSEVIBT_Init2DurationC FSEVIBT_Init2FreqC FSEVIBT_K2TableC FSEVIBT_LowCurrentThrC FSEVIBT_LutIbatRmsC FSEVIBT_LutIbatRmsGainC FSEVIBT_RmsCalculationCounterC FSEVIBT_ShortCircuitGndC FSEVIBT_ShortCircuitVccC FSEXCTX_AdLowerLimitC FSEXCTX_AdUpperLimitC FSEXCTX_DrtGainC FSEXCTX_HalfADRangeC FSEXCTX_IbatRmsGainC FSEXCTX_PwrThr2C FSEXCTX_RmsCalculationCounterC FSEXCTX_SpdCutOffFreqC FSEXCTX_SpdRangeThrC FSEXCTX_SpdThrC FSEXCTX_TolTqrLmtEnC FSEXCTX_TorComFreqC FSEXCTX_TqrThrC FSMTMTA_A2dMaxValueC FSMTMTA_A2dMinValueC FSMTMTA_A2DOutRngHThresholdHC FSMTMTA_A2DOutRngHThresholdLC FSMTMTA_A2DOutRngLThresholdHC FSMTMTA_A2DOutRngLThresholdLC FSMTMTA_AbnoramlWdgTempC FSMTMTA_CutOffFrequencyC FSMTMTA_GainTempWindingHead1C FSMTMTA_GainTempWindingHead2C FSMTMTA_HighTempWdgHead1ThdC FSMTMTA_HighTempWdgHead2ThdC FSMTMTA_LowTempWindingHead1ThdC FSMTMTA_LowTempWindingHead2ThdC FSMTMTA_LutInTempMotorC FSMTMTA_LutOutTempMotorC FSMTMTA_OffsetTempWindingHead1C FSMTMTA_OffsetTempWindingHead2C FSMTMTA_OilTempNormalC FSMTMTA_ShortCircuitGndC FSMTMTA_ShortCircuitVccC FSMTRDG_A2dMaxValueC FSMTRDG_A2dMinValueC FSMTRDG_A2DOffsetCosHC FSMTRDG_A2DOffsetCosLC FSMTRDG_A2DOffsetExtationC FSMTRDG_A2DOffsetSinHC FSMTRDG_A2DOffsetSinLC FSMTRDG_CosHScalingC FSMTRDG_CosLScalingC FSMTRDG_CutOffFrequencyC FSMTRDG_ExitationScalingC FSMTRDG_GainCosHC FSMTRDG_GainCosLC FSMTRDG_GainExitationVoltC FSMTRDG_GainSinHC FSMTRDG_GainSinLC FSMTRDG_IOFilterC FSMTRDG_SinHScalingC FSMTRDG_SinLScalingC FSSMACS_AbsMecaSpeedTrC FSSMACS_AkdStartVoltageC FSSMACS_AkdStopVoltageC FSSMACS_BenchKL15EnaC FSSMACS_BenchModeC FSSMACS_HiPwrRdyVoltC FSSMACS_HiPwrStbVoltC FSSMACS_KL15FilterC FSSMACS_OcCntMaxValueC FSSMACS_OcLowVolMaxC FSSMACS_OcLowVolMinC FSSMACS_PreCharFinVoltC FSSMACS_ReverseKL15EnaC FSSMACS_SpeedReadyFilterC FSSMACS_SpeedReadyThresholdC FSSMACS_TorqueExitSpdThrdC FSSMACS_UdsOCBenchModeOnOffC FSSMACS_UdsOcEnableC FSSMACS_UdsOcRdResFlagC FSSMACS_UdsOcStartReqC FSSMACS_ZeroTorqCounterC FSSMMAM_AclStateBypassOnOffC FSSMMAM_AclStateBypassValueC FSTCGTC_AbsSpdFildTrC FSTCGTC_AccPedPosLowC FSTCGTC_CounterInitU16C FSTCGTC_CtrlTrC FSTCGTC_CurLoadTqrC FSTCGTC_DividC FSTCGTC_fC FSTCGTC_GearCtrlEnaC FSTCGTC_HacCounter0C FSTCGTC_HacCounterC FSTCGTC_HacEnSpeedThrdC FSTCGTC_HacExitSpeedThrdC FSTCGTC_HacExitTorqDiffC FSTCGTC_HacModeEnaC FSTCGTC_HacOpenLoopTrqFildTrC FSTCGTC_HacTorqueFildTrC FSTCGTC_I0dqTgtC FSTCGTC_jC FSTCGTC_LcRotSpdThrC FSTCGTC_LcRotTqrC FSTCGTC_LutInCtrlIntC FSTCGTC_LutInTrqCompSpdC FSTCGTC_LutOutOpLpTrqTgtC FSTCGTC_LutOutTrqCompTorqC FSTCGTC_MaxOpenTorqueC FSTCGTC_MecaSpdOffsetC FSTCGTC_MotorMaxTorqueC FSTCGTC_OutSlewRateActC FSTCGTC_RelayLowC FSTCGTC_RelayUpC FSTCGTC_SpdCutOffFreqC FSTCGTC_SpdFiltEnC FSTCGTC_StandbyFilterC FSTCGTC_TorqTranCounterC FSTCGTC_TorqueFirstFildTrC FSTCGTC_TorquePreFildTrC FSTCGTC_TorqueTgtC FSTCGTC_TorqueTgtModeC FSTCGTC_TrqSatThrdC FSTCGTC_TrqSlewRateLutInBatC FSTCGTC_TrqSlewRateLutInSpdRpmC FSTCGTC_TrqSlewRateLutOutC FSTCGTC_U0dqTgtC FSTCGTC_ZeroSpdOffC FSTCGTC_ZeroSpdOnC FSTCGTC_ZeroToqueLowSpeedThrdC FSTCGTC_ZeroTorqueCompTgtC FSTCGTC_ZeroTorqueOffsetEnableC SAASITV_ADMaxValueC SAASITV_ADMinValueC SAASITV_MainSup1ScalGainC SAASITV_MainSup1ScalOffsetC SAASITV_MaxANVolC SAASITV_MinANVolC SAASITV_SnsSup1ScalGainC SAASITV_SnsSup1ScalOffsetC SAASITV_SnsSup2ScalGainC SAASITV_SnsSup2ScalOffsetC SAASITV_SupVolCutOffFreqC SABKP_ADMaxValueC SABKP_ADMinValueC SABKPV_ADBkpVolGainC SABKPV_ADBkpVolOffsetC SABKPV_BkpVolCutOffFreqC SABKPV_BkpVScalGainC SABKPV_BkpVScalOffsetC SABKPV_MaxBkpVolC SABKPV_MinBkpVolC SABKPV_VolThrC SADDV_ADMaxValueC SADDV_ADMinValueC SADDV_ADP5VolHSGainC SADDV_ADP5VolHSOffsetC SADDV_ADP5VolLSGainC SADDV_ADP5VolLSOffsetC SADDV_MaxP5VolC SADDV_MinP5VolC SADDV_P5VolCutOffFreqC SADDV_P5VScalGainC SAFSSM_AclStateBypassOnOffC SAFSSM_AclStateBypassValueC SAFTSM_AclStateBypassOnOffC SAFTSM_AclStateBypassValueC SAFTSM_FtModeReqBypassOnOffC SAFTSM_FtModeReqBypassValueC SAMTEPD_ErrAngleThdC SATDETD_AddC SATDETD_LowLmtC SATDETD_MinusC SATDETD_PnC SATDETD_Te_FreqCutOffC SATDETD_TorqueChangeRateThC SATDETD_TorqueRef2Eor SATDETD_UpLmtC TCCMCCS_BenchIdcTgtEnC TCCMCCS_BenchMotorDirRevEnC TCCMCCS_CurCtrlKiC TCCMCCS_CurCtrlKpC TCCMCCS_IdcFirstFildTrC TCCMCCS_IdcTargetSlewRateC TCCMCCS_OutSlewRateActC TCCMSPC_BenchSpdLoopBypassEnC TCCMSPC_BenchSpeedMergeEnC TCCMSPC_BenchSpeedRpmTgtC TCCMSPC_BenchSpeedRpmTgtEnC TCCMSPC_OutSlewRateActC TCCMSPC_SpdCtrlKiC TCCMSPC_SpdCtrlKpC TCCMSPC_SpdMergeRangeC TCCMSPC_SpeedFirstFildTrC TCCMSPC_SpeedTargetSlewRateC TCEVBLV_FreqCutOffC TCEVBLV_GainScalingC TCEVBLV_HighVoltageThr18C TCEVBLV_HighVoltageThr24C TCEVBLV_HighVoltageThr28C TCEVBLV_UnderVoltageThrC TCEVOPR_FreqCutOffC TCEVOTM_A2dMaxValueC TCEVOTM_A2dMinValueC TCEVOTM_FreqCutOffC TCEVOTM_GainTempCoolingC TCEVOTM_LutInTempPt100C TCEVOTM_LutOutTempPt100C TCEVOTM_OffsetTempCoolingC TCEVOTM_OverTemp120C TCEVOTM_OverTemp140C TCMTCUR_A2DCurrentLutInC TCMTCUR_CurContinueC TCMTCUR_CurLoadRatioFcutoffC TCMTCUR_CurrentLoadThrC TCMTCUR_DcCurFreqCutoffC TCMTCUR_FreqCutOffC TCMTCUR_IdcOutC TCMTCUR_IrmsOutC TCMTCUR_OverCurResetLoadThrC TCMTHAL_FreqCutOffC TCMTHAL_OverSpeedThrC TCMTHAL_TcHallFaultTimeOutC TCSMMAM_AclStateBypassOnOffC TCSMMAM_AclStateBypassValueC TCSMMAM_TcModeReqBypassOnOffC TCSMMAM_TcModeReqBypassValueC /end DEF_CHARACTERISTIC
 /begin OUT_MEASUREMENT FS_AccPedPos_F32 FS_ActualTorqueRef_F32 FS_AkdAfterAsc_B FS_AN_ExitationDiag_U16 FS_AntiSsGapDrt_F32 FS_AutoPhasing_F32 FS_BackupVoltRaw_U16 FS_BatVotValidFlag_B FS_BMS_BattSt_B FS_BMS_stMain_Neg_B FS_BMS_stMain_Pos_B FS_BMS_Ubms_F32 FS_BrakDerat_F32 FS_BSWReadyStatus_B FS_CmdAkdRes_B FS_CmdFtShutDownRes_B FS_CmdFtStartRes_B FS_CommandBoardTempHV_U16 FS_CommandBoardTempLV2_U16 FS_CommandBoardTempLV_U16 FS_CoolingTemp_U16 FS_CoolTempValidFlag_B FS_CosHDiag_U16 FS_CosLDiag_U16 FS_CurrentHvPhys_F32 FS_DampTorqueCompTgt_F32 FS_DCDCCooling_F32 FS_DeratingStatus_B FS_DischargeReq_U8 FS_DriverBoardTemp_U16 FS_EmWorkModCmd_U8 FS_EstPowmdlDrtGain_F32 FS_ExcDutyCycle_F32 FS_ExcFreq_F32 FS_EXT_CrashOutSts_U8 FS_FaultLevel_U16 FS_FTAclState_U16 FS_FTResloverFault_B FS_GateDrvState_U16 FS_GCUCooling_F32 FS_HandBrake_B FS_HVnetworkActive_B FS_IbatHV_U16 FS_IbatRmsHV_U16 FS_Id_ref_F32 FS_IO_ExitationDiag_B FS_Iq_ref_F32 FS_Iuvw3_F32[0] FS_Iuvw3_F32[1] FS_Iuvw3_F32[2] FS_KEY_ON_B FS_MaxMinTorqueAvailable_F32 FS_MaxPowerD_F32 FS_MecaSpeedRds_F32 FS_MecaSpeedRpm_F32 FS_MinPowerG_F32 FS_MotorAppliedTorque_F32 FS_MotorMagnetDrtGain_F32 FS_MotorWindingDrtGain_F32 FS_MotorWindingTemp1_U16 FS_MotorWindingTemp1L_U16 FS_MotorWindingTemp2_U16 FS_MotorWindingTemp2L_U16 FS_OcCycleFinish_B FS_OcRotoringFailFlg_B FS_OilTemp_F32 FS_P5VPort_U16 FS_PowerModuleTemp_U_U16 FS_PowerModuleTemp_V_U16 FS_PowerModuleTemp_W_U16 FS_PowmdlDrtGain_F32 FS_SinHDiag_U16 FS_SinLDiag_U16 FS_SlideSlopReq_B FS_TorqueSlewRate_F32 FS_UbatHV_U16 FS_UbatLV_U16 FS_UdsOcEnable_B FS_UdsOcRdResFlag_B FS_UdsOcStartReq_B FS_VCU_BMS_RlyClsReq_U8 FS_VCU_DCU_CurrMax_F32 FS_VCU_DCU_CurrMin_F32 FS_VCU_DCU_ModeReq_Inv_U8 FS_VCU_DCU_ModeReq_U8 FS_VCU_DCU_SpdSet_F32 FS_VCU_DCU_TorqMax_F32 FS_VCU_DCU_TorqMin_F32 FS_VCU_DCU_TorqSet_F32 FS_VCU_DCU_TorqSet_Rdd_F32 FS_VCU_DCU_VoltMax_F32 FS_VCU_DCU_VoltMin_F32 FS_VCU_PreChargeRlySts_B FS_VcuMcuEnableReq_U8 FS_VsiPwmDutyCycle3_F32[0] FS_VsiPwmDutyCycle3_F32[1] FS_VsiPwmDutyCycle3_F32[2] FSEVBHV_A2DResCorrdVoltage FSEVBHV_HighVoltReady FSEVBHV_LowVoltageWarnDetnZ FSEVBHV_SampleVolOutRngHDetn FSEVBHV_SampleVolOutRngLDetn FSEVBHV_UnderVoltageWarnDetn FSEVBHV_VolNotRationalDetn FSEVBHV_VolNotRationalErr FSEVBHV_Voltage FSEVBHV_VoltageFild FSEVBHV_VoltageFildZ FSEVBHV_VoltageGndDetn FSEVBHV_VoltageInv FSEVBHV_VoltageVccDetn FSEVBLV_A2DResCorrdBkpVolt FSEVBLV_A2DResCorrdVoltage FSEVBLV_BkpVolt FSEVBLV_LowVoltageWarnDetnZ FSEVBLV_UnderVolFlag FSEVBLV_UnderVoltageWarnDetn FSEVBLV_Voltage FSEVBLV_VoltageFild FSEVBLV_VoltageFildZ FSEVBLV_VoltageGndDetn FSEVBLV_VoltageVccDetn FSEVETA_CoolingRationalDetn FSEVETA_CorrdTempCooling FSEVETA_CorrdTempDrvBoardLeft FSEVETA_CorrdTempIgbtLeftU FSEVETA_CorrdTempIgbtLeftV FSEVETA_CorrdTempIgbtLeftW FSEVETA_CorrdTempLVCmdBoard FSEVETA_CorrdTempLVCmdBoard2 FSEVETA_CounterNumberZ FSEVETA_CtlBdTempRationalDetn FSEVETA_DrvTempRationDetn FSEVETA_IgbtTempRationa FSEVETA_IgbtTempSlopOver FSEVETA_IgbtTempZ FSEVETA_OverTempNTC1CmdBoardDetn FSEVETA_OverTempNTC2CmdBoardDetn FSEVETA_SampleIgbtTempOutRngHDetn FSEVETA_SampleIgbtTempOutRngLDetn FSEVETA_TempCmdBoard FSEVETA_TempCooling FSEVETA_TempCoolingFild FSEVETA_TempCoolingFildZ FSEVETA_TempDrvBoard FSEVETA_TempDrvBoardLeft FSEVETA_TempDrvBoardLeftFild FSEVETA_TempDrvBoardLeftFildZ FSEVETA_TempDrvBoardLeftGndDetn FSEVETA_TempDrvBoardLeftVccDetn FSEVETA_TempIgbt FSEVETA_TempIgbtLeftFild FSEVETA_TempIgbtLeftFildU FSEVETA_TempIgbtLeftFildV FSEVETA_TempIgbtLeftFildW FSEVETA_TempIgbtLeftFildZU FSEVETA_TempIgbtLeftFildZV FSEVETA_TempIgbtLeftFildZW FSEVETA_TempIgbtLeftU FSEVETA_TempIgbtLeftV FSEVETA_TempIgbtLeftW FSEVETA_TempLVCmdBoard FSEVETA_TempLVCmdBoard2 FSEVETA_TempLVCmdBoard2Fild FSEVETA_TempLVCmdBoard2FildZ FSEVETA_TempLVCmdBoardFild FSEVETA_TempLVCmdBoardFildZ FSEVETA_TempNTC1CmdBoardGndDetn FSEVETA_TempNTC1CmdBoardVccDetn FSEVETA_TempNTC2CmdBoardDetn FSEVETA_TempNTC2CmdBoardGndDetn FSEVETA_TempNTC2CmdBoardVccDetn FSEVETA_UnderTempDrvLeftDetn FSEVETA_UnderTempIgbtLeftDetn FSEVETA_UnderTempNTC1CmdBoardDetn FSEVETA_UnderTempNTC2CmdBoardDetn FSEVIBT_1ByAccumulator FSEVIBT_A2DOffsetIbatHV FSEVIBT_A2DOffsetSumIbatHVZ FSEVIBT_A2DResCorrdIbatHV FSEVIBT_A2DResCorrdIbatRmsHV FSEVIBT_AD2Phys FSEVIBT_CurrentGndDetn FSEVIBT_CurrentVccDetn FSEVIBT_IbatHV FSEVIBT_IbatHVFild FSEVIBT_IbatHVFildZ FSEVIBT_IbatRmsCalcEnable FSEVIBT_IbatRmsHV FSEVIBT_IbatRmsHV1 FSEVIBT_OverCurrentDetn FSEVIBT_RmsCalculationCounter FSEVIBT_RmsOffset FSEVIBT_SampleNumberZ FSEVIBT_SampleVolOutRngHDetn FSEVIBT_SampleVolOutRngLDetn FSEVIBT_SumSquareIbatRms FSEVIBT_SumSquareIbatRmsLatch FSEVIBT_SumSquareIbatRmsOld FSEVIBT_UnderCurrentDetn FSEXCTX_9550MultiTorque FSEXCTX_DCcurrentActual FSEXCTX_DCvoltActual FSEXCTX_DeratingStatus FSEXCTX_ElectricPower FSEXCTX_ErrorLevel FSEXCTX_EstiHvDcPower FSEXCTX_EstiIbatHv FSEXCTX_EstiIbatHvRms FSEXCTX_Fault1 FSEXCTX_Fault2 FSEXCTX_Fault3 FSEXCTX_FaultLampInd FSEXCTX_GateDrvState FSEXCTX_HVReadyStatus FSEXCTX_Idirect FSEXCTX_InverterTemp FSEXCTX_Iquadra FSEXCTX_MaxAvailableTorque FSEXCTX_MaxAvailableTorqueRed FSEXCTX_MCURepairInd FSEXCTX_Meca2DcPower FSEXCTX_MecaPowerSign FSEXCTX_MinAvailableTorque FSEXCTX_MinAvailableTorqueRed FSEXCTX_MotorAppliedTorque FSEXCTX_MotorAppliedTorqueRed FSEXCTX_MotorSpeed FSEXCTX_MotorSpeedFildZ FSEXCTX_MotorSpeedRed FSEXCTX_MotorState FSEXCTX_MotorTemp FSEXCTX_OffsetCalInd FSEXCTX_OffsetCalReq FSEXCTX_ProofSysEfficiency FSEXCTX_ResolverOffsetAngle FSEXCTX_RotorTemp FSEXCTX_SumSquareIbatRmsOld FSEXCTX_SwVerNum1 FSEXCTX_SwVerNum2 FSEXCTX_SwVerNum3 FSEXCTX_SwVerNum4 FSEXCTX_SysEfficiency FSEXCTX_SystemEfficiency FSEXCTX_SysTempOvrInd FSEXCTX_TorqueCompFildZ FSMTMTA_CorrdTempWindingHead1 FSMTMTA_CorrdTempWindingHead2 FSMTMTA_OverTempWdgHead2Detn FSMTMTA_TempWindHead1OutRngHDetn FSMTMTA_TempWindHead1OutRngLDetn FSMTMTA_TempWindHead2OutRngHDetn FSMTMTA_TempWindHead2OutRngLDetn FSMTMTA_TempWindHeadRationalDetn FSMTMTA_TempWinding[0] FSMTMTA_TempWinding[1] FSMTMTA_TempWindingHead1 FSMTMTA_TempWindingHead1Fild FSMTMTA_TempWindingHead1FildZ FSMTMTA_TempWindingHead2 FSMTMTA_TempWindingHead2Fild FSMTMTA_TempWindingHead2FildZ FSMTMTA_TempWindingHead2GndDetn FSMTMTA_TempWindingHead2VccDetn FSMTMTA_TempWindingMax FSMTMTA_UnderTempWdgHead1Detn FSMTMTA_UnderTempWdgHead2Detn FSMTRDG_A2DResCorrdCosH FSMTRDG_A2DResCorrdCosL FSMTRDG_A2DResCorrdExitation FSMTRDG_A2DResCorrdSinH FSMTRDG_A2DResCorrdSinL FSMTRDG_CosHGndDetn FSMTRDG_CosHVccDetn FSMTRDG_CosHVolt FSMTRDG_CosHVoltFild FSMTRDG_CosHVoltFildZ FSMTRDG_CosLegInternalFailDetn FSMTRDG_CosLegNormal FSMTRDG_CosLegOpen FSMTRDG_CosLegOpenDetn FSMTRDG_CosLegShortGnd FSMTRDG_CosLegShortGndDetn FSMTRDG_CosLegShortVcc FSMTRDG_CosLegShortVccDetn FSMTRDG_CosLGndDetn FSMTRDG_CosLVccDetn FSMTRDG_CosLVolt FSMTRDG_CosLVoltFild FSMTRDG_CosLVoltFildZ FSMTRDG_ExcDutyCycleErrDetn FSMTRDG_ExcFreqErrDetn FSMTRDG_ExcInternalFail FSMTRDG_ExcInternalFailDetn FSMTRDG_ExcNormal FSMTRDG_ExcOpen FSMTRDG_ExcOpenDetn FSMTRDG_ExcShortGnd FSMTRDG_ExcShortVcc FSMTRDG_ExcSignalGNDDetn FSMTRDG_ExcSignalVCCDetn FSMTRDG_ExcVoltageFild FSMTRDG_ExcVoltageFildZ FSMTRDG_ExitationDiagIO FSMTRDG_ExitationGndDetn FSMTRDG_ExitationVccDetn FSMTRDG_ExitationVolt FSMTRDG_IOcounterZ FSMTRDG_IOinZ FSMTRDG_IOoutZ FSMTRDG_OverVoltageDetn FSMTRDG_SinCosHLGnd FSMTRDG_SinCosHLOpen FSMTRDG_SinCosHLVcc FSMTRDG_SinHGndDetn FSMTRDG_SinHVccDetn FSMTRDG_SinHVolt FSMTRDG_SinHVoltFild FSMTRDG_SinHVoltFildZ FSMTRDG_SinLegInternalFail FSMTRDG_SinLegInternalFailDetn FSMTRDG_SinLegNormal FSMTRDG_SinLegOpen FSMTRDG_SinLegOpenDetn FSMTRDG_SinLegShortGnd FSMTRDG_SinLegShortGndDetn FSMTRDG_SinLegShortVcc FSMTRDG_SinLegShortVccDetn FSMTRDG_SinLGndDetn FSMTRDG_SinLVccDetn FSMTRDG_SinLVolt FSMTRDG_SinLVoltFild FSMTRDG_SinLVoltFildZ FSMTRDG_UnderVoltageDetn FSSMACS_AbsMecaSpeedRpmFild FSSMACS_AbsMecaSpeedRpmFildZ FSSMACS_AclState FSSMACS_CmdAkdReq FSSMACS_CmdFtShutDownReq FSSMACS_CmdFtStartReq FSSMACS_CmdPwmOffReq FSSMACS_CmdSleepReq FSSMACS_CmdSwShutDownReq FSSMACS_DCUMode FSSMACS_DCUModeZ FSSMACS_DisChargeStatus FSSMACS_DisChargeStatusZ FSSMACS_Flag FSSMACS_FTModeReq FSSMACS_GateDrvSt FSSMACS_KL15 FSSMACS_KL15counterZ FSSMACS_KL15in FSSMACS_KL15inZ FSSMACS_KL15outZ FSSMACS_McuCtrlMod FSSMACS_McuEnableSts FSSMACS_McuWorkMod FSSMACS_OcFailure FSSMACS_OcFinish FSSMACS_PrechargeFinish FSSMACS_SCSpeedReady FSSMACS_SCSpeedReadyinZ FSSMACS_SCSpeedReadyoutZ FSSMACS_SpeedReadycounterZ FSSMACS_TorqueEnable FSSMMAM_AclState FSSMMAM_EVBHV_CheckEnable FSSMMAM_EVBLV_CheckEnable FSSMMAM_EVIBT_State FSSMMAM_MTRDG_CheckEnable FSTCGTC_AccPedPosDisable FSTCGTC_AddCurZ FSTCGTC_CrashFlag FSTCGTC_CtrlIntegratorZ FSTCGTC_CtrlKi FSTCGTC_CtrlKp FSTCGTC_CtrlPropTgt FSTCGTC_CtrlTgt FSTCGTC_CurLoad FSTCGTC_EpsilonCtrl FSTCGTC_FirstFildZ FSTCGTC_HacCtrlTrqTgt FSTCGTC_HacCtrlTrqTgtSatZ FSTCGTC_HacDisable FSTCGTC_HacEnable FSTCGTC_HacModeDetn FSTCGTC_HacModeDetnZ FSTCGTC_HacNumberZ FSTCGTC_HacSpdSREnable FSTCGTC_HacTimeout FSTCGTC_HacTimeOutZ FSTCGTC_HacTrqAbsDisable FSTCGTC_I0dqTgt[0] FSTCGTC_I0dqTgt[1] FSTCGTC_I0dqTgt[2] FSTCGTC_LutOutOpLpTrqTgt FSTCGTC_LutOutOpLpTrqTgtZ FSTCGTC_MaxPwrCalTqr FSTCGTC_MaxTqr FSTCGTC_MaxTqrZ FSTCGTC_MecaSpeedRpmTgt FSTCGTC_MinPwrCalTqr FSTCGTC_OpenLoopTrqTgtZ FSTCGTC_OpenLpSumTgt FSTCGTC_PwrLmtMaxTqr FSTCGTC_PwrLmtMinTqr FSTCGTC_SlewLimitTorqueTgt FSTCGTC_SpeedAbsFildZ FSTCGTC_SpeedFildZ FSTCGTC_StandbyCounterZ FSTCGTC_StandbyDetninZ FSTCGTC_StandbyDetnZ FSTCGTC_TorqTranNumberZ FSTCGTC_TorqueOrgTgtPhy FSTCGTC_TorquePreTgtZ FSTCGTC_TorqueRefLimMot FSTCGTC_TorqueRefLimZ FSTCGTC_TorqueTgt FSTCGTC_TorqueTgtPhy FSTCGTC_TorqueTgtPhyComp FSTCGTC_TorqueTgtPhyCompZ FSTCGTC_TorqueTgtPhyZ FSTCGTC_TorqueTgtZ FSTCGTC_TorqueTranEn FSTCGTC_TsatActv FSTCGTC_TsatActvZ FSTCGTC_U0dqTgt[0] FSTCGTC_U0dqTgt[1] FSTCGTC_U0dqTgt[2] FSTCGTC_ZeroTorqueCompEnable SA_A2DResCorrdVoltage_F32 SA_ADBackupVol_U16 SA_ADMainSup1_U16 SA_ADMP5VRef1_U16 SA_ADP5VolHS_U16 SA_ADP5VoLS_U16 SA_ADSnsSup1_U16 SA_ADSnsSup2_U16 SA_AutoPhase_F32 SA_BatVotFlag_B SA_BMSDCCurrent_F32 SA_BmsVolt_F32 SA_CosScaled_F32 SA_DeratingStatus_B SA_EntrySlideFlag_B SA_Fai_F32 SA_FaultLevel_U16 SA_FsAclState_U16 SA_FSEVBHV_Voltage_F32 SA_FtAclState_U16 SA_FTModeReq_U16 SA_GeneratorDCCurrent_F32 SA_IdAct_F32 SA_IqAct_F32 SA_Ld_F32 SA_Lq_F32 SA_PllEstAgl_F32 SA_SinScaled_F32 SA_SpeedRpm_F32 SA_TorqueRef_F32 SA_VcuMcuEnableReq_U8 SAASITV_ADMainSup1VCorred SAASITV_ADSnsSup1VCorred SAASITV_ADSnsSup2VCorred SAASITV_CheckEnable SAASITV_MainSup1Vol SAASITV_MainSup1VolFildZ SAASITV_MP5VRef1VolFildZ SAASITV_SnsSup1Vol SAASITV_SnsSup1VolFildZ SAASITV_SnsSup2Vol SAASITV_SnsSup2VolFildZ SABKP_ADBkpVolCorred SABKPV_BkpVol SABKPV_BkpVolFildZ SABKPV_CheckEnable SADDV_ADP5VolHSCorred SADDV_ADP5VolLSCorred SADDV_CheckEnable SADDV_P5VolHS SADDV_P5VolHSFild SADDV_P5VolHSFildZ SADDV_P5VolLS SADDV_P5VolLSFild SADDV_P5VolLSFildZ SAFSSM_AclState SAFSSM_EVBHV_CheckEnable SAFSSM_EVBLV_CheckEnable SAFSSM_EVIBT_State SAFSSM_MTRDG_CheckEnable SAFTSM_AclState SAFTSM_EVEIT_MainEnable SAFTSM_FTCIVDC_State SAFTSM_FTCMCCS_State SAFTSM_FTCMSCS_State SAFTSM_FTCMTCS_State SAFTSM_FtModeReq SAFTSM_MTLCS_State SAFTSM_MTMEP_State SAMTEAL_AglRadError SAMTEAL_EorAgldu SAMTEAL_EstAlg SAMTEAL_PllEstAglXPi SAMTEPD_ErorAngle SATDETD_CheckEnable SATDETD_EstiamtedElecTorque SATDETD_FaultFlag SATDETD_SumZ SATDETD_TeFilteredZ SATDETD_TorqueActEorr SATDETD_TorqueChangeRateAbs SATDTCD_CheckEnable SATDTR_CheckEnable TC_A2DRawBusVoltage TC_A2DRawCurrent TC_A2DRawOilPressure TC_A2DRawOilTemp TC_A2DRawVoffset TC_BldcWorkMode TC_ExtAdcCalibDoneFlg TC_ExtCmdShutDownReq TC_ExtCmdStartReq TC_ExtFaultLevel TC_ExtHallStatus TC_ExtIdcTarget TC_ExtPwmDutyTarget TC_HallRawCapCnt TC_SpeedTarget TCCMCCS_DirectionCmd TCCMCCS_DutyCycle TCCMCCS_IdcCtrlIntegratorZ TCCMCCS_IdcRef TCCMCCS_IdcRefFiltZ TCCMCCS_IdcTgtRampZ TCCMSPC_DirCmd TCCMSPC_IdcTarget TCCMSPC_MergedSpeedFdb TCCMSPC_SpeedCtrlIntegratorZ TCCMSPC_SpeedRef TCCMSPC_SpeedTgtZ TCCMSPC_TorqueRefLimZ TCEVBLV_FilterOut TCEVBLV_FilterOutZ TCEVBLV_TcOverVolHighFlg TCEVBLV_TcOverVolLowFlg TCEVBLV_TcOverVolMidFlg TCEVBLV_TcUnderVolFlg TCEVOPR_FilterOutZ TCEVOPR_OilPressFilt TCEVOPR_RawOilPress TCEVOTM_FilterOutZ TCEVOTM_OilOverTmpFaultFlg TCEVOTM_OilPmpOverTmpWarFlg TCEVOTM_OilTempAdc TCEVOTM_OilTempAdcFilt TCEVOTM_OilTempAdcNoMinMaxFilt TCEVOTM_OilTempFilt TCEVOTM_RawOilTemp TCMTCUR_CurLoadRatio TCMTCUR_CurLoadRatioFilterZ TCMTCUR_CurrentFaultZ TCMTCUR_CurrentFiltered TCMTCUR_CurrentFilteredZ TCMTCUR_CurrentLoad TCMTCUR_CurrentRms TCMTCUR_DcCurFilt TCMTCUR_DcCurFilterZ TCMTCUR_RawDcCurFdb TCMTCUR_RealRawCurrent TCMTCUR_TcOverCurFlg TCMTHAL_FilterOutZ TCMTHAL_HallFaultTimeOutZ TCMTHAL_RotorStopFlag TCMTHAL_SpdFdb TCMTHAL_SpdFdbFilt TCMTHAL_StallCounterZ TCMTHAL_TcHallFaultFlg TCMTHAL_TcOverSpdFlg TCSALFM_OilOverTmpFaultDetn TCSALFM_OilPmpOverTmpWarDetn TCSALFM_TcOverCurDetn TCSALFM_TcOverSpdDetn TCSALFM_TcOverVolHighDetn TCSALFM_TcOverVolLowDetn TCSALFM_TcOverVolMidDetn TCSALFM_TcUnderVolDetn TCSMACS_AclPreState TCSMACS_AclState TCSMACS_CmdClearDutyReq TCSMACS_CmdPwmOffReq TCSMACS_CmdShutDownReq TCSMACS_CmdStartReq TCSMACS_ReadFlashDataFlg TCSMACS_SaveData2FlashFlg TCSMMAM_BldcWorkMode /end OUT_MEASUREMENT
/end FUNCTION
/begin FUNCTION SWC_FT ""
 /begin OUT_MEASUREMENT FT_AkdAfterAsc_B FT_AntiShake_B FT_BhvCheckEna_B FT_CmdFtShutDownReq_B FT_CmdFtStartReq_B FT_CmdPwmDirectRes_B FT_CmdPwmOffRes_B FT_CoolingTemp_F32 FT_DutyCycle3_F32[0] FT_DutyCycle3_F32[1] FT_DutyCycle3_F32[2] FT_ElecSpeedRds_F32 FT_ErrThetaRdSurPi_F32 FT_EXTAntiSlideEnable_B FT_EXTPrechargeFinish_B FT_FaultLevel_U16 FT_FTModeReq_U16 FT_HacModeDetn_B FT_I0dqTgt3_F32[0] FT_I0dqTgt3_F32[1] FT_I0dqTgt3_F32[2] FT_Iuvw3_U16[0] FT_Iuvw3_U16[1] FT_Iuvw3_U16[2] FT_Iuvw3Rms_F32[0] FT_Iuvw3Rms_F32[1] FT_Iuvw3Rms_F32[2] FT_MecaSpeedRds_F32 FT_MecaSpeedRpm_F32 FT_MecaSpeedRpmTgt_F32 FT_MotorMagnetTemp_F32 FT_MotorWindingTemp2_F32[0] FT_MotorWindingTemp2_F32[1] FT_PosiCurrentDelay_F32 FT_PowerModuleTemp_F32 FT_PwmZeroMatch_B FT_PwrLmtTqrMax_F32 FT_PwrLmtTqrMin_F32 FT_PwrMaxMinTqr_F32[0] FT_PwrMaxMinTqr_F32[1] FT_RandomNum_U32 FT_ResloverThetaRdSuiPi_F32 FT_ResThetaRdSurPiOc_F32 FT_SinCosNextThetaElec_F32[0] FT_SinCosNextThetaElec_F32[1] FT_SinCosThetaElec_F32[0] FT_SinCosThetaElec_F32[1] FT_SpdInitialValue_F32 FT_TorqueTgt_F32 FT_U0dqTgt3_F32[0] FT_U0dqTgt3_F32[1] FT_U0dqTgt3_F32[2] FT_UbatHV_F32 FT_VcuDampEnable_B FT_VsiPwmPeriod_F32 FT_VsiPwmRatioRes_U8 FTASBDS_BattVoltDrtGainMax FTASBDS_BattVoltDrtGainMin FTASDPM_DeratingStatus /end OUT_MEASUREMENT
/end FUNCTION
/end MODULE
/end PROJECT
