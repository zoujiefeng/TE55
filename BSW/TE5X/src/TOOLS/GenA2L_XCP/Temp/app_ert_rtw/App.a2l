ASAP2_VERSION 1 31
/begin PROJECT ProjectName "Project Comment Goes Here"
/begin HEADER "Header Comments go here" /end HEADER
/begin MODULE ModuleName "Module Comment Goes Here"
/begin MOD_COMMON "Mod Common Comment Here" BYTE_ORDER MSB_FIRST /end MOD_COMMON
/begin RECORD_LAYOUT Scalar_BOOLEAN FNC_VALUES 1 UBYTE COLUMN_DIR DIRECT /end RECORD_LAYOUT
/begin RECORD_LAYOUT Scalar_UBYTE FNC_VALUES 1 UBYTE COLUMN_DIR DIRECT /end RECORD_LAYOUT
/begin RECORD_LAYOUT Scalar_UWORD FNC_VALUES 1 UWORD COLUMN_DIR DIRECT /end RECORD_LAYOUT
/begin RECORD_LAYOUT Scalar_SWORD FNC_VALUES 1 SWORD COLUMN_DIR DIRECT /end RECORD_LAYOUT
/begin RECORD_LAYOUT Scalar_FLOAT32_IEEE FNC_VALUES 1 FLOAT32_IEEE COLUMN_DIR DIRECT /end RECORD_LAYOUT
/begin RECORD_LAYOUT Lookup1D_WORD FNC_VALUES 1 SWORD COLUMN_DIR DIRECT /end RECORD_LAYOUT
/begin RECORD_LAYOUT Lookup1D_X_WORD AXIS_PTS_X 1 SWORD INDEX_INCR DIRECT /end RECORD_LAYOUT
/begin COMPU_METHOD CM_T_Cnt_Num_1_1_u16 "Q = V" RAT_FUNC "%5.0" "Num (counts)" COEFFS 0 1 0 0 0 1 /end COMPU_METHOD
/begin COMPU_METHOD CM_T_r_NA_256_1_u16 "Q = V*256.000000" RAT_FUNC "%11.8" "NA (none)" COEFFS 0 256 0 0 0 1 /end COMPU_METHOD
/begin COMPU_METHOD CM_T_y_BitField8 "Q = V" RAT_FUNC "%3.0" "BitField" COEFFS 0 1 0 0 0 1 /end COMPU_METHOD
/begin COMPU_METHOD CM_T_Cnt_Num_1_1_u8 "Q = V" RAT_FUNC "%3.0" "Num (counts)" COEFFS 0 1 0 0 0 1 /end COMPU_METHOD
/begin COMPU_METHOD CM_T_BOOLEAN "Q = V" RAT_FUNC "%1.0" "Bool" COEFFS 0 1 0 0 0 1 /end COMPU_METHOD
/begin COMPU_METHOD CM_T_y_BitFieldDiagStatus "Q = V" RAT_FUNC "%3.0" "BitField" COEFFS 0 1 0 0 0 1 /end COMPU_METHOD
/begin COMPU_METHOD CM_T_y_BitFieldDiagProgress "Q = V" RAT_FUNC "%3.0" "BitField" COEFFS 0 1 0 0 0 1 /end COMPU_METHOD
/* (add any file trailer comments here) */ /* EOF CAND.a2l */
/begin RECORD_LAYOUT Scalar_BOOLEAN FNC_VALUES 1 UBYTE COLUMN_DIR DIRECT /end RECORD_LAYOUT
/begin RECORD_LAYOUT Scalar_UBYTE FNC_VALUES 1 UBYTE COLUMN_DIR DIRECT /end RECORD_LAYOUT
/begin RECORD_LAYOUT Scalar_UWORD FNC_VALUES 1 UWORD COLUMN_DIR DIRECT /end RECORD_LAYOUT
/begin RECORD_LAYOUT Scalar_SWORD FNC_VALUES 1 SWORD COLUMN_DIR DIRECT /end RECORD_LAYOUT
/begin RECORD_LAYOUT Scalar_FLOAT32_IEEE FNC_VALUES 1 FLOAT32_IEEE COLUMN_DIR DIRECT /end RECORD_LAYOUT
/begin RECORD_LAYOUT Lookup1D_WORD FNC_VALUES 1 SWORD COLUMN_DIR DIRECT /end RECORD_LAYOUT
/begin RECORD_LAYOUT Lookup1D_X_WORD AXIS_PTS_X 1 SWORD INDEX_INCR DIRECT /end RECORD_LAYOUT
/begin COMPU_METHOD CM_T_p_kPa_1_1_s16 "Q = V" RAT_FUNC "%5.0" "kPa (kiloPascals  (kPa))" COEFFS 0 1 0 0 0 1 /end COMPU_METHOD
/begin COMPU_METHOD CM_T_n_rpm_1_1_s16 "Q = V" RAT_FUNC "%5.0" "rpm (revolutions / minute  (rpm))" COEFFS 0 1 0 0 0 1 /end COMPU_METHOD
/begin COMPU_METHOD CM_T_Cnt_Num_1_1_u16 "Q = V" RAT_FUNC "%5.0" "Num (counts)" COEFFS 0 1 0 0 0 1 /end COMPU_METHOD
/begin COMPU_METHOD CM_T_M_Nm_32_1_s16 "Q = V*32.000000" RAT_FUNC "%9.5" "Nm (newton-meters  (Nm))" COEFFS 0 32 0 0 0 1 /end COMPU_METHOD
/begin COMPU_METHOD CM_T_r_NA_1024_1_s16 "Q = V*1024.000000" RAT_FUNC "%12.10" "NA (none)" COEFFS 0 1024 0 0 0 1 /end COMPU_METHOD
/begin COMPU_METHOD CM_T_T_degC_16_1_s16 "Q = V*16.000000" RAT_FUNC "%8.4" "degC (degrees Celsius  (deg C))" COEFFS 0 16 0 0 0 1 /end COMPU_METHOD
/begin COMPU_METHOD CM_T_K_NA_1024_1_u16 "Q = V*1024.000000" RAT_FUNC "%12.10" "NA (dependent upon the gain)" COEFFS 0 1024 0 0 0 1 /end COMPU_METHOD
/begin COMPU_METHOD CM_T_r_NA_16384_1_s16 "Q = V*16384.000000" RAT_FUNC "%15.14" "NA (none)" COEFFS 0 16384 0 0 0 1 /end COMPU_METHOD
/begin COMPU_METHOD CM_T_BOOLEAN "Q = V" RAT_FUNC "%1.0" "Bool" COEFFS 0 1 0 0 0 1 /end COMPU_METHOD
/begin COMPU_METHOD CM_T_P_kW_128_1_s16 "Q = V*128.000000" RAT_FUNC "%10.7" "kW (kilowatts  (kW))" COEFFS 0 128 0 0 0 1 /end COMPU_METHOD
/* EOF CCAP.a2l */
/begin RECORD_LAYOUT Scalar_BOOLEAN FNC_VALUES 1 UBYTE COLUMN_DIR DIRECT /end RECORD_LAYOUT
/begin RECORD_LAYOUT Scalar_UBYTE FNC_VALUES 1 UBYTE COLUMN_DIR DIRECT /end RECORD_LAYOUT
/begin RECORD_LAYOUT Scalar_UWORD FNC_VALUES 1 UWORD COLUMN_DIR DIRECT /end RECORD_LAYOUT
/begin RECORD_LAYOUT Scalar_SWORD FNC_VALUES 1 SWORD COLUMN_DIR DIRECT /end RECORD_LAYOUT
/begin RECORD_LAYOUT Scalar_FLOAT32_IEEE FNC_VALUES 1 FLOAT32_IEEE COLUMN_DIR DIRECT /end RECORD_LAYOUT
/begin RECORD_LAYOUT Lookup1D_WORD FNC_VALUES 1 SWORD COLUMN_DIR DIRECT /end RECORD_LAYOUT
/begin RECORD_LAYOUT Lookup1D_X_WORD AXIS_PTS_X 1 SWORD INDEX_INCR DIRECT /end RECORD_LAYOUT
/begin COMPU_METHOD CM_T_M_Nm_32_1_s16 "Q = V*32.000000" RAT_FUNC "%9.5" "Nm (newton-meters  (Nm))" COEFFS 0 32 0 0 0 1 /end COMPU_METHOD
/begin COMPU_METHOD CM_T_r_NA_16384_1_s16 "Q = V*16384.000000" RAT_FUNC "%15.14" "NA (none)" COEFFS 0 16384 0 0 0 1 /end COMPU_METHOD
/begin COMPU_METHOD CM_T_n_rpm_1_1_s16 "Q = V" RAT_FUNC "%5.0" "rpm (revolutions / minute  (rpm))" COEFFS 0 1 0 0 0 1 /end COMPU_METHOD
/begin COMPU_METHOD CM_T_Cnt_Num_1_1_u16 "Q = V" RAT_FUNC "%5.0" "Num (counts)" COEFFS 0 1 0 0 0 1 /end COMPU_METHOD
/begin COMPU_METHOD CM_T_BOOLEAN "Q = V" RAT_FUNC "%1.0" "Bool" COEFFS 0 1 0 0 0 1 /end COMPU_METHOD
/* EOF CLCO.a2l */
/begin RECORD_LAYOUT Scalar_BOOLEAN FNC_VALUES 1 UBYTE COLUMN_DIR DIRECT /end RECORD_LAYOUT
/begin RECORD_LAYOUT Scalar_UBYTE FNC_VALUES 1 UBYTE COLUMN_DIR DIRECT /end RECORD_LAYOUT
/begin RECORD_LAYOUT Scalar_UWORD FNC_VALUES 1 UWORD COLUMN_DIR DIRECT /end RECORD_LAYOUT
/begin RECORD_LAYOUT Scalar_SWORD FNC_VALUES 1 SWORD COLUMN_DIR DIRECT /end RECORD_LAYOUT
/begin RECORD_LAYOUT Scalar_FLOAT32_IEEE FNC_VALUES 1 FLOAT32_IEEE COLUMN_DIR DIRECT /end RECORD_LAYOUT
/begin RECORD_LAYOUT Lookup1D_WORD FNC_VALUES 1 SWORD COLUMN_DIR DIRECT /end RECORD_LAYOUT
/begin RECORD_LAYOUT Lookup1D_X_WORD AXIS_PTS_X 1 SWORD INDEX_INCR DIRECT /end RECORD_LAYOUT
/begin COMPU_METHOD CM_T_Pct_pct_256_1_s16 "Q = V*256.000000" RAT_FUNC "%11.8" "pct (percent  (%))" COEFFS 0 256 0 0 0 1 /end COMPU_METHOD
/begin COMPU_METHOD CM_T_n_rpm_1_1_s16 "Q = V" RAT_FUNC "%5.0" "rpm (revolutions / minute  (rpm))" COEFFS 0 1 0 0 0 1 /end COMPU_METHOD
/begin COMPU_METHOD CM_T_p_kPa_32_1_u16 "Q = V*32.000000" RAT_FUNC "%9.5" "kPa (kiloPascals  (kPa))" COEFFS 0 32 0 0 0 1 /end COMPU_METHOD
/begin COMPU_METHOD CM_T_T_degC_16_1_s16 "Q = V*16.000000" RAT_FUNC "%8.4" "degC (degrees Celsius  (deg C))" COEFFS 0 16 0 0 0 1 /end COMPU_METHOD
/begin COMPU_METHOD CM_T_p_kPa_1_1_s16 "Q = V" RAT_FUNC "%5.0" "kPa (kiloPascals  (kPa))" COEFFS 0 1 0 0 0 1 /end COMPU_METHOD
/begin COMPU_METHOD CM_T_K_NA_1024_1_u16 "Q = V*1024.000000" RAT_FUNC "%12.10" "NA (dependent upon the gain)" COEFFS 0 1024 0 0 0 1 /end COMPU_METHOD
/begin COMPU_METHOD CM_T_I_A_32_1_s16 "Q = V*32.000000" RAT_FUNC "%9.5" "A (amperes  (A))" COEFFS 0 32 0 0 0 1 /end COMPU_METHOD
/begin COMPU_METHOD CM_T_r_NA_32768_1_u16 "Q = V*32768.000000" RAT_FUNC "%16.15" "NA (none)" COEFFS 0 32768 0 0 0 1 /end COMPU_METHOD
/begin COMPU_METHOD CM_T_Cnt_Num_1_1_u16 "Q = V" RAT_FUNC "%5.0" "Num (counts)" COEFFS 0 1 0 0 0 1 /end COMPU_METHOD
/begin COMPU_METHOD CM_T_p_kPa_64_1_s16 "Q = V*64.000000" RAT_FUNC "%10.6" "kPa (kiloPascals  (kPa))" COEFFS 0 64 0 0 0 1 /end COMPU_METHOD
/begin COMPU_METHOD CM_T_M_Nm_32_1_s16 "Q = V*32.000000" RAT_FUNC "%9.5" "Nm (newton-meters  (Nm))" COEFFS 0 32 0 0 0 1 /end COMPU_METHOD
/begin COMPU_METHOD CM_T_I_A_Float32 "Q = V" RAT_FUNC "%8.6" "A (amperes  (A))" COEFFS 0 1 0 0 0 1 /end COMPU_METHOD
/begin COMPU_METHOD CM_T_Pct_pct_10_1_s16 "Q = V*10.000000" RAT_FUNC "%0.6" "pct (percent  (%))" COEFFS 0 10 0 0 0 1 /end COMPU_METHOD
/begin COMPU_METHOD CM_T_K_NA_32768_1_u16 "Q = V*32768.000000" RAT_FUNC "%16.15" "NA (dependent upon the gain)" COEFFS 0 32768 0 0 0 1 /end COMPU_METHOD
/begin COMPU_METHOD CM_T_r_NA_1024_1_s16 "Q = V*1024.000000" RAT_FUNC "%12.10" "NA (none)" COEFFS 0 1024 0 0 0 1 /end COMPU_METHOD
/begin COMPU_METHOD CM_T_Cnt_Num_1_1_u8 "Q = V" RAT_FUNC "%3.0" "Num (counts)" COEFFS 0 1 0 0 0 1 /end COMPU_METHOD
/begin COMPU_METHOD CM_T_BOOLEAN "Q = V" RAT_FUNC "%1.0" "Bool" COEFFS 0 1 0 0 0 1 /end COMPU_METHOD
/begin COMPU_METHOD CM_T_r_NA_Float32 "Q = V" RAT_FUNC "%8.6" "NA (none)" COEFFS 0 1 0 0 0 1 /end COMPU_METHOD
/* EOF CLPC.a2l */
/begin RECORD_LAYOUT Scalar_BOOLEAN FNC_VALUES 1 UBYTE COLUMN_DIR DIRECT /end RECORD_LAYOUT
/begin RECORD_LAYOUT Scalar_UBYTE FNC_VALUES 1 UBYTE COLUMN_DIR DIRECT /end RECORD_LAYOUT
/begin RECORD_LAYOUT Scalar_UWORD FNC_VALUES 1 UWORD COLUMN_DIR DIRECT /end RECORD_LAYOUT
/begin RECORD_LAYOUT Scalar_SWORD FNC_VALUES 1 SWORD COLUMN_DIR DIRECT /end RECORD_LAYOUT
/begin RECORD_LAYOUT Scalar_FLOAT32_IEEE FNC_VALUES 1 FLOAT32_IEEE COLUMN_DIR DIRECT /end RECORD_LAYOUT
/begin RECORD_LAYOUT Lookup1D_WORD FNC_VALUES 1 SWORD COLUMN_DIR DIRECT /end RECORD_LAYOUT
/begin RECORD_LAYOUT Lookup1D_X_WORD AXIS_PTS_X 1 SWORD INDEX_INCR DIRECT /end RECORD_LAYOUT
/begin COMPU_METHOD CM_SPARte_e_Validity "Enumerated data type: SPARte_e_Validity" TAB_VERB "%0.6" "" COMPU_TAB_REF VTAB_FOR_CM_SPARte_e_Validity /end COMPU_METHOD
/begin COMPU_VTAB VTAB_FOR_CM_SPARte_e_Validity "Enumerated data type: SPARte_e_Validity" TAB_VERB 4 0 "SPARce_e_Valid" 1 "SPARce_e_Invalid" 2 "SPARce_e_EstimatedReplaceValue" 3 "SPARce_e_NotEvaluatedYet" /end COMPU_VTAB
/begin COMPU_METHOD CM_T_Cnt_Num_1_1_u8 "Q = V" RAT_FUNC "%3.0" "Num (counts)" COEFFS 0 1 0 0 0 1 /end COMPU_METHOD
/begin COMPU_METHOD CM_T_BOOLEAN "Q = V" RAT_FUNC "%1.0" "Bool" COEFFS 0 1 0 0 0 1 /end COMPU_METHOD
/* EOF FDMA.a2l */
/begin RECORD_LAYOUT Scalar_BOOLEAN FNC_VALUES 1 UBYTE COLUMN_DIR DIRECT /end RECORD_LAYOUT
/begin RECORD_LAYOUT Scalar_UBYTE FNC_VALUES 1 UBYTE COLUMN_DIR DIRECT /end RECORD_LAYOUT
/begin RECORD_LAYOUT Scalar_UWORD FNC_VALUES 1 UWORD COLUMN_DIR DIRECT /end RECORD_LAYOUT
/begin RECORD_LAYOUT Scalar_SWORD FNC_VALUES 1 SWORD COLUMN_DIR DIRECT /end RECORD_LAYOUT
/begin RECORD_LAYOUT Scalar_FLOAT32_IEEE FNC_VALUES 1 FLOAT32_IEEE COLUMN_DIR DIRECT /end RECORD_LAYOUT
/begin RECORD_LAYOUT Lookup1D_WORD FNC_VALUES 1 SWORD COLUMN_DIR DIRECT /end RECORD_LAYOUT
/begin RECORD_LAYOUT Lookup1D_X_WORD AXIS_PTS_X 1 SWORD INDEX_INCR DIRECT /end RECORD_LAYOUT
/begin COMPU_METHOD CM_T_n_rpm_1_1_s16 "Q = V" RAT_FUNC "%5.0" "rpm (revolutions / minute  (rpm))" COEFFS 0 1 0 0 0 1 /end COMPU_METHOD
/begin COMPU_METHOD CM_SPARte_e_Validity "Enumerated data type: SPARte_e_Validity" TAB_VERB "%0.6" "" COMPU_TAB_REF VTAB_FOR_CM_SPARte_e_Validity /end COMPU_METHOD
/begin COMPU_VTAB VTAB_FOR_CM_SPARte_e_Validity "Enumerated data type: SPARte_e_Validity" TAB_VERB 4 0 "SPARce_e_Valid" 1 "SPARce_e_Invalid" 2 "SPARce_e_EstimatedReplaceValue" 3 "SPARce_e_NotEvaluatedYet" /end COMPU_VTAB
/begin COMPU_METHOD CM_T_Cnt_Num_1_1_u8 "Q = V" RAT_FUNC "%3.0" "Num (counts)" COEFFS 0 1 0 0 0 1 /end COMPU_METHOD
/begin COMPU_METHOD CM_T_BOOLEAN "Q = V" RAT_FUNC "%1.0" "Bool" COEFFS 0 1 0 0 0 1 /end COMPU_METHOD
/begin RECORD_LAYOUT Scalar_BOOLEAN FNC_VALUES 1 UBYTE COLUMN_DIR DIRECT /end RECORD_LAYOUT
/begin RECORD_LAYOUT Scalar_UBYTE FNC_VALUES 1 UBYTE COLUMN_DIR DIRECT /end RECORD_LAYOUT
/begin RECORD_LAYOUT Scalar_UWORD FNC_VALUES 1 UWORD COLUMN_DIR DIRECT /end RECORD_LAYOUT
/begin RECORD_LAYOUT Scalar_SWORD FNC_VALUES 1 SWORD COLUMN_DIR DIRECT /end RECORD_LAYOUT
/begin RECORD_LAYOUT Scalar_FLOAT32_IEEE FNC_VALUES 1 FLOAT32_IEEE COLUMN_DIR DIRECT /end RECORD_LAYOUT
/begin RECORD_LAYOUT Lookup1D_WORD FNC_VALUES 1 SWORD COLUMN_DIR DIRECT /end RECORD_LAYOUT
/begin RECORD_LAYOUT Lookup1D_X_WORD AXIS_PTS_X 1 SWORD INDEX_INCR DIRECT /end RECORD_LAYOUT
/begin COMPU_METHOD CM_T_n_rpm_1_1_s16 "Q = V" RAT_FUNC "%5.0" "rpm (revolutions / minute  (rpm))" COEFFS 0 1 0 0 0 1 /end COMPU_METHOD
/begin COMPU_METHOD CM_T_Cnt_Num_1_1_u16 "Q = V" RAT_FUNC "%5.0" "Num (counts)" COEFFS 0 1 0 0 0 1 /end COMPU_METHOD
/begin COMPU_METHOD CM_T_dV_lpm_128_1_s16 "Q = V*128.000000" RAT_FUNC "%10.7" "lpm (liters / minute  (l/m))" COEFFS 0 128 0 0 0 1 /end COMPU_METHOD
/begin COMPU_METHOD CM_T_p_kPa_32_1_u16 "Q = V*32.000000" RAT_FUNC "%9.5" "kPa (kiloPascals  (kPa))" COEFFS 0 32 0 0 0 1 /end COMPU_METHOD
/begin COMPU_METHOD CM_T_M_Nm_32_1_s16 "Q = V*32.000000" RAT_FUNC "%9.5" "Nm (newton-meters  (Nm))" COEFFS 0 32 0 0 0 1 /end COMPU_METHOD
/begin COMPU_METHOD CM_T_T_degC_16_1_s16 "Q = V*16.000000" RAT_FUNC "%8.4" "degC (degrees Celsius  (deg C))" COEFFS 0 16 0 0 0 1 /end COMPU_METHOD
/begin COMPU_METHOD CM_T_r_NA_1024_1_s16 "Q = V*1024.000000" RAT_FUNC "%12.10" "NA (none)" COEFFS 0 1024 0 0 0 1 /end COMPU_METHOD
/begin COMPU_METHOD CM_T_BOOLEAN "Q = V" RAT_FUNC "%1.0" "Bool" COEFFS 0 1 0 0 0 1 /end COMPU_METHOD
/* EOF SWIN.a2l */
/begin RECORD_LAYOUT Scalar_BOOLEAN FNC_VALUES 1 UBYTE COLUMN_DIR DIRECT /end RECORD_LAYOUT
/begin RECORD_LAYOUT Scalar_UBYTE FNC_VALUES 1 UBYTE COLUMN_DIR DIRECT /end RECORD_LAYOUT
/begin RECORD_LAYOUT Scalar_UWORD FNC_VALUES 1 UWORD COLUMN_DIR DIRECT /end RECORD_LAYOUT
/begin RECORD_LAYOUT Scalar_SWORD FNC_VALUES 1 SWORD COLUMN_DIR DIRECT /end RECORD_LAYOUT
/begin RECORD_LAYOUT Scalar_FLOAT32_IEEE FNC_VALUES 1 FLOAT32_IEEE COLUMN_DIR DIRECT /end RECORD_LAYOUT
/begin RECORD_LAYOUT Lookup1D_WORD FNC_VALUES 1 SWORD COLUMN_DIR DIRECT /end RECORD_LAYOUT
/begin RECORD_LAYOUT Lookup1D_X_WORD AXIS_PTS_X 1 SWORD INDEX_INCR DIRECT /end RECORD_LAYOUT
/begin COMPU_METHOD CM_T_T_degC_16_1_s16 "Q = V*16.000000" RAT_FUNC "%8.4" "degC (degrees Celsius  (deg C))" COEFFS 0 16 0 0 0 1 /end COMPU_METHOD
/begin COMPU_METHOD CM_T_BOOLEAN "Q = V" RAT_FUNC "%1.0" "Bool" COEFFS 0 1 0 0 0 1 /end COMPU_METHOD
/begin COMPU_METHOD CM_T_n_rpm_1_1_s16 "Q = V" RAT_FUNC "%5.0" "rpm (revolutions / minute  (rpm))" COEFFS 0 1 0 0 0 1 /end COMPU_METHOD
/begin COMPU_METHOD CM_T_I_A_32_1_s16 "Q = V*32.000000" RAT_FUNC "%9.5" "A (amperes  (A))" COEFFS 0 32 0 0 0 1 /end COMPU_METHOD
/begin COMPU_METHOD CM_T_Pct_pct_10_1_s16 "Q = V*10.000000" RAT_FUNC "%0.6" "pct (percent  (%))" COEFFS 0 10 0 0 0 1 /end COMPU_METHOD
/begin COMPU_METHOD CM_T_y_BitFieldDiagStatus "Q = V" RAT_FUNC "%3.0" "BitField" COEFFS 0 1 0 0 0 1 /end COMPU_METHOD
/begin COMPU_METHOD CM_T_y_BitField8 "Q = V" RAT_FUNC "%3.0" "BitField" COEFFS 0 1 0 0 0 1 /end COMPU_METHOD
/* EOF TAMD.a2l */
/begin RECORD_LAYOUT Scalar_BOOLEAN FNC_VALUES 1 UBYTE COLUMN_DIR DIRECT /end RECORD_LAYOUT
/begin RECORD_LAYOUT Scalar_UBYTE FNC_VALUES 1 UBYTE COLUMN_DIR DIRECT /end RECORD_LAYOUT
/begin RECORD_LAYOUT Scalar_UWORD FNC_VALUES 1 UWORD COLUMN_DIR DIRECT /end RECORD_LAYOUT
/begin RECORD_LAYOUT Scalar_SWORD FNC_VALUES 1 SWORD COLUMN_DIR DIRECT /end RECORD_LAYOUT
/begin RECORD_LAYOUT Scalar_FLOAT32_IEEE FNC_VALUES 1 FLOAT32_IEEE COLUMN_DIR DIRECT /end RECORD_LAYOUT
/begin RECORD_LAYOUT Lookup1D_WORD FNC_VALUES 1 SWORD COLUMN_DIR DIRECT /end RECORD_LAYOUT
/begin RECORD_LAYOUT Lookup1D_X_WORD AXIS_PTS_X 1 SWORD INDEX_INCR DIRECT /end RECORD_LAYOUT
/begin COMPU_METHOD CM_T_n_rpm_1_1_s16 "Q = V" RAT_FUNC "%5.0" "rpm (revolutions / minute  (rpm))" COEFFS 0 1 0 0 0 1 /end COMPU_METHOD
/begin COMPU_METHOD CM_T_T_degC_16_1_s16 "Q = V*16.000000" RAT_FUNC "%8.4" "degC (degrees Celsius  (deg C))" COEFFS 0 16 0 0 0 1 /end COMPU_METHOD
/begin COMPU_METHOD CM_T_Pct_pct_256_1_s16 "Q = V*256.000000" RAT_FUNC "%11.8" "pct (percent  (%))" COEFFS 0 256 0 0 0 1 /end COMPU_METHOD
/begin COMPU_METHOD CM_T_I_A_Float32 "Q = V" RAT_FUNC "%8.6" "A (amperes  (A))" COEFFS 0 1 0 0 0 1 /end COMPU_METHOD
/begin COMPU_METHOD CM_T_Cnt_Num_1_1_u16 "Q = V" RAT_FUNC "%5.0" "Num (counts)" COEFFS 0 1 0 0 0 1 /end COMPU_METHOD
/begin COMPU_METHOD CM_T_Pct_pct_10_1_s16 "Q = V*10.000000" RAT_FUNC "%0.6" "pct (percent  (%))" COEFFS 0 10 0 0 0 1 /end COMPU_METHOD
/begin COMPU_METHOD CM_T_K_NA_32768_1_u16 "Q = V*32768.000000" RAT_FUNC "%16.15" "NA (dependent upon the gain)" COEFFS 0 32768 0 0 0 1 /end COMPU_METHOD
/begin COMPU_METHOD CM_T_r_NA_32768_1_u16 "Q = V*32768.000000" RAT_FUNC "%16.15" "NA (none)" COEFFS 0 32768 0 0 0 1 /end COMPU_METHOD
/begin COMPU_METHOD CM_T_BOOLEAN "Q = V" RAT_FUNC "%1.0" "Bool" COEFFS 0 1 0 0 0 1 /end COMPU_METHOD
/begin COMPU_METHOD CM_T_r_NA_Float32 "Q = V" RAT_FUNC "%8.6" "NA (none)" COEFFS 0 1 0 0 0 1 /end COMPU_METHOD
/begin COMPU_METHOD CM_T_Cnt_Num_1_1_u8 "Q = V" RAT_FUNC "%3.0" "Num (counts)" COEFFS 0 1 0 0 0 1 /end COMPU_METHOD
/begin COMPU_METHOD CM_T_dV_lpm_128_1_s16 "Q = V*128.000000" RAT_FUNC "%10.7" "lpm (liters / minute  (l/m))" COEFFS 0 128 0 0 0 1 /end COMPU_METHOD
/* EOF TCFC.a2l */
/begin RECORD_LAYOUT Scalar_BOOLEAN FNC_VALUES 1 UBYTE COLUMN_DIR DIRECT /end RECORD_LAYOUT
/begin RECORD_LAYOUT Scalar_UBYTE FNC_VALUES 1 UBYTE COLUMN_DIR DIRECT /end RECORD_LAYOUT
/begin RECORD_LAYOUT Scalar_UWORD FNC_VALUES 1 UWORD COLUMN_DIR DIRECT /end RECORD_LAYOUT
/begin RECORD_LAYOUT Scalar_SWORD FNC_VALUES 1 SWORD COLUMN_DIR DIRECT /end RECORD_LAYOUT
/begin RECORD_LAYOUT Scalar_FLOAT32_IEEE FNC_VALUES 1 FLOAT32_IEEE COLUMN_DIR DIRECT /end RECORD_LAYOUT
/begin RECORD_LAYOUT Lookup1D_WORD FNC_VALUES 1 SWORD COLUMN_DIR DIRECT /end RECORD_LAYOUT
/begin RECORD_LAYOUT Lookup1D_X_WORD AXIS_PTS_X 1 SWORD INDEX_INCR DIRECT /end RECORD_LAYOUT
/begin CHARACTERISTIC TCFRke_T_CAP_PS_LowFanOff "Switching point for not requesting low fan due to CAP PowerStage temp less than this value" VALUE 0x0000 /* @ECU_Address@TCFRke_T_CAP_PS_LowFanOff@ */ Scalar_SWORD 0 CM_T_T_degC_16_1_s16 -2048.0 2047.9375 /end CHARACTERISTIC
/begin CHARACTERISTIC TCFRke_T_CAP_PS_LowFanOn "Switching point for requesting low fan due to CAP PowerStage temp greater than this value" VALUE 0x0000 /* @ECU_Address@TCFRke_T_CAP_PS_LowFanOn@ */ Scalar_SWORD 0 CM_T_T_degC_16_1_s16 -2048.0 2047.9375 /end CHARACTERISTIC
/begin CHARACTERISTIC TCFRke_T_CCPM_PS_OverTempRelease "This is the CCPM Powerstage temperature to release CCP degradation, if the CCP flow request has been lowered to MinLubrication due to Powerstage temperature the degradation will be released when the Powerstage temperature goes below this value" VALUE 0x0000 /* @ECU_Address@TCFRke_T_CCPM_PS_OverTempRelease@ */ Scalar_SWORD 0 CM_T_T_degC_16_1_s16 -2048.0 2047.9375 /end CHARACTERISTIC
/begin CHARACTERISTIC TCFRke_T_CCPM_PS_OverTempSet "This is the CCPM Powerstage temperature to activate CCP degradation, if Powerstage temperature is above this limit the CCP flow request is lowered to MinLubrication" VALUE 0x0000 /* @ECU_Address@TCFRke_T_CCPM_PS_OverTempSet@ */ Scalar_SWORD 0 CM_T_T_degC_16_1_s16 -2048.0 2047.9375 /end CHARACTERISTIC
/begin CHARACTERISTIC TCFRke_T_CCP_PS_HighFanOff "Switching point for not requesting high fan due to CCP PowerStage temp less than this value" VALUE 0x0000 /* @ECU_Address@TCFRke_T_CCP_PS_HighFanOff@ */ Scalar_SWORD 0 CM_T_T_degC_16_1_s16 -2048.0 2047.9375 /end CHARACTERISTIC
/begin CHARACTERISTIC TCFRke_T_CCP_PS_HighFanOn "Switching point for requesting high fan due to CCP PowerStage temp greater than this value" VALUE 0x0000 /* @ECU_Address@TCFRke_T_CCP_PS_HighFanOn@ */ Scalar_SWORD 0 CM_T_T_degC_16_1_s16 -2048.0 2047.9375 /end CHARACTERISTIC
/begin CHARACTERISTIC TCFRke_T_CCP_PS_LowFanOff "Switching point for not requesting low fan due to CCP PowerStage temp less than this value" VALUE 0x0000 /* @ECU_Address@TCFRke_T_CCP_PS_LowFanOff@ */ Scalar_SWORD 0 CM_T_T_degC_16_1_s16 -2048.0 2047.9375 /end CHARACTERISTIC
/begin CHARACTERISTIC TCFRke_T_CCP_PS_LowFanOn "Switching point for requesting low fan due to CCP PowerStage temp greater than this value" VALUE 0x0000 /* @ECU_Address@TCFRke_T_CCP_PS_LowFanOn@ */ Scalar_SWORD 0 CM_T_T_degC_16_1_s16 -2048.0 2047.9375 /end CHARACTERISTIC
/begin CHARACTERISTIC TCFRke_T_MaxCAP_PS_ForClutchActuation "Maximum CAP PowerStage temperature for indicating clutch actuation available, Clutch Actuation will be indicated as unavailable if CAP PS temperature is greater than this value" VALUE 0x0000 /* @ECU_Address@TCFRke_T_MaxCAP_PS_ForClutchActuation@ */ Scalar_SWORD 0 CM_T_T_degC_16_1_s16 -2048.0 2047.9375 /end CHARACTERISTIC
/begin CHARACTERISTIC TCFRke_T_MaxCCP_PS_ForCoolingIOC "Maximum CCP PowerStage temperature for allowing Cooling IOC (ShortTermAdjustment), IOC wont be allowed if CCP PS temp is greater than this value" VALUE 0x0000 /* @ECU_Address@TCFRke_T_MaxCCP_PS_ForCoolingIOC@ */ Scalar_SWORD 0 CM_T_T_degC_16_1_s16 -2048.0 2047.9375 /end CHARACTERISTIC
/begin CHARACTERISTIC TCFRke_T_MaxDiffForCurrentSetpointUpdate "This specifies the temperature change for setting a new setpoint for MinLubrication, if the absolute difference between the current oil-temperature and the \"stored\" temperature for current MinLubrication setpoint is greater than this value then a new MinLubrication setpoint will be made" VALUE 0x0000 /* @ECU_Address@TCFRke_T_MaxDiffForCurrentSetpointUpdate@ */ Scalar_SWORD 0 CM_T_T_degC_16_1_s16 0.0 2047.9375 EXTENDED_LIMITS -2048.0 2047.9375 /end CHARACTERISTIC
/begin CHARACTERISTIC TCFRke_T_MaxOilForCoolingIOC "Maximum OilTemp for allowing Cooling IOC (ShortTermAdjustment), IOC wont be allowed if OilTemp is greater than this value" VALUE 0x0000 /* @ECU_Address@TCFRke_T_MaxOilForCoolingIOC@ */ Scalar_SWORD 0 CM_T_T_degC_16_1_s16 -2048.0 2047.9375 /end CHARACTERISTIC
/begin CHARACTERISTIC TCFRke_T_MaxP1MotorForCoolingIOC "Maximum P1 Motor temperature for allowing Cooling IOC (ShortTermAdjustment), IOC wont be allowed if P1 Motor temp is greater than this value" VALUE 0x0000 /* @ECU_Address@TCFRke_T_MaxP1MotorForCoolingIOC@ */ Scalar_SWORD 0 CM_T_T_degC_16_1_s16 -2048.0 2047.9375 /end CHARACTERISTIC
/begin CHARACTERISTIC TCFRke_T_MaxP3MotorForCoolingIOC "Maximum P3 Motor temperature for allowing Cooling IOC (ShortTermAdjustment), IOC wont be allowed if P3 Motor temp is greater than this value" VALUE 0x0000 /* @ECU_Address@TCFRke_T_MaxP3MotorForCoolingIOC@ */ Scalar_SWORD 0 CM_T_T_degC_16_1_s16 -2048.0 2047.9375 /end CHARACTERISTIC
/begin CHARACTERISTIC TCFRke_T_MinOilForClutchActuation "Minimum OilTemp for indicating clutch actuation available, Clutch Actuation will be indicated as unavailable if OilTemp is less than this value" VALUE 0x0000 /* @ECU_Address@TCFRke_T_MinOilForClutchActuation@ */ Scalar_SWORD 0 CM_T_T_degC_16_1_s16 -2048.0 2047.9375 /end CHARACTERISTIC
/begin CHARACTERISTIC TCFRke_T_OilLongCoolingAfterRun "Oil temp limit for long cooling afterrun, long time will be used if oil temp is greater than this value" VALUE 0x0000 /* @ECU_Address@TCFRke_T_OilLongCoolingAfterRun@ */ Scalar_SWORD 0 CM_T_T_degC_16_1_s16 -2048.0 2047.9375 /end CHARACTERISTIC
/begin CHARACTERISTIC TCFRke_T_OilShortCoolingAfterRun "Oil temp limit for short cooling afterrun, short time will be used if oil temp is greater than this value (unless any condition for long time fulfilled, then long will be used instead)" VALUE 0x0000 /* @ECU_Address@TCFRke_T_OilShortCoolingAfterRun@ */ Scalar_SWORD 0 CM_T_T_degC_16_1_s16 -2048.0 2047.9375 /end CHARACTERISTIC
/begin CHARACTERISTIC TCFRke_T_OilTempDropToFinishAfterRun "Oil temperature drop since ignition off limit for early exit of cooling afterrun, if oil temperature has dropped more than this value (expected to be set to positive value unless when disabling condition, then set to maximum negative value), then afterrun could be release earlier if other conditions for early exit is fulfilled as well" VALUE 0x0000 /* @ECU_Address@TCFRke_T_OilTempDropToFinishAfterRun@ */ Scalar_SWORD 0 CM_T_T_degC_16_1_s16 0.0 2047.9375 EXTENDED_LIMITS -2048.0 2047.9375 /end CHARACTERISTIC
/begin CHARACTERISTIC TCFRke_T_OilTempHighFanOff "Switching point for turning off high fan request due to oil temp" VALUE 0x0000 /* @ECU_Address@TCFRke_T_OilTempHighFanOff@ */ Scalar_SWORD 0 CM_T_T_degC_16_1_s16 -2048.0 2047.9375 /end CHARACTERISTIC
/begin CHARACTERISTIC TCFRke_T_OilTempHighFanOn "Switching point for turning on high fan request due to oil temp" VALUE 0x0000 /* @ECU_Address@TCFRke_T_OilTempHighFanOn@ */ Scalar_SWORD 0 CM_T_T_degC_16_1_s16 -2048.0 2047.9375 /end CHARACTERISTIC
/begin CHARACTERISTIC TCFRke_T_OilTempLowFanOff "Switching point for turning off low fan request due to oil temp" VALUE 0x0000 /* @ECU_Address@TCFRke_T_OilTempLowFanOff@ */ Scalar_SWORD 0 CM_T_T_degC_16_1_s16 -2048.0 2047.9375 /end CHARACTERISTIC
/begin CHARACTERISTIC TCFRke_T_OilTempLowFanOn "Switching point for turning on low fan request due to oil temp" VALUE 0x0000 /* @ECU_Address@TCFRke_T_OilTempLowFanOn@ */ Scalar_SWORD 0 CM_T_T_degC_16_1_s16 -2048.0 2047.9375 /end CHARACTERISTIC
/begin CHARACTERISTIC TCFRke_T_OilTempMaxFinishAfterRun "Oil temperature limit for early exit of cooling afterrun, if oil temperature is less than this value, then afterrun could be release earlier if other conditions for early exit is fulfilled as well" VALUE 0x0000 /* @ECU_Address@TCFRke_T_OilTempMaxFinishAfterRun@ */ Scalar_SWORD 0 CM_T_T_degC_16_1_s16 -2048.0 2047.9375 /end CHARACTERISTIC
/begin CHARACTERISTIC TCFRke_T_P1MotorHighFanOff "Switching point for turning off high fan request due to P1 motor temp" VALUE 0x0000 /* @ECU_Address@TCFRke_T_P1MotorHighFanOff@ */ Scalar_SWORD 0 CM_T_T_degC_16_1_s16 -2048.0 2047.9375 /end CHARACTERISTIC
/begin CHARACTERISTIC TCFRke_T_P1MotorHighFanOn "Switching point for turning on high fan request due to P1 motor temp" VALUE 0x0000 /* @ECU_Address@TCFRke_T_P1MotorHighFanOn@ */ Scalar_SWORD 0 CM_T_T_degC_16_1_s16 -2048.0 2047.9375 /end CHARACTERISTIC
/begin CHARACTERISTIC TCFRke_T_P1MotorLongCoolingAfterRun "P1 Motor temp limit for long cooling afterrun, long time will be used if P1 Motor temp is greater than this value" VALUE 0x0000 /* @ECU_Address@TCFRke_T_P1MotorLongCoolingAfterRun@ */ Scalar_SWORD 0 CM_T_T_degC_16_1_s16 -2048.0 2047.9375 /end CHARACTERISTIC
/begin CHARACTERISTIC TCFRke_T_P1MotorLowFanOff "Switching point for turning off low fan request due to P1 motor temp" VALUE 0x0000 /* @ECU_Address@TCFRke_T_P1MotorLowFanOff@ */ Scalar_SWORD 0 CM_T_T_degC_16_1_s16 -2048.0 2047.9375 /end CHARACTERISTIC
/begin CHARACTERISTIC TCFRke_T_P1MotorLowFanOn "Switching point for turning on low fan request due to P1 motor temp" VALUE 0x0000 /* @ECU_Address@TCFRke_T_P1MotorLowFanOn@ */ Scalar_SWORD 0 CM_T_T_degC_16_1_s16 -2048.0 2047.9375 /end CHARACTERISTIC
/begin CHARACTERISTIC TCFRke_T_P1MotorShortCoolingAfterRun "P1 Motor temp limit for short cooling afterrun, short time will be used if P1 Motor temp is greater than this value (unless any condition for long time fulfilled, then long will be used instead)" VALUE 0x0000 /* @ECU_Address@TCFRke_T_P1MotorShortCoolingAfterRun@ */ Scalar_SWORD 0 CM_T_T_degC_16_1_s16 -2048.0 2047.9375 /end CHARACTERISTIC
/begin CHARACTERISTIC TCFRke_T_P3MotorHighFanOff "Switching point for turning off high fan request due to P3 motor temp" VALUE 0x0000 /* @ECU_Address@TCFRke_T_P3MotorHighFanOff@ */ Scalar_SWORD 0 CM_T_T_degC_16_1_s16 -2048.0 2047.9375 /end CHARACTERISTIC
/begin CHARACTERISTIC TCFRke_T_P3MotorHighFanOn "Switching point for turning on high fan request due to P3 motor temp" VALUE 0x0000 /* @ECU_Address@TCFRke_T_P3MotorHighFanOn@ */ Scalar_SWORD 0 CM_T_T_degC_16_1_s16 -2048.0 2047.9375 /end CHARACTERISTIC
/begin CHARACTERISTIC TCFRke_T_P3MotorLongCoolingAfterRun "P3 Motor temp limit for long cooling afterrun, long time will be used if P3 Motor temp is greater than this value" VALUE 0x0000 /* @ECU_Address@TCFRke_T_P3MotorLongCoolingAfterRun@ */ Scalar_SWORD 0 CM_T_T_degC_16_1_s16 -2048.0 2047.9375 /end CHARACTERISTIC
/begin CHARACTERISTIC TCFRke_T_P3MotorLowFanOff "Switching point for turning off low fan request due to P3 motor temp" VALUE 0x0000 /* @ECU_Address@TCFRke_T_P3MotorLowFanOff@ */ Scalar_SWORD 0 CM_T_T_degC_16_1_s16 -2048.0 2047.9375 /end CHARACTERISTIC
/begin CHARACTERISTIC TCFRke_T_P3MotorLowFanOn "Switching point for turning on low fan request due to P3 motor temp" VALUE 0x0000 /* @ECU_Address@TCFRke_T_P3MotorLowFanOn@ */ Scalar_SWORD 0 CM_T_T_degC_16_1_s16 -2048.0 2047.9375 /end CHARACTERISTIC
/begin CHARACTERISTIC TCFRke_T_P3MotorShortCoolingAfterRun "P3 Motor temp limit for short cooling afterrun, short time will be used if P3 Motor temp is greater than this value (unless any condition for long time fulfilled, then long will be used instead)" VALUE 0x0000 /* @ECU_Address@TCFRke_T_P3MotorShortCoolingAfterRun@ */ Scalar_SWORD 0 CM_T_T_degC_16_1_s16 -2048.0 2047.9375 /end CHARACTERISTIC
/begin CHARACTERISTIC TCFRke_T_PCB_HighFanOff "Switching point for not requesting high fan due to Controller PCB temp less than this value" VALUE 0x0000 /* @ECU_Address@TCFRke_T_PCB_HighFanOff@ */ Scalar_SWORD 0 CM_T_T_degC_16_1_s16 -2048.0 2047.9375 /end CHARACTERISTIC
/begin CHARACTERISTIC TCFRke_T_PCB_HighFanOn "Switching point for requesting high fan due to Controller PCB temp greater than this value" VALUE 0x0000 /* @ECU_Address@TCFRke_T_PCB_HighFanOn@ */ Scalar_SWORD 0 CM_T_T_degC_16_1_s16 -2048.0 2047.9375 /end CHARACTERISTIC
/begin CHARACTERISTIC TCFRke_T_PCB_LowFanOff "Switching point for not requesting low fan due to Controller PCB temp less than this value" VALUE 0x0000 /* @ECU_Address@TCFRke_T_PCB_LowFanOff@ */ Scalar_SWORD 0 CM_T_T_degC_16_1_s16 -2048.0 2047.9375 /end CHARACTERISTIC
/begin CHARACTERISTIC TCFRke_T_PCB_LowFanOn "Switching point for requesting low fan due to Controller PCB temp greater than this value" VALUE 0x0000 /* @ECU_Address@TCFRke_T_PCB_LowFanOn@ */ Scalar_SWORD 0 CM_T_T_degC_16_1_s16 -2048.0 2047.9375 /end CHARACTERISTIC
/begin CHARACTERISTIC TCFRke_T_PCB_OverTempRelease "This is the controller PCB temperature to release CCP degradation, if the CCP flow request has been lowered to MinLubrication due to controller PCB temperature the degradation will be released when the controller PCB temperature goes below this value" VALUE 0x0000 /* @ECU_Address@TCFRke_T_PCB_OverTempRelease@ */ Scalar_SWORD 0 CM_T_T_degC_16_1_s16 -2048.0 2047.9375 /end CHARACTERISTIC
/begin CHARACTERISTIC TCFRke_T_PCB_OverTempSet "This is the controller PCB temperature to activate CCP degradation, if controller PCB temperature is above this limit the CCP flow request is lowered to MinLubrication" VALUE 0x0000 /* @ECU_Address@TCFRke_T_PCB_OverTempSet@ */ Scalar_SWORD 0 CM_T_T_degC_16_1_s16 -2048.0 2047.9375 /end CHARACTERISTIC
/begin CHARACTERISTIC TCFRie_I_CAP_PhaseCurrentLimitation_Offset "Override offset for signal TCFRve_I_CAP_PhaseCurrentLimitation
      Shall be set to 0 for production SW
      " VALUE 0x0000 /* @ECU_Address@TCFRie_I_CAP_PhaseCurrentLimitation_Offset@ */ Scalar_SWORD 0 CM_T_I_A_32_1_s16 -1024.0 1023.96875 /end CHARACTERISTIC
/begin CHARACTERISTIC TCFRie_I_CurrentAvailableForClutch_Offset "Override offset for signal TCFRve_I_CurrentAvailableForClutch
      Shall be set to 0 for production SW" VALUE 0x0000 /* @ECU_Address@TCFRie_I_CurrentAvailableForClutch_Offset@ */ Scalar_SWORD 0 CM_T_I_A_32_1_s16 -1024.0 1023.96875 /end CHARACTERISTIC
/begin CHARACTERISTIC TCFRke_I_BusbarOverCurrent "This is the busbar maximum current limit, when the current goes above this limit without going below TCFRke_I_BusbarOverCurrentRestore for TCFRke_Cnt_BusbarOverCurrentDelay samples then the CCP limitation will be activated" VALUE 0x0000 /* @ECU_Address@TCFRke_I_BusbarOverCurrent@ */ Scalar_SWORD 0 CM_T_I_A_32_1_s16 0.0 1023.96875 EXTENDED_LIMITS -1024.0 1023.96875 /end CHARACTERISTIC
/begin CHARACTERISTIC TCFRke_I_MinLubricationNewSetPointChange "This is the change of \"stored\" MinLubrication current when a new setpoint is triggered due to change of oil-temp" VALUE 0x0000 /* @ECU_Address@TCFRke_I_MinLubricationNewSetPointChange@ */ Scalar_SWORD 0 CM_T_I_A_32_1_s16 -1024.0 0.0 EXTENDED_LIMITS -1024.0 1023.96875 /end CHARACTERISTIC
/begin CHARACTERISTIC TCFRie_dV_CoolingFlowCommand_Offset "Instrumentation slew offset for TCFRve_dV_CoolingFlowCommand" VALUE 0x0000 /* @ECU_Address@TCFRie_dV_CoolingFlowCommand_Offset@ */ Scalar_SWORD 0 CM_T_dV_lpm_128_1_s16 -256.0 255.9921875 /end CHARACTERISTIC
/begin CHARACTERISTIC TCFRke_dV_CCP_LimitationHighY_Decrease "Decrease rate-limitation of CCP flow limitation based current usage to be used when Y value of Busbar or SumCur is high, in liter/minute per sample (@ 1000ms)" VALUE 0x0000 /* @ECU_Address@TCFRke_dV_CCP_LimitationHighY_Decrease@ */ Scalar_SWORD 0 CM_T_dV_lpm_128_1_s16 -256.0 0.0 EXTENDED_LIMITS -256.0 255.9921875 /end CHARACTERISTIC
/begin CHARACTERISTIC TCFRke_dV_CCP_LimitationHighY_Increase "Increase rate-limitation of CCP flow limitation based current usage to be used when Y value of Busbar or SumCur is high, in liter/minute per sample (@ 1000ms)" VALUE 0x0000 /* @ECU_Address@TCFRke_dV_CCP_LimitationHighY_Increase@ */ Scalar_SWORD 0 CM_T_dV_lpm_128_1_s16 0.0 255.9921875 EXTENDED_LIMITS -256.0 255.9921875 /end CHARACTERISTIC
/begin CHARACTERISTIC TCFRke_dV_CCP_LimitationLowY_Decrease "Decrease rate-limitation of CCP flow limitation based current usage to be used when Y value of Busbar or SumCur is low, in liter/minute per sample (@ 1000ms)" VALUE 0x0000 /* @ECU_Address@TCFRke_dV_CCP_LimitationLowY_Decrease@ */ Scalar_SWORD 0 CM_T_dV_lpm_128_1_s16 -256.0 0.0 EXTENDED_LIMITS -256.0 255.9921875 /end CHARACTERISTIC
/begin CHARACTERISTIC TCFRke_dV_CCP_LimitationLowY_Increase "Increase rate-limitation of CCP flow limitation based current usage to be used when  Y value of Busbar or SumCur is low, in liter/minute per sample (@ 1000ms)" VALUE 0x0000 /* @ECU_Address@TCFRke_dV_CCP_LimitationLowY_Increase@ */ Scalar_SWORD 0 CM_T_dV_lpm_128_1_s16 0.0 255.9921875 EXTENDED_LIMITS -256.0 255.9921875 /end CHARACTERISTIC
/begin CHARACTERISTIC TCFRke_dV_CoolingAfterRun "Cooling flow target to be used when in cooling afterun" VALUE 0x0000 /* @ECU_Address@TCFRke_dV_CoolingAfterRun@ */ Scalar_SWORD 0 CM_T_dV_lpm_128_1_s16 0.0 255.9921875 EXTENDED_LIMITS -256.0 255.9921875 /end CHARACTERISTIC
/begin CHARACTERISTIC TCFRke_dV_MaxCoolingFlow "Maximum limit for cooling flow request" VALUE 0x0000 /* @ECU_Address@TCFRke_dV_MaxCoolingFlow@ */ Scalar_SWORD 0 CM_T_dV_lpm_128_1_s16 0.0 255.9921875 EXTENDED_LIMITS -256.0 255.9921875 /end CHARACTERISTIC
/begin CHARACTERISTIC TCFRke_dV_MinLubricationChangeForNewCurrentSetpoint "This specifies how much the MinLubrication flow can change from last setpoint, if the change is greater than this value the setpoint is updated" VALUE 0x0000 /* @ECU_Address@TCFRke_dV_MinLubricationChangeForNewCurrentSetpoint@ */ Scalar_SWORD 0 CM_T_dV_lpm_128_1_s16 0.0 255.9921875 EXTENDED_LIMITS -256.0 255.9921875 /end CHARACTERISTIC
/begin CHARACTERISTIC TCFRke_dV_SafeCooling "This is the minimum \"Safe Cooling\" flow when function action \"ForceTransOilLubricationToSafeLubricationMode\" is set" VALUE 0x0000 /* @ECU_Address@TCFRke_dV_SafeCooling@ */ Scalar_SWORD 0 CM_T_dV_lpm_128_1_s16 0.0 255.9921875 EXTENDED_LIMITS -256.0 255.9921875 /end CHARACTERISTIC
/begin CHARACTERISTIC TCFRke_dV_SafeLubrication "This is the minimum \"Safe Lubrication\" flow when function action \"ForceTransOilLubricationToSafeLubricationMode\" is set" VALUE 0x0000 /* @ECU_Address@TCFRke_dV_SafeLubrication@ */ Scalar_SWORD 0 CM_T_dV_lpm_128_1_s16 0.0 255.9921875 EXTENDED_LIMITS -256.0 255.9921875 /end CHARACTERISTIC
/begin CHARACTERISTIC TCFRke_dv_MaxDiffForCurrentSetpointUpdate "This specifies the maximum absolute difference between actual and MinLubriation flow for determination fo being at MinLubrication flow" VALUE 0x0000 /* @ECU_Address@TCFRke_dv_MaxDiffForCurrentSetpointUpdate@ */ Scalar_SWORD 0 CM_T_dV_lpm_128_1_s16 0.0 255.9921875 EXTENDED_LIMITS -256.0 255.9921875 /end CHARACTERISTIC
/begin CHARACTERISTIC TCFRke_K_P1CoolingVsOilTempFilter "Filter co-efficient (change per sample) for low pass filter of temperature diff between P1 motor and oil-temp, used for oil-flow demand for P1 cooling
      1 = No Filtering
      0 = No passthrough" VALUE 0x0000 /* @ECU_Address@TCFRke_K_P1CoolingVsOilTempFilter@ */ Scalar_UWORD 0 CM_T_K_NA_32768_1_u16 0.0 1.0 EXTENDED_LIMITS 0.0 1.999969482421875 /end CHARACTERISTIC
/begin CHARACTERISTIC TCFRke_K_P1MotorEfficiency "Rough estimation of P1 Motor Efficiency, to estimate cooling need.
      In reality the motor will have different efficiency based on current operational point" VALUE 0x0000 /* @ECU_Address@TCFRke_K_P1MotorEfficiency@ */ Scalar_UWORD 0 CM_T_K_NA_32768_1_u16 0.0 1.0 EXTENDED_LIMITS 0.0 1.999969482421875 /end CHARACTERISTIC
/begin CHARACTERISTIC TCFRke_K_P3CoolingVsOilTempFilter "Filter co-efficient (change per sample) for low pass filter of temperature diff between P3 motor and oil-temp, used for oil-flow demand for P3 cooling
      1 = No Filtering
      0 = No passthrough" VALUE 0x0000 /* @ECU_Address@TCFRke_K_P3CoolingVsOilTempFilter@ */ Scalar_UWORD 0 CM_T_K_NA_32768_1_u16 0.0 1.0 EXTENDED_LIMITS 0.0 1.999969482421875 /end CHARACTERISTIC
/begin CHARACTERISTIC TCFRke_K_P3MotorEfficiency "Rough estimation of P3 Motor Efficiency, to estimate cooling need.
      In reality the motor will have different efficiency based on current operational point" VALUE 0x0000 /* @ECU_Address@TCFRke_K_P3MotorEfficiency@ */ Scalar_UWORD 0 CM_T_K_NA_32768_1_u16 0.0 1.0 EXTENDED_LIMITS 0.0 1.999969482421875 /end CHARACTERISTIC
/begin CHARACTERISTIC TCFRke_r_Busbar_FlowLimitationRateLimY "This sets which rate limiter parameters shall be used based on TCFCve_r_Busbar_Y, for rate-limitation of CCP flow limitation based current usage." VALUE 0x0000 /* @ECU_Address@TCFRke_r_Busbar_FlowLimitationRateLimY@ */ Scalar_UWORD 0 CM_T_r_NA_32768_1_u16 0 1.999969482421875 /end CHARACTERISTIC
/begin CHARACTERISTIC TCFRke_r_Busbar_LatchTooCloseToOverCurrent "### Description
      This is the ratio for setting and latching indication that Busbar is close to overcurrent
      ### Usage
      Set to desired ratio for indicating Busbar too close to overcurrent, will set latching when TCFRve_r_Busbar_Y is greater than or equal to this value
      ### Calibration Note
      This value is compared to TCFRve_r_Busbar_Y, when this exceeds 1 the Busbar powerstage will be turned off by BSW
      The indication is released when TCFRve_r_Busbar_Y is equal or less than TCFRke_r_Busbar_ReleaseTooCloseToOverCurrent
      The too close to overcurrent indication needs to be enabled with TCFRke_Busbar_EnableTooCloseToOverCurrent
      " VALUE 0x0000 /* @ECU_Address@TCFRke_r_Busbar_LatchTooCloseToOverCurrent@ */ Scalar_UWORD 0 CM_T_r_NA_32768_1_u16 0.0 1.0 EXTENDED_LIMITS 0.0 1.999969482421875 /end CHARACTERISTIC
/begin CHARACTERISTIC TCFRke_r_Busbar_ReleaseTooCloseToOverCurrent "### Description
      This is the ratio for releasing indication that Busbar is close to overcurrent
      ### Usage
      Set to desired ratio for releasing Busbar too close to overcurrent, will release latching when TCFRve_r_Busbar_Y is equal to or less than this value
      ### Calibration Note
      This value is compared to TCFRve_r_Busbar_Y, when this exceeds 1 BSW will turn off BLDCs
      The indication is set and latched when TCFRve_r_Busbar_Y is greater than or equal to TCFRke_r_Busbar_LatchTooCloseToOverCurrent
      The too close to overcurrent indication needs to be enabled with TCFRke_Busbar_EnableTooCloseToOverCurrent
      " VALUE 0x0000 /* @ECU_Address@TCFRke_r_Busbar_ReleaseTooCloseToOverCurrent@ */ Scalar_UWORD 0 CM_T_r_NA_32768_1_u16 0.0 1.0 EXTENDED_LIMITS 0.0 1.999969482421875 /end CHARACTERISTIC
/begin CHARACTERISTIC TCFRke_r_Busbar_Y_OverCurrentMargin "### Description
      This is the margin for Busbar overcurrent filter load value Y, used to prevent Busbar Overcurrent.
      The speed limit will be reduced when the margin (relative to 1) is smaller than this value
      ### Usage
      Set to desired minimum margin for filtered load current before flow limitation is reduced
      ### Calibration Note" VALUE 0x0000 /* @ECU_Address@TCFRke_r_Busbar_Y_OverCurrentMargin@ */ Scalar_UWORD 0 CM_T_r_NA_32768_1_u16 0.0 1.0 EXTENDED_LIMITS 0.0 1.999969482421875 /end CHARACTERISTIC
/begin CHARACTERISTIC TCFRke_r_SumCur_FlowLimitationRateLimY "This sets which rate limiter parameters shall be used based on TCFCve_r_SumCur_Y, for rate-limitation of CCP flow limitation based current usage." VALUE 0x0000 /* @ECU_Address@TCFRke_r_SumCur_FlowLimitationRateLimY@ */ Scalar_UWORD 0 CM_T_r_NA_32768_1_u16 0 1.999969482421875 /end CHARACTERISTIC
/begin CHARACTERISTIC TCFRke_r_SumCur_LatchLimitCAP_Current "### Description
      This is the ratio for activating and latching CAP Phase Current Limitation to avoid exceding SumCur (Sum Phase Current) limit
      ### Usage
      Set to desired ratio for activating and latching limit for CAP Phase current
      ### Calibration Note
      
      
      " VALUE 0x0000 /* @ECU_Address@TCFRke_r_SumCur_LatchLimitCAP_Current@ */ Scalar_UWORD 0 CM_T_r_NA_32768_1_u16 0 1.999969482421875 /end CHARACTERISTIC
/begin CHARACTERISTIC TCFRke_r_SumCur_LatchTooCloseToOverCurrent "### Description
      This is the ratio for setting and latching indication that SumCur is close to overcurrent
      ### Usage
      Set to desired ratio for indicating SumCur too close to overcurrent, will set latching when TCFRve_r_SumCur_Y is greater than or equal to this value
      ### Calibration Note
      This value is compared to TCFRve_r_SumCur_Y, when this exceeds 1 the SumCur powerstage will be turned off by BSW
      The indication is released when TCFRve_r_SumCur_Y is equal or less than TCFRke_r_SumCur_ReleaseTooCloseToOverCurrent
      The too close to overcurrent indication needs to be enabled with TCFRke_SumCur_EnableTooCloseToOverCurrent
      
      " VALUE 0x0000 /* @ECU_Address@TCFRke_r_SumCur_LatchTooCloseToOverCurrent@ */ Scalar_UWORD 0 CM_T_r_NA_32768_1_u16 0.0 1.0 EXTENDED_LIMITS 0.0 1.999969482421875 /end CHARACTERISTIC
/begin CHARACTERISTIC TCFRke_r_SumCur_ReleaseLimitCAP_Current "### Description
      This is the ratio for releasing CAP Phase Current Limitation to avoid exceding SumCur (Sum Phase Current) limit
      ### Usage
      Set to desired ratio for releasing limit for CAP Phase current
      ### Calibration Note
      
      " VALUE 0x0000 /* @ECU_Address@TCFRke_r_SumCur_ReleaseLimitCAP_Current@ */ Scalar_UWORD 0 CM_T_r_NA_32768_1_u16 0 1.999969482421875 /end CHARACTERISTIC
/begin CHARACTERISTIC TCFRke_r_SumCur_ReleaseTooCloseToOverCurrent "### Description
      This is the ratio for releasing indication that SumCur is close to overcurrent
      ### Usage
      Set to desired ratio for releasing SumCur too close to overcurrent, will release latching when TCFRve_r_SumCur_Y is equal to or less than this value
      ### Calibration Note
      This value is compared to TCFRve_r_SumCur_Y, when this exceeds 1 BSW will turn off BLDCs
      The indication is set and latched when TCFRve_r_SumCur_Y is greater than or equal to TCFRke_r_SumCur_LatchTooCloseToOverCurrent
      The too close to overcurrent indication needs to be enabled with TCFRke_SumCur_EnableTooCloseToOverCurrent
      " VALUE 0x0000 /* @ECU_Address@TCFRke_r_SumCur_ReleaseTooCloseToOverCurrent@ */ Scalar_UWORD 0 CM_T_r_NA_32768_1_u16 0.0 1.0 EXTENDED_LIMITS 0.0 1.999969482421875 /end CHARACTERISTIC
/begin CHARACTERISTIC TCFRke_r_SumCur_Y_OverCurrentMargin "### Description
      This is the margin for SumCur overcurrent filter load value Y, used to prevent SumCur Overcurrent.
      The speed limit will be reduced when the margin (relative to 1) is smaller than this value
      ### Usage
      Set to desired minimum margin for filtered load current before flow limitation is reduced
      ### Calibration Note" VALUE 0x0000 /* @ECU_Address@TCFRke_r_SumCur_Y_OverCurrentMargin@ */ Scalar_UWORD 0 CM_T_r_NA_32768_1_u16 0.0 1.0 EXTENDED_LIMITS 0.0 1.999969482421875 /end CHARACTERISTIC
/begin CHARACTERISTIC TCFRie_r_CAP_PhaseCurrentLimitation_Scaling "Passtrough scaling for signal TCFRve_I_CAP_PhaseCurrentLimitation
      Shall be set to 1 for production SW
      " VALUE 0x0000 /* @ECU_Address@TCFRie_r_CAP_PhaseCurrentLimitation_Scaling@ */ Scalar_SWORD 0 CM_T_r_NA_1024_1_s16 -5.0 5.0 EXTENDED_LIMITS -32.0 31.9990234375 /end CHARACTERISTIC
/begin CHARACTERISTIC TCFRie_r_CoolingFlowCommand_Scaling "Instrumentation slew scaling for TCFRve_dV_CoolingFlowCommand, i.e. how much of nominal cooling flow functionality shall be passed through" VALUE 0x0000 /* @ECU_Address@TCFRie_r_CoolingFlowCommand_Scaling@ */ Scalar_SWORD 0 CM_T_r_NA_1024_1_s16 -5.0 5.0 EXTENDED_LIMITS -32.0 31.9990234375 /end CHARACTERISTIC
/begin CHARACTERISTIC TCFRie_r_CurrentAvailableForClutch_Scaling "Passtrough scaling for signal TCFRve_I_CurrentAvailableForClutch
      Shall be set to 1 for production SW" VALUE 0x0000 /* @ECU_Address@TCFRie_r_CurrentAvailableForClutch_Scaling@ */ Scalar_SWORD 0 CM_T_r_NA_1024_1_s16 -5.0 5.0 EXTENDED_LIMITS -32.0 31.9990234375 /end CHARACTERISTIC
/begin CHARACTERISTIC TCFRie_r_FanRequest_Scaling "Instrumentation slew scaling for TCFRve_Pct_FanRequest, i.e. how much of nominal signal TCFRve_Pct_OilTempFanRequest shall be passed through" VALUE 0x0000 /* @ECU_Address@TCFRie_r_FanRequest_Scaling@ */ Scalar_SWORD 0 CM_T_r_NA_1024_1_s16 -5.0 5.0 EXTENDED_LIMITS -32.0 31.9990234375 /end CHARACTERISTIC
/begin CHARACTERISTIC TCFRke_K_P1PowerLossToCoolingFlow "Conversion factor for cooling need for P1 motor due to losses
      From losses (in kW) to flow (in liter per minute)" VALUE 0x0000 /* @ECU_Address@TCFRke_K_P1PowerLossToCoolingFlow@ */ Scalar_SWORD 0 CM_T_K_NA_1024_1_s16 0.0 30.0 EXTENDED_LIMITS -32.0 31.9990234375 /end CHARACTERISTIC
/begin CHARACTERISTIC TCFRke_K_P3PowerLossToCoolingFlow "Conversion factor for cooling need for P3 motor due to losses
      From losses (in kW) to flow (in liter per minute)" VALUE 0x0000 /* @ECU_Address@TCFRke_K_P3PowerLossToCoolingFlow@ */ Scalar_SWORD 0 CM_T_K_NA_1024_1_s16 0.0 30.0 EXTENDED_LIMITS -32.0 31.9990234375 /end CHARACTERISTIC
/begin CHARACTERISTIC TCFRie_Pct_FanRequest_Offset "Instrumentation slew offset for TCFRve_Pct_FanRequest" VALUE 0x0000 /* @ECU_Address@TCFRie_Pct_FanRequest_Offset@ */ Scalar_SWORD 0 CM_T_Pct_pct_256_1_s16 -128.0 127.99609375 /end CHARACTERISTIC
/begin CHARACTERISTIC TCFRke_Pct_FanRequestHigh "Fan request to be used for \"high\" fan request" VALUE 0x0000 /* @ECU_Address@TCFRke_Pct_FanRequestHigh@ */ Scalar_SWORD 0 CM_T_Pct_pct_256_1_s16 0.0 100.0 EXTENDED_LIMITS -128.0 127.99609375 /end CHARACTERISTIC
/begin CHARACTERISTIC TCFRke_Pct_FanRequestLow "Fan request to be used for \"low\" fan request" VALUE 0x0000 /* @ECU_Address@TCFRke_Pct_FanRequestLow@ */ Scalar_SWORD 0 CM_T_Pct_pct_256_1_s16 0.0 100.0 EXTENDED_LIMITS -128.0 127.99609375 /end CHARACTERISTIC
/begin CHARACTERISTIC TCFRke_Pct_FanRequestOff "Fan request to be used for no fan request (i.e. off)" VALUE 0x0000 /* @ECU_Address@TCFRke_Pct_FanRequestOff@ */ Scalar_SWORD 0 CM_T_Pct_pct_256_1_s16 0.0 100.0 EXTENDED_LIMITS -128.0 127.99609375 /end CHARACTERISTIC
/begin CHARACTERISTIC TCFRke_r_MinLubricationDown "Ramp up ratio of MinLubrication when switching off MinLubrication.
      In ratio per 10ms sample
      " VALUE 0x0000 /* @ECU_Address@TCFRke_r_MinLubricationDown@ */ Scalar_SWORD 0 CM_T_r_NA_16384_1_s16 -2.0 0.0 EXTENDED_LIMITS -2.0 1.99993896484375 /end CHARACTERISTIC
/begin CHARACTERISTIC TCFRke_r_MinLubricationUp "Ramp up ratio of MinLubrication when switching on MinLubrication.
      In ratio per 10ms sample
      " VALUE 0x0000 /* @ECU_Address@TCFRke_r_MinLubricationUp@ */ Scalar_SWORD 0 CM_T_r_NA_16384_1_s16 0.0 1.99993896484375 EXTENDED_LIMITS -2.0 1.99993896484375 /end CHARACTERISTIC
/begin CHARACTERISTIC TCFRie_b_AfterRunRequest_OB "Override enable for TCFRve_b_AfterRunRequest" VALUE 0x0000 /* @ECU_Address@TCFRie_b_AfterRunRequest_OB@ */ Scalar_BOOLEAN 0 CM_T_BOOLEAN 0.0 1.0 /end CHARACTERISTIC
/begin CHARACTERISTIC TCFRie_b_AfterRunRequest_OV "Override value for TCFRve_b_AfterRunRequest" VALUE 0x0000 /* @ECU_Address@TCFRie_b_AfterRunRequest_OV@ */ Scalar_BOOLEAN 0 CM_T_BOOLEAN 0.0 1.0 /end CHARACTERISTIC
/begin CHARACTERISTIC TCFRie_b_ClutchAvailable_OB "Override enable for TCFRve_b_ClutchAvailable" VALUE 0x0000 /* @ECU_Address@TCFRie_b_ClutchAvailable_OB@ */ Scalar_BOOLEAN 0 CM_T_BOOLEAN 0.0 1.0 /end CHARACTERISTIC
/begin CHARACTERISTIC TCFRie_b_ClutchAvailable_OV "Override value for TCFRbe_e_ClutchAvailable" VALUE 0x0000 /* @ECU_Address@TCFRie_b_ClutchAvailable_OV@ */ Scalar_BOOLEAN 0 CM_T_BOOLEAN 0.0 1.0 /end CHARACTERISTIC
/begin CHARACTERISTIC TCFRie_b_EnableCoolingFlowAndFanWithoutPropulsionActive "Ovverides the logic to not allow cooling flow and fan request until propulsion system active" VALUE 0x0000 /* @ECU_Address@TCFRie_b_EnableCoolingFlowAndFanWithoutPropulsionActive@ */ Scalar_BOOLEAN 0 CM_T_BOOLEAN 0.0 1.0 /end CHARACTERISTIC
/begin CHARACTERISTIC TCFRke_b_Busbar_EnableTooCloseToOverCurrent "### Description
      This enables indicating if Busbar is close to overcurrent
      ### Usage
      Set to true if close to overcurrent shall be indicated for Busbar
      ### Calibration Note
      The indication is set when TCFRve_r_Busbar_Y reaches TCFRke_r_Busbar_LatchTooCloseToOverCurrent
      The indication is released when TCFRve_r_Busbar_Y has gone down to TCFRke_r_Busbar_ReleaseTooCloseToOverCurrent
      BSW will BLDCs when TCFRve_r_Busbar_Y is greater than 1" VALUE 0x0000 /* @ECU_Address@TCFRke_b_Busbar_EnableTooCloseToOverCurrent@ */ Scalar_BOOLEAN 0 CM_T_BOOLEAN 0.0 1.0 /end CHARACTERISTIC
/begin CHARACTERISTIC TCFRke_b_Busbar_OverCurrent_UseBSW_Limit_X "### Description
      This enables indicating using the BSW Busbar BLDC current limit
      ### Usage
      Set to true to use information from BSW as well as (max of) the calculated value in TCFR
      Set to false to only use the calculated value in TCFR
      ### Calibration Note
      The BSW value can be measured with TCFRve_r_Busbar_BSW_X and the TCFR value with TCFRve_r_Busbar_ASW_X
      " VALUE 0x0000 /* @ECU_Address@TCFRke_b_Busbar_OverCurrent_UseBSW_Limit_X@ */ Scalar_BOOLEAN 0 CM_T_BOOLEAN 0.0 1.0 /end CHARACTERISTIC
/begin CHARACTERISTIC TCFRke_b_Busbar_OverCurrent_UseBSW_Limit_Y "### Description
      This enables indicating using the BSW Busbar BLDC filtered overcurrent limit
      ### Usage
      Set to true to use information from BSW as well as (max of) the calculated value in TCFR
      Set to false to only use the calculated value in TCFR
      ### Calibration Note
      The BSW value can be measured with TCFRve_r_Busbar_BSW_Y and the TCFR value with TCFRve_r_Busbar_ASW_Y
      " VALUE 0x0000 /* @ECU_Address@TCFRke_b_Busbar_OverCurrent_UseBSW_Limit_Y@ */ Scalar_BOOLEAN 0 CM_T_BOOLEAN 0.0 1.0 /end CHARACTERISTIC
/begin CHARACTERISTIC TCFRke_b_DebouncedRoundingOfOilTempForMinLubrication "This enables rounding of oil temp value that is used for temperature based MinLubrication
      When enabled the used oil temp is rounded to complete degrees C, with some hysteresis when switching." VALUE 0x0000 /* @ECU_Address@TCFRke_b_DebouncedRoundingOfOilTempForMinLubrication@ */ Scalar_BOOLEAN 0 CM_T_BOOLEAN 0.0 1.0 /end CHARACTERISTIC
/begin CHARACTERISTIC TCFRke_b_DisableCooling "Enable the function to disable cooling when P1 and P3 motor is stopped" VALUE 0x0000 /* @ECU_Address@TCFRke_b_DisableCooling@ */ Scalar_BOOLEAN 0 CM_T_BOOLEAN 0.0 1.0 /end CHARACTERISTIC
/begin CHARACTERISTIC TCFRke_b_Enable_CCP_CurrentLimitation "This enables using Busbar and SumCur limitation of CCP flow request to avoid overcurrent" VALUE 0x0000 /* @ECU_Address@TCFRke_b_Enable_CCP_CurrentLimitation@ */ Scalar_BOOLEAN 0 CM_T_BOOLEAN 0.0 1.0 /end CHARACTERISTIC
/begin CHARACTERISTIC TCFRke_b_SumCur_EnableTooCloseToOverCurrent "### Description
      This enables indicating if SumCur is close to overcurrent
      ### Usage
      Set to true if close to overcurrent shall be indicated for SumCur
      ### Calibration Note
      The indication is set when TCFRve_r_SumCur_Y reaches TCFRke_r_SumCur_LatchTooCloseToOverCurrent
      The indication is released when TCFRve_r_SumCur_Y has gone down to TCFRke_r_SumCur_ReleaseTooCloseToOverCurrent
      BSW will BLDCs when TCFRve_r_SumCur_Y is greater than 1" VALUE 0x0000 /* @ECU_Address@TCFRke_b_SumCur_EnableTooCloseToOverCurrent@ */ Scalar_BOOLEAN 0 CM_T_BOOLEAN 0.0 1.0 /end CHARACTERISTIC
/begin CHARACTERISTIC TCFRke_b_SumCur_OverCurrent_UseBSW_Limit_Y "### Description
      This enables indicating using the BSW SumCur BLDC filtered overcurrent limit
      ### Usage
      Set to true to use information from BSW as well as (max of) the calculated value in TCFR
      Set to false to only use the calculated value in TCFR
      ### Calibration Note
      The BSW value can be measured with TCFRve_r_SumCur_BSW_Y and the TCFR value with TCFRve_r_SumCur_ASW_Y
      " VALUE 0x0000 /* @ECU_Address@TCFRke_b_SumCur_OverCurrent_UseBSW_Limit_Y@ */ Scalar_BOOLEAN 0 CM_T_BOOLEAN 0.0 1.0 /end CHARACTERISTIC
/begin CHARACTERISTIC TCFRke_b_SumCur_ScaleCAP_Limitation "This enables scaling of CAP phase limitation to keep SumCur from going into overcurrent
      If not scaled, the CAP limitation will likely toggle on/off
      " VALUE 0x0000 /* @ECU_Address@TCFRke_b_SumCur_ScaleCAP_Limitation@ */ Scalar_BOOLEAN 0 CM_T_BOOLEAN 0.0 1.0 /end CHARACTERISTIC
/begin MEASUREMENT TCFRve_I_MinLubricationCurrent "This is the estimated current needed for the MinLubrication flow" FLOAT32_IEEE CM_T_I_A_Float32 0 0 0.0 100.0 ECU_ADDRESS 0x0000 /* @ECU_Address@TCFRve_I_MinLubricationCurrent@ */ /end MEASUREMENT
/begin MEASUREMENT TCFRve_e_FanRequestOilTemp "Fan request due to oil temp" UBYTE CM_TCFRte_e_FanRequest 0 0 0 2 ECU_ADDRESS 0x0000 /* @ECU_Address@TCFRve_e_FanRequestOilTemp@ */ /end MEASUREMENT
/begin MEASUREMENT TCFRve_e_FanRequestCCP_PS "Fan request level needed for CCP PowerStage cooling" UBYTE CM_TCFRte_e_FanRequest 0 0 0 2 ECU_ADDRESS 0x0000 /* @ECU_Address@TCFRve_e_FanRequestCCP_PS@ */ /end MEASUREMENT
/begin MEASUREMENT TCFRve_e_FanRequestCAP_PS "Fan request level needed for CAP PowerStage cooling" UBYTE CM_TCFRte_e_FanRequest 0 0 0 2 ECU_ADDRESS 0x0000 /* @ECU_Address@TCFRve_e_FanRequestCAP_PS@ */ /end MEASUREMENT
/begin MEASUREMENT TCFRve_e_FanRequestPCB "Fan request level needed for Controller PCB cooling" UBYTE CM_TCFRte_e_FanRequest 0 0 0 2 ECU_ADDRESS 0x0000 /* @ECU_Address@TCFRve_e_FanRequestPCB@ */ /end MEASUREMENT
/begin MEASUREMENT TCFRve_e_FanRequestSafeMode "The \"Safe-mode\" fan-level request" UBYTE CM_TCFRte_e_FanRequest 0 0 0 2 ECU_ADDRESS 0x0000 /* @ECU_Address@TCFRve_e_FanRequestSafeMode@ */ /end MEASUREMENT
/begin MEASUREMENT TCFRve_e_P1MotorFanRequest "Fan request due to P1 motor temp" UBYTE CM_TCFRte_e_FanRequest 0 0 0 2 ECU_ADDRESS 0x0000 /* @ECU_Address@TCFRve_e_P1MotorFanRequest@ */ /end MEASUREMENT
/begin MEASUREMENT TCFRve_e_P3MotorFanRequest "Fan request due to P3 motor temp" UBYTE CM_TCFRte_e_FanRequest 0 0 0 2 ECU_ADDRESS 0x0000 /* @ECU_Address@TCFRve_e_P3MotorFanRequest@ */ /end MEASUREMENT
/begin MEASUREMENT TCFRve_n_AbsP1MtrSpd "Absolute P1 motor speed" SWORD CM_T_n_rpm_1_1_s16 0 0 0.0 32767.0 ECU_ADDRESS 0x0000 /* @ECU_Address@TCFRve_n_AbsP1MtrSpd@ */ /end MEASUREMENT
/begin MEASUREMENT TCFRve_n_AbsP3MtrSpd "Absolute speed for P3 Motor" SWORD CM_T_n_rpm_1_1_s16 0 0 -32768.0 32767.0 ECU_ADDRESS 0x0000 /* @ECU_Address@TCFRve_n_AbsP3MtrSpd@ */ /end MEASUREMENT
/begin MEASUREMENT TCFRve_Cnt_CoolingAfterRun "Target time (in counts of periodic sample time) for cooling afterrun" UWORD CM_T_Cnt_Num_1_1_u16 0 0 0.0 65535.0 ECU_ADDRESS 0x0000 /* @ECU_Address@TCFRve_Cnt_CoolingAfterRun@ */ /end MEASUREMENT
/begin MEASUREMENT TCFRve_Cnt_CoolingAfterRunTimer "Actual time (in counts of periodic sample time) for cooling afterrun and prepare shutdown" UWORD CM_T_Cnt_Num_1_1_u16 0 0 0.0 65535.0 ECU_ADDRESS 0x0000 /* @ECU_Address@TCFRve_Cnt_CoolingAfterRunTimer@ */ /end MEASUREMENT
/begin MEASUREMENT TCFRve_T_OilSumpTemp "Oil temp in sump" SWORD CM_T_T_degC_16_1_s16 0 0 -2048.0 2047.9375 ECU_ADDRESS 0x0000 /* @ECU_Address@TCFRve_T_OilSumpTemp@ */ /end MEASUREMENT
/begin MEASUREMENT TCFRve_T_P1Motor "P1 motor temperature" SWORD CM_T_T_degC_16_1_s16 0 0 -2048.0 2047.9375 ECU_ADDRESS 0x0000 /* @ECU_Address@TCFRve_T_P1Motor@ */ /end MEASUREMENT
/begin MEASUREMENT TCFRve_T_P1VsOilTemp "This is temperature difference of how much hotter the P1 motor is than the Transmission Oil temp" SWORD CM_T_T_degC_16_1_s16 0 0 0.0 2047.9375 ECU_ADDRESS 0x0000 /* @ECU_Address@TCFRve_T_P1VsOilTemp@ */ /end MEASUREMENT
/begin MEASUREMENT TCFRve_T_P3Motor "P3 Motor Temperature" SWORD CM_T_T_degC_16_1_s16 0 0 -2048.0 2047.9375 ECU_ADDRESS 0x0000 /* @ECU_Address@TCFRve_T_P3Motor@ */ /end MEASUREMENT
/begin MEASUREMENT TCFRve_T_P3VsOilTemp "This is temperature difference of how much hotter the P3 motor is than the Transmission Oil temp" SWORD CM_T_T_degC_16_1_s16 0 0 0.0 2047.9375 ECU_ADDRESS 0x0000 /* @ECU_Address@TCFRve_T_P3VsOilTemp@ */ /end MEASUREMENT
/begin MEASUREMENT TCFRve_T_OilTempRounded "This is the oil-temperature rounded to complete degrees, with some hysteresis" SWORD CM_T_T_degC_16_1_s16 0 0 -2048.0 2047.9375 ECU_ADDRESS 0x0000 /* @ECU_Address@TCFRve_T_OilTempRounded@ */ /end MEASUREMENT
/begin MEASUREMENT TCFRve_T_OilTemp "This is the oil-temperature used for MinLubrication lookup" SWORD CM_T_T_degC_16_1_s16 0 0 -2048.0 2047.9375 ECU_ADDRESS 0x0000 /* @ECU_Address@TCFRve_T_OilTemp@ */ /end MEASUREMENT
/begin MEASUREMENT TCFRve_I_CurrentAvailableForClutch_raw "Busbar current available for clutch, before override" SWORD CM_T_I_A_32_1_s16 0 0 0.0 1023.96875 ECU_ADDRESS 0x0000 /* @ECU_Address@TCFRve_I_CurrentAvailableForClutch_raw@ */ /end MEASUREMENT
/begin MEASUREMENT TCFRve_I_Busbar_Current "Total Busbar current (total current for all BLDC PowerStages)" SWORD CM_T_I_A_32_1_s16 0 0 -1024.0 1023.96875 ECU_ADDRESS 0x0000 /* @ECU_Address@TCFRve_I_Busbar_Current@ */ /end MEASUREMENT
/begin MEASUREMENT TCFRve_dV_P1Cooling "Needed cooling flow due to P1 motor temperature" SWORD CM_T_dV_lpm_128_1_s16 0 0 0.0 255.9921875 ECU_ADDRESS 0x0000 /* @ECU_Address@TCFRve_dV_P1Cooling@ */ /end MEASUREMENT
/begin MEASUREMENT TCFRve_P_P1PowerLossEstimation "This is an estimation of power loss in P1 motor" SWORD CM_T_P_kW_128_1_s16 0 0 0.0 255.9921875 ECU_ADDRESS 0x0000 /* @ECU_Address@TCFRve_P_P1PowerLossEstimation@ */ /end MEASUREMENT
/begin MEASUREMENT TCFRve_dV_TotalP1Cooling "Needed cooling flow due to total P1 motor cooling need" SWORD CM_T_dV_lpm_128_1_s16 0 0 0.0 255.9921875 ECU_ADDRESS 0x0000 /* @ECU_Address@TCFRve_dV_TotalP1Cooling@ */ /end MEASUREMENT
/begin MEASUREMENT TCFRve_dV_P3Cooling "Needed cooling flow due to P3 motor temperature" SWORD CM_T_dV_lpm_128_1_s16 0 0 0.0 255.9921875 ECU_ADDRESS 0x0000 /* @ECU_Address@TCFRve_dV_P3Cooling@ */ /end MEASUREMENT
/begin MEASUREMENT TCFRve_P_P3PowerLossEstimation "This is an estimation of power loss in P3 motor" SWORD CM_T_P_kW_128_1_s16 0 0 0.0 255.9921875 ECU_ADDRESS 0x0000 /* @ECU_Address@TCFRve_P_P3PowerLossEstimation@ */ /end MEASUREMENT
/begin MEASUREMENT TCFRve_dV_TotalP3Cooling "Needed cooling flow due to total P3 motor cooling need" SWORD CM_T_dV_lpm_128_1_s16 0 0 0.0 255.9921875 ECU_ADDRESS 0x0000 /* @ECU_Address@TCFRve_dV_TotalP3Cooling@ */ /end MEASUREMENT
/begin MEASUREMENT TCFRve_dV_CoolingFlowOilTemp "Needed cooling flow due to oil temp" SWORD CM_T_dV_lpm_128_1_s16 0 0 0.0 255.9921875 ECU_ADDRESS 0x0000 /* @ECU_Address@TCFRve_dV_CoolingFlowOilTemp@ */ /end MEASUREMENT
/begin MEASUREMENT TCFRve_dV_LubricationFlow "Total lubrication flow request" SWORD CM_T_dV_lpm_128_1_s16 0 0 0.0 255.9921875 ECU_ADDRESS 0x0000 /* @ECU_Address@TCFRve_dV_LubricationFlow@ */ /end MEASUREMENT
/begin MEASUREMENT TCFRve_dV_MinLubrication "The minimum allowed lubrication flow" SWORD CM_T_dV_lpm_128_1_s16 0 0 0.0 255.9921875 ECU_ADDRESS 0x0000 /* @ECU_Address@TCFRve_dV_MinLubrication@ */ /end MEASUREMENT
/begin MEASUREMENT TCFRve_dV_CCP_Limit "The maximum flow cooling/lubrication flow allowed, with respect to temporary degradation due to overtemp or overcurrent" SWORD CM_T_dV_lpm_128_1_s16 0 0 0.0 255.9921875 ECU_ADDRESS 0x0000 /* @ECU_Address@TCFRve_dV_CCP_Limit@ */ /end MEASUREMENT
/begin MEASUREMENT TCFRve_Pct_FanRequestRaw "TCFRve_Pct_FanRequest before override" SWORD CM_T_Pct_pct_256_1_s16 0 0 0.0 100.0 ECU_ADDRESS 0x0000 /* @ECU_Address@TCFRve_Pct_FanRequestRaw@ */ /end MEASUREMENT
/begin MEASUREMENT TCFRve_Cnt_MinLubricationMemory "Indication of current state of \"storing\" of MinLubrication current
      0 = NoLubricationRequest
      1 = SetNewMinLubrication
      2 = AtMinLubrication
      3 = NotAtMinLubrication" UBYTE CM_T_Cnt_Num_1_1_u8 0 0 0.0 3.0 ECU_ADDRESS 0x0000 /* @ECU_Address@TCFRve_Cnt_MinLubricationMemory@ */ /end MEASUREMENT
/begin MEASUREMENT TCFRve_b_EnableCoolingFlowAndFan "Indication of cooling and fan being enabled, allowed to be used" UBYTE CM_T_BOOLEAN 0 0 0 1 ECU_ADDRESS 0x0000 /* @ECU_Address@TCFRve_b_EnableCoolingFlowAndFan@ */ /end MEASUREMENT
/begin MEASUREMENT TCFRve_b_CoolingAfterRun "This signal indicates that cooling afterrun is active, i.e. used for fan and cooling flow setpoints" UBYTE CM_T_BOOLEAN 0 0 0.0 1.0 ECU_ADDRESS 0x0000 /* @ECU_Address@TCFRve_b_CoolingAfterRun@ */ /end MEASUREMENT
/begin MEASUREMENT TCFRve_b_PrepareShutdown "Prepare shutdown, turn off fan request and cooling flow" UBYTE CM_T_BOOLEAN 0 0 0.0 1.0 ECU_ADDRESS 0x0000 /* @ECU_Address@TCFRve_b_PrepareShutdown@ */ /end MEASUREMENT
/begin MEASUREMENT TCFRve_b_MotorIsStopped "P1 and P3 motor is stopped" UBYTE CM_T_BOOLEAN 0 0 0.0 1.0 ECU_ADDRESS 0x0000 /* @ECU_Address@TCFRve_b_MotorIsStopped@ */ /end MEASUREMENT
/begin MEASUREMENT TCFRve_b_ReduceCCPM_OvertempProtection "Indicates if cooling/lubrication flow needs to be degraded due to overtemp conditions" UBYTE CM_T_BOOLEAN 0 0 0.0 1.0 ECU_ADDRESS 0x0000 /* @ECU_Address@TCFRve_b_ReduceCCPM_OvertempProtection@ */ /end MEASUREMENT
/begin MEASUREMENT TCFRve_b_AtMinLubrication "Indication that the CCP flow is at MinLubrication" UBYTE CM_T_BOOLEAN 0 0 0 1 ECU_ADDRESS 0x0000 /* @ECU_Address@TCFRve_b_AtMinLubrication@ */ /end MEASUREMENT
/begin MEASUREMENT TCFRve_r_Busbar_BSW_X "Busbar current from BSW" FLOAT32_IEEE CM_T_r_NA_Float32 0 0 -3.4E+38 3.4E+38 ECU_ADDRESS 0x0000 /* @ECU_Address@TCFRve_r_Busbar_BSW_X@ */ /end MEASUREMENT
/begin MEASUREMENT TCFRve_r_Busbar_ASW_X "Busbar current estimated in ASW" FLOAT32_IEEE CM_T_r_NA_Float32 0 0 -3.4E+38 3.4E+38 ECU_ADDRESS 0x0000 /* @ECU_Address@TCFRve_r_Busbar_ASW_X@ */ /end MEASUREMENT
/begin MEASUREMENT TCFRve_r_Busbar_X "Normalized Busbar Current, when this is above 1 the Busbar Current is above the current limit" FLOAT32_IEEE CM_T_r_NA_Float32 0 0 -3.4E+38 3.4E+38 ECU_ADDRESS 0x0000 /* @ECU_Address@TCFRve_r_Busbar_X@ */ /end MEASUREMENT
/begin MEASUREMENT TCFRve_r_CCP_X "The estimated X value of CCP Phase current" FLOAT32_IEEE CM_T_r_NA_Float32 0 0 -3.4E+38 3.4E+38 ECU_ADDRESS 0x0000 /* @ECU_Address@TCFRve_r_CCP_X@ */ /end MEASUREMENT
/begin MEASUREMENT TCFRve_r_SumCur_X "Normalized SumCur Current, when this is above 1 the SumCur Current is above the current limit" FLOAT32_IEEE CM_T_r_NA_Float32 0 0 -3.4E+38 3.4E+38 ECU_ADDRESS 0x0000 /* @ECU_Address@TCFRve_r_SumCur_X@ */ /end MEASUREMENT
/begin MEASUREMENT TCFRve_I_CAP_PhaseCurrentLimitationRaw "Raw (before override) value of TCFRve_I_CAP_PhaseCurrentLimitation" SWORD CM_T_I_A_32_1_s16 0 0 -1024.0 1023.96875 ECU_ADDRESS 0x0000 /* @ECU_Address@TCFRve_I_CAP_PhaseCurrentLimitationRaw@ */ /end MEASUREMENT
/begin MEASUREMENT TCFRve_r_Busbar_BSW_Y "Busbar current load from BSW" UWORD CM_T_r_NA_32768_1_u16 0 0 0 1.999969482421875 ECU_ADDRESS 0x0000 /* @ECU_Address@TCFRve_r_Busbar_BSW_Y@ */ /end MEASUREMENT
/begin MEASUREMENT TCFRve_r_Busbar_ASW_Y "Busbar current load estimated in ASW" UWORD CM_T_r_NA_32768_1_u16 0 0 0 1.999969482421875 ECU_ADDRESS 0x0000 /* @ECU_Address@TCFRve_r_Busbar_ASW_Y@ */ /end MEASUREMENT
/begin MEASUREMENT TCFRve_r_Busbar_Y "Normalized filtered Busbar Current, when this is above 1 the filtered Busbar Current is above the current limit" UWORD CM_T_r_NA_32768_1_u16 0 0 0 1.999969482421875 ECU_ADDRESS 0x0000 /* @ECU_Address@TCFRve_r_Busbar_Y@ */ /end MEASUREMENT
/begin MEASUREMENT TCFRve_r_SumCur_BSW_Y "Phase Sum Current load from BSW" UWORD CM_T_r_NA_32768_1_u16 0 0 0 1.999969482421875 ECU_ADDRESS 0x0000 /* @ECU_Address@TCFRve_r_SumCur_BSW_Y@ */ /end MEASUREMENT
/begin MEASUREMENT TCFRve_r_SumCur_ASW_Y "SumCur current load estimated in ASW" UWORD CM_T_r_NA_32768_1_u16 0 0 0 1.999969482421875 ECU_ADDRESS 0x0000 /* @ECU_Address@TCFRve_r_SumCur_ASW_Y@ */ /end MEASUREMENT
/begin MEASUREMENT TCFRve_r_SumCur_Y "Normalized filtered SumCur Current, when this is above 1 the filtered Busbar Current is above the current limit" UWORD CM_T_r_NA_32768_1_u16 0 0 0 1.999969482421875 ECU_ADDRESS 0x0000 /* @ECU_Address@TCFRve_r_SumCur_Y@ */ /end MEASUREMENT
/begin MEASUREMENT TCFRve_b_Busbar_TooCloseToOverCurrent "Indication that Busbar current is too close to overcurrent" UBYTE CM_T_BOOLEAN 0 0 0.0 1.0 ECU_ADDRESS 0x0000 /* @ECU_Address@TCFRve_b_Busbar_TooCloseToOverCurrent@ */ /end MEASUREMENT
/begin MEASUREMENT TCFRve_b_SumCur_TooCloseToOverCurrent "Indication that SumCur current is too close to overcurrent" UBYTE CM_T_BOOLEAN 0 0 0.0 1.0 ECU_ADDRESS 0x0000 /* @ECU_Address@TCFRve_b_SumCur_TooCloseToOverCurrent@ */ /end MEASUREMENT
/begin COMPU_METHOD CM_T_dV_lpm_128_1_s16 "Q = V*128.000000" RAT_FUNC "%10.7" "lpm (liters / minute  (l/m))" COEFFS 0 128 0 0 0 1 /end COMPU_METHOD
/begin COMPU_METHOD CM_T_T_degC_16_1_s16 "Q = V*16.000000" RAT_FUNC "%8.4" "degC (degrees Celsius  (deg C))" COEFFS 0 16 0 0 0 1 /end COMPU_METHOD
/begin COMPU_METHOD CM_T_r_NA_32768_1_u16 "Q = V*32768.000000" RAT_FUNC "%16.15" "NA (none)" COEFFS 0 32768 0 0 0 1 /end COMPU_METHOD
/begin COMPU_METHOD CM_T_n_rpm_1_1_s16 "Q = V" RAT_FUNC "%5.0" "rpm (revolutions / minute  (rpm))" COEFFS 0 1 0 0 0 1 /end COMPU_METHOD
/begin COMPU_METHOD CM_T_I_A_Float32 "Q = V" RAT_FUNC "%8.6" "A (amperes  (A))" COEFFS 0 1 0 0 0 1 /end COMPU_METHOD
/begin COMPU_METHOD CM_T_r_NA_Float32 "Q = V" RAT_FUNC "%8.6" "NA (none)" COEFFS 0 1 0 0 0 1 /end COMPU_METHOD
/begin COMPU_METHOD CM_TCFRte_e_FanRequest "Enumerated data type: TCFRte_e_FanRequest" TAB_VERB "%0.6" "" COMPU_TAB_REF VTAB_FOR_CM_TCFRte_e_FanRequest /end COMPU_METHOD
/begin COMPU_VTAB VTAB_FOR_CM_TCFRte_e_FanRequest "Enumerated data type: TCFRte_e_FanRequest" TAB_VERB 3 0 "TCFRce_e_FanRequestOff" 1 "TCFRce_e_FanRequestLow" 2 "TCFRce_e_FanRequestHigh" /end COMPU_VTAB
/begin COMPU_METHOD CM_T_Cnt_Num_1_1_u16 "Q = V" RAT_FUNC "%5.0" "Num (counts)" COEFFS 0 1 0 0 0 1 /end COMPU_METHOD
/begin COMPU_METHOD CM_T_I_A_32_1_s16 "Q = V*32.000000" RAT_FUNC "%9.5" "A (amperes  (A))" COEFFS 0 32 0 0 0 1 /end COMPU_METHOD
/begin COMPU_METHOD CM_T_K_NA_32768_1_u16 "Q = V*32768.000000" RAT_FUNC "%16.15" "NA (dependent upon the gain)" COEFFS 0 32768 0 0 0 1 /end COMPU_METHOD
/begin COMPU_METHOD CM_T_r_NA_1024_1_s16 "Q = V*1024.000000" RAT_FUNC "%12.10" "NA (none)" COEFFS 0 1024 0 0 0 1 /end COMPU_METHOD
/begin COMPU_METHOD CM_T_K_NA_1024_1_s16 "Q = V*1024.000000" RAT_FUNC "%12.10" "NA (dependent upon the gain)" COEFFS 0 1024 0 0 0 1 /end COMPU_METHOD
/begin COMPU_METHOD CM_T_Pct_pct_256_1_s16 "Q = V*256.000000" RAT_FUNC "%11.8" "pct (percent  (%))" COEFFS 0 256 0 0 0 1 /end COMPU_METHOD
/begin COMPU_METHOD CM_T_r_NA_16384_1_s16 "Q = V*16384.000000" RAT_FUNC "%15.14" "NA (none)" COEFFS 0 16384 0 0 0 1 /end COMPU_METHOD
/begin COMPU_METHOD CM_T_BOOLEAN "Q = V" RAT_FUNC "%1.0" "Bool" COEFFS 0 1 0 0 0 1 /end COMPU_METHOD
/begin COMPU_METHOD CM_T_P_kW_128_1_s16 "Q = V*128.000000" RAT_FUNC "%10.7" "kW (kilowatts  (kW))" COEFFS 0 128 0 0 0 1 /end COMPU_METHOD
/begin COMPU_METHOD CM_T_Cnt_Num_1_1_u8 "Q = V" RAT_FUNC "%3.0" "Num (counts)" COEFFS 0 1 0 0 0 1 /end COMPU_METHOD
/* EOF TCFR.a2l */
/begin RECORD_LAYOUT Scalar_BOOLEAN FNC_VALUES 1 UBYTE COLUMN_DIR DIRECT /end RECORD_LAYOUT
/begin RECORD_LAYOUT Scalar_UBYTE FNC_VALUES 1 UBYTE COLUMN_DIR DIRECT /end RECORD_LAYOUT
/begin RECORD_LAYOUT Scalar_UWORD FNC_VALUES 1 UWORD COLUMN_DIR DIRECT /end RECORD_LAYOUT
/begin RECORD_LAYOUT Scalar_SWORD FNC_VALUES 1 SWORD COLUMN_DIR DIRECT /end RECORD_LAYOUT
/begin RECORD_LAYOUT Scalar_FLOAT32_IEEE FNC_VALUES 1 FLOAT32_IEEE COLUMN_DIR DIRECT /end RECORD_LAYOUT
/begin RECORD_LAYOUT Lookup1D_WORD FNC_VALUES 1 SWORD COLUMN_DIR DIRECT /end RECORD_LAYOUT
/begin RECORD_LAYOUT Lookup1D_X_WORD AXIS_PTS_X 1 SWORD INDEX_INCR DIRECT /end RECORD_LAYOUT
/begin CHARACTERISTIC TCMDie_n_ActualMotRotSpd_OV "Override value for the actual motor speed signal." VALUE 0x0000 /* @ECU_Address@TCMDie_n_ActualMotRotSpd_OV@ */ Scalar_SWORD 0 CM_T_n_rpm_1_1_s16 -32768 32767 /end CHARACTERISTIC
/begin CHARACTERISTIC TCMDke_n_RC_SpdDev_Limit "Deviation limit for the cooling motor speed rationality." VALUE 0x0000 /* @ECU_Address@TCMDke_n_RC_SpdDev_Limit@ */ Scalar_SWORD 0 CM_T_n_rpm_1_1_s16 -32768 32767 /end CHARACTERISTIC
/begin CHARACTERISTIC TCMDke_Cnt_RC_SpdDev_DiagCounts "Number of executions before issuing a PASS report for the cooling pump motor speed rationality" VALUE 0x0000 /* @ECU_Address@TCMDke_Cnt_RC_SpdDev_DiagCounts@ */ Scalar_UWORD 0 CM_T_Cnt_Num_1_1_u16 0 65535 /end CHARACTERISTIC
/begin CHARACTERISTIC TCMDie_T_CoolingActPwrStgTemp_OV "Override value for the Motor power stage temperature signal, TCMDve_T_CoolingActPwrStg." VALUE 0x0000 /* @ECU_Address@TCMDie_T_CoolingActPwrStgTemp_OV@ */ Scalar_SWORD 0 CM_T_T_degC_16_1_s16 -2048.0 2047.9375 /end CHARACTERISTIC
/begin CHARACTERISTIC TCMDke_T_Offset "Temperature offset for the power stage temperature." VALUE 0x0000 /* @ECU_Address@TCMDke_T_Offset@ */ Scalar_SWORD 0 CM_T_T_degC_16_1_s16 -2048.0 2047.0 EXTENDED_LIMITS -2048.0 2047.9375 /end CHARACTERISTIC
/begin CHARACTERISTIC TCMDke_T_RC_SpdDev_TempLim "When the transmission oil temperature is above this limit the cooling pump motor speed rationality diagnosis will execute." VALUE 0x0000 /* @ECU_Address@TCMDke_T_RC_SpdDev_TempLim@ */ Scalar_SWORD 0 CM_T_T_degC_16_1_s16 -2048.0 2047.9375 /end CHARACTERISTIC
/begin CHARACTERISTIC TCMDke_r_RC_SpdDev_RatioToFail "Ratio of failed sampled in relation to executed test before issuing a FAIL report for the cooling pump motor speed rationality." VALUE 0x0000 /* @ECU_Address@TCMDke_r_RC_SpdDev_RatioToFail@ */ Scalar_UWORD 0 CM_T_r_NA_256_1_u16 0 255.99609375 /end CHARACTERISTIC
/begin CHARACTERISTIC TCMDie_b_ActualMotRotSpd_OB "Override boolean for the actual motor speed signal." VALUE 0x0000 /* @ECU_Address@TCMDie_b_ActualMotRotSpd_OB@ */ Scalar_BOOLEAN 0 CM_T_BOOLEAN 0 1 /end CHARACTERISTIC
/begin CHARACTERISTIC TCMDie_b_CoolingActPwrStgTemp_OB "Override boolean for the Motor power stage temperature signal, TCMDve_T_CoolingActPwrStg." VALUE 0x0000 /* @ECU_Address@TCMDie_b_CoolingActPwrStgTemp_OB@ */ Scalar_BOOLEAN 0 CM_T_BOOLEAN 0 1 /end CHARACTERISTIC
/begin CHARACTERISTIC TCMDie_b_ElecFault_OB "Override boolean for the BSW electrical check." VALUE 0x0000 /* @ECU_Address@TCMDie_b_ElecFault_OB@ */ Scalar_BOOLEAN 0 CM_T_BOOLEAN 0.0 1.0 /end CHARACTERISTIC
/begin CHARACTERISTIC TCMDie_b_ElecFault_OV "Override value for BSW electrical diagnosis." VALUE 0x0000 /* @ECU_Address@TCMDie_b_ElecFault_OV@ */ Scalar_BOOLEAN 0 CM_T_BOOLEAN 0.0 1.0 /end CHARACTERISTIC
/begin CHARACTERISTIC TCMDie_b_MosElecFault_OB "Override boolean for the BSW mosfet electrical check." VALUE 0x0000 /* @ECU_Address@TCMDie_b_MosElecFault_OB@ */ Scalar_BOOLEAN 0 CM_T_BOOLEAN 0.0 1.0 /end CHARACTERISTIC
/begin CHARACTERISTIC TCMDie_b_MosElecFault_OV "Override value for BSW mosfet electrical diagnosis." VALUE 0x0000 /* @ECU_Address@TCMDie_b_MosElecFault_OV@ */ Scalar_BOOLEAN 0 CM_T_BOOLEAN 0.0 1.0 /end CHARACTERISTIC
/begin CHARACTERISTIC TCMDie_b_RC_CCPMSpdCtrlAct_OB "Override boolean for TCFC signal regarding CCPM/BLDC control.
      If set to TRUE the override value will be used
      
      " VALUE 0x0000 /* @ECU_Address@TCMDie_b_RC_CCPMSpdCtrlAct_OB@ */ Scalar_BOOLEAN 0 CM_T_BOOLEAN 0 1 /end CHARACTERISTIC
/begin CHARACTERISTIC TCMDie_b_RC_CCPMSpdCtrlAct_OV "Override value for TCFC signal regarding CCPM/BLDC control.
      If set to TRUE the diagnose does not take TCFC signal into consideration. May be a risk of report P07C3-Cooling pump speed deviation fault
      
      " VALUE 0x0000 /* @ECU_Address@TCMDie_b_RC_CCPMSpdCtrlAct_OV@ */ Scalar_BOOLEAN 0 CM_T_BOOLEAN 0 1 /end CHARACTERISTIC
/begin CHARACTERISTIC TCMDie_b_StuckFault_OB "Override boolean for the BSW BLDC Stuck check." VALUE 0x0000 /* @ECU_Address@TCMDie_b_StuckFault_OB@ */ Scalar_BOOLEAN 0 CM_T_BOOLEAN 0 1 /end CHARACTERISTIC
/begin CHARACTERISTIC TCMDie_b_StuckFault_OV "Override value for BSW BLDC Stuck diagnosis." VALUE 0x0000 /* @ECU_Address@TCMDie_b_StuckFault_OV@ */ Scalar_BOOLEAN 0 CM_T_BOOLEAN 0 1 /end CHARACTERISTIC
/begin CHARACTERISTIC TCMDke_b_EC_DiagEnbl "When this is set to TRUE, the electrical checks are executed." VALUE 0x0000 /* @ECU_Address@TCMDke_b_EC_DiagEnbl@ */ Scalar_BOOLEAN 0 CM_T_BOOLEAN 0 1 /end CHARACTERISTIC
/begin CHARACTERISTIC TCMDke_b_EC_MosDiagEnbl "When this is set to TRUE, the mosfet electrical checks are executed." VALUE 0x0000 /* @ECU_Address@TCMDke_b_EC_MosDiagEnbl@ */ Scalar_BOOLEAN 0 CM_T_BOOLEAN 0 1 /end CHARACTERISTIC
/begin CHARACTERISTIC TCMDke_b_EC_StuckDiagEnbl "BLDC STUCK diag Enable" VALUE 0x0000 /* @ECU_Address@TCMDke_b_EC_StuckDiagEnbl@ */ Scalar_BOOLEAN 0 CM_T_BOOLEAN 0 1 /end CHARACTERISTIC
/begin CHARACTERISTIC TCMDke_b_RC_SpdDev_DiagEnbl "Set this parameter to TRUE to enable the speed deviation rationality diagnosis." VALUE 0x0000 /* @ECU_Address@TCMDke_b_RC_SpdDev_DiagEnbl@ */ Scalar_BOOLEAN 0 CM_T_BOOLEAN 0 1 /end CHARACTERISTIC
/begin MEASUREMENT TCMDve_n_RC_SpdDev_Diff "Difference between target and actual speed." SWORD CM_T_n_rpm_1_1_s16 0 0 -32768 32767 ECU_ADDRESS 0x0000 /* @ECU_Address@TCMDve_n_RC_SpdDev_Diff@ */ /end MEASUREMENT
/begin MEASUREMENT TCMDve_n_ActualMotSpd "Actual speed for the cooling pump motor." SWORD CM_T_n_rpm_1_1_s16 0 0 -32768 32767 ECU_ADDRESS 0x0000 /* @ECU_Address@TCMDve_n_ActualMotSpd@ */ /end MEASUREMENT
/begin MEASUREMENT TCMDve_n_HWIO_MotorRotSpd "Engine speed from HWIO for DID 3102." SWORD CM_T_n_rpm_1_1_s16 0 0 -32768 32767 ECU_ADDRESS 0x0000 /* @ECU_Address@TCMDve_n_HWIO_MotorRotSpd@ */ /end MEASUREMENT
/begin MEASUREMENT TCMDve_Cnt_RC_SpdDev_FailLim "Fail limit for RC speed deviation." UWORD CM_T_Cnt_Num_1_1_u16 0 0 0 65535 ECU_ADDRESS 0x0000 /* @ECU_Address@TCMDve_Cnt_RC_SpdDev_FailLim@ */ /end MEASUREMENT
/begin MEASUREMENT TCMDve_T_CoolingActPwrStg_ "Motor power stage temperature." SWORD CM_T_T_degC_16_1_s16 0 0 -2048.0 2047.9375 ECU_ADDRESS 0x0000 /* @ECU_Address@TCMDve_T_CoolingActPwrStg_@ */ /end MEASUREMENT
/begin MEASUREMENT TCMDve_I_HWIO_MotorCurrent "Engine current from HWIO." SWORD CM_T_I_A_32_1_s16 0 0 -1024.0 1023.96875 ECU_ADDRESS 0x0000 /* @ECU_Address@TCMDve_I_HWIO_MotorCurrent@ */ /end MEASUREMENT
/begin MEASUREMENT TCMDve_Pct_HWIO_MotorActPWM "Engine PWM from HWIO for DID 3102." SWORD CM_T_Pct_pct_10_1_s16 0 0 -3276.8 3276.7000000000003 ECU_ADDRESS 0x0000 /* @ECU_Address@TCMDve_Pct_HWIO_MotorActPWM@ */ /end MEASUREMENT
/begin MEASUREMENT TCMDve_y_Status_ "Duplicated signal to make it measurable also without consumers." UBYTE CM_T_y_BitFieldDiagStatus 0 0 0 255 ECU_ADDRESS 0x0000 /* @ECU_Address@TCMDve_y_Status_@ */ /end MEASUREMENT
/begin MEASUREMENT TCMDve_y_BSWDiagStuck "BLDC Stuck" UBYTE CM_T_y_BitField8 0 0 0 255 ECU_ADDRESS 0x0000 /* @ECU_Address@TCMDve_y_BSWDiagStuck@ */ /end MEASUREMENT
/begin MEASUREMENT TCMDve_y_BSWDiagMosHWOverCurrent "GCU hardware over current." UBYTE CM_T_y_BitField8 0 0 0 255 ECU_ADDRESS 0x0000 /* @ECU_Address@TCMDve_y_BSWDiagMosHWOverCurrent@ */ /end MEASUREMENT
/begin MEASUREMENT TCMDve_y_BSWDiagMosOverVolt "BUS voltage of GCU over voltage." UBYTE CM_T_y_BitField8 0 0 0 255 ECU_ADDRESS 0x0000 /* @ECU_Address@TCMDve_y_BSWDiagMosOverVolt@ */ /end MEASUREMENT
/begin MEASUREMENT TCMDve_y_BSWDiagMosShort "GCU mosfet short circuit." UBYTE CM_T_y_BitField8 0 0 0 255 ECU_ADDRESS 0x0000 /* @ECU_Address@TCMDve_y_BSWDiagMosShort@ */ /end MEASUREMENT
/begin MEASUREMENT TCMDve_y_BSWDiagMosShutDown "GCU Driver chip shutdown because temperature is too high." UBYTE CM_T_y_BitField8 0 0 0 255 ECU_ADDRESS 0x0000 /* @ECU_Address@TCMDve_y_BSWDiagMosShutDown@ */ /end MEASUREMENT
/begin MEASUREMENT TCMDve_y_BSWDiagMosSWOverCurrent "GCU software over current." UBYTE CM_T_y_BitField8 0 0 0 255 ECU_ADDRESS 0x0000 /* @ECU_Address@TCMDve_y_BSWDiagMosSWOverCurrent@ */ /end MEASUREMENT
/begin MEASUREMENT TCMDve_y_BSWDiagMosUnderVolt "BUS voltage of GCU under voltage." UBYTE CM_T_y_BitField8 0 0 0 255 ECU_ADDRESS 0x0000 /* @ECU_Address@TCMDve_y_BSWDiagMosUnderVolt@ */ /end MEASUREMENT
/begin MEASUREMENT TCMDve_y_BSWDiagDrvOvrCur "Cooling pump motor driver current too high." UBYTE CM_T_y_BitField8 0 0 0 255 ECU_ADDRESS 0x0000 /* @ECU_Address@TCMDve_y_BSWDiagDrvOvrCur@ */ /end MEASUREMENT
/begin MEASUREMENT TCMDve_y_BSWDiagDrvOvrTemp "Cooling pump power stage temperature high" UBYTE CM_T_y_BitField8 0 0 0 255 ECU_ADDRESS 0x0000 /* @ECU_Address@TCMDve_y_BSWDiagDrvOvrTemp@ */ /end MEASUREMENT
/begin MEASUREMENT TCMDve_y_BSWDiagDrvSupOvrVolt "Cooling pump motor driver supply voltage too high" UBYTE CM_T_y_BitField8 0 0 0 255 ECU_ADDRESS 0x0000 /* @ECU_Address@TCMDve_y_BSWDiagDrvSupOvrVolt@ */ /end MEASUREMENT
/begin MEASUREMENT TCMDve_y_BSWDiagHALFault "Cooling pump HAL sensor fault" UBYTE CM_T_y_BitField8 0 0 0 255 ECU_ADDRESS 0x0000 /* @ECU_Address@TCMDve_y_BSWDiagHALFault@ */ /end MEASUREMENT
/begin MEASUREMENT TCMDve_y_BSWDiagHALSupOvrVolt "Cooling pump HAL sensor supply over voltage" UBYTE CM_T_y_BitField8 0 0 0 255 ECU_ADDRESS 0x0000 /* @ECU_Address@TCMDve_y_BSWDiagHALSupOvrVolt@ */ /end MEASUREMENT
/begin MEASUREMENT TCMDve_y_BSWDiagHALSupUndrVolt "Cooling pump HAL sensor supply under voltage" UBYTE CM_T_y_BitField8 0 0 0 255 ECU_ADDRESS 0x0000 /* @ECU_Address@TCMDve_y_BSWDiagHALSupUndrVolt@ */ /end MEASUREMENT
/begin MEASUREMENT TCMDve_y_BSWDiagPhasePerf "Cooling pump motor phase U-V-W performance" UBYTE CM_T_y_BitField8 0 0 0 255 ECU_ADDRESS 0x0000 /* @ECU_Address@TCMDve_y_BSWDiagPhasePerf@ */ /end MEASUREMENT
/begin MEASUREMENT TCMDve_y_BSWDiagPhaseHigh "Cooling pump motor phase U-V-W short to power" UBYTE CM_T_y_BitField8 0 0 0 255 ECU_ADDRESS 0x0000 /* @ECU_Address@TCMDve_y_BSWDiagPhaseHigh@ */ /end MEASUREMENT
/begin MEASUREMENT TCMDve_y_BSWDiagPhaseLow "Cooling pump motor phase U-V-W short to ground" UBYTE CM_T_y_BitField8 0 0 0 255 ECU_ADDRESS 0x0000 /* @ECU_Address@TCMDve_y_BSWDiagPhaseLow@ */ /end MEASUREMENT
/begin MEASUREMENT TCMDve_y_BSWDiagHALInvalFault "Cooling pump  HAL sensor invalid" UBYTE CM_T_y_BitField8 0 0 0 255 ECU_ADDRESS 0x0000 /* @ECU_Address@TCMDve_y_BSWDiagHALInvalFault@ */ /end MEASUREMENT
/begin MEASUREMENT TCMDve_y_BSWDiagHALUndefFault "Cooling pump HAL sensor undefined" UBYTE CM_T_y_BitField8 0 0 0 255 ECU_ADDRESS 0x0000 /* @ECU_Address@TCMDve_y_BSWDiagHALUndefFault@ */ /end MEASUREMENT
/begin MEASUREMENT TCMDve_b_RC_SpdDev_DiagEnbl "Enable for RC speed deviation" UBYTE CM_T_BOOLEAN 0 0 0 1 ECU_ADDRESS 0x0000 /* @ECU_Address@TCMDve_b_RC_SpdDev_DiagEnbl@ */ /end MEASUREMENT
/begin MEASUREMENT TCMDve_b_RC_SpdDev_DepOK "Dependency for RC speed deviation" UBYTE CM_T_BOOLEAN 0 0 0 1 ECU_ADDRESS 0x0000 /* @ECU_Address@TCMDve_b_RC_SpdDev_DepOK@ */ /end MEASUREMENT
/begin MEASUREMENT TCMDve_b_RC_SpdDev_Error "Error detected for RC speed deviation" UBYTE CM_T_BOOLEAN 0 0 0 1 ECU_ADDRESS 0x0000 /* @ECU_Address@TCMDve_b_RC_SpdDev_Error@ */ /end MEASUREMENT
/begin MEASUREMENT TCMDve_b_StuckFault "whether Stuck Fault" UBYTE CM_T_BOOLEAN 0 0 0 1 ECU_ADDRESS 0x0000 /* @ECU_Address@TCMDve_b_StuckFault@ */ /end MEASUREMENT
/begin MEASUREMENT TCMDve_b_EC_StuckDiagEnbl "Stuck Enable" UBYTE CM_T_BOOLEAN 0 0 0 1 ECU_ADDRESS 0x0000 /* @ECU_Address@TCMDve_b_EC_StuckDiagEnbl@ */ /end MEASUREMENT
/begin MEASUREMENT TCMDve_b_MosElecFault "mosfet Electrical diagnostic status from BSW" UBYTE CM_T_BOOLEAN 0 0 0 1 ECU_ADDRESS 0x0000 /* @ECU_Address@TCMDve_b_MosElecFault@ */ /end MEASUREMENT
/begin MEASUREMENT TCMDve_b_EC_MosDiagEnbl "This measurement signal indicates if the enable conditions are fulfilled for the mosfet electrical diagnosis." UBYTE CM_T_BOOLEAN 0 0 0 1 ECU_ADDRESS 0x0000 /* @ECU_Address@TCMDve_b_EC_MosDiagEnbl@ */ /end MEASUREMENT
/begin MEASUREMENT TCMDve_b_ElecFault "Electrical diagnostic status from BSW" UBYTE CM_T_BOOLEAN 0 0 0 1 ECU_ADDRESS 0x0000 /* @ECU_Address@TCMDve_b_ElecFault@ */ /end MEASUREMENT
/begin MEASUREMENT TCMDve_b_EC_DiagEnbl "This measurement signal indicates if the enable conditions are fulfilled for the electrical diagnosis." UBYTE CM_T_BOOLEAN 0 0 0 1 ECU_ADDRESS 0x0000 /* @ECU_Address@TCMDve_b_EC_DiagEnbl@ */ /end MEASUREMENT
/begin MEASUREMENT TCMDve_Cnt_RC_SpdDev_Diags "Pass counter for monitor." UWORD CM_T_Cnt_Num_1_1_u16 0 0 0 65535 ECU_ADDRESS 0x0000 /* @ECU_Address@TCMDve_Cnt_RC_SpdDev_Diags@ */ /end MEASUREMENT
/begin MEASUREMENT TCMDve_Cnt_RC_SpdDev_Fails "Fail counter for monitor." UWORD CM_T_Cnt_Num_1_1_u16 0 0 0 65535 ECU_ADDRESS 0x0000 /* @ECU_Address@TCMDve_Cnt_RC_SpdDev_Fails@ */ /end MEASUREMENT
/begin MEASUREMENT TCMDve_y_EC_MosStatus "The bundled status of of the electrical checks.
      
      Status bit field:
      Data type: T_y_BitFieldDiagStatus
      Dec:	Status:
      0	STATUS_ALL_OK
      1	STATUS_SAMPLE_FAIL
      2	STATUS_TEST_FAIL
      4	STATUS_TEST_FAIL_THIS_CYCLE
      8	STATUS_TEST_NOT_RUN_THIS_CYCLE
      " UBYTE CM_T_y_BitFieldDiagStatus 0 0 0 255 ECU_ADDRESS 0x0000 /* @ECU_Address@TCMDve_y_EC_MosStatus@ */ /end MEASUREMENT
/begin MEASUREMENT TCMDve_y_EC_StuckStatus "The bundled status of of the electrical checks.
      
      Status bit field:
      Data type: T_y_BitFieldDiagStatus
      Dec:	Status:
      0	STATUS_ALL_OK
      1	STATUS_SAMPLE_FAIL
      2	STATUS_TEST_FAIL
      4	STATUS_TEST_FAIL_THIS_CYCLE
      8	STATUS_TEST_NOT_RUN_THIS_CYCLE
      " UBYTE CM_T_y_BitFieldDiagStatus 0 0 0 255 ECU_ADDRESS 0x0000 /* @ECU_Address@TCMDve_y_EC_StuckStatus@ */ /end MEASUREMENT
/begin MEASUREMENT TCMDve_y_EC_Status "The bundled status of of the electrical checks.
      
      Status bit field:
      Data type: T_y_BitFieldDiagStatus
      Dec:	Status:
      0	STATUS_ALL_OK
      1	STATUS_SAMPLE_FAIL
      2	STATUS_TEST_FAIL
      4	STATUS_TEST_FAIL_THIS_CYCLE
      8	STATUS_TEST_NOT_RUN_THIS_CYCLE
      " UBYTE CM_T_y_BitFieldDiagStatus 0 0 0 255 ECU_ADDRESS 0x0000 /* @ECU_Address@TCMDve_y_EC_Status@ */ /end MEASUREMENT
/begin MEASUREMENT TCMDve_y_RC_SpdDev_Progress "Progress for monitor." UBYTE CM_T_y_BitFieldDiagProgress 0 0 0 255 ECU_ADDRESS 0x0000 /* @ECU_Address@TCMDve_y_RC_SpdDev_Progress@ */ /end MEASUREMENT
/begin MEASUREMENT TCMDve_y_RC_SpdDev_Status "Status for monitor." UBYTE CM_T_y_BitFieldDiagStatus 0 0 0 255 ECU_ADDRESS 0x0000 /* @ECU_Address@TCMDve_y_RC_SpdDev_Status@ */ /end MEASUREMENT
/begin MEASUREMENT TCMDve_b_NewCycle "TRUE when the diagnosis is initalized" UBYTE CM_T_BOOLEAN 0 0 0 1 ECU_ADDRESS 0x0000 /* @ECU_Address@TCMDve_b_NewCycle@ */ /end MEASUREMENT
/begin MEASUREMENT TCMDve_b_MosNewCycle "TRUE when the diagnosis is initalized" UBYTE CM_T_BOOLEAN 0 0 0 1 ECU_ADDRESS 0x0000 /* @ECU_Address@TCMDve_b_MosNewCycle@ */ /end MEASUREMENT
/begin MEASUREMENT TCMDve_b_StuckNewCycle "TRUE when the diagnosis is initalized" UBYTE CM_T_BOOLEAN 0 0 0 1 ECU_ADDRESS 0x0000 /* @ECU_Address@TCMDve_b_StuckNewCycle@ */ /end MEASUREMENT
/begin COMPU_METHOD CM_T_n_rpm_1_1_s16 "Q = V" RAT_FUNC "%5.0" "rpm (revolutions / minute  (rpm))" COEFFS 0 1 0 0 0 1 /end COMPU_METHOD
/begin COMPU_METHOD CM_T_Cnt_Num_1_1_u16 "Q = V" RAT_FUNC "%5.0" "Num (counts)" COEFFS 0 1 0 0 0 1 /end COMPU_METHOD
/begin COMPU_METHOD CM_T_T_degC_16_1_s16 "Q = V*16.000000" RAT_FUNC "%8.4" "degC (degrees Celsius  (deg C))" COEFFS 0 16 0 0 0 1 /end COMPU_METHOD
/begin COMPU_METHOD CM_T_r_NA_256_1_u16 "Q = V*256.000000" RAT_FUNC "%11.8" "NA (none)" COEFFS 0 256 0 0 0 1 /end COMPU_METHOD
/begin COMPU_METHOD CM_T_BOOLEAN "Q = V" RAT_FUNC "%1.0" "Bool" COEFFS 0 1 0 0 0 1 /end COMPU_METHOD
/begin COMPU_METHOD CM_T_I_A_32_1_s16 "Q = V*32.000000" RAT_FUNC "%9.5" "A (amperes  (A))" COEFFS 0 32 0 0 0 1 /end COMPU_METHOD
/begin COMPU_METHOD CM_T_Pct_pct_10_1_s16 "Q = V*10.000000" RAT_FUNC "%0.6" "pct (percent  (%))" COEFFS 0 10 0 0 0 1 /end COMPU_METHOD
/begin COMPU_METHOD CM_T_y_BitFieldDiagStatus "Q = V" RAT_FUNC "%3.0" "BitField" COEFFS 0 1 0 0 0 1 /end COMPU_METHOD
/begin COMPU_METHOD CM_T_y_BitField8 "Q = V" RAT_FUNC "%3.0" "BitField" COEFFS 0 1 0 0 0 1 /end COMPU_METHOD
/begin COMPU_METHOD CM_T_y_BitFieldDiagProgress "Q = V" RAT_FUNC "%3.0" "BitField" COEFFS 0 1 0 0 0 1 /end COMPU_METHOD
/* EOF TCMD.a2l */
/begin RECORD_LAYOUT Scalar_BOOLEAN FNC_VALUES 1 UBYTE COLUMN_DIR DIRECT /end RECORD_LAYOUT
/begin RECORD_LAYOUT Scalar_UBYTE FNC_VALUES 1 UBYTE COLUMN_DIR DIRECT /end RECORD_LAYOUT
/begin RECORD_LAYOUT Scalar_UWORD FNC_VALUES 1 UWORD COLUMN_DIR DIRECT /end RECORD_LAYOUT
/begin RECORD_LAYOUT Scalar_SWORD FNC_VALUES 1 SWORD COLUMN_DIR DIRECT /end RECORD_LAYOUT
/begin RECORD_LAYOUT Scalar_FLOAT32_IEEE FNC_VALUES 1 FLOAT32_IEEE COLUMN_DIR DIRECT /end RECORD_LAYOUT
/begin RECORD_LAYOUT Lookup1D_WORD FNC_VALUES 1 SWORD COLUMN_DIR DIRECT /end RECORD_LAYOUT
/begin RECORD_LAYOUT Lookup1D_X_WORD AXIS_PTS_X 1 SWORD INDEX_INCR DIRECT /end RECORD_LAYOUT
/begin CHARACTERISTIC TCPDke_p_MaxAllowedBiasComp "Max allowed absolute compensation for sensor bias." VALUE 0x0000 /* @ECU_Address@TCPDke_p_MaxAllowedBiasComp@ */ Scalar_FLOAT32_IEEE 0 CM_T_p_kPa_Float32 -3.4E+38 3.4E+38 /end CHARACTERISTIC
/begin CHARACTERISTIC TCPDke_p_MaxAllowedTempComp "The maximum adjustment of the temperature compensation (absolute value)." VALUE 0x0000 /* @ECU_Address@TCPDke_p_MaxAllowedTempComp@ */ Scalar_FLOAT32_IEEE 0 CM_T_p_kPa_Float32 -3.4E+38 3.4E+38 /end CHARACTERISTIC
/begin CHARACTERISTIC TCPDke_p_RC_Bias_CompLim "This parameter defines the limit for the bias compensation diagnosis. If the amount of compensation is greater than this value a fault will be detected." VALUE 0x0000 /* @ECU_Address@TCPDke_p_RC_Bias_CompLim@ */ Scalar_FLOAT32_IEEE 0 CM_T_p_kPa_Float32 -3.4E+38 3.4E+38 /end CHARACTERISTIC
/begin CHARACTERISTIC TCPDke_p_TempComp_Offset "The offset for the temperature compensation." VALUE 0x0000 /* @ECU_Address@TCPDke_p_TempComp_Offset@ */ Scalar_FLOAT32_IEEE 0 CM_T_p_kPa_Float32 -3.4E+38 3.4E+38 /end CHARACTERISTIC
/begin CHARACTERISTIC TCPDie_U_ClutchPressureVoltage_OV "Override value for the clutch pressure voltage." VALUE 0x0000 /* @ECU_Address@TCPDie_U_ClutchPressureVoltage_OV@ */ Scalar_SWORD 0 CM_T_U_mV_1_1_s16 -32768 32767 /end CHARACTERISTIC
/begin CHARACTERISTIC TCPDke_p_RC_HighClutchPres_FailLim "Fault limit for the high clutch pressure fault. When target-actual is greater than this a fault will be detected." VALUE 0x0000 /* @ECU_Address@TCPDke_p_RC_HighClutchPres_FailLim@ */ Scalar_SWORD 0 CM_T_p_kPa_1_1_s16 -32768 32767 /end CHARACTERISTIC
/begin CHARACTERISTIC TCPDke_p_RC_LowClutchPres_FailLim "Fault limit for the low clutch pressure fault. When target-actual is greater than this a fault will be detected." VALUE 0x0000 /* @ECU_Address@TCPDke_p_RC_LowClutchPres_FailLim@ */ Scalar_SWORD 0 CM_T_p_kPa_1_1_s16 -32768 32767 /end CHARACTERISTIC
/begin CHARACTERISTIC TCPDke_Cnt_RC_Bias_DiagCounts "Counter for the number of performed diagnostic samples before PASS report." VALUE 0x0000 /* @ECU_Address@TCPDke_Cnt_RC_Bias_DiagCounts@ */ Scalar_UWORD 0 CM_T_Cnt_Num_1_1_u16 0 65535 /end CHARACTERISTIC
/begin CHARACTERISTIC TCPDke_Cnt_RC_HighClutchPres_Diags "Counter for the number of performed diagnostic samples before PASS report." VALUE 0x0000 /* @ECU_Address@TCPDke_Cnt_RC_HighClutchPres_Diags@ */ Scalar_UWORD 0 CM_T_Cnt_Num_1_1_u16 0.0 65535.0 /end CHARACTERISTIC
/begin CHARACTERISTIC TCPDke_Cnt_RC_LowClutchPres_Diags "Counter for the number of performed diagnostic samples before PASS report." VALUE 0x0000 /* @ECU_Address@TCPDke_Cnt_RC_LowClutchPres_Diags@ */ Scalar_UWORD 0 CM_T_Cnt_Num_1_1_u16 0.0 65535.0 /end CHARACTERISTIC
/begin CHARACTERISTIC TCPDke_Cnt_RC_MaxPres_DiagCounts "Counter for the number of performed diagnostic samples before PASS report." VALUE 0x0000 /* @ECU_Address@TCPDke_Cnt_RC_MaxPres_DiagCounts@ */ Scalar_UWORD 0 CM_T_Cnt_Num_1_1_u16 0.0 65535.0 /end CHARACTERISTIC
/begin CHARACTERISTIC TCPDke_t_Bias_Timestep "Execution intervall for the bias compensation runnable." VALUE 0x0000 /* @ECU_Address@TCPDke_t_Bias_Timestep@ */ Scalar_UWORD 0 CM_T_t_ms_1_1_u16 0.0 100.0 EXTENDED_LIMITS 0.0 65535.0 /end CHARACTERISTIC
/begin CHARACTERISTIC TCPDie_p_ClutchPressure_OV "Override value for the clutch pressure." VALUE 0x0000 /* @ECU_Address@TCPDie_p_ClutchPressure_OV@ */ Scalar_UWORD 0 CM_T_p_kPa_32_1_u16 0.0 2047.0 EXTENDED_LIMITS 0.0 2047.96875 /end CHARACTERISTIC
/begin CHARACTERISTIC TCPDke_p_RC_MaxPres_Lim "Maximum allowed clutch pressure " VALUE 0x0000 /* @ECU_Address@TCPDke_p_RC_MaxPres_Lim@ */ Scalar_UWORD 0 CM_T_p_kPa_32_1_u16 0.0 2047.0 EXTENDED_LIMITS 0.0 2047.96875 /end CHARACTERISTIC
/begin CHARACTERISTIC TCPDke_r_RC_Bias_RatioToFail "The number of failed samples as a ratio of TCPDke_Cnt_RC_Bias_DiagCounts before reporting FAIL." VALUE 0x0000 /* @ECU_Address@TCPDke_r_RC_Bias_RatioToFail@ */ Scalar_UWORD 0 CM_T_r_NA_256_1_u16 0 255.99609375 /end CHARACTERISTIC
/begin CHARACTERISTIC TCPDke_r_RC_HighClutchPres_RatioToFail "The number of failed samples as a ratio of TCPDke_Cnt_RC_HighClutchPres_DiagCounts before reporting FAIL." VALUE 0x0000 /* @ECU_Address@TCPDke_r_RC_HighClutchPres_RatioToFail@ */ Scalar_UWORD 0 CM_T_r_NA_256_1_u16 0.0 1.0 EXTENDED_LIMITS 0.0 255.99609375 /end CHARACTERISTIC
/begin CHARACTERISTIC TCPDke_r_RC_LowClutchPres_RatioToFail "The number of failed samples as a ratio of TCPDke_Cnt_RC_LowClutchPres_DiagCounts before reporting FAIL." VALUE 0x0000 /* @ECU_Address@TCPDke_r_RC_LowClutchPres_RatioToFail@ */ Scalar_UWORD 0 CM_T_r_NA_256_1_u16 0.0 1.0 EXTENDED_LIMITS 0.0 255.99609375 /end CHARACTERISTIC
/begin CHARACTERISTIC TCPDke_r_RC_MaxPres_RatioToFail "The number of failed samples as a ratio of performed cycles before reporting FAIL." VALUE 0x0000 /* @ECU_Address@TCPDke_r_RC_MaxPres_RatioToFail@ */ Scalar_UWORD 0 CM_T_r_NA_256_1_u16 0.0 1.0 EXTENDED_LIMITS 0.0 255.99609375 /end CHARACTERISTIC
/begin CHARACTERISTIC TCPDke_K_Slope "Slope used for signal conversion." VALUE 0x0000 /* @ECU_Address@TCPDke_K_Slope@ */ Scalar_SWORD 0 CM_T_K_NA_1024_1_s16 -32.0 31.9 EXTENDED_LIMITS -32.0 31.9990234375 /end CHARACTERISTIC
/begin CHARACTERISTIC TCPDke_K_TempComp_Slope "The slope for the temperature compensation." VALUE 0x0000 /* @ECU_Address@TCPDke_K_TempComp_Slope@ */ Scalar_SWORD 0 CM_T_K_NA_1024_1_s16 -32.0 31.9990234375 /end CHARACTERISTIC
/begin CHARACTERISTIC TCPDke_p_Offset "Offset used for signal conversion" VALUE 0x0000 /* @ECU_Address@TCPDke_p_Offset@ */ Scalar_SWORD 0 CM_T_p_kPa_64_1_s16 -512.0 511.0 EXTENDED_LIMITS -512.0 511.984375 /end CHARACTERISTIC
/begin CHARACTERISTIC TCPDke_K_Bias_LowPassFilterConst "Low pass filter constant. Defines how much of the signal change will propagate through each iteration.
      0 = no propagation. (infinite filtering).
      1 = instant propagation. (No filtering).
      
      Value should typically be somewhere between 0 and 1.
      " VALUE 0x0000 /* @ECU_Address@TCPDke_K_Bias_LowPassFilterConst@ */ Scalar_UWORD 0 CM_T_K_NA_32768_1_u16 0.0 1.0 EXTENDED_LIMITS 0.0 1.999969482421875 /end CHARACTERISTIC
/begin CHARACTERISTIC TCPDke_K_LowPassFilterConst "Low pass filter constant. Defines how much of the signal change will propagate through each iteration.
      0 = no propagation. (infinite filtering).
      1 = instant propagation. (No filtering).
      
      Value should typically be somewhere between 0 and 1.
      
      " VALUE 0x0000 /* @ECU_Address@TCPDke_K_LowPassFilterConst@ */ Scalar_UWORD 0 CM_T_K_NA_32768_1_u16 0.0 1.0 EXTENDED_LIMITS 0.0 1.999969482421875 /end CHARACTERISTIC
/begin CHARACTERISTIC TCPDke_t_BiasFilteringTime "Time to filter the pressure signal before creating the bias compensation." VALUE 0x0000 /* @ECU_Address@TCPDke_t_BiasFilteringTime@ */ Scalar_UWORD 0 CM_T_t_s_10_1_u16 0.0 163.0 EXTENDED_LIMITS 0.0 6553.5 /end CHARACTERISTIC
/begin CHARACTERISTIC TCPDke_t_BiasStartupDelay "Delay after controller start before sampling for bias compensation. This time is used to let the BSW signal stabilize." VALUE 0x0000 /* @ECU_Address@TCPDke_t_BiasStartupDelay@ */ Scalar_UWORD 0 CM_T_t_s_10_1_u16 0.0 163.0 EXTENDED_LIMITS 0.0 6553.5 /end CHARACTERISTIC
/begin CHARACTERISTIC TCPDke_Cnt_CtrlMon_100ms_Index "This is the index reported to the control flow function. It should be unique and in the correct order of execution according to the scheduler." VALUE 0x0000 /* @ECU_Address@TCPDke_Cnt_CtrlMon_100ms_Index@ */ Scalar_UBYTE 0 CM_T_Cnt_Num_1_1_u8 0.0 255.0 /end CHARACTERISTIC
/begin CHARACTERISTIC TCPDke_Cnt_CtrlMon_5ms_Index "This is the index reported to the control flow function. It should be unique and in the correct order of execution according to the scheduler." VALUE 0x0000 /* @ECU_Address@TCPDke_Cnt_CtrlMon_5ms_Index@ */ Scalar_UBYTE 0 CM_T_Cnt_Num_1_1_u8 0.0 255.0 /end CHARACTERISTIC
/begin CHARACTERISTIC TCPDke_i_V5RefSelector "5V reference selector.
      Set 1 to use V5RDve_U_VRef1RawValue
      Set 2 to use V5RDve_U_VRef2RawValue
      Set 3 to use V5RDve_U_VRef3RawValue
      Set 0 to not use V5RD at all (=constant value)
      
      " VALUE 0x0000 /* @ECU_Address@TCPDke_i_V5RefSelector@ */ Scalar_UBYTE 0 CM_T_Cnt_Num_1_1_u8 0 255 /end CHARACTERISTIC
/begin CHARACTERISTIC TCPDie_b_ClutchPressureVoltage_OB "Override boolean for the clutch pressure voltage." VALUE 0x0000 /* @ECU_Address@TCPDie_b_ClutchPressureVoltage_OB@ */ Scalar_BOOLEAN 0 CM_T_BOOLEAN 0 1 /end CHARACTERISTIC
/begin CHARACTERISTIC TCPDie_b_ClutchPressure_OB "Override boolean for the clutch pressure." VALUE 0x0000 /* @ECU_Address@TCPDie_b_ClutchPressure_OB@ */ Scalar_BOOLEAN 0 CM_T_BOOLEAN 0.0 1.0 /end CHARACTERISTIC
/begin CHARACTERISTIC TCPDie_b_CtrlMon_100ms_BlockReport "This override blocks the report of the execution to the monitoring system.
      Should be used during testing to verify correct behaviour of the monitoring system.
      
      " VALUE 0x0000 /* @ECU_Address@TCPDie_b_CtrlMon_100ms_BlockReport@ */ Scalar_BOOLEAN 0 CM_T_BOOLEAN 0.0 1.0 /end CHARACTERISTIC
/begin CHARACTERISTIC TCPDie_b_CtrlMon_5ms_BlockReport "This override blocks the report of the execution to the monitoring system.
      Should be used during testing to verify correct behaviour of the monitoring system.
      
      " VALUE 0x0000 /* @ECU_Address@TCPDie_b_CtrlMon_5ms_BlockReport@ */ Scalar_BOOLEAN 0 CM_T_BOOLEAN 0.0 1.0 /end CHARACTERISTIC
/begin CHARACTERISTIC TCPDie_b_ElecFault_OB "Override boolean for the BSW electrical diagnosis." VALUE 0x0000 /* @ECU_Address@TCPDie_b_ElecFault_OB@ */ Scalar_BOOLEAN 0 CM_T_BOOLEAN 0.0 1.0 /end CHARACTERISTIC
/begin CHARACTERISTIC TCPDie_b_ElecFault_OV "Override value for BSW electrical diagnosis." VALUE 0x0000 /* @ECU_Address@TCPDie_b_ElecFault_OV@ */ Scalar_BOOLEAN 0 CM_T_BOOLEAN 0.0 1.0 /end CHARACTERISTIC
/begin CHARACTERISTIC TCPDke_b_EC_DiagEnbl "Enable boolean for the BSW diagnosis.
      Set to TRUE to activate diagnosis.
      " VALUE 0x0000 /* @ECU_Address@TCPDke_b_EC_DiagEnbl@ */ Scalar_BOOLEAN 0 CM_T_BOOLEAN 0.0 1.0 /end CHARACTERISTIC
/begin CHARACTERISTIC TCPDke_b_RC_Bias_DiagEnbl "When this parameter is TRUE the bias/offset diagnosis will be enabled." VALUE 0x0000 /* @ECU_Address@TCPDke_b_RC_Bias_DiagEnbl@ */ Scalar_BOOLEAN 0 CM_T_BOOLEAN 0 1 /end CHARACTERISTIC
/begin CHARACTERISTIC TCPDke_b_RC_HighClutchPres_DiagEnbl "Enable boolean for the rationality diagnosis.
      Set to TRUE to activate diagnosis.
      " VALUE 0x0000 /* @ECU_Address@TCPDke_b_RC_HighClutchPres_DiagEnbl@ */ Scalar_BOOLEAN 0 CM_T_BOOLEAN 0.0 1.0 /end CHARACTERISTIC
/begin CHARACTERISTIC TCPDke_b_RC_LowClutchPres_DiagEnbl "Enable boolean for the rationality diagnosis.
      Set to TRUE to activate diagnosis.
      " VALUE 0x0000 /* @ECU_Address@TCPDke_b_RC_LowClutchPres_DiagEnbl@ */ Scalar_BOOLEAN 0 CM_T_BOOLEAN 0.0 1.0 /end CHARACTERISTIC
/begin CHARACTERISTIC TCPDke_b_RC_MaxPres_DiagEnbl "Enable boolean for the rationality diagnosis.
      Set to TRUE to activate diagnosis.
      " VALUE 0x0000 /* @ECU_Address@TCPDke_b_RC_MaxPres_DiagEnbl@ */ Scalar_BOOLEAN 0 CM_T_BOOLEAN 0.0 1.0 /end CHARACTERISTIC
/begin CHARACTERISTIC TCPDke_b_ResetBiasComp "Set this parameter to TRUE to reset the bias compensation." VALUE 0x0000 /* @ECU_Address@TCPDke_b_ResetBiasComp@ */ Scalar_BOOLEAN 0 CM_T_BOOLEAN 0 1 /end CHARACTERISTIC
/begin MEASUREMENT TCPDve_p_BiasComp "Used bias compensation after limitation by TCPDke_p_MaxAllowedBiasComp." FLOAT32_IEEE CM_T_p_kPa_Float32 0 0 -3.4E+38 3.4E+38 ECU_ADDRESS 0x0000 /* @ECU_Address@TCPDve_p_BiasComp@ */ /end MEASUREMENT
/begin MEASUREMENT TCPDve_p_ClutchPressBiasComp "Clutch pressure after filtering and compensations before overrides." FLOAT32_IEEE CM_T_p_kPa_Float32 0 0 -3.4E+38 3.4E+38 ECU_ADDRESS 0x0000 /* @ECU_Address@TCPDve_p_ClutchPressBiasComp@ */ /end MEASUREMENT
/begin MEASUREMENT TCPDve_p_TempComp "Bias compensation from oil temperature." FLOAT32_IEEE CM_T_p_kPa_Float32 0 0 -3.4E+38 3.4E+38 ECU_ADDRESS 0x0000 /* @ECU_Address@TCPDve_p_TempComp@ */ /end MEASUREMENT
/begin MEASUREMENT TCPDve_p_ClutchPressTempComp "Clutch pressure after oil temperature compensation, before offset bias compensation." FLOAT32_IEEE CM_T_p_kPa_Float32 0 0 -3.4E+38 3.4E+38 ECU_ADDRESS 0x0000 /* @ECU_Address@TCPDve_p_ClutchPressTempComp@ */ /end MEASUREMENT
/begin MEASUREMENT TCPDve_p_ClutchPressureRaw "The raw pressure signal after conversion." FLOAT32_IEEE CM_T_p_kPa_Float32 0 0 -3.4E+38 3.4E+38 ECU_ADDRESS 0x0000 /* @ECU_Address@TCPDve_p_ClutchPressureRaw@ */ /end MEASUREMENT
/begin MEASUREMENT TCPDve_p_RC_PressureError "Difference between target pressure and actual pressure." SWORD CM_T_p_kPa_1_1_s16 0 0 -32768 32767 ECU_ADDRESS 0x0000 /* @ECU_Address@TCPDve_p_RC_PressureError@ */ /end MEASUREMENT
/begin MEASUREMENT TCPDve_U_ClutchPressureVoltage "Raw Clutch Pressure Voltage after overrides.Used for ECs." SWORD CM_T_U_mV_1_1_s16 0 0 -32768 32767 ECU_ADDRESS 0x0000 /* @ECU_Address@TCPDve_U_ClutchPressureVoltage@ */ /end MEASUREMENT
/begin MEASUREMENT TCPDve_U_Ref "Voltage of the selected V5 ref." SWORD CM_T_U_mV_1_1_s16 0 0 -32768 32767 ECU_ADDRESS 0x0000 /* @ECU_Address@TCPDve_U_Ref@ */ /end MEASUREMENT
/begin MEASUREMENT TCPDve_U_ClutchPressureRaw "Measurement of the clutch pressure sensor voltage. Read directly from BSW" SWORD CM_T_U_mV_1_1_s16 0 0 -32768 32767 ECU_ADDRESS 0x0000 /* @ECU_Address@TCPDve_U_ClutchPressureRaw@ */ /end MEASUREMENT
/begin MEASUREMENT TCPDve_Cnt_RC_MaxPres_FailLim "Fail limit" UWORD CM_T_Cnt_Num_1_1_u16 0 0 0 65535 ECU_ADDRESS 0x0000 /* @ECU_Address@TCPDve_Cnt_RC_MaxPres_FailLim@ */ /end MEASUREMENT
/begin MEASUREMENT TCPDve_Cnt_RC_Bias_FailLim "Fail limit for this monitor." UWORD CM_T_Cnt_Num_1_1_u16 0 0 0 65535 ECU_ADDRESS 0x0000 /* @ECU_Address@TCPDve_Cnt_RC_Bias_FailLim@ */ /end MEASUREMENT
/begin MEASUREMENT TCPDve_Cnt_RC_LowClutchPres_FailLim "Fail limit" UWORD CM_T_Cnt_Num_1_1_u16 0 0 0 65535 ECU_ADDRESS 0x0000 /* @ECU_Address@TCPDve_Cnt_RC_LowClutchPres_FailLim@ */ /end MEASUREMENT
/begin MEASUREMENT TCPDve_Cnt_RC_HighClutchPres_FailLim "Fail limit" UWORD CM_T_Cnt_Num_1_1_u16 0 0 0 65535 ECU_ADDRESS 0x0000 /* @ECU_Address@TCPDve_Cnt_RC_HighClutchPres_FailLim@ */ /end MEASUREMENT
/begin MEASUREMENT TCPDve_y_Status_ "Bundled diagnostic status." UBYTE CM_T_y_BitFieldDiagStatus 0 0 0 255 ECU_ADDRESS 0x0000 /* @ECU_Address@TCPDve_y_Status_@ */ /end MEASUREMENT
/begin MEASUREMENT TCPDve_y_Progress "Bundled diagnostic progress" UBYTE CM_T_y_BitFieldDiagProgress 0 0 0 255 ECU_ADDRESS 0x0000 /* @ECU_Address@TCPDve_y_Progress@ */ /end MEASUREMENT
/begin MEASUREMENT TCPDve_y_RC_ClutchPres_Status "Bundled status for RCs." UBYTE CM_T_y_BitFieldDiagStatus 0 0 0 255 ECU_ADDRESS 0x0000 /* @ECU_Address@TCPDve_y_RC_ClutchPres_Status@ */ /end MEASUREMENT
/begin MEASUREMENT TCPDve_y_BSWDiagHigh "Result of the BSW diagnosis (short high)." UBYTE CM_T_y_BitField8 0 0 0 255 ECU_ADDRESS 0x0000 /* @ECU_Address@TCPDve_y_BSWDiagHigh@ */ /end MEASUREMENT
/begin MEASUREMENT TCPDve_y_BSWDiagLow "Result of the BSW diagnosis (short low)." UBYTE CM_T_y_BitField8 0 0 0 255 ECU_ADDRESS 0x0000 /* @ECU_Address@TCPDve_y_BSWDiagLow@ */ /end MEASUREMENT
/begin MEASUREMENT TCPDve_y_V5RefStatus "Diagnostic status for the selected V5 ref." UBYTE CM_T_y_BitFieldDiagStatus 0 0 0 255 ECU_ADDRESS 0x0000 /* @ECU_Address@TCPDve_y_V5RefStatus@ */ /end MEASUREMENT
/begin MEASUREMENT TCPDve_b_RC_MaxPres_Error "TRUE if the clutch pressure is above maximum limit" UBYTE CM_T_BOOLEAN 0 0 0 1 ECU_ADDRESS 0x0000 /* @ECU_Address@TCPDve_b_RC_MaxPres_Error@ */ /end MEASUREMENT
/begin MEASUREMENT TCPDve_b_RC_MaxPres_DiagEnbl "True if the diagnosis is enabled." UBYTE CM_T_BOOLEAN 0 0 0 1 ECU_ADDRESS 0x0000 /* @ECU_Address@TCPDve_b_RC_MaxPres_DiagEnbl@ */ /end MEASUREMENT
/begin MEASUREMENT TCPDve_b_RC_MaxPres_DepOk "True if dependencies are met." UBYTE CM_T_BOOLEAN 0 0 0 1 ECU_ADDRESS 0x0000 /* @ECU_Address@TCPDve_b_RC_MaxPres_DepOk@ */ /end MEASUREMENT
/begin MEASUREMENT TCPDve_b_RC_Bias_Error "TRUE when sample error for this monitor." UBYTE CM_T_BOOLEAN 0 0 0 1 ECU_ADDRESS 0x0000 /* @ECU_Address@TCPDve_b_RC_Bias_Error@ */ /end MEASUREMENT
/begin MEASUREMENT TCPDve_b_RC_Bias_DiagEnbl "TRUE when all enable conditions for this monitor are fulfulled." UBYTE CM_T_BOOLEAN 0 0 0 1 ECU_ADDRESS 0x0000 /* @ECU_Address@TCPDve_b_RC_Bias_DiagEnbl@ */ /end MEASUREMENT
/begin MEASUREMENT TCPDve_b_RC_Bias_DepOk "TRUE when all depends for this monitors are OK." UBYTE CM_T_BOOLEAN 0 0 0 1 ECU_ADDRESS 0x0000 /* @ECU_Address@TCPDve_b_RC_Bias_DepOk@ */ /end MEASUREMENT
/begin MEASUREMENT TCPDve_b_RC_LowClutchPres_Error "When this is true a low clutch pressure has been detected and is being debounced." UBYTE CM_T_BOOLEAN 0 0 0 1 ECU_ADDRESS 0x0000 /* @ECU_Address@TCPDve_b_RC_LowClutchPres_Error@ */ /end MEASUREMENT
/begin MEASUREMENT TCPDve_b_RC_HighClutchPres_Error "When this is true a high clutch pressure has been detected and is being debounced." UBYTE CM_T_BOOLEAN 0 0 0 1 ECU_ADDRESS 0x0000 /* @ECU_Address@TCPDve_b_RC_HighClutchPres_Error@ */ /end MEASUREMENT
/begin MEASUREMENT TCPDve_b_RC_HighClutchPres_DiagEnbl "When this variable is TRUE the enable conditions for the diagnosis are fulfilled." UBYTE CM_T_BOOLEAN 0 0 0 1 ECU_ADDRESS 0x0000 /* @ECU_Address@TCPDve_b_RC_HighClutchPres_DiagEnbl@ */ /end MEASUREMENT
/begin MEASUREMENT TCPDve_b_RC_LowClutchPres_DiagEnbl "When this variable is TRUE the enable conditions for the diagnosis are fulfilled." UBYTE CM_T_BOOLEAN 0 0 0 1 ECU_ADDRESS 0x0000 /* @ECU_Address@TCPDve_b_RC_LowClutchPres_DiagEnbl@ */ /end MEASUREMENT
/begin MEASUREMENT TCPDve_b_RC_ClutchPres_DepOk "When this is TRUE all dependencies are fulfilled for the high clutch pressure diagnosis." UBYTE CM_T_BOOLEAN 0 0 0 1 ECU_ADDRESS 0x0000 /* @ECU_Address@TCPDve_b_RC_ClutchPres_DepOk@ */ /end MEASUREMENT
/begin MEASUREMENT TCPDve_b_ElecFault "Fault as reported by BSW." UBYTE CM_T_BOOLEAN 0 0 0 1 ECU_ADDRESS 0x0000 /* @ECU_Address@TCPDve_b_ElecFault@ */ /end MEASUREMENT
/begin MEASUREMENT TCPDve_b_EC_DiagEnbl "When this variable is TRUE the BSW diagnosis is enabled" UBYTE CM_T_BOOLEAN 0 0 0 1 ECU_ADDRESS 0x0000 /* @ECU_Address@TCPDve_b_EC_DiagEnbl@ */ /end MEASUREMENT
/begin MEASUREMENT TCPDve_b_EC_DepOk "When this is TRUE the dependencies for the BSW diagnosis are fulfilled." UBYTE CM_T_BOOLEAN 0 0 0 1 ECU_ADDRESS 0x0000 /* @ECU_Address@TCPDve_b_EC_DepOk@ */ /end MEASUREMENT
/begin MEASUREMENT TCPDve_b_BiasSamplingDone "Bias compensation sampling is done" UBYTE CM_T_BOOLEAN 0 0 0 1 ECU_ADDRESS 0x0000 /* @ECU_Address@TCPDve_b_BiasSamplingDone@ */ /end MEASUREMENT
/begin MEASUREMENT TCPDve_b_BiasStartDelayDone "Delay before starting sampling for bias compensation is done." UBYTE CM_T_BOOLEAN 0 0 0 1 ECU_ADDRESS 0x0000 /* @ECU_Address@TCPDve_b_BiasStartDelayDone@ */ /end MEASUREMENT
/begin MEASUREMENT TCPDve_p_ClutchPressureFilt "Clutch pressure after low pass filtering, before compensations (temperature and drift)." FLOAT32_IEEE CM_T_p_kPa_Float32 0 0 -3.4E+38 3.4E+38 ECU_ADDRESS 0x0000 /* @ECU_Address@TCPDve_p_ClutchPressureFilt@ */ /end MEASUREMENT
/begin MEASUREMENT TCPDve_p_AveragePresAtStart "The filtered pressure at controller start." FLOAT32_IEEE CM_T_p_kPa_Float32 0 0 -3.4E+38 3.4E+38 ECU_ADDRESS 0x0000 /* @ECU_Address@TCPDve_p_AveragePresAtStart@ */ /end MEASUREMENT
/begin MEASUREMENT TCPDne_p_BiasComp "Non volatile compensation for the pressure sensor." FLOAT32_IEEE CM_T_p_kPa_Float32 0 0 -3.4E+38 3.4E+38 ECU_ADDRESS 0x0000 /* @ECU_Address@TCPDne_p_BiasComp@ */ /end MEASUREMENT
/begin MEASUREMENT TCPDve_Cnt_RC_Bias_Fails "Diagnosic fail counter for this monitor." UWORD CM_T_Cnt_Num_1_1_u16 0 0 0 65535 ECU_ADDRESS 0x0000 /* @ECU_Address@TCPDve_Cnt_RC_Bias_Fails@ */ /end MEASUREMENT
/begin MEASUREMENT TCPDve_Cnt_RC_Bias_Diags "Diagnosic counter for this monitor." UWORD CM_T_Cnt_Num_1_1_u16 0 0 0 65535 ECU_ADDRESS 0x0000 /* @ECU_Address@TCPDve_Cnt_RC_Bias_Diags@ */ /end MEASUREMENT
/begin MEASUREMENT TCPDve_Cnt_RC_MaxPres_Fails "Fails" UWORD CM_T_Cnt_Num_1_1_u16 0 0 0 65535 ECU_ADDRESS 0x0000 /* @ECU_Address@TCPDve_Cnt_RC_MaxPres_Fails@ */ /end MEASUREMENT
/begin MEASUREMENT TCPDve_Cnt_RC_MaxPres_Diags "DiagCounts" UWORD CM_T_Cnt_Num_1_1_u16 0 0 0 65535 ECU_ADDRESS 0x0000 /* @ECU_Address@TCPDve_Cnt_RC_MaxPres_Diags@ */ /end MEASUREMENT
/begin MEASUREMENT TCPDve_Cnt_RC_LowClutchPres_Fails "Number of failed samples" UWORD CM_T_Cnt_Num_1_1_u16 0 0 0 65535 ECU_ADDRESS 0x0000 /* @ECU_Address@TCPDve_Cnt_RC_LowClutchPres_Fails@ */ /end MEASUREMENT
/begin MEASUREMENT TCPDve_Cnt_RC_LowClutchPres_Diags "Number of diagnostic samples." UWORD CM_T_Cnt_Num_1_1_u16 0 0 0 65535 ECU_ADDRESS 0x0000 /* @ECU_Address@TCPDve_Cnt_RC_LowClutchPres_Diags@ */ /end MEASUREMENT
/begin MEASUREMENT TCPDve_Cnt_RC_HighClutchPres_Fails "Number of failed samples" UWORD CM_T_Cnt_Num_1_1_u16 0 0 0 65535 ECU_ADDRESS 0x0000 /* @ECU_Address@TCPDve_Cnt_RC_HighClutchPres_Fails@ */ /end MEASUREMENT
/begin MEASUREMENT TCPDve_Cnt_RC_HighClutchPres_Diags "Number of diagnostic samples." UWORD CM_T_Cnt_Num_1_1_u16 0 0 0 65535 ECU_ADDRESS 0x0000 /* @ECU_Address@TCPDve_Cnt_RC_HighClutchPres_Diags@ */ /end MEASUREMENT
/begin MEASUREMENT TCPDve_y_RC_LowClutchPres_Status "Status" UBYTE CM_T_y_BitFieldDiagStatus 0 0 0 255 ECU_ADDRESS 0x0000 /* @ECU_Address@TCPDve_y_RC_LowClutchPres_Status@ */ /end MEASUREMENT
/begin MEASUREMENT TCPDve_y_RC_LowClutchPres_Progress "Progress" UBYTE CM_T_y_BitFieldDiagProgress 0 0 0 255 ECU_ADDRESS 0x0000 /* @ECU_Address@TCPDve_y_RC_LowClutchPres_Progress@ */ /end MEASUREMENT
/begin MEASUREMENT TCPDve_y_RC_Bias_Progress "Diagnosic progress for this monitor." UBYTE CM_T_y_BitFieldDiagProgress 0 0 0 255 ECU_ADDRESS 0x0000 /* @ECU_Address@TCPDve_y_RC_Bias_Progress@ */ /end MEASUREMENT
/begin MEASUREMENT TCPDve_y_EC_Status "Bundled status for ECs." UBYTE CM_T_y_BitFieldDiagStatus 0 0 0 255 ECU_ADDRESS 0x0000 /* @ECU_Address@TCPDve_y_EC_Status@ */ /end MEASUREMENT
/begin MEASUREMENT TCPDve_y_RC_MaxPres_Progress "Progress" UBYTE CM_T_y_BitFieldDiagProgress 0 0 0 255 ECU_ADDRESS 0x0000 /* @ECU_Address@TCPDve_y_RC_MaxPres_Progress@ */ /end MEASUREMENT
/begin MEASUREMENT TCPDve_y_RC_MaxPres_Status "Status" UBYTE CM_T_y_BitFieldDiagStatus 0 0 0 255 ECU_ADDRESS 0x0000 /* @ECU_Address@TCPDve_y_RC_MaxPres_Status@ */ /end MEASUREMENT
/begin MEASUREMENT TCPDve_y_RC_HighClutchPres_Status "Status" UBYTE CM_T_y_BitFieldDiagStatus 0 0 0 255 ECU_ADDRESS 0x0000 /* @ECU_Address@TCPDve_y_RC_HighClutchPres_Status@ */ /end MEASUREMENT
/begin MEASUREMENT TCPDve_y_RC_HighClutchPres_Progress "Progress" UBYTE CM_T_y_BitFieldDiagProgress 0 0 0 255 ECU_ADDRESS 0x0000 /* @ECU_Address@TCPDve_y_RC_HighClutchPres_Progress@ */ /end MEASUREMENT
/begin MEASUREMENT TCPDve_y_RC_Bias_Status "Diagnosic status for this monitor." UBYTE CM_T_y_BitFieldDiagStatus 0 0 0 255 ECU_ADDRESS 0x0000 /* @ECU_Address@TCPDve_y_RC_Bias_Status@ */ /end MEASUREMENT
/begin MEASUREMENT TCPDve_b_ClearBiasComp "When this measurement is true the BiasComp NVM variables shall be reset." UBYTE CM_T_BOOLEAN 0 0 0 1 ECU_ADDRESS 0x0000 /* @ECU_Address@TCPDve_b_ClearBiasComp@ */ /end MEASUREMENT
/begin COMPU_METHOD CM_T_p_kPa_Float32 "Q = V" RAT_FUNC "%8.6" "kPa (kiloPascals  (kPa))" COEFFS 0 1 0 0 0 1 /end COMPU_METHOD
/begin COMPU_METHOD CM_T_U_mV_1_1_s16 "Q = V" RAT_FUNC "%5.0" "mV (millivolts  (mV))" COEFFS 0 1 0 0 0 1 /end COMPU_METHOD
/begin COMPU_METHOD CM_T_p_kPa_1_1_s16 "Q = V" RAT_FUNC "%5.0" "kPa (kiloPascals  (kPa))" COEFFS 0 1 0 0 0 1 /end COMPU_METHOD
/begin COMPU_METHOD CM_T_Cnt_Num_1_1_u16 "Q = V" RAT_FUNC "%5.0" "Num (counts)" COEFFS 0 1 0 0 0 1 /end COMPU_METHOD
/begin COMPU_METHOD CM_T_t_ms_1_1_u16 "Q = V" RAT_FUNC "%5.0" "ms (milliseconds  (ms))" COEFFS 0 1 0 0 0 1 /end COMPU_METHOD
/begin COMPU_METHOD CM_T_p_kPa_32_1_u16 "Q = V*32.000000" RAT_FUNC "%9.5" "kPa (kiloPascals  (kPa))" COEFFS 0 32 0 0 0 1 /end COMPU_METHOD
/begin COMPU_METHOD CM_T_r_NA_256_1_u16 "Q = V*256.000000" RAT_FUNC "%11.8" "NA (none)" COEFFS 0 256 0 0 0 1 /end COMPU_METHOD
/begin COMPU_METHOD CM_T_K_NA_1024_1_s16 "Q = V*1024.000000" RAT_FUNC "%12.10" "NA (dependent upon the gain)" COEFFS 0 1024 0 0 0 1 /end COMPU_METHOD
/begin COMPU_METHOD CM_T_p_kPa_64_1_s16 "Q = V*64.000000" RAT_FUNC "%10.6" "kPa (kiloPascals  (kPa))" COEFFS 0 64 0 0 0 1 /end COMPU_METHOD
/begin COMPU_METHOD CM_T_K_NA_32768_1_u16 "Q = V*32768.000000" RAT_FUNC "%16.15" "NA (dependent upon the gain)" COEFFS 0 32768 0 0 0 1 /end COMPU_METHOD
/begin COMPU_METHOD CM_T_t_s_10_1_u16 "Q = V*10.000000" RAT_FUNC "%0.6" "s (seconds  (s))" COEFFS 0 10 0 0 0 1 /end COMPU_METHOD
/begin COMPU_METHOD CM_T_Cnt_Num_1_1_u8 "Q = V" RAT_FUNC "%3.0" "Num (counts)" COEFFS 0 1 0 0 0 1 /end COMPU_METHOD
/begin COMPU_METHOD CM_T_BOOLEAN "Q = V" RAT_FUNC "%1.0" "Bool" COEFFS 0 1 0 0 0 1 /end COMPU_METHOD
/begin COMPU_METHOD CM_T_y_BitFieldDiagStatus "Q = V" RAT_FUNC "%3.0" "BitField" COEFFS 0 1 0 0 0 1 /end COMPU_METHOD
/begin COMPU_METHOD CM_T_y_BitFieldDiagProgress "Q = V" RAT_FUNC "%3.0" "BitField" COEFFS 0 1 0 0 0 1 /end COMPU_METHOD
/begin COMPU_METHOD CM_T_y_BitField8 "Q = V" RAT_FUNC "%3.0" "BitField" COEFFS 0 1 0 0 0 1 /end COMPU_METHOD
/* EOF TCPD.a2l */
/begin RECORD_LAYOUT Scalar_BOOLEAN FNC_VALUES 1 UBYTE COLUMN_DIR DIRECT /end RECORD_LAYOUT
/begin RECORD_LAYOUT Scalar_UBYTE FNC_VALUES 1 UBYTE COLUMN_DIR DIRECT /end RECORD_LAYOUT
/begin RECORD_LAYOUT Scalar_UWORD FNC_VALUES 1 UWORD COLUMN_DIR DIRECT /end RECORD_LAYOUT
/begin RECORD_LAYOUT Scalar_SWORD FNC_VALUES 1 SWORD COLUMN_DIR DIRECT /end RECORD_LAYOUT
/begin RECORD_LAYOUT Scalar_FLOAT32_IEEE FNC_VALUES 1 FLOAT32_IEEE COLUMN_DIR DIRECT /end RECORD_LAYOUT
/begin RECORD_LAYOUT Lookup1D_BYTE FNC_VALUES 1 SBYTE COLUMN_DIR DIRECT /end RECORD_LAYOUT
/begin RECORD_LAYOUT Lookup1D_X_BYTE AXIS_PTS_X 1 SBYTE INDEX_INCR DIRECT /end RECORD_LAYOUT
/begin RECORD_LAYOUT Lookup1D_X_UBYTE AXIS_PTS_X 1 UBYTE INDEX_INCR DIRECT /end RECORD_LAYOUT
/begin RECORD_LAYOUT Lookup1D_WORD FNC_VALUES 1 SWORD COLUMN_DIR DIRECT /end RECORD_LAYOUT
/begin RECORD_LAYOUT Lookup1D_X_WORD AXIS_PTS_X 1 SWORD INDEX_INCR DIRECT /end RECORD_LAYOUT
/begin RECORD_LAYOUT Lookup1D_ULONG FNC_VALUES 1 ULONG COLUMN_DIR DIRECT /end RECORD_LAYOUT
/begin RECORD_LAYOUT Lookup1D_X_ULONG AXIS_PTS_X 1 ULONG INDEX_INCR DIRECT /end RECORD_LAYOUT
/begin RECORD_LAYOUT Lookup1D_SLONG FNC_VALUES 1 SLONG COLUMN_DIR DIRECT /end RECORD_LAYOUT
/begin RECORD_LAYOUT Lookup1D_X_LONG AXIS_PTS_X 1 SLONG INDEX_INCR DIRECT /end RECORD_LAYOUT
/begin RECORD_LAYOUT Lookup1D_FLOAT32_IEEE FNC_VALUES 1 FLOAT32_IEEE COLUMN_DIR DIRECT /end RECORD_LAYOUT
/begin RECORD_LAYOUT Lookup1D_X_FLOAT32_IEEE AXIS_PTS_X 1 FLOAT32_IEEE INDEX_INCR DIRECT /end RECORD_LAYOUT
/begin RECORD_LAYOUT Lookup1D_FLOAT64_IEEE FNC_VALUES 1 FLOAT64_IEEE COLUMN_DIR DIRECT /end RECORD_LAYOUT
/begin RECORD_LAYOUT Lookup1D_X_FLOAT64_IEEE AXIS_PTS_X 1 FLOAT64_IEEE INDEX_INCR DIRECT /end RECORD_LAYOUT
/begin RECORD_LAYOUT Lookup2D_UBYTE FNC_VALUES 1 UBYTE COLUMN_DIR DIRECT /end RECORD_LAYOUT
/begin RECORD_LAYOUT Lookup2D_X_UBYTE AXIS_PTS_X 1 UBYTE INDEX_INCR DIRECT /end RECORD_LAYOUT
/begin RECORD_LAYOUT Lookup2D_BYTE FNC_VALUES 1 SBYTE COLUMN_DIR DIRECT /end RECORD_LAYOUT
/begin RECORD_LAYOUT Lookup2D_X_BYTE AXIS_PTS_X 1 SBYTE INDEX_INCR DIRECT /end RECORD_LAYOUT
/begin RECORD_LAYOUT Lookup2D_ULONG FNC_VALUES 1 ULONG COLUMN_DIR DIRECT /end RECORD_LAYOUT
/begin RECORD_LAYOUT Lookup2D_X_ULONG AXIS_PTS_X 1 ULONG INDEX_INCR DIRECT /end RECORD_LAYOUT
/begin RECORD_LAYOUT Lookup2D_LONG FNC_VALUES 1 SLONG COLUMN_DIR DIRECT /end RECORD_LAYOUT
/begin RECORD_LAYOUT Lookup2D_X_LONG AXIS_PTS_X 1 SLONG INDEX_INCR DIRECT /end RECORD_LAYOUT
/begin RECORD_LAYOUT Lookup2D_FLOAT32_IEEE FNC_VALUES 1 FLOAT32_IEEE COLUMN_DIR DIRECT /end RECORD_LAYOUT
/begin RECORD_LAYOUT Lookup2D_X_FLOAT32_IEEE AXIS_PTS_X 1 FLOAT32_IEEE INDEX_INCR DIRECT /end RECORD_LAYOUT
/begin RECORD_LAYOUT Lookup2D_FLOAT64_IEEE FNC_VALUES 1 FLOAT64_IEEE COLUMN_DIR DIRECT /end RECORD_LAYOUT
/begin RECORD_LAYOUT Lookup2D_X_FLOAT64_IEEE AXIS_PTS_X 1 FLOAT64_IEEE INDEX_INCR DIRECT /end RECORD_LAYOUT
/begin CHARACTERISTIC TLMDkt_M_ClutchTrqTrnsfrCapActP1 "Current clutch torque transfer capability as fed back from clutch oil pressure sensor" CURVE 0x0000 /* @ECU_Address@TLMDkt_M_ClutchTrqTrnsfrCapActP1@ */ Lookup1D_WORD 0 CM_T_M_Nm_4_1_s16 0.0 8000.0 EXTENDED_LIMITS -8192.0 8191.75
 /begin AXIS_DESCR COM_AXIS NO_INPUT_QUANTITY CM_T_p_kPa_1_1_s16 4 0.0 2000.0 AXIS_PTS_REF TLMDkn_p_AxisName /end AXIS_DESCR
/end CHARACTERISTIC
/begin AXIS_PTS TLMDkn_p_AxisName "Break point axis" 0x0000 /* @ECU_Address@TLMDkn_p_AxisName@ */ NO_INPUT_QUANTITY Lookup1D_X_WORD 0 CM_T_p_kPa_1_1_s16 4 0.0 2000.0 EXTENDED_LIMITS -32768.0 32767.0 /end AXIS_PTS
/begin CHARACTERISTIC TLMDke_p_KisspointNominal "Nominal kisspoint clutch pressure" VALUE 0x0000 /* @ECU_Address@TLMDke_p_KisspointNominal@ */ Scalar_SWORD 0 CM_T_p_kPa_1_1_s16 0.0 400.0 EXTENDED_LIMITS -32768.0 32767.0 /end CHARACTERISTIC
/begin CHARACTERISTIC TLMDke_Cnt_TransCtrlSysPerfDiagCounts "Number of ticks to count before reporting pass" VALUE 0x0000 /* @ECU_Address@TLMDke_Cnt_TransCtrlSysPerfDiagCounts@ */ Scalar_UWORD 0 CM_T_Cnt_Num_1_1_u16 1.0 65000.0 EXTENDED_LIMITS 0.0 65535.0 /end CHARACTERISTIC
/begin CHARACTERISTIC TLMDke_r_TransCtrlSysPerfRatioToFail "Ratio of debounce window to report fail" VALUE 0x0000 /* @ECU_Address@TLMDke_r_TransCtrlSysPerfRatioToFail@ */ Scalar_UWORD 0 CM_T_r_NA_256_1_u16 0.0 1.0 EXTENDED_LIMITS 0.0 255.99609375 /end CHARACTERISTIC
/begin CHARACTERISTIC TLMDke_K_TIRC_LimitOnHETE "L1 limits HETE by 1.5 (represented by this cal) times TIRC. Then max of that and of TIRC is used as \"VCU torque command\"." VALUE 0x0000 /* @ECU_Address@TLMDke_K_TIRC_LimitOnHETE@ */ Scalar_UWORD 0 CM_T_K_NA_1024_1_u16 0.0 63.0 EXTENDED_LIMITS 0.0 63.9990234375 /end CHARACTERISTIC
/begin CHARACTERISTIC TLMDke_M_AntiSlipOffset "Anti slip offset torque added as in Level 1" VALUE 0x0000 /* @ECU_Address@TLMDke_M_AntiSlipOffset@ */ Scalar_SWORD 0 CM_T_M_Nm_4_1_s16 0.0 100.0 EXTENDED_LIMITS -8192.0 8191.75 /end CHARACTERISTIC
/begin CHARACTERISTIC TLMDke_M_ClutchTrqCapMarginP1 "Margin added in Level 2 in order to determine excessive clutch torque transfer." VALUE 0x0000 /* @ECU_Address@TLMDke_M_ClutchTrqCapMarginP1@ */ Scalar_SWORD 0 CM_T_M_Nm_4_1_s16 0.0 1000.0 EXTENDED_LIMITS -8192.0 8191.75 /end CHARACTERISTIC
/begin CHARACTERISTIC TLMDke_Cnt_CtrlMon_10ms_Index "Execution order of this runnable" VALUE 0x0000 /* @ECU_Address@TLMDke_Cnt_CtrlMon_10ms_Index@ */ Scalar_UBYTE 0 CM_T_Cnt_Num_1_1_u8 0.0 255.0 /end CHARACTERISTIC
/begin CHARACTERISTIC TLMDke_i_CltchActtrPwrstgIdx "Index for referencing clutch actuator powerstage" VALUE 0x0000 /* @ECU_Address@TLMDke_i_CltchActtrPwrstgIdx@ */ Scalar_UBYTE 0 CM_UInt8 0.0 255.0 /end CHARACTERISTIC
/begin CHARACTERISTIC TLMDke_i_V5RefSelector "5V reference selector for dependency
      
      Set 1 to use V5RDve_y_EC_Ref1_Status
      Set 2 to use V5RDve_y_EC_Ref2_Status
      Set 3 to use V5RDve_y_EC_Ref3_Status
      Set 0 to not use V5RD dependency at all
      
      " VALUE 0x0000 /* @ECU_Address@TLMDke_i_V5RefSelector@ */ Scalar_UBYTE 0 CM_T_Cnt_Num_1_1_u8 0.0 3.0 EXTENDED_LIMITS 0.0 255.0 /end CHARACTERISTIC
/begin CHARACTERISTIC TLMDie_b_CltchActtrPwrstgReEnblTest "This slew gives the opportunity to test the clutch powerstage reenabling" VALUE 0x0000 /* @ECU_Address@TLMDie_b_CltchActtrPwrstgReEnblTest@ */ Scalar_BOOLEAN 0 CM_T_BOOLEAN 0.0 1.0 /end CHARACTERISTIC
/begin CHARACTERISTIC TLMDie_b_CltchActtrPwrstgShtOffTest "This slew gives the opportunity to test the clutch powerstage shutoff path" VALUE 0x0000 /* @ECU_Address@TLMDie_b_CltchActtrPwrstgShtOffTest@ */ Scalar_BOOLEAN 0 CM_T_BOOLEAN 0.0 1.0 /end CHARACTERISTIC
/begin CHARACTERISTIC TLMDie_b_CtrlMon_10ms_BlockReport "Blocks the function call to the program flow check" VALUE 0x0000 /* @ECU_Address@TLMDie_b_CtrlMon_10ms_BlockReport@ */ Scalar_BOOLEAN 0 CM_T_BOOLEAN 0.0 1.0 /end CHARACTERISTIC
/begin CHARACTERISTIC TLMDke_b_CltchActtrPwrstgReEnblEnbl "Enables the reenabling of the clutch powerstage" VALUE 0x0000 /* @ECU_Address@TLMDke_b_CltchActtrPwrstgReEnblEnbl@ */ Scalar_BOOLEAN 0 CM_T_BOOLEAN 0.0 1.0 /end CHARACTERISTIC
/begin CHARACTERISTIC TLMDke_b_CltchActtrPwrstgShtOffEnbl "Enables the execution of the clutch powerstage shutoff command upon a debounced fault" VALUE 0x0000 /* @ECU_Address@TLMDke_b_CltchActtrPwrstgShtOffEnbl@ */ Scalar_BOOLEAN 0 CM_T_BOOLEAN 0.0 1.0 /end CHARACTERISTIC
/begin CHARACTERISTIC TLMDke_b_TransCtrlSysPerfDiagEnbl "Diag enbale switch" VALUE 0x0000 /* @ECU_Address@TLMDke_b_TransCtrlSysPerfDiagEnbl@ */ Scalar_BOOLEAN 0 CM_T_BOOLEAN 0.0 1.0 /end CHARACTERISTIC
/begin MEASUREMENT TLMDve_e_TransCtrlSysPerfVldRaw "supply to FDMA" UBYTE CM_SPARte_e_Validity 0 0 0 3 ECU_ADDRESS 0x0000 /* @ECU_Address@TLMDve_e_TransCtrlSysPerfVldRaw@ */ /end MEASUREMENT
/begin MEASUREMENT TLMDve_M_CltchTrqTrnsfrCapP1Act "Actual clutch torque transfer capability as determined from clutch oil pressure sensor" SWORD CM_T_M_Nm_4_1_s16 0 0 -8192.0 8191.75 ECU_ADDRESS 0x0000 /* @ECU_Address@TLMDve_M_CltchTrqTrnsfrCapP1Act@ */ /end MEASUREMENT
/begin MEASUREMENT TLMDve_M_CltchTrqTrnsfrCapP1Prmttd "Clutch torque transfer capability error threshold" SWORD CM_T_M_Nm_4_1_s16 0 0 -8192.0 8191.75 ECU_ADDRESS 0x0000 /* @ECU_Address@TLMDve_M_CltchTrqTrnsfrCapP1Prmttd@ */ /end MEASUREMENT
/begin MEASUREMENT TLMDve_b_CltchTrqTrnsfrCapFA "Fault active flag" UBYTE CM_T_BOOLEAN 0 0 0 1 ECU_ADDRESS 0x0000 /* @ECU_Address@TLMDve_b_CltchTrqTrnsfrCapFA@ */ /end MEASUREMENT
/begin MEASUREMENT TLMDve_b_TransCtrlSysPerfDiagEnbl "Diag enable" UBYTE CM_T_BOOLEAN 0 0 0 1 ECU_ADDRESS 0x0000 /* @ECU_Address@TLMDve_b_TransCtrlSysPerfDiagEnbl@ */ /end MEASUREMENT
/begin MEASUREMENT TLMDve_b_TransCtrlSysPerfDiagDpndOK "Diag depend" UBYTE CM_T_BOOLEAN 0 0 0 1 ECU_ADDRESS 0x0000 /* @ECU_Address@TLMDve_b_TransCtrlSysPerfDiagDpndOK@ */ /end MEASUREMENT
/begin MEASUREMENT TLMDve_b_RunCrank "RUN/CRANK as read via client server interface" UBYTE CM_T_BOOLEAN 0 0 0 1 ECU_ADDRESS 0x0000 /* @ECU_Address@TLMDve_b_RunCrank@ */ /end MEASUREMENT
/begin MEASUREMENT TLMDve_Cnt_TransCtrlSysPerf_Diags "Debounce counts" UWORD CM_T_Cnt_Num_1_1_u16 0 0 0 65535 ECU_ADDRESS 0x0000 /* @ECU_Address@TLMDve_Cnt_TransCtrlSysPerf_Diags@ */ /end MEASUREMENT
/begin MEASUREMENT TLMDve_Cnt_TransCtrlSysPerf_Fails "Failed debounce counts" UWORD CM_T_Cnt_Num_1_1_u16 0 0 0 65535 ECU_ADDRESS 0x0000 /* @ECU_Address@TLMDve_Cnt_TransCtrlSysPerf_Fails@ */ /end MEASUREMENT
/begin MEASUREMENT TLMDve_y_TransCtrlSysPerf_Progress "Progress" UBYTE CM_T_y_BitFieldDiagProgress 0 0 0 255 ECU_ADDRESS 0x0000 /* @ECU_Address@TLMDve_y_TransCtrlSysPerf_Progress@ */ /end MEASUREMENT
/begin MEASUREMENT TLMDve_y_TransCtrlSysPerf_Status "Status" UBYTE CM_T_y_BitFieldDiagStatus 0 0 0 255 ECU_ADDRESS 0x0000 /* @ECU_Address@TLMDve_y_TransCtrlSysPerf_Status@ */ /end MEASUREMENT
/begin MEASUREMENT TLMDve_b_PwrstgCrrntlShtOffByTLMD "Indicates that the clutch actuator powerstage is in shutoff state due to shutdown by TLMD" UBYTE CM_T_BOOLEAN 0 0 0 1 ECU_ADDRESS 0x0000 /* @ECU_Address@TLMDve_b_PwrstgCrrntlShtOffByTLMD@ */ /end MEASUREMENT
/begin COMPU_METHOD CM_T_M_Nm_4_1_s16 "Q = V*4.000000" RAT_FUNC "%7.2" "Nm (newton-meters  (Nm))" COEFFS 0 4 0 0 0 1 /end COMPU_METHOD
/begin COMPU_METHOD CM_T_p_kPa_1_1_s16 "Q = V" RAT_FUNC "%5.0" "kPa (kiloPascals  (kPa))" COEFFS 0 1 0 0 0 1 /end COMPU_METHOD
/begin COMPU_METHOD CM_T_Cnt_Num_1_1_u16 "Q = V" RAT_FUNC "%5.0" "Num (counts)" COEFFS 0 1 0 0 0 1 /end COMPU_METHOD
/begin COMPU_METHOD CM_T_r_NA_256_1_u16 "Q = V*256.000000" RAT_FUNC "%11.8" "NA (none)" COEFFS 0 256 0 0 0 1 /end COMPU_METHOD
/begin COMPU_METHOD CM_T_K_NA_1024_1_u16 "Q = V*1024.000000" RAT_FUNC "%12.10" "NA (dependent upon the gain)" COEFFS 0 1024 0 0 0 1 /end COMPU_METHOD
/begin COMPU_METHOD CM_T_Cnt_Num_1_1_u8 "Q = V" RAT_FUNC "%3.0" "Num (counts)" COEFFS 0 1 0 0 0 1 /end COMPU_METHOD
/begin COMPU_METHOD CM_UInt8 "Q = V" RAT_FUNC "%3.0" "Num" COEFFS 0 1 0 0 0 1 /end COMPU_METHOD
/begin COMPU_METHOD CM_T_BOOLEAN "Q = V" RAT_FUNC "%1.0" "Bool" COEFFS 0 1 0 0 0 1 /end COMPU_METHOD
/begin COMPU_METHOD CM_SPARte_e_Validity "Enumerated data type: SPARte_e_Validity" TAB_VERB "%0.6" "" COMPU_TAB_REF VTAB_FOR_CM_SPARte_e_Validity /end COMPU_METHOD
/begin COMPU_VTAB VTAB_FOR_CM_SPARte_e_Validity "Enumerated data type: SPARte_e_Validity" TAB_VERB 4 0 "SPARce_e_Valid" 1 "SPARce_e_Invalid" 2 "SPARce_e_EstimatedReplaceValue" 3 "SPARce_e_NotEvaluatedYet" /end COMPU_VTAB
/begin COMPU_METHOD CM_T_y_BitFieldDiagProgress "Q = V" RAT_FUNC "%3.0" "BitField" COEFFS 0 1 0 0 0 1 /end COMPU_METHOD
/begin COMPU_METHOD CM_T_y_BitFieldDiagStatus "Q = V" RAT_FUNC "%3.0" "BitField" COEFFS 0 1 0 0 0 1 /end COMPU_METHOD
/* EOF TLMD.a2l */
/begin RECORD_LAYOUT Scalar_BOOLEAN FNC_VALUES 1 UBYTE COLUMN_DIR DIRECT /end RECORD_LAYOUT
/begin RECORD_LAYOUT Scalar_UBYTE FNC_VALUES 1 UBYTE COLUMN_DIR DIRECT /end RECORD_LAYOUT
/begin RECORD_LAYOUT Scalar_BYTE FNC_VALUES 1 SBYTE COLUMN_DIR DIRECT /end RECORD_LAYOUT
/begin RECORD_LAYOUT Scalar_UWORD FNC_VALUES 1 UWORD COLUMN_DIR DIRECT /end RECORD_LAYOUT
/begin RECORD_LAYOUT Scalar_SWORD FNC_VALUES 1 SWORD COLUMN_DIR DIRECT /end RECORD_LAYOUT
/begin RECORD_LAYOUT Scalar_LONG FNC_VALUES 1 SLONG COLUMN_DIR DIRECT /end RECORD_LAYOUT
/begin RECORD_LAYOUT Scalar_FLOAT32_IEEE FNC_VALUES 1 FLOAT32_IEEE COLUMN_DIR DIRECT /end RECORD_LAYOUT
/begin RECORD_LAYOUT Scalar_FLOAT64_IEEE FNC_VALUES 1 FLOAT64_IEEE COLUMN_DIR DIRECT /end RECORD_LAYOUT
/begin RECORD_LAYOUT Lookup1D_BYTE FNC_VALUES 1 SBYTE COLUMN_DIR DIRECT /end RECORD_LAYOUT
/begin RECORD_LAYOUT Lookup1D_X_BYTE AXIS_PTS_X 1 SBYTE INDEX_INCR DIRECT /end RECORD_LAYOUT
/begin RECORD_LAYOUT Lookup1D_X_UBYTE AXIS_PTS_X 1 UBYTE INDEX_INCR DIRECT /end RECORD_LAYOUT
/begin RECORD_LAYOUT Lookup1D_WORD FNC_VALUES 1 SWORD COLUMN_DIR DIRECT /end RECORD_LAYOUT
/begin RECORD_LAYOUT Lookup1D_X_WORD AXIS_PTS_X 1 SWORD INDEX_INCR DIRECT /end RECORD_LAYOUT
/begin RECORD_LAYOUT Lookup1D_ULONG FNC_VALUES 1 ULONG COLUMN_DIR DIRECT /end RECORD_LAYOUT
/begin RECORD_LAYOUT Lookup1D_X_ULONG AXIS_PTS_X 1 ULONG INDEX_INCR DIRECT /end RECORD_LAYOUT
/begin RECORD_LAYOUT Lookup1D_SLONG FNC_VALUES 1 SLONG COLUMN_DIR DIRECT /end RECORD_LAYOUT
/begin RECORD_LAYOUT Lookup1D_X_LONG AXIS_PTS_X 1 SLONG INDEX_INCR DIRECT /end RECORD_LAYOUT
/begin RECORD_LAYOUT Lookup1D_FLOAT32_IEEE FNC_VALUES 1 FLOAT32_IEEE COLUMN_DIR DIRECT /end RECORD_LAYOUT
/begin RECORD_LAYOUT Lookup1D_X_FLOAT32_IEEE AXIS_PTS_X 1 FLOAT32_IEEE INDEX_INCR DIRECT /end RECORD_LAYOUT
/begin RECORD_LAYOUT Lookup1D_FLOAT64_IEEE FNC_VALUES 1 FLOAT64_IEEE COLUMN_DIR DIRECT /end RECORD_LAYOUT
/begin RECORD_LAYOUT Lookup1D_X_FLOAT64_IEEE AXIS_PTS_X 1 FLOAT64_IEEE INDEX_INCR DIRECT /end RECORD_LAYOUT
/begin RECORD_LAYOUT Lookup2D_UBYTE FNC_VALUES 1 UBYTE COLUMN_DIR DIRECT /end RECORD_LAYOUT
/begin RECORD_LAYOUT Lookup2D_X_UBYTE AXIS_PTS_X 1 UBYTE INDEX_INCR DIRECT /end RECORD_LAYOUT
/begin RECORD_LAYOUT Lookup2D_BYTE FNC_VALUES 1 SBYTE COLUMN_DIR DIRECT /end RECORD_LAYOUT
/begin RECORD_LAYOUT Lookup2D_X_BYTE AXIS_PTS_X 1 SBYTE INDEX_INCR DIRECT /end RECORD_LAYOUT
/begin RECORD_LAYOUT Lookup2D_ULONG FNC_VALUES 1 ULONG COLUMN_DIR DIRECT /end RECORD_LAYOUT
/begin RECORD_LAYOUT Lookup2D_X_ULONG AXIS_PTS_X 1 ULONG INDEX_INCR DIRECT /end RECORD_LAYOUT
/begin RECORD_LAYOUT Lookup2D_LONG FNC_VALUES 1 SLONG COLUMN_DIR DIRECT /end RECORD_LAYOUT
/begin RECORD_LAYOUT Lookup2D_X_LONG AXIS_PTS_X 1 SLONG INDEX_INCR DIRECT /end RECORD_LAYOUT
/begin RECORD_LAYOUT Lookup2D_FLOAT32_IEEE FNC_VALUES 1 FLOAT32_IEEE COLUMN_DIR DIRECT /end RECORD_LAYOUT
/begin RECORD_LAYOUT Lookup2D_X_FLOAT32_IEEE AXIS_PTS_X 1 FLOAT32_IEEE INDEX_INCR DIRECT /end RECORD_LAYOUT
/begin RECORD_LAYOUT Lookup2D_FLOAT64_IEEE FNC_VALUES 1 FLOAT64_IEEE COLUMN_DIR DIRECT /end RECORD_LAYOUT
/begin RECORD_LAYOUT Lookup2D_X_FLOAT64_IEEE AXIS_PTS_X 1 FLOAT64_IEEE INDEX_INCR DIRECT /end RECORD_LAYOUT
/begin CHARACTERISTIC TOTDkt_T_OilTempLookup "Oil temperature" CURVE 0x0000 /* @ECU_Address@TOTDkt_T_OilTempLookup@ */ Lookup1D_WORD 0 CM_T_T_degC_16_1_s16 -2048.0 2047.0 EXTENDED_LIMITS -2048.0 2047.9375
 /begin AXIS_DESCR COM_AXIS NO_INPUT_QUANTITY CM_T_U_mV_1_1_s16 17 -32768.0 32767.0 AXIS_PTS_REF TOTDkn_U_OilTempLookup /end AXIS_DESCR
/end CHARACTERISTIC
/begin AXIS_PTS TOTDkn_U_OilTempLookup "Sensor voltage" 0x0000 /* @ECU_Address@TOTDkn_U_OilTempLookup@ */ NO_INPUT_QUANTITY Lookup1D_X_WORD 0 CM_T_U_mV_1_1_s16 17 -32768.0 32767.0 /end AXIS_PTS
/begin CHARACTERISTIC TOTDke_n_RC_PumpSpdChkLim "Minimum required cooling motor speed in order to enable the \"unreasonable oil temperature\" rationality diagnosis." VALUE 0x0000 /* @ECU_Address@TOTDke_n_RC_PumpSpdChkLim@ */ Scalar_SWORD 0 CM_T_n_rpm_1_1_s16 0.0 32767.0 EXTENDED_LIMITS -32768.0 32767.0 /end CHARACTERISTIC
/begin CHARACTERISTIC TOTDke_Cnt_RC_OilT_CritDiagCounts "Counter for the number of performed diagnostic samples before PASS report for \"system oil temperature too high\" critical DTC." VALUE 0x0000 /* @ECU_Address@TOTDke_Cnt_RC_OilT_CritDiagCounts@ */ Scalar_UWORD 0 CM_T_Cnt_Num_1_1_u16 0 65535 /end CHARACTERISTIC
/begin CHARACTERISTIC TOTDke_Cnt_RC_OilT_WarnDiagCounts "Counter for the number of performed diagnostic samples before PASS report for \"system oil temperature too high\" warning DTC." VALUE 0x0000 /* @ECU_Address@TOTDke_Cnt_RC_OilT_WarnDiagCounts@ */ Scalar_UWORD 0 CM_T_Cnt_Num_1_1_u16 0 65535 /end CHARACTERISTIC
/begin CHARACTERISTIC TOTDke_Cnt_RC_UnReOilT_DiagCounts "Counter for the number of performed diagnostic samples before PASS report for \"unreasonable high oil temperature\"." VALUE 0x0000 /* @ECU_Address@TOTDke_Cnt_RC_UnReOilT_DiagCounts@ */ Scalar_UWORD 0 CM_T_Cnt_Num_1_1_u16 0 65535 /end CHARACTERISTIC
/begin CHARACTERISTIC TOTDie_T_OilTemperature_OV "Override value for the oil temperature." VALUE 0x0000 /* @ECU_Address@TOTDie_T_OilTemperature_OV@ */ Scalar_SWORD 0 CM_T_T_degC_16_1_s16 -2048.0 2047.0 EXTENDED_LIMITS -2048.0 2047.9375 /end CHARACTERISTIC
/begin CHARACTERISTIC TOTDke_T_RC_OilT_CritTempLim "When the transmission oil temperature is above this limit a high oil temperature action shall be taken." VALUE 0x0000 /* @ECU_Address@TOTDke_T_RC_OilT_CritTempLim@ */ Scalar_SWORD 0 CM_T_T_degC_16_1_s16 -2048.0 2047.9375 /end CHARACTERISTIC
/begin CHARACTERISTIC TOTDke_T_RC_OilT_CritTempRecover "When the transmission oil temperature is below this limit oil temperature action shall be Recover." VALUE 0x0000 /* @ECU_Address@TOTDke_T_RC_OilT_CritTempRecover@ */ Scalar_SWORD 0 CM_T_T_degC_16_1_s16 -2048.0 2047.9375 /end CHARACTERISTIC
/begin CHARACTERISTIC TOTDke_T_RC_OilT_WarnTempLim "When the transmission oil temperature is above this limit a high oil temperature warning shall be issued." VALUE 0x0000 /* @ECU_Address@TOTDke_T_RC_OilT_WarnTempLim@ */ Scalar_SWORD 0 CM_T_T_degC_16_1_s16 -2048.0 2047.9375 /end CHARACTERISTIC
/begin CHARACTERISTIC TOTDke_T_RC_OilT_WarnTempRecover "When the transmission oil temperature is below this limit  oil temperature warning shall be Recovered" VALUE 0x0000 /* @ECU_Address@TOTDke_T_RC_OilT_WarnTempRecover@ */ Scalar_SWORD 0 CM_T_T_degC_16_1_s16 -2048.0 2047.9375 /end CHARACTERISTIC
/begin CHARACTERISTIC TOTDke_T_RC_UnReOilT_CorrFailLim "The parameter defines the Correlation failure threshold for the unreasonable oil temperature diagnosis." VALUE 0x0000 /* @ECU_Address@TOTDke_T_RC_UnReOilT_CorrFailLim@ */ Scalar_SWORD 0 CM_T_T_degC_16_1_s16 0.0 2047.0 EXTENDED_LIMITS -2048.0 2047.9375 /end CHARACTERISTIC
/begin CHARACTERISTIC TOTDke_T_RC_UnReOilT_HiLim "The parameter defines the absolute failure threshold for the unreasonable High oil temperature diagnosis." VALUE 0x0000 /* @ECU_Address@TOTDke_T_RC_UnReOilT_HiLim@ */ Scalar_SWORD 0 CM_T_T_degC_16_1_s16 -40.0 2047.0 EXTENDED_LIMITS -2048.0 2047.9375 /end CHARACTERISTIC
/begin CHARACTERISTIC TOTDke_T_RC_UnReOilT_LoLim "The parameter defines the absolute failure threshold for the unreasonable low oil temperature diagnosis." VALUE 0x0000 /* @ECU_Address@TOTDke_T_RC_UnReOilT_LoLim@ */ Scalar_SWORD 0 CM_T_T_degC_16_1_s16 -40.0 2047.0 EXTENDED_LIMITS -2048.0 2047.9375 /end CHARACTERISTIC
/begin CHARACTERISTIC TOTDke_r_RC_OilT_CritRatioToFail "The number of failed samples as a ratio of TOTDke_Cnt_RC_OilT_CritDiagCounts before reporting FAIL." VALUE 0x0000 /* @ECU_Address@TOTDke_r_RC_OilT_CritRatioToFail@ */ Scalar_UWORD 0 CM_T_r_NA_256_1_u16 0 255.99609375 /end CHARACTERISTIC
/begin CHARACTERISTIC TOTDke_r_RC_OilT_WarnRatioToFail "The number of failed samples as a ratio of TOTDke_Cnt_RC_OilT_WarnDiagCounts before reporting FAIL." VALUE 0x0000 /* @ECU_Address@TOTDke_r_RC_OilT_WarnRatioToFail@ */ Scalar_UWORD 0 CM_T_r_NA_256_1_u16 0 255.99609375 /end CHARACTERISTIC
/begin CHARACTERISTIC TOTDke_r_RC_UnReOilT_RatioToFail "The number of failed samples as a ratio of TOTDke_Cnt_RC_UnReOilT_DiagCounts before reporting FAIL." VALUE 0x0000 /* @ECU_Address@TOTDke_r_RC_UnReOilT_RatioToFail@ */ Scalar_UWORD 0 CM_T_r_NA_256_1_u16 0.0 1.0 EXTENDED_LIMITS 0.0 255.99609375 /end CHARACTERISTIC
/begin CHARACTERISTIC TOTDke_t_RC_PumpTimeChkLim "Minimum required cooling motor run time in order to enable the \"unreasonable oil temperature\" rationality diagnosis." VALUE 0x0000 /* @ECU_Address@TOTDke_t_RC_PumpTimeChkLim@ */ Scalar_UWORD 0 CM_T_t_s_10_1_u16 0.0 6553.0 EXTENDED_LIMITS 0.0 6553.5 /end CHARACTERISTIC
/begin CHARACTERISTIC TOTDke_K_LowPassFilterConst "Low pass filter constant. Defines how much of the signal change will propagate through each iteration.
      0 = no propagation. (infinite filtering).
      1 = instant propagation. (No filtering).
      
      Value should typically be somewhere between 0 and 1.
      
      " VALUE 0x0000 /* @ECU_Address@TOTDke_K_LowPassFilterConst@ */ Scalar_UWORD 0 CM_T_K_NA_32768_1_u16 0.0 1.0 EXTENDED_LIMITS 0.0 1.999969482421875 /end CHARACTERISTIC
/begin CHARACTERISTIC TOTDke_i_V5RefSelector "5V reference selector.
      Set 1 to use V5RDve_U_VRef1RawValue
      Set 2 to use V5RDve_U_VRef2RawValue
      Set 3 to use V5RDve_U_VRef3RawValue
      Set 0 to not use V5RD at all (=constant value)
      " VALUE 0x0000 /* @ECU_Address@TOTDke_i_V5RefSelector@ */ Scalar_UBYTE 0 CM_T_Cnt_Num_1_1_u8 0 255 /end CHARACTERISTIC
/begin CHARACTERISTIC TOTDke_y_RC_LimEnblDepends "Bitmask to enable depend conditions
      BIT0 - V5Ref
      BIT1 - TCMDve_y_Status
      
      " VALUE 0x0000 /* @ECU_Address@TOTDke_y_RC_LimEnblDepends@ */ Scalar_UBYTE 0 CM_T_y_BitField8 0.0 255.0 /end CHARACTERISTIC
/begin CHARACTERISTIC TOTDie_b_OilTemperature_OB "Override boolean for the oil temperature." VALUE 0x0000 /* @ECU_Address@TOTDie_b_OilTemperature_OB@ */ Scalar_BOOLEAN 0 CM_T_BOOLEAN 0.0 1.0 /end CHARACTERISTIC
/begin CHARACTERISTIC TOTDke_b_RC_OilT_DiagEnbl "Set this parameter to TRUE to enable the oil temperature high system rationality check." VALUE 0x0000 /* @ECU_Address@TOTDke_b_RC_OilT_DiagEnbl@ */ Scalar_BOOLEAN 0 CM_T_BOOLEAN 0 1 /end CHARACTERISTIC
/begin CHARACTERISTIC TOTDke_b_RC_UnReOilT_DiagEnbl "Set true to enable the monitor for unreasonable oil temperature." VALUE 0x0000 /* @ECU_Address@TOTDke_b_RC_UnReOilT_DiagEnbl@ */ Scalar_BOOLEAN 0 CM_T_BOOLEAN 0.0 1.0 /end CHARACTERISTIC
/begin MEASUREMENT TOTDve_U_Ref "Voltage of the selected 5V reference." SWORD CM_T_U_mV_1_1_s16 0 0 -32768 32767 ECU_ADDRESS 0x0000 /* @ECU_Address@TOTDve_U_Ref@ */ /end MEASUREMENT
/begin MEASUREMENT TOTDve_U_OilTemperatureRaw "Voltage from the oil temperature sensor." SWORD CM_T_U_mV_1_1_s16 0 0 -32768 32767 ECU_ADDRESS 0x0000 /* @ECU_Address@TOTDve_U_OilTemperatureRaw@ */ /end MEASUREMENT
/begin MEASUREMENT TOTDve_Cnt_RC_OilT_WarmFailLim "Fail lim." UWORD CM_T_Cnt_Num_1_1_u16 0 0 0 65535 ECU_ADDRESS 0x0000 /* @ECU_Address@TOTDve_Cnt_RC_OilT_WarmFailLim@ */ /end MEASUREMENT
/begin MEASUREMENT TOTDve_Cnt_RC_OilT_CritFailLim "Fail Lim" UWORD CM_T_Cnt_Num_1_1_u16 0 0 0 65535 ECU_ADDRESS 0x0000 /* @ECU_Address@TOTDve_Cnt_RC_OilT_CritFailLim@ */ /end MEASUREMENT
/begin MEASUREMENT TOTDve_Cnt_RC_Low_FailLim "Fail Limit for this monitor." UWORD CM_T_Cnt_Num_1_1_u16 0 0 0 65535 ECU_ADDRESS 0x0000 /* @ECU_Address@TOTDve_Cnt_RC_Low_FailLim@ */ /end MEASUREMENT
/begin MEASUREMENT TOTDve_Cnt_RC_High_FailLim "Fail Limit for this monitor." UWORD CM_T_Cnt_Num_1_1_u16 0 0 0 65535 ECU_ADDRESS 0x0000 /* @ECU_Address@TOTDve_Cnt_RC_High_FailLim@ */ /end MEASUREMENT
/begin MEASUREMENT TOTDve_T_P1OTDffTmp "Difference calculation P1 - TOTD" SWORD CM_T_T_degC_16_1_s16 0 0 -2048.0 2047.9375 ECU_ADDRESS 0x0000 /* @ECU_Address@TOTDve_T_P1OTDffTmp@ */ /end MEASUREMENT
/begin MEASUREMENT TOTDve_T_P3OTDffTmp "Difference calculation P3 - TOTD" SWORD CM_T_T_degC_16_1_s16 0 0 -2048.0 2047.9375 ECU_ADDRESS 0x0000 /* @ECU_Address@TOTDve_T_P3OTDffTmp@ */ /end MEASUREMENT
/begin MEASUREMENT TOTDve_T_OilTemperature_ "Oil temperature, low pass filtered." SWORD CM_T_T_degC_16_1_s16 0 0 -2048.0 2047.9375 ECU_ADDRESS 0x0000 /* @ECU_Address@TOTDve_T_OilTemperature_@ */ /end MEASUREMENT
/begin MEASUREMENT TOTDve_T_OilTemperatureNorm "Oil temperature after normalisation and the signal conversion from volt." SWORD CM_T_T_degC_16_1_s16 0 0 -2048.0 2047.9375 ECU_ADDRESS 0x0000 /* @ECU_Address@TOTDve_T_OilTemperatureNorm@ */ /end MEASUREMENT
/begin MEASUREMENT TOTDve_y_Status_ "Bundled status all monitors." UBYTE CM_T_y_BitFieldDiagStatus 0 0 0 255 ECU_ADDRESS 0x0000 /* @ECU_Address@TOTDve_y_Status_@ */ /end MEASUREMENT
/begin MEASUREMENT TOTDve_y_Progress "Bundled progress all monitors." UBYTE CM_T_y_BitFieldDiagProgress 0 0 0 255 ECU_ADDRESS 0x0000 /* @ECU_Address@TOTDve_y_Progress@ */ /end MEASUREMENT
/begin MEASUREMENT TOTDve_y_RC_LimDep "Mask to make sure that dependency criteras are ok, depending on TOTDke_y_RC_LimEnblDepends
      BIT0 - V5RefStatus
      BIT1 - TCMDve_y_Status
      " UBYTE CM_T_y_BitField8 0 0 0.0 255.0 ECU_ADDRESS 0x0000 /* @ECU_Address@TOTDve_y_RC_LimDep@ */ /end MEASUREMENT
/begin MEASUREMENT TOTDve_y_V5RefStatus "Diagnostic status of the selected 5V reference." UBYTE CM_T_y_BitFieldDiagStatus 0 0 0 255 ECU_ADDRESS 0x0000 /* @ECU_Address@TOTDve_y_V5RefStatus@ */ /end MEASUREMENT
/begin MEASUREMENT TOTDve_b_RC_OilT_DiagEnbl "Enable conditions" UBYTE CM_T_BOOLEAN 0 0 0 1 ECU_ADDRESS 0x0000 /* @ECU_Address@TOTDve_b_RC_OilT_DiagEnbl@ */ /end MEASUREMENT
/begin MEASUREMENT TOTDve_b_RC_OilT_DepOK "Dependencies." UBYTE CM_T_BOOLEAN 0 0 0 1 ECU_ADDRESS 0x0000 /* @ECU_Address@TOTDve_b_RC_OilT_DepOK@ */ /end MEASUREMENT
/begin MEASUREMENT TOTDve_b_RC_HiCorrErr "Sample error present for this monitor." UBYTE CM_T_BOOLEAN 0 0 0.0 1.0 ECU_ADDRESS 0x0000 /* @ECU_Address@TOTDve_b_RC_HiCorrErr@ */ /end MEASUREMENT
/begin MEASUREMENT TOTDve_b_RC_LoCorrErr "Sample error present for this monitor." UBYTE CM_T_BOOLEAN 0 0 0.0 1.0 ECU_ADDRESS 0x0000 /* @ECU_Address@TOTDve_b_RC_LoCorrErr@ */ /end MEASUREMENT
/begin MEASUREMENT TOTDve_b_RC_HiLimErr "Sample error present for this monitor.
      Higher temperature limit reached
      
      
      
      " UBYTE CM_T_BOOLEAN 0 0 0.0 1.0 ECU_ADDRESS 0x0000 /* @ECU_Address@TOTDve_b_RC_HiLimErr@ */ /end MEASUREMENT
/begin MEASUREMENT TOTDve_b_RC_UnRsnblHi_Err "Both errors are currently active
      - TOTDve_b_RC_HiCorrErr
      - TOTDve_b_RC_HiLimErr
      " UBYTE CM_T_BOOLEAN 0 0 0.0 1.0 ECU_ADDRESS 0x0000 /* @ECU_Address@TOTDve_b_RC_UnRsnblHi_Err@ */ /end MEASUREMENT
/begin MEASUREMENT TOTDve_b_RC_LoLimErr "Sample error present for this monitor.
      Lower temperature limit reached
      
      
      
      " UBYTE CM_T_BOOLEAN 0 0 0.0 1.0 ECU_ADDRESS 0x0000 /* @ECU_Address@TOTDve_b_RC_LoLimErr@ */ /end MEASUREMENT
/begin MEASUREMENT TOTDve_b_RC_UnRsnblLo_Err "Both errors are currently active
      - TOTDve_b_RC_LoCorrErr
      - TOTDve_b_RC_LoLimErr
      " UBYTE CM_T_BOOLEAN 0 0 0.0 1.0 ECU_ADDRESS 0x0000 /* @ECU_Address@TOTDve_b_RC_UnRsnblLo_Err@ */ /end MEASUREMENT
/begin MEASUREMENT TOTDve_b_UnReasOilT_DiagEnbl "When this signal is TRUE the unreasonable oil temperature rationality diagnosis is active." UBYTE CM_T_BOOLEAN 0 0 0 1 ECU_ADDRESS 0x0000 /* @ECU_Address@TOTDve_b_UnReasOilT_DiagEnbl@ */ /end MEASUREMENT
/begin MEASUREMENT TOTDve_b_RC_VldTempSignals "Validity signals OK for TOTD Dependency, e.g. Not Invalid" UBYTE CM_T_BOOLEAN 0 0 0.0 1.0 ECU_ADDRESS 0x0000 /* @ECU_Address@TOTDve_b_RC_VldTempSignals@ */ /end MEASUREMENT
/begin MEASUREMENT TOTDve_b_RC_DepOK "All dependecies for this monitor are OK." UBYTE CM_T_BOOLEAN 0 0 0 1 ECU_ADDRESS 0x0000 /* @ECU_Address@TOTDve_b_RC_DepOK@ */ /end MEASUREMENT
/begin MEASUREMENT TOTDve_b_RC_OilT_CritError "TRUE when critical error is present." UBYTE CM_T_BOOLEAN 0 0 0 1 ECU_ADDRESS 0x0000 /* @ECU_Address@TOTDve_b_RC_OilT_CritError@ */ /end MEASUREMENT
/begin MEASUREMENT TOTDve_b_RC_OilT_WarnError "TRUE when warning-error is present." UBYTE CM_T_BOOLEAN 0 0 0 1 ECU_ADDRESS 0x0000 /* @ECU_Address@TOTDve_b_RC_OilT_WarnError@ */ /end MEASUREMENT
/begin MEASUREMENT TOTDve_Cnt_RC_High_Diags "Pass counter for monitor." UWORD CM_T_Cnt_Num_1_1_u16 0 0 0 65535 ECU_ADDRESS 0x0000 /* @ECU_Address@TOTDve_Cnt_RC_High_Diags@ */ /end MEASUREMENT
/begin MEASUREMENT TOTDve_Cnt_RC_High_Fails "Fail counter for monitor." UWORD CM_T_Cnt_Num_1_1_u16 0 0 0 65535 ECU_ADDRESS 0x0000 /* @ECU_Address@TOTDve_Cnt_RC_High_Fails@ */ /end MEASUREMENT
/begin MEASUREMENT TOTDve_Cnt_RC_Low_Diags "Pass counter for monitor." UWORD CM_T_Cnt_Num_1_1_u16 0 0 0 65535 ECU_ADDRESS 0x0000 /* @ECU_Address@TOTDve_Cnt_RC_Low_Diags@ */ /end MEASUREMENT
/begin MEASUREMENT TOTDve_Cnt_RC_Low_Fails "Fail counter for monitor." UWORD CM_T_Cnt_Num_1_1_u16 0 0 0 65535 ECU_ADDRESS 0x0000 /* @ECU_Address@TOTDve_Cnt_RC_Low_Fails@ */ /end MEASUREMENT
/begin MEASUREMENT TOTDve_Cnt_RC_OilT_CritDiags "Diagnostic counter" UWORD CM_T_Cnt_Num_1_1_u16 0 0 0 65535 ECU_ADDRESS 0x0000 /* @ECU_Address@TOTDve_Cnt_RC_OilT_CritDiags@ */ /end MEASUREMENT
/begin MEASUREMENT TOTDve_Cnt_RC_OilT_CritFails " Diagnostic fail counter" UWORD CM_T_Cnt_Num_1_1_u16 0 0 0 65535 ECU_ADDRESS 0x0000 /* @ECU_Address@TOTDve_Cnt_RC_OilT_CritFails@ */ /end MEASUREMENT
/begin MEASUREMENT TOTDve_Cnt_RC_OilT_WarnDiags " Diagnostic counter" UWORD CM_T_Cnt_Num_1_1_u16 0 0 0 65535 ECU_ADDRESS 0x0000 /* @ECU_Address@TOTDve_Cnt_RC_OilT_WarnDiags@ */ /end MEASUREMENT
/begin MEASUREMENT TOTDve_Cnt_RC_OilT_WarnFails "Diagnostic fail counter" UWORD CM_T_Cnt_Num_1_1_u16 0 0 0 65535 ECU_ADDRESS 0x0000 /* @ECU_Address@TOTDve_Cnt_RC_OilT_WarnFails@ */ /end MEASUREMENT
/begin MEASUREMENT TOTDve_y_RC_High_Progress "Progress for monitor." UBYTE CM_T_y_BitFieldDiagProgress 0 0 0 255 ECU_ADDRESS 0x0000 /* @ECU_Address@TOTDve_y_RC_High_Progress@ */ /end MEASUREMENT
/begin MEASUREMENT TOTDve_y_RC_High_Status "Status for monitor." UBYTE CM_T_y_BitFieldDiagStatus 0 0 0 255 ECU_ADDRESS 0x0000 /* @ECU_Address@TOTDve_y_RC_High_Status@ */ /end MEASUREMENT
/begin MEASUREMENT TOTDve_y_RC_Low_Progress "Progress for monitor." UBYTE CM_T_y_BitFieldDiagProgress 0 0 0 255 ECU_ADDRESS 0x0000 /* @ECU_Address@TOTDve_y_RC_Low_Progress@ */ /end MEASUREMENT
/begin MEASUREMENT TOTDve_y_RC_Low_Status "Status for monitor." UBYTE CM_T_y_BitFieldDiagStatus 0 0 0 255 ECU_ADDRESS 0x0000 /* @ECU_Address@TOTDve_y_RC_Low_Status@ */ /end MEASUREMENT
/begin MEASUREMENT TOTDve_y_RC_OilT_CritProgress "Diagnostic prgoress" UBYTE CM_T_y_BitFieldDiagProgress 0 0 0 255 ECU_ADDRESS 0x0000 /* @ECU_Address@TOTDve_y_RC_OilT_CritProgress@ */ /end MEASUREMENT
/begin MEASUREMENT TOTDve_y_RC_OilT_CritStatus "Diagnostic status" UBYTE CM_T_y_BitFieldDiagStatus 0 0 0 255 ECU_ADDRESS 0x0000 /* @ECU_Address@TOTDve_y_RC_OilT_CritStatus@ */ /end MEASUREMENT
/begin MEASUREMENT TOTDve_y_RC_OilT_WarnProgress "Diagnostic prgoress" UBYTE CM_T_y_BitFieldDiagProgress 0 0 0 255 ECU_ADDRESS 0x0000 /* @ECU_Address@TOTDve_y_RC_OilT_WarnProgress@ */ /end MEASUREMENT
/begin MEASUREMENT TOTDve_y_RC_OilT_WarnStatus "Diagnostic status" UBYTE CM_T_y_BitFieldDiagStatus 0 0 0 255 ECU_ADDRESS 0x0000 /* @ECU_Address@TOTDve_y_RC_OilT_WarnStatus@ */ /end MEASUREMENT
/begin MEASUREMENT TOTDve_b_RC_DltFailRst "Reset flag when error detected" UBYTE CM_T_BOOLEAN 0 0 0 1 ECU_ADDRESS 0x0000 /* @ECU_Address@TOTDve_b_RC_DltFailRst@ */ /end MEASUREMENT
/begin COMPU_METHOD CM_T_T_degC_16_1_s16 "Q = V*16.000000" RAT_FUNC "%8.4" "degC (degrees Celsius  (deg C))" COEFFS 0 16 0 0 0 1 /end COMPU_METHOD
/begin COMPU_METHOD CM_T_U_mV_1_1_s16 "Q = V" RAT_FUNC "%5.0" "mV (millivolts  (mV))" COEFFS 0 1 0 0 0 1 /end COMPU_METHOD
/begin COMPU_METHOD CM_T_n_rpm_1_1_s16 "Q = V" RAT_FUNC "%5.0" "rpm (revolutions / minute  (rpm))" COEFFS 0 1 0 0 0 1 /end COMPU_METHOD
/begin COMPU_METHOD CM_T_Cnt_Num_1_1_u16 "Q = V" RAT_FUNC "%5.0" "Num (counts)" COEFFS 0 1 0 0 0 1 /end COMPU_METHOD
/begin COMPU_METHOD CM_T_r_NA_256_1_u16 "Q = V*256.000000" RAT_FUNC "%11.8" "NA (none)" COEFFS 0 256 0 0 0 1 /end COMPU_METHOD
/begin COMPU_METHOD CM_T_t_s_10_1_u16 "Q = V*10.000000" RAT_FUNC "%0.6" "s (seconds  (s))" COEFFS 0 10 0 0 0 1 /end COMPU_METHOD
/begin COMPU_METHOD CM_T_K_NA_32768_1_u16 "Q = V*32768.000000" RAT_FUNC "%16.15" "NA (dependent upon the gain)" COEFFS 0 32768 0 0 0 1 /end COMPU_METHOD
/begin COMPU_METHOD CM_T_Cnt_Num_1_1_u8 "Q = V" RAT_FUNC "%3.0" "Num (counts)" COEFFS 0 1 0 0 0 1 /end COMPU_METHOD
/begin COMPU_METHOD CM_T_y_BitField8 "Q = V" RAT_FUNC "%3.0" "BitField" COEFFS 0 1 0 0 0 1 /end COMPU_METHOD
/begin COMPU_METHOD CM_T_BOOLEAN "Q = V" RAT_FUNC "%1.0" "Bool" COEFFS 0 1 0 0 0 1 /end COMPU_METHOD
/begin COMPU_METHOD CM_T_y_BitFieldDiagStatus "Q = V" RAT_FUNC "%3.0" "BitField" COEFFS 0 1 0 0 0 1 /end COMPU_METHOD
/begin COMPU_METHOD CM_T_y_BitFieldDiagProgress "Q = V" RAT_FUNC "%3.0" "BitField" COEFFS 0 1 0 0 0 1 /end COMPU_METHOD
/* EOF TOTD.a2l */
/begin RECORD_LAYOUT Scalar_BOOLEAN FNC_VALUES 1 UBYTE COLUMN_DIR DIRECT /end RECORD_LAYOUT
/begin RECORD_LAYOUT Scalar_UBYTE FNC_VALUES 1 UBYTE COLUMN_DIR DIRECT /end RECORD_LAYOUT
/begin RECORD_LAYOUT Scalar_BYTE FNC_VALUES 1 SBYTE COLUMN_DIR DIRECT /end RECORD_LAYOUT
/begin RECORD_LAYOUT Scalar_UWORD FNC_VALUES 1 UWORD COLUMN_DIR DIRECT /end RECORD_LAYOUT
/begin RECORD_LAYOUT Scalar_SWORD FNC_VALUES 1 SWORD COLUMN_DIR DIRECT /end RECORD_LAYOUT
/begin RECORD_LAYOUT Scalar_LONG FNC_VALUES 1 SLONG COLUMN_DIR DIRECT /end RECORD_LAYOUT
/begin RECORD_LAYOUT Scalar_FLOAT32_IEEE FNC_VALUES 1 FLOAT32_IEEE COLUMN_DIR DIRECT /end RECORD_LAYOUT
/begin RECORD_LAYOUT Scalar_FLOAT64_IEEE FNC_VALUES 1 FLOAT64_IEEE COLUMN_DIR DIRECT /end RECORD_LAYOUT
/begin RECORD_LAYOUT Lookup1D_BYTE FNC_VALUES 1 SBYTE COLUMN_DIR DIRECT /end RECORD_LAYOUT
/begin RECORD_LAYOUT Lookup1D_X_BYTE AXIS_PTS_X 1 SBYTE INDEX_INCR DIRECT /end RECORD_LAYOUT
/begin RECORD_LAYOUT Lookup1D_X_UBYTE AXIS_PTS_X 1 UBYTE INDEX_INCR DIRECT /end RECORD_LAYOUT
/begin RECORD_LAYOUT Lookup1D_WORD FNC_VALUES 1 SWORD COLUMN_DIR DIRECT /end RECORD_LAYOUT
/begin RECORD_LAYOUT Lookup1D_X_WORD AXIS_PTS_X 1 SWORD INDEX_INCR DIRECT /end RECORD_LAYOUT
/begin RECORD_LAYOUT Lookup1D_ULONG FNC_VALUES 1 ULONG COLUMN_DIR DIRECT /end RECORD_LAYOUT
/begin RECORD_LAYOUT Lookup1D_X_ULONG AXIS_PTS_X 1 ULONG INDEX_INCR DIRECT /end RECORD_LAYOUT
/begin RECORD_LAYOUT Lookup1D_SLONG FNC_VALUES 1 SLONG COLUMN_DIR DIRECT /end RECORD_LAYOUT
/begin RECORD_LAYOUT Lookup1D_X_LONG AXIS_PTS_X 1 SLONG INDEX_INCR DIRECT /end RECORD_LAYOUT
/begin RECORD_LAYOUT Lookup1D_FLOAT32_IEEE FNC_VALUES 1 FLOAT32_IEEE COLUMN_DIR DIRECT /end RECORD_LAYOUT
/begin RECORD_LAYOUT Lookup1D_X_FLOAT32_IEEE AXIS_PTS_X 1 FLOAT32_IEEE INDEX_INCR DIRECT /end RECORD_LAYOUT
/begin RECORD_LAYOUT Lookup1D_FLOAT64_IEEE FNC_VALUES 1 FLOAT64_IEEE COLUMN_DIR DIRECT /end RECORD_LAYOUT
/begin RECORD_LAYOUT Lookup1D_X_FLOAT64_IEEE AXIS_PTS_X 1 FLOAT64_IEEE INDEX_INCR DIRECT /end RECORD_LAYOUT
/begin RECORD_LAYOUT Lookup2D_UBYTE FNC_VALUES 1 UBYTE COLUMN_DIR DIRECT /end RECORD_LAYOUT
/begin RECORD_LAYOUT Lookup2D_X_UBYTE AXIS_PTS_X 1 UBYTE INDEX_INCR DIRECT /end RECORD_LAYOUT
/begin RECORD_LAYOUT Lookup2D_BYTE FNC_VALUES 1 SBYTE COLUMN_DIR DIRECT /end RECORD_LAYOUT
/begin RECORD_LAYOUT Lookup2D_X_BYTE AXIS_PTS_X 1 SBYTE INDEX_INCR DIRECT /end RECORD_LAYOUT
/begin RECORD_LAYOUT Lookup2D_ULONG FNC_VALUES 1 ULONG COLUMN_DIR DIRECT /end RECORD_LAYOUT
/begin RECORD_LAYOUT Lookup2D_X_ULONG AXIS_PTS_X 1 ULONG INDEX_INCR DIRECT /end RECORD_LAYOUT
/begin RECORD_LAYOUT Lookup2D_LONG FNC_VALUES 1 SLONG COLUMN_DIR DIRECT /end RECORD_LAYOUT
/begin RECORD_LAYOUT Lookup2D_X_LONG AXIS_PTS_X 1 SLONG INDEX_INCR DIRECT /end RECORD_LAYOUT
/begin RECORD_LAYOUT Lookup2D_FLOAT32_IEEE FNC_VALUES 1 FLOAT32_IEEE COLUMN_DIR DIRECT /end RECORD_LAYOUT
/begin RECORD_LAYOUT Lookup2D_X_FLOAT32_IEEE AXIS_PTS_X 1 FLOAT32_IEEE INDEX_INCR DIRECT /end RECORD_LAYOUT
/begin RECORD_LAYOUT Lookup2D_FLOAT64_IEEE FNC_VALUES 1 FLOAT64_IEEE COLUMN_DIR DIRECT /end RECORD_LAYOUT
/begin RECORD_LAYOUT Lookup2D_X_FLOAT64_IEEE AXIS_PTS_X 1 FLOAT64_IEEE INDEX_INCR DIRECT /end RECORD_LAYOUT
/begin CHARACTERISTIC TSPCke_b_TransInptSpdUsEngSpd "Changes between True: SWINve_n_EngSpd and False: TISCve_n_TargetIdleSped as a target idle speed." VALUE 0x0000 /* @ECU_Address@TSPCke_b_TransInptSpdUsEngSpd@ */ Scalar_BOOLEAN 0 CM_T_BOOLEAN 0.0 1.0 /end CHARACTERISTIC
/begin COMPU_METHOD CM_T_BOOLEAN "Q = V" RAT_FUNC "%1.0" "Bool" COEFFS 0 1 0 0 0 1 /end COMPU_METHOD
/* EOF TSPC.a2l */
/begin RECORD_LAYOUT Scalar_BOOLEAN FNC_VALUES 1 UBYTE COLUMN_DIR DIRECT /end RECORD_LAYOUT
/begin RECORD_LAYOUT Scalar_UBYTE FNC_VALUES 1 UBYTE COLUMN_DIR DIRECT /end RECORD_LAYOUT
/begin RECORD_LAYOUT Scalar_BYTE FNC_VALUES 1 SBYTE COLUMN_DIR DIRECT /end RECORD_LAYOUT
/begin RECORD_LAYOUT Scalar_UWORD FNC_VALUES 1 UWORD COLUMN_DIR DIRECT /end RECORD_LAYOUT
/begin RECORD_LAYOUT Scalar_SWORD FNC_VALUES 1 SWORD COLUMN_DIR DIRECT /end RECORD_LAYOUT
/begin RECORD_LAYOUT Scalar_LONG FNC_VALUES 1 SLONG COLUMN_DIR DIRECT /end RECORD_LAYOUT
/begin RECORD_LAYOUT Scalar_FLOAT32_IEEE FNC_VALUES 1 FLOAT32_IEEE COLUMN_DIR DIRECT /end RECORD_LAYOUT
/begin RECORD_LAYOUT Scalar_FLOAT64_IEEE FNC_VALUES 1 FLOAT64_IEEE COLUMN_DIR DIRECT /end RECORD_LAYOUT
/begin RECORD_LAYOUT Lookup1D_BYTE FNC_VALUES 1 SBYTE COLUMN_DIR DIRECT /end RECORD_LAYOUT
/begin RECORD_LAYOUT Lookup1D_X_BYTE AXIS_PTS_X 1 SBYTE INDEX_INCR DIRECT /end RECORD_LAYOUT
/begin RECORD_LAYOUT Lookup1D_X_UBYTE AXIS_PTS_X 1 UBYTE INDEX_INCR DIRECT /end RECORD_LAYOUT
/begin RECORD_LAYOUT Lookup1D_WORD FNC_VALUES 1 SWORD COLUMN_DIR DIRECT /end RECORD_LAYOUT
/begin RECORD_LAYOUT Lookup1D_X_WORD AXIS_PTS_X 1 SWORD INDEX_INCR DIRECT /end RECORD_LAYOUT
/begin RECORD_LAYOUT Lookup1D_ULONG FNC_VALUES 1 ULONG COLUMN_DIR DIRECT /end RECORD_LAYOUT
/begin RECORD_LAYOUT Lookup1D_X_ULONG AXIS_PTS_X 1 ULONG INDEX_INCR DIRECT /end RECORD_LAYOUT
/begin RECORD_LAYOUT Lookup1D_SLONG FNC_VALUES 1 SLONG COLUMN_DIR DIRECT /end RECORD_LAYOUT
/begin RECORD_LAYOUT Lookup1D_X_LONG AXIS_PTS_X 1 SLONG INDEX_INCR DIRECT /end RECORD_LAYOUT
/begin RECORD_LAYOUT Lookup1D_FLOAT32_IEEE FNC_VALUES 1 FLOAT32_IEEE COLUMN_DIR DIRECT /end RECORD_LAYOUT
/begin RECORD_LAYOUT Lookup1D_X_FLOAT32_IEEE AXIS_PTS_X 1 FLOAT32_IEEE INDEX_INCR DIRECT /end RECORD_LAYOUT
/begin RECORD_LAYOUT Lookup1D_FLOAT64_IEEE FNC_VALUES 1 FLOAT64_IEEE COLUMN_DIR DIRECT /end RECORD_LAYOUT
/begin RECORD_LAYOUT Lookup1D_X_FLOAT64_IEEE AXIS_PTS_X 1 FLOAT64_IEEE INDEX_INCR DIRECT /end RECORD_LAYOUT
/begin RECORD_LAYOUT Lookup2D_UBYTE FNC_VALUES 1 UBYTE COLUMN_DIR DIRECT /end RECORD_LAYOUT
/begin RECORD_LAYOUT Lookup2D_X_UBYTE AXIS_PTS_X 1 UBYTE INDEX_INCR DIRECT /end RECORD_LAYOUT
/begin RECORD_LAYOUT Lookup2D_BYTE FNC_VALUES 1 SBYTE COLUMN_DIR DIRECT /end RECORD_LAYOUT
/begin RECORD_LAYOUT Lookup2D_X_BYTE AXIS_PTS_X 1 SBYTE INDEX_INCR DIRECT /end RECORD_LAYOUT
/begin RECORD_LAYOUT Lookup2D_ULONG FNC_VALUES 1 ULONG COLUMN_DIR DIRECT /end RECORD_LAYOUT
/begin RECORD_LAYOUT Lookup2D_X_ULONG AXIS_PTS_X 1 ULONG INDEX_INCR DIRECT /end RECORD_LAYOUT
/begin RECORD_LAYOUT Lookup2D_LONG FNC_VALUES 1 SLONG COLUMN_DIR DIRECT /end RECORD_LAYOUT
/begin RECORD_LAYOUT Lookup2D_X_LONG AXIS_PTS_X 1 SLONG INDEX_INCR DIRECT /end RECORD_LAYOUT
/begin RECORD_LAYOUT Lookup2D_FLOAT32_IEEE FNC_VALUES 1 FLOAT32_IEEE COLUMN_DIR DIRECT /end RECORD_LAYOUT
/begin RECORD_LAYOUT Lookup2D_X_FLOAT32_IEEE AXIS_PTS_X 1 FLOAT32_IEEE INDEX_INCR DIRECT /end RECORD_LAYOUT
/begin RECORD_LAYOUT Lookup2D_FLOAT64_IEEE FNC_VALUES 1 FLOAT64_IEEE COLUMN_DIR DIRECT /end RECORD_LAYOUT
/begin RECORD_LAYOUT Lookup2D_X_FLOAT64_IEEE AXIS_PTS_X 1 FLOAT64_IEEE INDEX_INCR DIRECT /end RECORD_LAYOUT
/begin CHARACTERISTIC TSSDke_r_RC_ClTrq_GearRatio "This parameter defines the gear ratio between the generator and the traction motor." VALUE 0x0000 /* @ECU_Address@TSSDke_r_RC_ClTrq_GearRatio@ */ Scalar_FLOAT32_IEEE 0 CM_T_r_NA_Float32 -3.4E+38 3.4E+38 /end CHARACTERISTIC
/begin CHARACTERISTIC TSSDke_e_RC_DrgTrq_ICEOffCond "Calibration indicating what state is reported when the internal combustion engine is not running." VALUE 0x0000 /* @ECU_Address@TSSDke_e_RC_DrgTrq_ICEOffCond@ */ Scalar_UBYTE 0 CM_SSSCte_e_EngineStatus 0 6 EXTENDED_LIMITS 0 0 /end CHARACTERISTIC
/begin CHARACTERISTIC TSSDke_n_RC_ClTrq_SlipLim "This parameter defines the maximum deviation between the generator and traction motor. It the rotational speed difference is greater than this a clutch torque capacity insufficient fault will be detected." VALUE 0x0000 /* @ECU_Address@TSSDke_n_RC_ClTrq_SlipLim@ */ Scalar_SWORD 0 CM_T_n_rpm_1_1_s16 -32768 32767 /end CHARACTERISTIC
/begin CHARACTERISTIC TSSDke_n_RC_ClTrq_UseSmallDiffFiltBelow "Switchpoint for the small and large filter constant usage. If slip speed is smaller than this parameter the TSSDke_K_RC_ClTrq_SmallDiffFiltConst will be used by the filter. Otherwise the TSSDke_K_RC_ClTrq_LargeDiffFiltConst will be used." VALUE 0x0000 /* @ECU_Address@TSSDke_n_RC_ClTrq_UseSmallDiffFiltBelow@ */ Scalar_SWORD 0 CM_T_n_rpm_1_1_s16 -32768 32767 /end CHARACTERISTIC
/begin CHARACTERISTIC TSSDke_n_RC_DrgTrq_GenSpdLim "When the generator spins faster than this limit the diagnosis will detect a high clutch drag torque fault." VALUE 0x0000 /* @ECU_Address@TSSDke_n_RC_DrgTrq_GenSpdLim@ */ Scalar_SWORD 0 CM_T_n_rpm_1_1_s16 -32768 32767 /end CHARACTERISTIC
/begin CHARACTERISTIC TSSDke_n_RC_DrgTrq_MotChkLim "When the traction motor spins faster than this limit a high drag torque check will be performed" VALUE 0x0000 /* @ECU_Address@TSSDke_n_RC_DrgTrq_MotChkLim@ */ Scalar_SWORD 0 CM_T_n_rpm_1_1_s16 -32768 32767 /end CHARACTERISTIC
/begin CHARACTERISTIC TSSDke_Cnt_RC_ClTrq_DiagCounts "This parameter defines the number of samples required to test before reporting PASS for the clutch capacity insufficient rationality diagnosis." VALUE 0x0000 /* @ECU_Address@TSSDke_Cnt_RC_ClTrq_DiagCounts@ */ Scalar_UWORD 0 CM_T_Cnt_Num_1_1_u16 0 65535 /end CHARACTERISTIC
/begin CHARACTERISTIC TSSDke_Cnt_RC_DrgTrq_DiagCounts "This parameter defines the number of samples required to test before reporting PASS for the clutch capacity insufficient rationality diagnosis." VALUE 0x0000 /* @ECU_Address@TSSDke_Cnt_RC_DrgTrq_DiagCounts@ */ Scalar_UWORD 0 CM_T_Cnt_Num_1_1_u16 0 65535 /end CHARACTERISTIC
/begin CHARACTERISTIC TSSDke_M_RC_DrgTrq_GenTLim "The absolute value of the generator torque must be below this limit in order to run the clutch drag torque too high diagnostic." VALUE 0x0000 /* @ECU_Address@TSSDke_M_RC_DrgTrq_GenTLim@ */ Scalar_SWORD 0 CM_T_M_Nm_32_1_s16 -1024.0 1023.96875 /end CHARACTERISTIC
/begin CHARACTERISTIC TSSDke_p_RC_ClTrq_PresLim "Only when the clutch pressure is above this limit will the diagnosis start checking for clutch slip." VALUE 0x0000 /* @ECU_Address@TSSDke_p_RC_ClTrq_PresLim@ */ Scalar_UWORD 0 CM_T_p_kPa_32_1_u16 0 2047.96875 /end CHARACTERISTIC
/begin CHARACTERISTIC TSSDke_t_RC_DrgTrq_ClOpenTime "If the clutch has been open for this time the diagnosis can start checking for high drag torque." VALUE 0x0000 /* @ECU_Address@TSSDke_t_RC_DrgTrq_ClOpenTime@ */ Scalar_UWORD 0 CM_T_t_s_10_1_u16 0 6553.5 /end CHARACTERISTIC
/begin CHARACTERISTIC TSSDke_t_RC_DrgTrq_ICEOffTime "When the internal combustion engine has been off for this amount of time a high drag torque check shall be performed." VALUE 0x0000 /* @ECU_Address@TSSDke_t_RC_DrgTrq_ICEOffTime@ */ Scalar_UWORD 0 CM_T_t_s_10_1_u16 0 6553.5 /end CHARACTERISTIC
/begin CHARACTERISTIC TSSDke_r_RC_ClTrq_RatioToFail "This parameter defines the ratio of failed number of samples in relation to TSSDke_Cnt_RC_ClTrq_DiagCounts before reporting FAIL for the clutch capacity insufficient rationality diagnosis." VALUE 0x0000 /* @ECU_Address@TSSDke_r_RC_ClTrq_RatioToFail@ */ Scalar_UWORD 0 CM_T_r_NA_256_1_u16 0 255.99609375 /end CHARACTERISTIC
/begin CHARACTERISTIC TSSDke_r_RC_DrgTrq_RatioToFail "This parameter defines the ratio of failed number of samples in relation to TSSDke_Cnt_RC_DrgTrq_DiagCounts before reporting FAIL for the clutch capacity insufficient rationality diagnosis." VALUE 0x0000 /* @ECU_Address@TSSDke_r_RC_DrgTrq_RatioToFail@ */ Scalar_UWORD 0 CM_T_r_NA_256_1_u16 0 255.99609375 /end CHARACTERISTIC
/begin CHARACTERISTIC TSSDke_K_RC_ClTrq_LargeDiffFiltConst "Low pass filter constant. Defines how much of the signal change will propagate through each iteration.
      0 = no propagation. (infinite filtering).
      1 = instant propagation. (No filtering).
      
      Value should typically be somewhere between 0 and 1.
      " VALUE 0x0000 /* @ECU_Address@TSSDke_K_RC_ClTrq_LargeDiffFiltConst@ */ Scalar_UWORD 0 CM_T_K_NA_32768_1_u16 0.0 1.0 EXTENDED_LIMITS 0.0 1.999969482421875 /end CHARACTERISTIC
/begin CHARACTERISTIC TSSDke_K_RC_ClTrq_SmallDiffFiltConst "Low pass filter constant. Defines how much of the signal change will propagate through each iteration.
      0 = no propagation. (infinite filtering).
      1 = instant propagation. (No filtering).
      
      Value should typically be somewhere between 0 and 1.
      
      
      
      " VALUE 0x0000 /* @ECU_Address@TSSDke_K_RC_ClTrq_SmallDiffFiltConst@ */ Scalar_UWORD 0 CM_T_K_NA_32768_1_u16 0.0 1.0 EXTENDED_LIMITS 0.0 1.999969482421875 /end CHARACTERISTIC
/begin CHARACTERISTIC TSSDke_Cnt_ClutchDragTrqTooHighLim "The maximum number of failures allowed in this driving cycle" VALUE 0x0000 /* @ECU_Address@TSSDke_Cnt_ClutchDragTrqTooHighLim@ */ Scalar_UBYTE 0 CM_T_Cnt_Num_1_1_u8 0 255 /end CHARACTERISTIC
/begin CHARACTERISTIC TSSDke_b_RC_ClTrq_DiagEnbl "Set this parameter to TRUE to enable the clutch capacity insufficient rationality diagnosis." VALUE 0x0000 /* @ECU_Address@TSSDke_b_RC_ClTrq_DiagEnbl@ */ Scalar_BOOLEAN 0 CM_T_BOOLEAN 0 1 /end CHARACTERISTIC
/begin CHARACTERISTIC TSSDke_b_RC_ClTrq_InvertP3 "Set to TRUE in order to invert the P3 rotational speed signal." VALUE 0x0000 /* @ECU_Address@TSSDke_b_RC_ClTrq_InvertP3@ */ Scalar_BOOLEAN 0 CM_T_BOOLEAN 0.0 1.0 /end CHARACTERISTIC
/begin CHARACTERISTIC TSSDke_b_RC_DrgTrq_DiagEnbl "Set this parameter to TRUE to enable the clutch capacity insufficient rationality diagnosis." VALUE 0x0000 /* @ECU_Address@TSSDke_b_RC_DrgTrq_DiagEnbl@ */ Scalar_BOOLEAN 0 CM_T_BOOLEAN 0 1 /end CHARACTERISTIC
/begin MEASUREMENT TSSDve_e_ClutchDragTrqTooHighVldIRV "Used to count the number of diagnostic ClutchDragTrqTooHighVld
      only 0 to 1 need plus 1
      " UBYTE CM_SPARte_e_Validity 0 0 0 3 ECU_ADDRESS 0x0000 /* @ECU_Address@TSSDve_e_ClutchDragTrqTooHighVldIRV@ */ /end MEASUREMENT
/begin MEASUREMENT TSSDve_n_P1MtrSpd_Corr "P1MtrSpd after gear ratio correction." SWORD CM_T_n_rpm_1_1_s16 0 0 -32768 32767 ECU_ADDRESS 0x0000 /* @ECU_Address@TSSDve_n_P1MtrSpd_Corr@ */ /end MEASUREMENT
/begin MEASUREMENT TSSDve_n_RC_ClTrq_Slip "This measurement signal contains the absolute difference in speed between the generator and the traction motor." SWORD CM_T_n_rpm_1_1_s16 0 0 -32768 32767 ECU_ADDRESS 0x0000 /* @ECU_Address@TSSDve_n_RC_ClTrq_Slip@ */ /end MEASUREMENT
/begin MEASUREMENT TSSDve_n_RC_ClTrq_SlipLim "This signal is a direct measurement of the calibration parameter TSSDke_n_RC_ClTrq_SlipLim. It is provided to make calibration of the function easier." SWORD CM_T_n_rpm_1_1_s16 0 0 -32768 32767 ECU_ADDRESS 0x0000 /* @ECU_Address@TSSDve_n_RC_ClTrq_SlipLim@ */ /end MEASUREMENT
/begin MEASUREMENT TSSDve_n_RC_ClTrq_Slip_Filt "This measurement signal contains the absolute difference in speed between the generator and the traction motor." SWORD CM_T_n_rpm_1_1_s16 0 0 -32768 32767 ECU_ADDRESS 0x0000 /* @ECU_Address@TSSDve_n_RC_ClTrq_Slip_Filt@ */ /end MEASUREMENT
/begin MEASUREMENT TSSDve_Cnt_RC_DrgTrq_FailLim "Fail limit for RC clutch torque capacity insufficient." UWORD CM_T_Cnt_Num_1_1_u16 0 0 0 65535 ECU_ADDRESS 0x0000 /* @ECU_Address@TSSDve_Cnt_RC_DrgTrq_FailLim@ */ /end MEASUREMENT
/begin MEASUREMENT TSSDve_Cnt_RC_ClTrq_FailLim "Fail limit for RC clutch torque capacity insufficient." UWORD CM_T_Cnt_Num_1_1_u16 0 0 0 65535 ECU_ADDRESS 0x0000 /* @ECU_Address@TSSDve_Cnt_RC_ClTrq_FailLim@ */ /end MEASUREMENT
/begin MEASUREMENT TSSDve_y_Status_ "Bundled status for all the diagnostics in the SWU. Needed to be measureable even without consumers on the output signal." UBYTE CM_T_y_BitFieldDiagStatus 0 0 0 255 ECU_ADDRESS 0x0000 /* @ECU_Address@TSSDve_y_Status_@ */ /end MEASUREMENT
/begin MEASUREMENT TSSDve_y_Progress "Bundled progress for all the diagnostics in the SWU." UBYTE CM_T_y_BitFieldDiagProgress 0 0 0 255 ECU_ADDRESS 0x0000 /* @ECU_Address@TSSDve_y_Progress@ */ /end MEASUREMENT
/begin MEASUREMENT TSSDve_b_RC_DrgTrq_ErrorRaw "When this signal is TRUE, a sample error is found by this monitor Raw." UBYTE CM_T_BOOLEAN 0 0 0 1 ECU_ADDRESS 0x0000 /* @ECU_Address@TSSDve_b_RC_DrgTrq_ErrorRaw@ */ /end MEASUREMENT
/begin MEASUREMENT TSSDve_b_RC_DrgTrq_Error "When this signal is TRUE, a sample error is found by this monitor." UBYTE CM_T_BOOLEAN 0 0 0 1 ECU_ADDRESS 0x0000 /* @ECU_Address@TSSDve_b_RC_DrgTrq_Error@ */ /end MEASUREMENT
/begin MEASUREMENT TSSDve_b_RC_DrgTrq_DiagEnbl "When this signal is TRUE, all the enable conditions are fulfilled and the diagnosis can run." UBYTE CM_T_BOOLEAN 0 0 0 1 ECU_ADDRESS 0x0000 /* @ECU_Address@TSSDve_b_RC_DrgTrq_DiagEnbl@ */ /end MEASUREMENT
/begin MEASUREMENT TSSDve_b_RC_DrgTrq_DepOK "Set this parameter to TRUE to enable the clutch capacity insufficient rationality diagnosis." UBYTE CM_T_BOOLEAN 0 0 0 1 ECU_ADDRESS 0x0000 /* @ECU_Address@TSSDve_b_RC_DrgTrq_DepOK@ */ /end MEASUREMENT
/begin MEASUREMENT TSSDve_b_RC_ClTrq_Error "When this signal is TRUE, a sample error is found by this monitor." UBYTE CM_T_BOOLEAN 0 0 0 1 ECU_ADDRESS 0x0000 /* @ECU_Address@TSSDve_b_RC_ClTrq_Error@ */ /end MEASUREMENT
/begin MEASUREMENT TSSDve_b_RC_ClTrq_DiagEnbl "When this signal is TRUE, all the enable conditions are fulfilled and the diagnosis can run." UBYTE CM_T_BOOLEAN 0 0 0 1 ECU_ADDRESS 0x0000 /* @ECU_Address@TSSDve_b_RC_ClTrq_DiagEnbl@ */ /end MEASUREMENT
/begin MEASUREMENT TSSDve_b_RC_ClTrq_DepOK "Set this parameter to TRUE to enable the clutch capacity insufficient rationality diagnosis." UBYTE CM_T_BOOLEAN 0 0 0 1 ECU_ADDRESS 0x0000 /* @ECU_Address@TSSDve_b_RC_ClTrq_DepOK@ */ /end MEASUREMENT
/begin MEASUREMENT TSSDve_Cnt_RC_ClTrq_Fails "Diagnostic fail counter for RC clutch torque capacity insufficient." UWORD CM_T_Cnt_Num_1_1_u16 0 0 0 65535 ECU_ADDRESS 0x0000 /* @ECU_Address@TSSDve_Cnt_RC_ClTrq_Fails@ */ /end MEASUREMENT
/begin MEASUREMENT TSSDve_Cnt_RC_ClTrq_Diags "Diagnostic counter for RC clutch torque capacity insufficient." UWORD CM_T_Cnt_Num_1_1_u16 0 0 0 65535 ECU_ADDRESS 0x0000 /* @ECU_Address@TSSDve_Cnt_RC_ClTrq_Diags@ */ /end MEASUREMENT
/begin MEASUREMENT TSSDve_Cnt_RC_DrgTrq_Fails "Diagnostic fail counter for RC clutch torque capacity insufficient." UWORD CM_T_Cnt_Num_1_1_u16 0 0 0 65535 ECU_ADDRESS 0x0000 /* @ECU_Address@TSSDve_Cnt_RC_DrgTrq_Fails@ */ /end MEASUREMENT
/begin MEASUREMENT TSSDve_Cnt_RC_DrgTrq_Diags "Diagnostic counter for RC clutch torque capacity insufficient." UWORD CM_T_Cnt_Num_1_1_u16 0 0 0 65535 ECU_ADDRESS 0x0000 /* @ECU_Address@TSSDve_Cnt_RC_DrgTrq_Diags@ */ /end MEASUREMENT
/begin MEASUREMENT TSSDve_t_RC_DrgTrq_ClOpenTimer "Timer to ensure clutch has been open long enough before staring monitor" UWORD CM_T_t_s_10_1_u16 0 0 0 6553.5 ECU_ADDRESS 0x0000 /* @ECU_Address@TSSDve_t_RC_DrgTrq_ClOpenTimer@ */ /end MEASUREMENT
/begin MEASUREMENT TSSDve_t_RC_DrgTrq_ICEOffTimer "Timer to ensure engine has been off long enough before staring monitor" UWORD CM_T_t_s_10_1_u16 0 0 0 6553.5 ECU_ADDRESS 0x0000 /* @ECU_Address@TSSDve_t_RC_DrgTrq_ICEOffTimer@ */ /end MEASUREMENT
/begin MEASUREMENT TSSDve_y_RC_ClTrq_Status "Diagnostic status for RC clutch torque capacity insufficient." UBYTE CM_T_y_BitFieldDiagStatus 0 0 0 255 ECU_ADDRESS 0x0000 /* @ECU_Address@TSSDve_y_RC_ClTrq_Status@ */ /end MEASUREMENT
/begin MEASUREMENT TSSDve_y_RC_ClTrq_Progress "Diagnostic progress for RC clutch torque capacity insufficient." UBYTE CM_T_y_BitFieldDiagProgress 0 0 0 255 ECU_ADDRESS 0x0000 /* @ECU_Address@TSSDve_y_RC_ClTrq_Progress@ */ /end MEASUREMENT
/begin MEASUREMENT TSSDve_y_RC_DrgTrq_Status "Diagnostic status for RC clutch torque capacity insufficient." UBYTE CM_T_y_BitFieldDiagStatus 0 0 0 255 ECU_ADDRESS 0x0000 /* @ECU_Address@TSSDve_y_RC_DrgTrq_Status@ */ /end MEASUREMENT
/begin MEASUREMENT TSSDve_y_RC_DrgTrq_Progress "Diagnostic progress for RC clutch torque capacity insufficient." UBYTE CM_T_y_BitFieldDiagProgress 0 0 0 255 ECU_ADDRESS 0x0000 /* @ECU_Address@TSSDve_y_RC_DrgTrq_Progress@ */ /end MEASUREMENT
/begin MEASUREMENT TSSDve_Cnt_ClutchDragTrqTooHighFail "The Fail num of ClutchDragTrqTooHigh Fail" UBYTE CM_T_Cnt_Num_1_1_u8 0 0 0 255 ECU_ADDRESS 0x0000 /* @ECU_Address@TSSDve_Cnt_ClutchDragTrqTooHighFail@ */ /end MEASUREMENT
/begin COMPU_METHOD CM_T_r_NA_Float32 "Q = V" RAT_FUNC "%8.6" "NA (none)" COEFFS 0 1 0 0 0 1 /end COMPU_METHOD
/begin COMPU_METHOD CM_SSSCte_e_EngineStatus "Enumerated data type: SSSCte_e_EngineStatus" TAB_VERB "%0.6" "" COMPU_TAB_REF VTAB_FOR_CM_SSSCte_e_EngineStatus /end COMPU_METHOD
/begin COMPU_VTAB VTAB_FOR_CM_SSSCte_e_EngineStatus "Enumerated data type: SSSCte_e_EngineStatus" TAB_VERB 7 0 "SSSCce_e_EngineStatusOff" 1 "SSSCce_e_EngineStatusRunning" 2 "SSSCce_e_EngineStatusAutoStop" 3 "SSSCce_e_EngineStatusStarting" 4 "SSSCce_e_EngineStatusReStarting" 5 "SSSCce_e_EngineStatusStalled" 6 "SSSCce_e_EngineStatusStopping" /end COMPU_VTAB
/begin COMPU_METHOD CM_T_n_rpm_1_1_s16 "Q = V" RAT_FUNC "%5.0" "rpm (revolutions / minute  (rpm))" COEFFS 0 1 0 0 0 1 /end COMPU_METHOD
/begin COMPU_METHOD CM_T_Cnt_Num_1_1_u16 "Q = V" RAT_FUNC "%5.0" "Num (counts)" COEFFS 0 1 0 0 0 1 /end COMPU_METHOD
/begin COMPU_METHOD CM_T_M_Nm_32_1_s16 "Q = V*32.000000" RAT_FUNC "%9.5" "Nm (newton-meters  (Nm))" COEFFS 0 32 0 0 0 1 /end COMPU_METHOD
/begin COMPU_METHOD CM_T_p_kPa_32_1_u16 "Q = V*32.000000" RAT_FUNC "%9.5" "kPa (kiloPascals  (kPa))" COEFFS 0 32 0 0 0 1 /end COMPU_METHOD
/begin COMPU_METHOD CM_T_t_s_10_1_u16 "Q = V*10.000000" RAT_FUNC "%0.6" "s (seconds  (s))" COEFFS 0 10 0 0 0 1 /end COMPU_METHOD
/begin COMPU_METHOD CM_T_r_NA_256_1_u16 "Q = V*256.000000" RAT_FUNC "%11.8" "NA (none)" COEFFS 0 256 0 0 0 1 /end COMPU_METHOD
/begin COMPU_METHOD CM_T_K_NA_32768_1_u16 "Q = V*32768.000000" RAT_FUNC "%16.15" "NA (dependent upon the gain)" COEFFS 0 32768 0 0 0 1 /end COMPU_METHOD
/begin COMPU_METHOD CM_T_Cnt_Num_1_1_u8 "Q = V" RAT_FUNC "%3.0" "Num (counts)" COEFFS 0 1 0 0 0 1 /end COMPU_METHOD
/begin COMPU_METHOD CM_T_BOOLEAN "Q = V" RAT_FUNC "%1.0" "Bool" COEFFS 0 1 0 0 0 1 /end COMPU_METHOD
/begin COMPU_METHOD CM_SPARte_e_Validity "Enumerated data type: SPARte_e_Validity" TAB_VERB "%0.6" "" COMPU_TAB_REF VTAB_FOR_CM_SPARte_e_Validity /end COMPU_METHOD
/begin COMPU_VTAB VTAB_FOR_CM_SPARte_e_Validity "Enumerated data type: SPARte_e_Validity" TAB_VERB 4 0 "SPARce_e_Valid" 1 "SPARce_e_Invalid" 2 "SPARce_e_EstimatedReplaceValue" 3 "SPARce_e_NotEvaluatedYet" /end COMPU_VTAB
/begin COMPU_METHOD CM_T_y_BitFieldDiagStatus "Q = V" RAT_FUNC "%3.0" "BitField" COEFFS 0 1 0 0 0 1 /end COMPU_METHOD
/begin COMPU_METHOD CM_T_y_BitFieldDiagProgress "Q = V" RAT_FUNC "%3.0" "BitField" COEFFS 0 1 0 0 0 1 /end COMPU_METHOD
/* EOF TSSD.a2l */
/begin RECORD_LAYOUT Scalar_BOOLEAN FNC_VALUES 1 UBYTE COLUMN_DIR DIRECT /end RECORD_LAYOUT
/begin RECORD_LAYOUT Scalar_UBYTE FNC_VALUES 1 UBYTE COLUMN_DIR DIRECT /end RECORD_LAYOUT
/begin RECORD_LAYOUT Scalar_BYTE FNC_VALUES 1 SBYTE COLUMN_DIR DIRECT /end RECORD_LAYOUT
/begin RECORD_LAYOUT Scalar_UWORD FNC_VALUES 1 UWORD COLUMN_DIR DIRECT /end RECORD_LAYOUT
/begin RECORD_LAYOUT Scalar_SWORD FNC_VALUES 1 SWORD COLUMN_DIR DIRECT /end RECORD_LAYOUT
/begin RECORD_LAYOUT Scalar_LONG FNC_VALUES 1 SLONG COLUMN_DIR DIRECT /end RECORD_LAYOUT
/begin RECORD_LAYOUT Scalar_FLOAT32_IEEE FNC_VALUES 1 FLOAT32_IEEE COLUMN_DIR DIRECT /end RECORD_LAYOUT
/begin RECORD_LAYOUT Scalar_FLOAT64_IEEE FNC_VALUES 1 FLOAT64_IEEE COLUMN_DIR DIRECT /end RECORD_LAYOUT
/begin RECORD_LAYOUT Lookup1D_BYTE FNC_VALUES 1 SBYTE COLUMN_DIR DIRECT /end RECORD_LAYOUT
/begin RECORD_LAYOUT Lookup1D_X_BYTE AXIS_PTS_X 1 SBYTE INDEX_INCR DIRECT /end RECORD_LAYOUT
/begin RECORD_LAYOUT Lookup1D_X_UBYTE AXIS_PTS_X 1 UBYTE INDEX_INCR DIRECT /end RECORD_LAYOUT
/begin RECORD_LAYOUT Lookup1D_WORD FNC_VALUES 1 SWORD COLUMN_DIR DIRECT /end RECORD_LAYOUT
/begin RECORD_LAYOUT Lookup1D_X_WORD AXIS_PTS_X 1 SWORD INDEX_INCR DIRECT /end RECORD_LAYOUT
/begin RECORD_LAYOUT Lookup1D_ULONG FNC_VALUES 1 ULONG COLUMN_DIR DIRECT /end RECORD_LAYOUT
/begin RECORD_LAYOUT Lookup1D_X_ULONG AXIS_PTS_X 1 ULONG INDEX_INCR DIRECT /end RECORD_LAYOUT
/begin RECORD_LAYOUT Lookup1D_SLONG FNC_VALUES 1 SLONG COLUMN_DIR DIRECT /end RECORD_LAYOUT
/begin RECORD_LAYOUT Lookup1D_X_LONG AXIS_PTS_X 1 SLONG INDEX_INCR DIRECT /end RECORD_LAYOUT
/begin RECORD_LAYOUT Lookup1D_FLOAT32_IEEE FNC_VALUES 1 FLOAT32_IEEE COLUMN_DIR DIRECT /end RECORD_LAYOUT
/begin RECORD_LAYOUT Lookup1D_X_FLOAT32_IEEE AXIS_PTS_X 1 FLOAT32_IEEE INDEX_INCR DIRECT /end RECORD_LAYOUT
/begin RECORD_LAYOUT Lookup1D_FLOAT64_IEEE FNC_VALUES 1 FLOAT64_IEEE COLUMN_DIR DIRECT /end RECORD_LAYOUT
/begin RECORD_LAYOUT Lookup1D_X_FLOAT64_IEEE AXIS_PTS_X 1 FLOAT64_IEEE INDEX_INCR DIRECT /end RECORD_LAYOUT
/begin RECORD_LAYOUT Lookup2D_UBYTE FNC_VALUES 1 UBYTE COLUMN_DIR DIRECT /end RECORD_LAYOUT
/begin RECORD_LAYOUT Lookup2D_X_UBYTE AXIS_PTS_X 1 UBYTE INDEX_INCR DIRECT /end RECORD_LAYOUT
/begin RECORD_LAYOUT Lookup2D_BYTE FNC_VALUES 1 SBYTE COLUMN_DIR DIRECT /end RECORD_LAYOUT
/begin RECORD_LAYOUT Lookup2D_X_BYTE AXIS_PTS_X 1 SBYTE INDEX_INCR DIRECT /end RECORD_LAYOUT
/begin RECORD_LAYOUT Lookup2D_ULONG FNC_VALUES 1 ULONG COLUMN_DIR DIRECT /end RECORD_LAYOUT
/begin RECORD_LAYOUT Lookup2D_X_ULONG AXIS_PTS_X 1 ULONG INDEX_INCR DIRECT /end RECORD_LAYOUT
/begin RECORD_LAYOUT Lookup2D_LONG FNC_VALUES 1 SLONG COLUMN_DIR DIRECT /end RECORD_LAYOUT
/begin RECORD_LAYOUT Lookup2D_X_LONG AXIS_PTS_X 1 SLONG INDEX_INCR DIRECT /end RECORD_LAYOUT
/begin RECORD_LAYOUT Lookup2D_FLOAT32_IEEE FNC_VALUES 1 FLOAT32_IEEE COLUMN_DIR DIRECT /end RECORD_LAYOUT
/begin RECORD_LAYOUT Lookup2D_X_FLOAT32_IEEE AXIS_PTS_X 1 FLOAT32_IEEE INDEX_INCR DIRECT /end RECORD_LAYOUT
/begin RECORD_LAYOUT Lookup2D_FLOAT64_IEEE FNC_VALUES 1 FLOAT64_IEEE COLUMN_DIR DIRECT /end RECORD_LAYOUT
/begin RECORD_LAYOUT Lookup2D_X_FLOAT64_IEEE AXIS_PTS_X 1 FLOAT64_IEEE INDEX_INCR DIRECT /end RECORD_LAYOUT
/begin CHARACTERISTIC V5RDie_U_VRef1_OV "Override value for the measured 5 volt reference in bank 1." VALUE 0x0000 /* @ECU_Address@V5RDie_U_VRef1_OV@ */ Scalar_SWORD 0 CM_T_U_mV_1_1_s16 0.0 32767.0 EXTENDED_LIMITS -32768.0 32767.0 /end CHARACTERISTIC
/begin CHARACTERISTIC V5RDie_U_VRef2_OV "Override value for the measured 5 volt reference in bank 2." VALUE 0x0000 /* @ECU_Address@V5RDie_U_VRef2_OV@ */ Scalar_SWORD 0 CM_T_U_mV_1_1_s16 0.0 32767.0 EXTENDED_LIMITS -32768.0 32767.0 /end CHARACTERISTIC
/begin CHARACTERISTIC V5RDie_U_VRef3_OV "Override value for the measured 5 volt reference in bank 3." VALUE 0x0000 /* @ECU_Address@V5RDie_U_VRef3_OV@ */ Scalar_SWORD 0 CM_T_U_mV_1_1_s16 0.0 32767.0 EXTENDED_LIMITS -32768.0 32767.0 /end CHARACTERISTIC
/begin CHARACTERISTIC V5RDie_b_ElecFault_VRef1_OB "Override boolean" VALUE 0x0000 /* @ECU_Address@V5RDie_b_ElecFault_VRef1_OB@ */ Scalar_BOOLEAN 0 CM_T_BOOLEAN 0.0 1.0 /end CHARACTERISTIC
/begin CHARACTERISTIC V5RDie_b_ElecFault_VRef1_OV "Fault from BSW" VALUE 0x0000 /* @ECU_Address@V5RDie_b_ElecFault_VRef1_OV@ */ Scalar_BOOLEAN 0 CM_T_BOOLEAN 0.0 1.0 /end CHARACTERISTIC
/begin CHARACTERISTIC V5RDie_b_ElecFault_VRef2_OB "Override boolean" VALUE 0x0000 /* @ECU_Address@V5RDie_b_ElecFault_VRef2_OB@ */ Scalar_BOOLEAN 0 CM_T_BOOLEAN 0.0 1.0 /end CHARACTERISTIC
/begin CHARACTERISTIC V5RDie_b_ElecFault_VRef2_OV "Fault from BSW" VALUE 0x0000 /* @ECU_Address@V5RDie_b_ElecFault_VRef2_OV@ */ Scalar_BOOLEAN 0 CM_T_BOOLEAN 0.0 1.0 /end CHARACTERISTIC
/begin CHARACTERISTIC V5RDie_b_ElecFault_VRef3_OB "Override boolean" VALUE 0x0000 /* @ECU_Address@V5RDie_b_ElecFault_VRef3_OB@ */ Scalar_BOOLEAN 0 CM_T_BOOLEAN 0.0 1.0 /end CHARACTERISTIC
/begin CHARACTERISTIC V5RDie_b_ElecFault_VRef3_OV "Fault from BSW" VALUE 0x0000 /* @ECU_Address@V5RDie_b_ElecFault_VRef3_OV@ */ Scalar_BOOLEAN 0 CM_T_BOOLEAN 0.0 1.0 /end CHARACTERISTIC
/begin CHARACTERISTIC V5RDie_b_VRef1_OB "Set this to true to override the voltage in bank 1." VALUE 0x0000 /* @ECU_Address@V5RDie_b_VRef1_OB@ */ Scalar_BOOLEAN 0 CM_T_BOOLEAN 0.0 1.0 /end CHARACTERISTIC
/begin CHARACTERISTIC V5RDie_b_VRef2_OB "Set this to true to override the voltage in bank 2." VALUE 0x0000 /* @ECU_Address@V5RDie_b_VRef2_OB@ */ Scalar_BOOLEAN 0 CM_T_BOOLEAN 0.0 1.0 /end CHARACTERISTIC
/begin CHARACTERISTIC V5RDie_b_VRef3_OB "Set this to true to override the voltage in bank 3." VALUE 0x0000 /* @ECU_Address@V5RDie_b_VRef3_OB@ */ Scalar_BOOLEAN 0 CM_T_BOOLEAN 0.0 1.0 /end CHARACTERISTIC
/begin CHARACTERISTIC V5RDke_b_EC_DiagEnblVref1 "Enable flag for 5V reference voltage electrical diagnosis, bank 1." VALUE 0x0000 /* @ECU_Address@V5RDke_b_EC_DiagEnblVref1@ */ Scalar_BOOLEAN 0 CM_T_BOOLEAN 0.0 1.0 /end CHARACTERISTIC
/begin CHARACTERISTIC V5RDke_b_EC_DiagEnblVref2 "Enable flag for 5V reference voltage electrical diagnosis, bank 2." VALUE 0x0000 /* @ECU_Address@V5RDke_b_EC_DiagEnblVref2@ */ Scalar_BOOLEAN 0 CM_T_BOOLEAN 0.0 1.0 /end CHARACTERISTIC
/begin CHARACTERISTIC V5RDke_b_EC_DiagEnblVref3 "Enable flag for 5V reference voltage electrical diagnosis, bank 3." VALUE 0x0000 /* @ECU_Address@V5RDke_b_EC_DiagEnblVref3@ */ Scalar_BOOLEAN 0 CM_T_BOOLEAN 0.0 1.0 /end CHARACTERISTIC
/begin MEASUREMENT V5RDve_U_HWIO_VREF3_5V "Local connector for the V5 reference #3. Directly after the HWIO interface.
      This should typically be used by the test department.
      
      " SWORD CM_T_U_mV_1_1_s16 0 0 -32768 32767 ECU_ADDRESS 0x0000 /* @ECU_Address@V5RDve_U_HWIO_VREF3_5V@ */ /end MEASUREMENT
/begin MEASUREMENT V5RDve_U_HWIO_VREF2_5V "Local connector for the V5 reference #2. Directly after the HWIO interface.
      This should typically be used by the test department.
      
      " SWORD CM_T_U_mV_1_1_s16 0 0 -32768 32767 ECU_ADDRESS 0x0000 /* @ECU_Address@V5RDve_U_HWIO_VREF2_5V@ */ /end MEASUREMENT
/begin MEASUREMENT V5RDve_U_HWIO_VREF1_5V "Local connector for the 5V reference #1. Directly after the HWIO interface.
      This should typically be used by the test department.
      " SWORD CM_T_U_mV_1_1_s16 0 0 -32768 32767 ECU_ADDRESS 0x0000 /* @ECU_Address@V5RDve_U_HWIO_VREF1_5V@ */ /end MEASUREMENT
/begin MEASUREMENT V5RDve_y_BSWDiagRefCUnrVolt "Ref C over volt" UBYTE CM_T_y_BitField8 0 0 0 255 ECU_ADDRESS 0x0000 /* @ECU_Address@V5RDve_y_BSWDiagRefCUnrVolt@ */ /end MEASUREMENT
/begin MEASUREMENT V5RDve_y_BSWDiagRefCOvrVolt "Ref C over volt" UBYTE CM_T_y_BitField8 0 0 0 255 ECU_ADDRESS 0x0000 /* @ECU_Address@V5RDve_y_BSWDiagRefCOvrVolt@ */ /end MEASUREMENT
/begin MEASUREMENT V5RDve_y_BSWDiagRefBUnrVolt "Ref B over volt" UBYTE CM_T_y_BitField8 0 0 0 255 ECU_ADDRESS 0x0000 /* @ECU_Address@V5RDve_y_BSWDiagRefBUnrVolt@ */ /end MEASUREMENT
/begin MEASUREMENT V5RDve_y_BSWDiagRefBOvrVolt "Ref B over volt" UBYTE CM_T_y_BitField8 0 0 0 255 ECU_ADDRESS 0x0000 /* @ECU_Address@V5RDve_y_BSWDiagRefBOvrVolt@ */ /end MEASUREMENT
/begin MEASUREMENT V5RDve_y_BSWDiagRefAUnrVolt "Ref A under volt" UBYTE CM_T_y_BitField8 0 0 0 255 ECU_ADDRESS 0x0000 /* @ECU_Address@V5RDve_y_BSWDiagRefAUnrVolt@ */ /end MEASUREMENT
/begin MEASUREMENT V5RDve_y_BSWDiagRefAOvrVolt "Ref A over volt" UBYTE CM_T_y_BitField8 0 0 0 255 ECU_ADDRESS 0x0000 /* @ECU_Address@V5RDve_y_BSWDiagRefAOvrVolt@ */ /end MEASUREMENT
/begin MEASUREMENT V5RDve_b_ElecFaultVref3 "Bundled status of the BSW diagnosis." UBYTE CM_T_BOOLEAN 0 0 0 1 ECU_ADDRESS 0x0000 /* @ECU_Address@V5RDve_b_ElecFaultVref3@ */ /end MEASUREMENT
/begin MEASUREMENT V5RDve_b_ElecFaultVref2 "Bundled status of the BSW diagnosis." UBYTE CM_T_BOOLEAN 0 0 0 1 ECU_ADDRESS 0x0000 /* @ECU_Address@V5RDve_b_ElecFaultVref2@ */ /end MEASUREMENT
/begin MEASUREMENT V5RDve_b_ElecFaultVref1 "Bundled status of the BSW diagnosis." UBYTE CM_T_BOOLEAN 0 0 0 1 ECU_ADDRESS 0x0000 /* @ECU_Address@V5RDve_b_ElecFaultVref1@ */ /end MEASUREMENT
/begin MEASUREMENT V5RDve_y_EC_Ref1_Stat "Diagnostic EC Low Status" UBYTE CM_T_y_BitFieldDiagStatus 0 0 0.0 255.0 ECU_ADDRESS 0x0000 /* @ECU_Address@V5RDve_y_EC_Ref1_Stat@ */ /end MEASUREMENT
/begin MEASUREMENT V5RDve_y_EC_Ref2_Stat "Diagnostic EC High Status" UBYTE CM_T_y_BitFieldDiagStatus 0 0 0.0 255.0 ECU_ADDRESS 0x0000 /* @ECU_Address@V5RDve_y_EC_Ref2_Stat@ */ /end MEASUREMENT
/begin MEASUREMENT V5RDve_y_EC_Ref3_Stat "Diagnostic EC High Status" UBYTE CM_T_y_BitFieldDiagStatus 0 0 0.0 255.0 ECU_ADDRESS 0x0000 /* @ECU_Address@V5RDve_y_EC_Ref3_Stat@ */ /end MEASUREMENT
/begin COMPU_METHOD CM_T_U_mV_1_1_s16 "Q = V" RAT_FUNC "%5.0" "mV (millivolts  (mV))" COEFFS 0 1 0 0 0 1 /end COMPU_METHOD
/begin COMPU_METHOD CM_T_BOOLEAN "Q = V" RAT_FUNC "%1.0" "Bool" COEFFS 0 1 0 0 0 1 /end COMPU_METHOD
/begin COMPU_METHOD CM_T_y_BitField8 "Q = V" RAT_FUNC "%3.0" "BitField" COEFFS 0 1 0 0 0 1 /end COMPU_METHOD
/begin COMPU_METHOD CM_T_y_BitFieldDiagStatus "Q = V" RAT_FUNC "%3.0" "BitField" COEFFS 0 1 0 0 0 1 /end COMPU_METHOD
/* EOF V5RD.a2l */
/begin RECORD_LAYOUT Scalar_BOOLEAN FNC_VALUES 1 UBYTE COLUMN_DIR DIRECT /end RECORD_LAYOUT
/begin RECORD_LAYOUT Scalar_UBYTE FNC_VALUES 1 UBYTE COLUMN_DIR DIRECT /end RECORD_LAYOUT
/begin RECORD_LAYOUT Scalar_BYTE FNC_VALUES 1 SBYTE COLUMN_DIR DIRECT /end RECORD_LAYOUT
/begin RECORD_LAYOUT Scalar_UWORD FNC_VALUES 1 UWORD COLUMN_DIR DIRECT /end RECORD_LAYOUT
/begin RECORD_LAYOUT Scalar_SWORD FNC_VALUES 1 SWORD COLUMN_DIR DIRECT /end RECORD_LAYOUT
/begin RECORD_LAYOUT Scalar_LONG FNC_VALUES 1 SLONG COLUMN_DIR DIRECT /end RECORD_LAYOUT
/begin RECORD_LAYOUT Scalar_FLOAT32_IEEE FNC_VALUES 1 FLOAT32_IEEE COLUMN_DIR DIRECT /end RECORD_LAYOUT
/begin RECORD_LAYOUT Scalar_FLOAT64_IEEE FNC_VALUES 1 FLOAT64_IEEE COLUMN_DIR DIRECT /end RECORD_LAYOUT
/begin RECORD_LAYOUT Lookup1D_BYTE FNC_VALUES 1 SBYTE COLUMN_DIR DIRECT /end RECORD_LAYOUT
/begin RECORD_LAYOUT Lookup1D_X_BYTE AXIS_PTS_X 1 SBYTE INDEX_INCR DIRECT /end RECORD_LAYOUT
/begin RECORD_LAYOUT Lookup1D_X_UBYTE AXIS_PTS_X 1 UBYTE INDEX_INCR DIRECT /end RECORD_LAYOUT
/begin RECORD_LAYOUT Lookup1D_WORD FNC_VALUES 1 SWORD COLUMN_DIR DIRECT /end RECORD_LAYOUT
/begin RECORD_LAYOUT Lookup1D_X_WORD AXIS_PTS_X 1 SWORD INDEX_INCR DIRECT /end RECORD_LAYOUT
/begin RECORD_LAYOUT Lookup1D_ULONG FNC_VALUES 1 ULONG COLUMN_DIR DIRECT /end RECORD_LAYOUT
/begin RECORD_LAYOUT Lookup1D_X_ULONG AXIS_PTS_X 1 ULONG INDEX_INCR DIRECT /end RECORD_LAYOUT
/begin RECORD_LAYOUT Lookup1D_SLONG FNC_VALUES 1 SLONG COLUMN_DIR DIRECT /end RECORD_LAYOUT
/begin RECORD_LAYOUT Lookup1D_X_LONG AXIS_PTS_X 1 SLONG INDEX_INCR DIRECT /end RECORD_LAYOUT
/begin RECORD_LAYOUT Lookup1D_FLOAT32_IEEE FNC_VALUES 1 FLOAT32_IEEE COLUMN_DIR DIRECT /end RECORD_LAYOUT
/begin RECORD_LAYOUT Lookup1D_X_FLOAT32_IEEE AXIS_PTS_X 1 FLOAT32_IEEE INDEX_INCR DIRECT /end RECORD_LAYOUT
/begin RECORD_LAYOUT Lookup1D_FLOAT64_IEEE FNC_VALUES 1 FLOAT64_IEEE COLUMN_DIR DIRECT /end RECORD_LAYOUT
/begin RECORD_LAYOUT Lookup1D_X_FLOAT64_IEEE AXIS_PTS_X 1 FLOAT64_IEEE INDEX_INCR DIRECT /end RECORD_LAYOUT
/begin RECORD_LAYOUT Lookup2D_UBYTE FNC_VALUES 1 UBYTE COLUMN_DIR DIRECT /end RECORD_LAYOUT
/begin RECORD_LAYOUT Lookup2D_X_UBYTE AXIS_PTS_X 1 UBYTE INDEX_INCR DIRECT /end RECORD_LAYOUT
/begin RECORD_LAYOUT Lookup2D_BYTE FNC_VALUES 1 SBYTE COLUMN_DIR DIRECT /end RECORD_LAYOUT
/begin RECORD_LAYOUT Lookup2D_X_BYTE AXIS_PTS_X 1 SBYTE INDEX_INCR DIRECT /end RECORD_LAYOUT
/begin RECORD_LAYOUT Lookup2D_ULONG FNC_VALUES 1 ULONG COLUMN_DIR DIRECT /end RECORD_LAYOUT
/begin RECORD_LAYOUT Lookup2D_X_ULONG AXIS_PTS_X 1 ULONG INDEX_INCR DIRECT /end RECORD_LAYOUT
/begin RECORD_LAYOUT Lookup2D_LONG FNC_VALUES 1 SLONG COLUMN_DIR DIRECT /end RECORD_LAYOUT
/begin RECORD_LAYOUT Lookup2D_X_LONG AXIS_PTS_X 1 SLONG INDEX_INCR DIRECT /end RECORD_LAYOUT
/begin RECORD_LAYOUT Lookup2D_FLOAT32_IEEE FNC_VALUES 1 FLOAT32_IEEE COLUMN_DIR DIRECT /end RECORD_LAYOUT
/begin RECORD_LAYOUT Lookup2D_X_FLOAT32_IEEE AXIS_PTS_X 1 FLOAT32_IEEE INDEX_INCR DIRECT /end RECORD_LAYOUT
/begin RECORD_LAYOUT Lookup2D_FLOAT64_IEEE FNC_VALUES 1 FLOAT64_IEEE COLUMN_DIR DIRECT /end RECORD_LAYOUT
/begin RECORD_LAYOUT Lookup2D_X_FLOAT64_IEEE AXIS_PTS_X 1 FLOAT64_IEEE INDEX_INCR DIRECT /end RECORD_LAYOUT
/begin CHARACTERISTIC VSPEke_v_EstimateHigh "Below this limit the Validity is kept and above we can make a new estimation" VALUE 0x0000 /* @ECU_Address@VSPEke_v_EstimateHigh@ */ Scalar_UWORD 0 CM_T_v_kph_64_1_u16 0.0 50.0 EXTENDED_LIMITS 0.0 1023.984375 /end CHARACTERISTIC
/begin CHARACTERISTIC VSPEke_v_EstimateLow "Under this limit we set SignalValidity to InValid" VALUE 0x0000 /* @ECU_Address@VSPEke_v_EstimateLow@ */ Scalar_UWORD 0 CM_T_v_kph_64_1_u16 0.0 20.0 EXTENDED_LIMITS 0.0 1023.984375 /end CHARACTERISTIC
/begin CHARACTERISTIC VSPEke_b_UseDrivenwheels4COGUnsigned "When set to 1 we will use driven wheel speed to calculate vehicle speed
      useful for benchtests
      " VALUE 0x0000 /* @ECU_Address@VSPEke_b_UseDrivenwheels4COGUnsigned@ */ Scalar_BOOLEAN 0 CM_T_BOOLEAN 0.0 1.0 /end CHARACTERISTIC
/begin CHARACTERISTIC VSPEke_b_UseTOSForSpeedDir "If true the sign of transaction decides the sign of driven wheel speed. Else the sign of driven wheel is given by the range selector position." VALUE 0x0000 /* @ECU_Address@VSPEke_b_UseTOSForSpeedDir@ */ Scalar_BOOLEAN 0 CM_T_BOOLEAN 0.0 1.0 /end CHARACTERISTIC
/begin CHARACTERISTIC VSPEke_b_UseTOS_Not_ABSInfo "If you want to use TOS based calculation for driven wheels set this one to 1=True." VALUE 0x0000 /* @ECU_Address@VSPEke_b_UseTOS_Not_ABSInfo@ */ Scalar_BOOLEAN 0 CM_T_BOOLEAN 0.0 1.0 /end CHARACTERISTIC
/begin MEASUREMENT VSPEve_e_DrvnWhlsSpdValidityEst "Status of the Driven wheels speed that we estimate using clutch state and speed " UBYTE CM_SPARte_e_Validity 0 0 0 3 ECU_ADDRESS 0x0000 /* @ECU_Address@VSPEve_e_DrvnWhlsSpdValidityEst@ */ /end MEASUREMENT
/begin COMPU_METHOD CM_T_v_kph_64_1_u16 "Q = V*64.000000" RAT_FUNC "%10.6" "kph (kilometers / hour  (kph))" COEFFS 0 64 0 0 0 1 /end COMPU_METHOD
/begin COMPU_METHOD CM_T_BOOLEAN "Q = V" RAT_FUNC "%1.0" "Bool" COEFFS 0 1 0 0 0 1 /end COMPU_METHOD
/begin COMPU_METHOD CM_SPARte_e_Validity "Enumerated data type: SPARte_e_Validity" TAB_VERB "%0.6" "" COMPU_TAB_REF VTAB_FOR_CM_SPARte_e_Validity /end COMPU_METHOD
/begin COMPU_VTAB VTAB_FOR_CM_SPARte_e_Validity "Enumerated data type: SPARte_e_Validity" TAB_VERB 4 0 "SPARce_e_Valid" 1 "SPARce_e_Invalid" 2 "SPARce_e_EstimatedReplaceValue" 3 "SPARce_e_NotEvaluatedYet" /end COMPU_VTAB
/end MODULE
/end PROJECT
