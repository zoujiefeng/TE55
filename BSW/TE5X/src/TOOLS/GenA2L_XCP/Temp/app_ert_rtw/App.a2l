ASAP2_VERSION 1 31
/begin PROJECT ProjectName "Project Comment Goes Here"
/begin HEADER "Header Comments go here" /end HEADER
/begin MODULE ModuleName "Module Comment Goes Here"
/begin MOD_COMMON "Mod Common Comment Here" BYTE_ORDER MSB_FIRST /end MOD_COMMON
/begin RECORD_LAYOUT Scalar_BOOLEAN FNC_VALUES 1 UBYTE COLUMN_DIR DIRECT /end RECORD_LAYOUT
/begin COMPU_METHOD CM_T_BOOLEAN "Q = V" RAT_FUNC "%1.0" "Bool" COEFFS 0 1 0 0 0 1 /end COMPU_METHOD
/* (add any file trailer comments here) */ /* EOF CAND.a2l */
/begin RECORD_LAYOUT Scalar_BOOLEAN FNC_VALUES 1 UBYTE COLUMN_DIR DIRECT /end RECORD_LAYOUT
/begin COMPU_METHOD CM_T_BOOLEAN "Q = V" RAT_FUNC "%1.0" "Bool" COEFFS 0 1 0 0 0 1 /end COMPU_METHOD
/* EOF CCAP.a2l */
/begin RECORD_LAYOUT Scalar_BOOLEAN FNC_VALUES 1 UBYTE COLUMN_DIR DIRECT /end RECORD_LAYOUT
/begin COMPU_METHOD CM_T_BOOLEAN "Q = V" RAT_FUNC "%1.0" "Bool" COEFFS 0 1 0 0 0 1 /end COMPU_METHOD
/* EOF CLCO.a2l */
/begin RECORD_LAYOUT Scalar_BOOLEAN FNC_VALUES 1 UBYTE COLUMN_DIR DIRECT /end RECORD_LAYOUT
/begin CHARACTERISTIC CLPCke_b_CAPM_CommandDBC_Enable "CAP_DBC_control_enable" VALUE 0x0000 /* @ECU_Address@CLPCke_b_CAPM_CommandDBC_Enable@ */ Scalar_BOOLEAN 0 CM_T_BOOLEAN 0.0 1.0 /end CHARACTERISTIC
/begin COMPU_METHOD CM_T_BOOLEAN "Q = V" RAT_FUNC "%1.0" "Bool" COEFFS 0 1 0 0 0 1 /end COMPU_METHOD
/* EOF CLPC.a2l */
/begin RECORD_LAYOUT Scalar_BOOLEAN FNC_VALUES 1 UBYTE COLUMN_DIR DIRECT /end RECORD_LAYOUT
/begin CHARACTERISTIC FDMAie_b_ForceEngineStop_ob "Override boolean." VALUE 0x0000 /* @ECU_Address@FDMAie_b_ForceEngineStop_ob@ */ Scalar_BOOLEAN 0 CM_T_BOOLEAN 0.0 1.0 /end CHARACTERISTIC
/begin CHARACTERISTIC FDMAie_b_ForceEngineStop_ov "Override value." VALUE 0x0000 /* @ECU_Address@FDMAie_b_ForceEngineStop_ov@ */ Scalar_BOOLEAN 0 CM_T_BOOLEAN 0.0 1.0 /end CHARACTERISTIC
/begin CHARACTERISTIC FDMAie_b_ForceNeutralGear_ob "Override boolean." VALUE 0x0000 /* @ECU_Address@FDMAie_b_ForceNeutralGear_ob@ */ Scalar_BOOLEAN 0 CM_T_BOOLEAN 0.0 1.0 /end CHARACTERISTIC
/begin CHARACTERISTIC FDMAie_b_ForceNeutralGear_ov "Override value." VALUE 0x0000 /* @ECU_Address@FDMAie_b_ForceNeutralGear_ov@ */ Scalar_BOOLEAN 0 CM_T_BOOLEAN 0.0 1.0 /end CHARACTERISTIC
/begin COMPU_METHOD CM_T_BOOLEAN "Q = V" RAT_FUNC "%1.0" "Bool" COEFFS 0 1 0 0 0 1 /end COMPU_METHOD
/* EOF FDMA.a2l */
/begin RECORD_LAYOUT Scalar_BOOLEAN FNC_VALUES 1 UBYTE COLUMN_DIR DIRECT /end RECORD_LAYOUT
/begin COMPU_METHOD CM_T_BOOLEAN "Q = V" RAT_FUNC "%1.0" "Bool" COEFFS 0 1 0 0 0 1 /end COMPU_METHOD
/* EOF PORS.a2l */
/begin RECORD_LAYOUT DATA_RECORD_UBYTE FNC_VALUES 1 UBYTE ROW_DIR DIRECT /end RECORD_LAYOUT
/begin RECORD_LAYOUT DATA_RECORD_UWORD FNC_VALUES 1 UWORD ROW_DIR DIRECT /end RECORD_LAYOUT
/begin RECORD_LAYOUT DATA_RECORD_SWORD FNC_VALUES 1 SWORD ROW_DIR DIRECT /end RECORD_LAYOUT
/begin RECORD_LAYOUT DATA_RECORD_ULONG FNC_VALUES 1 ULONG ROW_DIR DIRECT /end RECORD_LAYOUT
/begin RECORD_LAYOUT DATA_RECORD_SLONG FNC_VALUES 1 SLONG ROW_DIR DIRECT /end RECORD_LAYOUT
/begin RECORD_LAYOUT DATA_RECORD_FLOAT32_IEEE FNC_VALUES 1 FLOAT32_IEEE ROW_DIR DIRECT /end RECORD_LAYOUT
/begin CHARACTERISTIC BSW_ku16CCPReinitTriggerC "Spare" VALUE 0x80060076 DATA_RECORD_UWORD 2621.4 F_0v04_p1_8 1 2622.4 /end CHARACTERISTIC
/begin CHARACTERISTIC MAIN_CCPbBenchTestOnC "Tx MSG activation" VALUE 0x80060ABC DATA_RECORD_UBYTE 1 Bool_ON_OFF 0 1 BIT_MASK 0x01 /end CHARACTERISTIC
/begin CHARACTERISTIC MAIN_HARDBenchOnC "HARD activation" VALUE 0x80060B28 DATA_RECORD_UBYTE 1 Bool_ON_OFF 0 1 BIT_MASK 0x01 /end CHARACTERISTIC
/begin CHARACTERISTIC MAIN_MSGRxBenchOnC "Rx MSG activation" VALUE 0x80060B1C DATA_RECORD_UBYTE 1 Bool_ON_OFF 0 1 BIT_MASK 0x01 /end CHARACTERISTIC
/begin CHARACTERISTIC MAIN_MSGTxBenchOnC "Tx MSG activation" VALUE 0x80060B18 DATA_RECORD_UBYTE 1 Bool_ON_OFF 0 1 BIT_MASK 0x01 /end CHARACTERISTIC
/begin CHARACTERISTIC MAIN_MSGbBenchTestOnC "Tx MSG activation" VALUE 0x80060B24 DATA_RECORD_UBYTE 1 Bool_ON_OFF 0 1 BIT_MASK 0x01 /end CHARACTERISTIC
/begin CHARACTERISTIC MAIN_MSGbDbgFrameOnC "Tx MSG activation" VALUE 0x80060B20 DATA_RECORD_UBYTE 1 Bool_ON_OFF 0 1 BIT_MASK 0x01 /end CHARACTERISTIC
/begin CHARACTERISTIC MAIN_MSGu8PwModFiltCntC "Spare" VALUE 0x80060030 DATA_RECORD_UBYTE 255 I_1 0 255 /end CHARACTERISTIC
/begin CHARACTERISTIC MAIN_TCUbHilTestOnC "Tx MSG activation" VALUE 0x80060B0C DATA_RECORD_UBYTE 1 Bool_ON_OFF 0 1 BIT_MASK 0x01 /end CHARACTERISTIC
/begin CHARACTERISTIC MAIN_TCUs16GcuMotTorqC "Spare" VALUE 0x80060064 DATA_RECORD_SWORD 65535 I_1 -32768 32767 /end CHARACTERISTIC
/begin CHARACTERISTIC MAIN_TCUs16McuMotTorqC "Spare" VALUE 0x8006006A DATA_RECORD_SWORD 65535 I_1 -32768 32767 /end CHARACTERISTIC
/begin CHARACTERISTIC MAIN_TCUu16OilPresVoltC "Spare" VALUE 0x80060062 DATA_RECORD_UWORD 65.535 F_0v001_p0_100 0 65.535 /end CHARACTERISTIC
/begin CHARACTERISTIC MAIN_TCUu16OilTempC "Spare" VALUE 0x80060060 DATA_RECORD_UWORD 65.535 F_0v001_p0_100 0 65.535 /end CHARACTERISTIC
/begin CHARACTERISTIC MAIN_TCUu32GcuMotSpeedC "Spare" VALUE 0x80060B58 DATA_RECORD_ULONG 4294967295 F_1_m20000_33 -20000 4294947295 /end CHARACTERISTIC
/begin CHARACTERISTIC MAIN_TCUu32McuMotSpeedC "Spare" VALUE 0x80060B54 DATA_RECORD_ULONG 4294967295 F_1_m20000_33 -20000 4294947295 /end CHARACTERISTIC
/begin CHARACTERISTIC MAIN_TCUu8GcuTempC "Spare" VALUE 0x80060032 DATA_RECORD_UBYTE 255 F_1_m40_27 -40 215 /end CHARACTERISTIC
/begin CHARACTERISTIC MAIN_TCUu8McuTempC "Spare" VALUE 0x80060031 DATA_RECORD_UBYTE 255 F_1_m40_27 -40 215 /end CHARACTERISTIC
/begin CHARACTERISTIC MAIN_TSTBenchOnC "TST activation" VALUE 0x80060B08 DATA_RECORD_UBYTE 1 Bool_ON_OFF 0 1 BIT_MASK 0x01 /end CHARACTERISTIC
/begin CHARACTERISTIC MAIN_VSIBenchOnWriteDataC "Bench VSI write datas" VALUE 0x80060B04 DATA_RECORD_UBYTE 1 Bool_ON_OFF 0 1 BIT_MASK 0x01 /end CHARACTERISTIC
/begin CHARACTERISTIC MAIN_VSIBenchOnWriteEmergSwC "Bench VSI write EmergencySW" VALUE 0x80060B00 DATA_RECORD_UBYTE 1 Bool_ON_OFF 0 1 BIT_MASK 0x01 /end CHARACTERISTIC
/begin CHARACTERISTIC MAIN_bBldcBenchOnC "..." VALUE 0x80060AB8 DATA_RECORD_UBYTE 1 Bool_ON_OFF 0 1 BIT_MASK 0x01 /end CHARACTERISTIC
/begin CHARACTERISTIC MAIN_bMSGRxToutBenchOnC "COM MSG Rx activation" VALUE 0x80060B2C DATA_RECORD_UBYTE 1 Bool_ON_OFF 0 1 BIT_MASK 0x01 /end CHARACTERISTIC
/begin CHARACTERISTIC MAIN_bTcuStuckFlagTestOnC "..." VALUE 0x80060AFC DATA_RECORD_UBYTE 1 Bool_ON_OFF 0 1 BIT_MASK 0x01 /end CHARACTERISTIC
/begin CHARACTERISTIC MAIN_f32AccPosClrSSTimC "Spare" VALUE 0x80060B9C DATA_RECORD_FLOAT32_IEEE 3.402823466E+038 F_1_p0_99 -3.402823466E+038 3.402823466E+038 /end CHARACTERISTIC
/begin CHARACTERISTIC MAIN_f32AntiSlopExitSpdC "Spare" VALUE 0x80060B98 DATA_RECORD_FLOAT32_IEEE 3.402823466E+038 F_1_p0_52 -3.402823466E+038 3.402823466E+038 /end CHARACTERISTIC
/begin CHARACTERISTIC MAIN_f32AntiSsGapDrtGainC "Spare" VALUE 0x80060B94 DATA_RECORD_FLOAT32_IEEE 3.402823466E+038 F_1_p0_4 -3.402823466E+038 3.402823466E+038 /end CHARACTERISTIC
/begin CHARACTERISTIC MAIN_f32AntiSsValidTrqC "Spare" VALUE 0x80060B90 DATA_RECORD_FLOAT32_IEEE 3.402823466E+038 F_1_p0_49 -3.402823466E+038 3.402823466E+038 /end CHARACTERISTIC
/begin CHARACTERISTIC MAIN_f32BldcDebugDutyC "Spare" VALUE 0x80060B30 DATA_RECORD_FLOAT32_IEEE 3.402823466E+038 F_1_p0_49 -3.402823466E+038 3.402823466E+038 /end CHARACTERISTIC
/begin CHARACTERISTIC MAIN_f32BrakDeratGainC "Spare" VALUE 0x80060B8C DATA_RECORD_FLOAT32_IEEE 3.402823466E+038 F_1_p0_4 -3.402823466E+038 3.402823466E+038 /end CHARACTERISTIC
/begin CHARACTERISTIC MAIN_f32BrakPedPosHighC "Spare" VALUE 0x80060B84 DATA_RECORD_FLOAT32_IEEE 3.402823466E+038 F_1_p0_99 -3.402823466E+038 3.402823466E+038 /end CHARACTERISTIC
/begin CHARACTERISTIC MAIN_f32BrakPedalPosLowC "Spare" VALUE 0x80060B88 DATA_RECORD_FLOAT32_IEEE 3.402823466E+038 F_1_p0_99 -3.402823466E+038 3.402823466E+038 /end CHARACTERISTIC
/begin CHARACTERISTIC MAIN_f32OcAutophsGainC "Spare" VALUE 0x80060B80 DATA_RECORD_FLOAT32_IEEE 3.402823466E+038 F_1_p0_4 -3.402823466E+038 3.402823466E+038 /end CHARACTERISTIC
/begin CHARACTERISTIC MAIN_f32OcAutophsOffstC "Spare" VALUE 0x80060B7C DATA_RECORD_FLOAT32_IEEE 3.402823466E+038 F_1_p0_4 -3.402823466E+038 3.402823466E+038 /end CHARACTERISTIC
/begin CHARACTERISTIC MAIN_f32PowerdownVoltC "Spare" VALUE 0x80060B34 DATA_RECORD_FLOAT32_IEEE 3.402823466E+038 F_1_p0_4 -3.402823466E+038 3.402823466E+038 /end CHARACTERISTIC
/begin CHARACTERISTIC MAIN_f32PwmFreqHighThrdC "Spare" VALUE 0x80060B64 DATA_RECORD_FLOAT32_IEEE 3.402823466E+038 F_1_p0_46 -3.402823466E+038 3.402823466E+038 /end CHARACTERISTIC
/begin CHARACTERISTIC MAIN_f32PwmMaxDutyPhysC "Spare" VALUE 0x80060B78 DATA_RECORD_FLOAT32_IEEE 3.402823466E+038 F_1_p0_4 -3.402823466E+038 3.402823466E+038 /end CHARACTERISTIC
/begin CHARACTERISTIC MAIN_f32PwmMinDutyPhysC "Spare" VALUE 0x80060B74 DATA_RECORD_FLOAT32_IEEE 3.402823466E+038 F_1_p0_4 -3.402823466E+038 3.402823466E+038 /end CHARACTERISTIC
/begin CHARACTERISTIC MAIN_f32PwmRatioReduceC "Spare" VALUE 0x80060B60 DATA_RECORD_FLOAT32_IEEE 3.402823466E+038 F_1_p0_46 -3.402823466E+038 3.402823466E+038 /end CHARACTERISTIC
/begin CHARACTERISTIC MAIN_f32RandomFrecMecaSpdMaxC "Spare" VALUE 0x80060B38 DATA_RECORD_FLOAT32_IEEE 3.402823466E+038 F_1_p0_52 -3.402823466E+038 3.402823466E+038 /end CHARACTERISTIC
/begin CHARACTERISTIC MAIN_f32RandomFrecMecaSpdMinC "Spare" VALUE 0x80060B3C DATA_RECORD_FLOAT32_IEEE 3.402823466E+038 F_1_p0_52 -3.402823466E+038 3.402823466E+038 /end CHARACTERISTIC
/begin CHARACTERISTIC MAIN_f32SlopOrRoadSpdDiffC "Spare" VALUE 0x80060B70 DATA_RECORD_FLOAT32_IEEE 3.402823466E+038 F_1_p0_52 -3.402823466E+038 3.402823466E+038 /end CHARACTERISTIC
/begin CHARACTERISTIC MAIN_f32UvwOvCurrThdC "Spare" VALUE 0x80060B6C DATA_RECORD_FLOAT32_IEEE 3.402823466E+038 F_1_p0_46 -3.402823466E+038 3.402823466E+038 /end CHARACTERISTIC
/begin CHARACTERISTIC MAIN_f32VsiPwmPeriodC "Spare" VALUE 0x80060B5C DATA_RECORD_FLOAT32_IEEE 3.402823466E+038 F_1000000_p0_102 -3.402823466E+038 3.402823466E+038 /end CHARACTERISTIC
/begin CHARACTERISTIC MAIN_ku16PwmPerdInitValC "MAIN_ku16PwmPerdInitValC" VALUE 0x80060068 DATA_RECORD_UWORD 65535 I_1 0 65535 /end CHARACTERISTIC
/begin CHARACTERISTIC MAIN_ku16SpdReadyEstConfirmC "Spare" VALUE 0x80060066 DATA_RECORD_UWORD 65535 F_1_p0_4 0 65535 /end CHARACTERISTIC
/begin CHARACTERISTIC MAIN_s32CurHardDelayC "Spare" VALUE 0x80060B48 DATA_RECORD_SLONG 4294967295 F_1_p0_4 -2147483648 2147483647 /end CHARACTERISTIC
/begin CHARACTERISTIC MAIN_s32ResHardDelayC "Spare" VALUE 0x80060B44 DATA_RECORD_SLONG 4294967295 F_1_p0_4 -2147483648 2147483647 /end CHARACTERISTIC
/begin CHARACTERISTIC MAIN_s32SampleDelayC "Spare" VALUE 0x80060B40 DATA_RECORD_SLONG 4294967295 F_1_p0_4 -2147483648 2147483647 /end CHARACTERISTIC
/begin CHARACTERISTIC MAIN_u16AntiSsChkTimC "Spare" VALUE 0x8006005E DATA_RECORD_UWORD 65535 F_1_p0_4 0 65535 /end CHARACTERISTIC
/begin CHARACTERISTIC MAIN_u16AntiSsEnaBrakTimC "Spare" VALUE 0x8006005C DATA_RECORD_UWORD 65535 F_1_p0_66 0 65535 /end CHARACTERISTIC
/begin CHARACTERISTIC MAIN_u16AntiSsGapTimC "Spare" VALUE 0x8006005A DATA_RECORD_UWORD 65535 F_1_p0_66 0 65535 /end CHARACTERISTIC
/begin CHARACTERISTIC MAIN_u16BrakRelsDelayC "Spare" VALUE 0x80060058 DATA_RECORD_UWORD 65535 F_1_p0_66 0 65535 /end CHARACTERISTIC
/begin CHARACTERISTIC MAIN_u16DetectSpdTestC "Spare" VALUE 0x80060040 DATA_RECORD_UWORD 65535 F_1_p0_52 0 65535 /end CHARACTERISTIC
/begin CHARACTERISTIC MAIN_u16FpgaFltClrTimoutC "Spare" VALUE 0x80060056 DATA_RECORD_UWORD 65535 F_1_p0_4 0 65535 /end CHARACTERISTIC
/begin CHARACTERISTIC MAIN_u16IdqDeltaCntMaxC "Spare" VALUE 0x80060054 DATA_RECORD_UWORD 65535 F_1_p0_4 0 65535 /end CHARACTERISTIC
/begin CHARACTERISTIC MAIN_u16OverBhvThdC "Spare" VALUE 0x80060052 DATA_RECORD_UWORD 65535 F_1_p0_46 0 65535 /end CHARACTERISTIC
/begin CHARACTERISTIC MAIN_u16PwmRatioPerd0C "Spare" VALUE 0x80060050 DATA_RECORD_UWORD 2621.4 F_0v04_p1_104 1 2622.4 /end CHARACTERISTIC
/begin CHARACTERISTIC MAIN_u16PwmRatioPerd1C "Spare" VALUE 0x8006004E DATA_RECORD_UWORD 2621.4 F_0v04_p1_104 1 2622.4 /end CHARACTERISTIC
/begin CHARACTERISTIC MAIN_u16PwmRatioPerd2C "Spare" VALUE 0x8006004C DATA_RECORD_UWORD 2621.4 F_0v04_p1_104 1 2622.4 /end CHARACTERISTIC
/begin CHARACTERISTIC MAIN_u16PwmRatioPerd3C "Spare" VALUE 0x8006004A DATA_RECORD_UWORD 2621.4 F_0v04_p1_104 1 2622.4 /end CHARACTERISTIC
/begin CHARACTERISTIC MAIN_u16RandomFrecMaxC "Spare" VALUE 0x80060038 DATA_RECORD_UWORD 65535 F_1_p0_66 0 65535 /end CHARACTERISTIC
/begin CHARACTERISTIC MAIN_u16SlopSlideTim1C "Spare" VALUE 0x80060048 DATA_RECORD_UWORD 65535 F_1_p0_66 0 65535 /end CHARACTERISTIC
/begin CHARACTERISTIC MAIN_u16SlopSlideTim2C "Spare" VALUE 0x80060046 DATA_RECORD_UWORD 65535 F_1_p0_66 0 65535 /end CHARACTERISTIC
/begin CHARACTERISTIC MAIN_u16SlopSlideTimoutC "Spare" VALUE 0x80060044 DATA_RECORD_UWORD 65535 F_1_p0_66 0 65535 /end CHARACTERISTIC
/begin CHARACTERISTIC MAIN_u16SlopSpdConfirmC "Spare" VALUE 0x80060042 DATA_RECORD_UWORD 65535 F_1_p0_4 0 65535 /end CHARACTERISTIC
/begin CHARACTERISTIC MAIN_u16StuckRecoverTimeStepC "Spare" VALUE 0x8006003A DATA_RECORD_UWORD 65535 F_1_p0_66 0 65535 /end CHARACTERISTIC
/begin CHARACTERISTIC MAIN_u16StuckSpdThresholdC "Spare" VALUE 0x8006003E DATA_RECORD_UWORD 65535 F_1_p0_52 0 65535 /end CHARACTERISTIC
/begin CHARACTERISTIC MAIN_u16StuckTimeThresholdC "Spare" VALUE 0x8006003C DATA_RECORD_UWORD 65535 F_1_p0_66 0 65535 /end CHARACTERISTIC
/begin CHARACTERISTIC MAIN_u32VSICntCkreqESMStartedC "MAIN_u32VSICntCkreqESMStartedC" VALUE 0x80060B50 DATA_RECORD_ULONG 4294967295 I_1 0 4294967295 /end CHARACTERISTIC
/begin CHARACTERISTIC MAIN_u32VSICntCkreqVSIStartedC "MAIN_u32VSICntCkreqVSIStartedC" VALUE 0x80060B4C DATA_RECORD_ULONG 4294967295 I_1 0 4294967295 /end CHARACTERISTIC
/begin CHARACTERISTIC MosSWOverCurrentTestOnC "..." VALUE 0x80060AF8 DATA_RECORD_UBYTE 1 Bool_ON_OFF 0 1 BIT_MASK 0x01 /end CHARACTERISTIC
/begin CHARACTERISTIC RES_bGenerateSyncPosC "Enable generation of the SyncPos signal" VALUE 0x80060026 DATA_RECORD_UBYTE 1 Bool_ON_OFF 0 1 BIT_MASK 0x01 /end CHARACTERISTIC
/begin CHARACTERISTIC RES_u16ExcitDelayC "Resolver excitation delay" VALUE 0x80060AA6 DATA_RECORD_UWORD 6553.5 F_0v1_p0_110 0 6553.5 /end CHARACTERISTIC
/begin CHARACTERISTIC RES_u16SyncDelayC "Delay time between the failing eadg of the CS to the generation of SyncPos signal" VALUE 0x80060AA4 DATA_RECORD_UWORD 6553.5 F_0v1_p0_110 0 6553.5 /end CHARACTERISTIC
/begin CHARACTERISTIC RES_u16VSICkreqPeriodDefC "Resolver default value for VSI Ckreq period" VALUE 0x80060AA2 DATA_RECORD_UWORD 6553.5 F_0v1_p0_110 0 6553.5 /end CHARACTERISTIC
/begin CHARACTERISTIC RES_u8ExcitDutyPercentC "Resolver excitation duty cycle value" VALUE 0x80060034 DATA_RECORD_UBYTE 255 F_1_p0_99 0 255 /end CHARACTERISTIC
/begin CHARACTERISTIC RES_u8SyncDutyPercentC "Resolver excitation duty cycle value" VALUE 0x80060033 DATA_RECORD_UBYTE 255 F_1_p0_99 0 255 /end CHARACTERISTIC
/begin CHARACTERISTIC RTE_bCCPDrvOverCurrentTestOnC "..." VALUE 0x80060AF4 DATA_RECORD_UBYTE 1 Bool_ON_OFF 0 1 BIT_MASK 0x01 /end CHARACTERISTIC
/begin CHARACTERISTIC RTE_bCCPDrvOverTempTestOnC "..." VALUE 0x80060ACC DATA_RECORD_UBYTE 1 Bool_ON_OFF 0 1 BIT_MASK 0x01 /end CHARACTERISTIC
/begin CHARACTERISTIC RTE_bCCPDrvOverVoltageTestOnC "..." VALUE 0x80060AEC DATA_RECORD_UBYTE 1 Bool_ON_OFF 0 1 BIT_MASK 0x01 /end CHARACTERISTIC
/begin CHARACTERISTIC RTE_bCCPDrvUnderVoltageTestOnC "..." VALUE 0x80060AE8 DATA_RECORD_UBYTE 1 Bool_ON_OFF 0 1 BIT_MASK 0x01 /end CHARACTERISTIC
/begin CHARACTERISTIC RTE_bCCPHALOrderInvalidTestOnC "..." VALUE 0x80060AD8 DATA_RECORD_UBYTE 1 Bool_ON_OFF 0 1 BIT_MASK 0x01 /end CHARACTERISTIC
/begin CHARACTERISTIC RTE_bCCPHALOverVoltTestOnC "..." VALUE 0x80060AE4 DATA_RECORD_UBYTE 1 Bool_ON_OFF 0 1 BIT_MASK 0x01 /end CHARACTERISTIC
/begin CHARACTERISTIC RTE_bCCPHALUndefinedTestOnC "..." VALUE 0x80060ADC DATA_RECORD_UBYTE 1 Bool_ON_OFF 0 1 BIT_MASK 0x01 /end CHARACTERISTIC
/begin CHARACTERISTIC RTE_bCCPHALUnderVoltTestOnC "..." VALUE 0x80060AE0 DATA_RECORD_UBYTE 1 Bool_ON_OFF 0 1 BIT_MASK 0x01 /end CHARACTERISTIC
/begin CHARACTERISTIC RTE_bCCPPhasePerfTestOnC "..." VALUE 0x80060AD4 DATA_RECORD_UBYTE 1 Bool_ON_OFF 0 1 BIT_MASK 0x01 /end CHARACTERISTIC
/begin CHARACTERISTIC RTE_bCCPPhaseShortHighTestOnC "..." VALUE 0x80060AC4 DATA_RECORD_UBYTE 1 Bool_ON_OFF 0 1 BIT_MASK 0x01 /end CHARACTERISTIC
/begin CHARACTERISTIC RTE_bCCPPhaseShortLowTestOnC "..." VALUE 0x80060AD0 DATA_RECORD_UBYTE 1 Bool_ON_OFF 0 1 BIT_MASK 0x01 /end CHARACTERISTIC
/begin CHARACTERISTIC RTE_bCCPSwOverCurrentTestOnC "..." VALUE 0x80060AF0 DATA_RECORD_UBYTE 1 Bool_ON_OFF 0 1 BIT_MASK 0x01 /end CHARACTERISTIC
/begin CHARACTERISTIC RTE_bCCPbTcuStuckFlagTestOnC "..." VALUE 0x80060AC8 DATA_RECORD_UBYTE 1 Bool_ON_OFF 0 1 BIT_MASK 0x01 /end CHARACTERISTIC
/begin CHARACTERISTIC SBC_bServiceDisableC "Spare" VALUE 0x80060BB0 DATA_RECORD_UBYTE 1 Bool_ON_OFF 0 1 BIT_MASK 0x01 /end CHARACTERISTIC
/begin CHARACTERISTIC SBC_f32RecoverThresholdC "Spare" VALUE 0x80060BB8 DATA_RECORD_FLOAT32_IEEE 3.402823466E+038 F_1_p0_4 -3.402823466E+038 3.402823466E+038 /end CHARACTERISTIC
/begin CHARACTERISTIC SBC_f32UnderVolHighThresholdC "Spare" VALUE 0x80060BC0 DATA_RECORD_FLOAT32_IEEE 3.402823466E+038 F_1_p0_4 -3.402823466E+038 3.402823466E+038 /end CHARACTERISTIC
/begin CHARACTERISTIC SBC_f32UnderVolLowThresholdC "Spare" VALUE 0x80060BBC DATA_RECORD_FLOAT32_IEEE 3.402823466E+038 F_1_p0_4 -3.402823466E+038 3.402823466E+038 /end CHARACTERISTIC
/begin CHARACTERISTIC TCFCke_b_CCPM_CommandDBC_Enable "..." VALUE 0x8005921F DATA_RECORD_UBYTE 1 Bool_ON_OFF 0 1 BIT_MASK 0x01 /end CHARACTERISTIC
/begin MEASUREMENT ADCTotalTime "ADCTotalTime" ULONG I_1 1 2 0 4294967295 ECU_ADDRESS 0x7000689C /end MEASUREMENT
/begin MEASUREMENT ASWNM_bFullComSts "..." UBYTE Bool_ON_OFF 1 2 0 1 BIT_MASK 0x01 ECU_ADDRESS 0x700009FD /end MEASUREMENT
/begin MEASUREMENT ASWNM_u8CurrentState "..." UBYTE Id_0x00 1 2 0 255 MATRIX_DIM 21 1 1 ECU_ADDRESS 0x70002879 /end MEASUREMENT
/begin MEASUREMENT ASWNM_u8CurrentState[0] "ASWNM_u8CurrentState[0]" UBYTE Id_0x00 1 2 0 255 ECU_ADDRESS 0x70002879 /end MEASUREMENT
/begin MEASUREMENT ASWNM_u8CurrentState[10] "ASWNM_u8CurrentState[10]" UBYTE Id_0x00 1 2 0 255 ECU_ADDRESS 0x70002883 /end MEASUREMENT
/begin MEASUREMENT ASWNM_u8CurrentState[11] "ASWNM_u8CurrentState[11]" UBYTE Id_0x00 1 2 0 255 ECU_ADDRESS 0x70002884 /end MEASUREMENT
/begin MEASUREMENT ASWNM_u8CurrentState[12] "ASWNM_u8CurrentState[12]" UBYTE Id_0x00 1 2 0 255 ECU_ADDRESS 0x70002885 /end MEASUREMENT
/begin MEASUREMENT ASWNM_u8CurrentState[13] "ASWNM_u8CurrentState[13]" UBYTE Id_0x00 1 2 0 255 ECU_ADDRESS 0x70002886 /end MEASUREMENT
/begin MEASUREMENT ASWNM_u8CurrentState[14] "ASWNM_u8CurrentState[14]" UBYTE Id_0x00 1 2 0 255 ECU_ADDRESS 0x70002887 /end MEASUREMENT
/begin MEASUREMENT ASWNM_u8CurrentState[15] "ASWNM_u8CurrentState[15]" UBYTE Id_0x00 1 2 0 255 ECU_ADDRESS 0x70002888 /end MEASUREMENT
/begin MEASUREMENT ASWNM_u8CurrentState[16] "ASWNM_u8CurrentState[16]" UBYTE Id_0x00 1 2 0 255 ECU_ADDRESS 0x70002889 /end MEASUREMENT
/begin MEASUREMENT ASWNM_u8CurrentState[17] "ASWNM_u8CurrentState[17]" UBYTE Id_0x00 1 2 0 255 ECU_ADDRESS 0x7000288A /end MEASUREMENT
/begin MEASUREMENT ASWNM_u8CurrentState[18] "ASWNM_u8CurrentState[18]" UBYTE Id_0x00 1 2 0 255 ECU_ADDRESS 0x7000288B /end MEASUREMENT
/begin MEASUREMENT ASWNM_u8CurrentState[19] "ASWNM_u8CurrentState[19]" UBYTE Id_0x00 1 2 0 255 ECU_ADDRESS 0x7000288C /end MEASUREMENT
/begin MEASUREMENT ASWNM_u8CurrentState[1] "ASWNM_u8CurrentState[1]" UBYTE Id_0x00 1 2 0 255 ECU_ADDRESS 0x7000287A /end MEASUREMENT
/begin MEASUREMENT ASWNM_u8CurrentState[20] "ASWNM_u8CurrentState[20]" UBYTE Id_0x00 1 2 0 255 ECU_ADDRESS 0x7000288D /end MEASUREMENT
/begin MEASUREMENT ASWNM_u8CurrentState[2] "ASWNM_u8CurrentState[2]" UBYTE Id_0x00 1 2 0 255 ECU_ADDRESS 0x7000287B /end MEASUREMENT
/begin MEASUREMENT ASWNM_u8CurrentState[3] "ASWNM_u8CurrentState[3]" UBYTE Id_0x00 1 2 0 255 ECU_ADDRESS 0x7000287C /end MEASUREMENT
/begin MEASUREMENT ASWNM_u8CurrentState[4] "ASWNM_u8CurrentState[4]" UBYTE Id_0x00 1 2 0 255 ECU_ADDRESS 0x7000287D /end MEASUREMENT
/begin MEASUREMENT ASWNM_u8CurrentState[5] "ASWNM_u8CurrentState[5]" UBYTE Id_0x00 1 2 0 255 ECU_ADDRESS 0x7000287E /end MEASUREMENT
/begin MEASUREMENT ASWNM_u8CurrentState[6] "ASWNM_u8CurrentState[6]" UBYTE Id_0x00 1 2 0 255 ECU_ADDRESS 0x7000287F /end MEASUREMENT
/begin MEASUREMENT ASWNM_u8CurrentState[7] "ASWNM_u8CurrentState[7]" UBYTE Id_0x00 1 2 0 255 ECU_ADDRESS 0x70002880 /end MEASUREMENT
/begin MEASUREMENT ASWNM_u8CurrentState[8] "ASWNM_u8CurrentState[8]" UBYTE Id_0x00 1 2 0 255 ECU_ADDRESS 0x70002881 /end MEASUREMENT
/begin MEASUREMENT ASWNM_u8CurrentState[9] "ASWNM_u8CurrentState[9]" UBYTE Id_0x00 1 2 0 255 ECU_ADDRESS 0x70002882 /end MEASUREMENT
/begin MEASUREMENT Calibration_debut "Calibration_debut" UWORD I_1 1 2 0 65535 ECU_ADDRESS 0x80060000 /end MEASUREMENT
/begin MEASUREMENT Core0_f32Asw100msLoad "..." FLOAT32_IEEE F_1_p0_21 1 2 -3.402823466E+038 3.402823466E+038 ECU_ADDRESS 0x700062B0 /end MEASUREMENT
/begin MEASUREMENT Core0_f32Asw10msLoad "..." FLOAT32_IEEE F_1_p0_21 1 2 -3.402823466E+038 3.402823466E+038 ECU_ADDRESS 0x700062AC /end MEASUREMENT
/begin MEASUREMENT Core0_f32Bsw100msLoad "..." FLOAT32_IEEE F_1_p0_21 1 2 -3.402823466E+038 3.402823466E+038 ECU_ADDRESS 0x700062A8 /end MEASUREMENT
/begin MEASUREMENT Core0_f32Bsw10msLoad "..." FLOAT32_IEEE F_1_p0_21 1 2 -3.402823466E+038 3.402823466E+038 ECU_ADDRESS 0x700062A4 /end MEASUREMENT
/begin MEASUREMENT Core0_f32Bsw1msLoad "..." FLOAT32_IEEE F_1_p0_21 1 2 -3.402823466E+038 3.402823466E+038 ECU_ADDRESS 0x700062A0 /end MEASUREMENT
/begin MEASUREMENT Core0_f32Bsw50msLoad "..." FLOAT32_IEEE F_1_p0_21 1 2 -3.402823466E+038 3.402823466E+038 ECU_ADDRESS 0x7000629C /end MEASUREMENT
/begin MEASUREMENT Core0_f32ModReqLoad "..." FLOAT32_IEEE F_1_p0_21 1 2 -3.402823466E+038 3.402823466E+038 ECU_ADDRESS 0x700062B4 /end MEASUREMENT
/begin MEASUREMENT Core0_f32VsiTreatmentLoad "..." FLOAT32_IEEE F_1_p0_21 1 2 -3.402823466E+038 3.402823466E+038 ECU_ADDRESS 0x70006298 /end MEASUREMENT
/begin MEASUREMENT Core1_f32Asw10msLoad "..." FLOAT32_IEEE F_1_p0_21 1 2 -3.402823466E+038 3.402823466E+038 ECU_ADDRESS 0x70006294 /end MEASUREMENT
/begin MEASUREMENT Core1_f32Asw1msLoad "..." FLOAT32_IEEE F_1_p0_21 1 2 -3.402823466E+038 3.402823466E+038 ECU_ADDRESS 0x70006290 /end MEASUREMENT
/begin MEASUREMENT Core1_f32Bsw10msLoad "..." FLOAT32_IEEE F_1_p0_21 1 2 -3.402823466E+038 3.402823466E+038 ECU_ADDRESS 0x7000628C /end MEASUREMENT
/begin MEASUREMENT Core1_f32PosTreatmentLoad "..." FLOAT32_IEEE F_1_p0_21 1 2 -3.402823466E+038 3.402823466E+038 ECU_ADDRESS 0x70006288 /end MEASUREMENT
/begin MEASUREMENT Core2_f32Asw10msLoad "..." FLOAT32_IEEE F_1_p0_21 1 2 -3.402823466E+038 3.402823466E+038 ECU_ADDRESS 0x70006284 /end MEASUREMENT
/begin MEASUREMENT Core2_f32Asw1msLoad "..." FLOAT32_IEEE F_1_p0_21 1 2 -3.402823466E+038 3.402823466E+038 ECU_ADDRESS 0x70006280 /end MEASUREMENT
/begin MEASUREMENT Core2_f32BldcTreatmentLoad "..." FLOAT32_IEEE F_1_p0_21 1 2 -3.402823466E+038 3.402823466E+038 ECU_ADDRESS 0x70006278 /end MEASUREMENT
/begin MEASUREMENT Core2_f32Bsw10msLoad "..." FLOAT32_IEEE F_1_p0_21 1 2 -3.402823466E+038 3.402823466E+038 ECU_ADDRESS 0x7000627C /end MEASUREMENT
/begin MEASUREMENT MAIN_ESMGo2StartupIEvent "Evï¿½nement pour rï¿½initialiser lautomate ESM" UBYTE Bool_ON_OFF 1 2 0 1 BIT_MASK 0x01 ECU_ADDRESS 0x7000681B /end MEASUREMENT
/begin MEASUREMENT MAIN_MSGbCCP_DrvOverTemp "BSW Power on check finish flag." UBYTE Bool_ON_OFF 1 2 0 1 BIT_MASK 0x01 ECU_ADDRESS 0x70006818 /end MEASUREMENT
/begin MEASUREMENT MAIN_MSGbCCP_DrvOverVoltage "BSW Power on check finish flag." UBYTE Bool_ON_OFF 1 2 0 1 BIT_MASK 0x01 ECU_ADDRESS 0x70006817 /end MEASUREMENT
/begin MEASUREMENT MAIN_MSGbCCP_DrvUnderVoltage "BSW Power on check finish flag." UBYTE Bool_ON_OFF 1 2 0 1 BIT_MASK 0x01 ECU_ADDRESS 0x70006816 /end MEASUREMENT
/begin MEASUREMENT MAIN_MSGbCCP_FetShorted "BSW Power on check finish flag." UBYTE Bool_ON_OFF 1 2 0 1 BIT_MASK 0x01 ECU_ADDRESS 0x7000680E /end MEASUREMENT
/begin MEASUREMENT MAIN_MSGbCCP_HALOrderInvalid "BSW Power on check finish flag." UBYTE Bool_ON_OFF 1 2 0 1 BIT_MASK 0x01 ECU_ADDRESS 0x70006814 /end MEASUREMENT
/begin MEASUREMENT MAIN_MSGbCCP_HALOverVolt "BSW Power on check finish flag." UBYTE Bool_ON_OFF 1 2 0 1 BIT_MASK 0x01 ECU_ADDRESS 0x70006813 /end MEASUREMENT
/begin MEASUREMENT MAIN_MSGbCCP_HALUndefined "BSW Power on check finish flag." UBYTE Bool_ON_OFF 1 2 0 1 BIT_MASK 0x01 ECU_ADDRESS 0x70006815 /end MEASUREMENT
/begin MEASUREMENT MAIN_MSGbCCP_HALUnderVolt "BSW Power on check finish flag." UBYTE Bool_ON_OFF 1 2 0 1 BIT_MASK 0x01 ECU_ADDRESS 0x70006812 /end MEASUREMENT
/begin MEASUREMENT MAIN_MSGbCCP_HwOverCurrent "BSW Power on check finish flag." UBYTE Bool_ON_OFF 1 2 0 1 BIT_MASK 0x01 ECU_ADDRESS 0x7000681A /end MEASUREMENT
/begin MEASUREMENT MAIN_MSGbCCP_PhasePerf "BSW Power on check finish flag." UBYTE Bool_ON_OFF 1 2 0 1 BIT_MASK 0x01 ECU_ADDRESS 0x70006811 /end MEASUREMENT
/begin MEASUREMENT MAIN_MSGbCCP_PhaseShortHigh "BSW Power on check finish flag." UBYTE Bool_ON_OFF 1 2 0 1 BIT_MASK 0x01 ECU_ADDRESS 0x70006810 /end MEASUREMENT
/begin MEASUREMENT MAIN_MSGbCCP_PhaseShortLow "BSW Power on check finish flag." UBYTE Bool_ON_OFF 1 2 0 1 BIT_MASK 0x01 ECU_ADDRESS 0x7000680F /end MEASUREMENT
/begin MEASUREMENT MAIN_MSGbCCP_PhaseVoltHigh "BSW Power on check finish flag." UBYTE Bool_ON_OFF 1 2 0 1 BIT_MASK 0x01 ECU_ADDRESS 0x7000680D /end MEASUREMENT
/begin MEASUREMENT MAIN_MSGbCCP_StuckFlag "BSW Power on check finish flag." UBYTE Bool_ON_OFF 1 2 0 1 BIT_MASK 0x01 ECU_ADDRESS 0x7000680A /end MEASUREMENT
/begin MEASUREMENT MAIN_MSGbCCP_SwOverCurrent "BSW Power on check finish flag." UBYTE Bool_ON_OFF 1 2 0 1 BIT_MASK 0x01 ECU_ADDRESS 0x70006819 /end MEASUREMENT
/begin MEASUREMENT MAIN_MSGbCCP_ThermalShutDown "BSW Power on check finish flag." UBYTE Bool_ON_OFF 1 2 0 1 BIT_MASK 0x01 ECU_ADDRESS 0x7000680C /end MEASUREMENT
/begin MEASUREMENT MAIN_MSGbEMS1_CalLoadValValid "..." UBYTE Bool_ON_OFF 1 2 0 1 BIT_MASK 0x01 ECU_ADDRESS 0x70006809 /end MEASUREMENT
/begin MEASUREMENT MAIN_MSGbEMS1_EngRunStatusValid "..." UBYTE Bool_ON_OFF 1 2 0 1 BIT_MASK 0x01 ECU_ADDRESS 0x70006808 /end MEASUREMENT
/begin MEASUREMENT MAIN_MSGbEMS1_EngSpdValid "..." UBYTE Bool_ON_OFF 1 2 0 1 BIT_MASK 0x01 ECU_ADDRESS 0x70006807 /end MEASUREMENT
/begin MEASUREMENT MAIN_MSGbEMS1_StartAllowed "..." UBYTE Bool_ON_OFF 1 2 0 1 BIT_MASK 0x01 ECU_ADDRESS 0x70006805 /end MEASUREMENT
/begin MEASUREMENT MAIN_MSGbEMS1_StopAllowed "..." UBYTE Bool_ON_OFF 1 2 0 1 BIT_MASK 0x01 ECU_ADDRESS 0x70006804 /end MEASUREMENT
/begin MEASUREMENT MAIN_MSGbEMS1_engStartfailure "..." UBYTE Bool_ON_OFF 1 2 0 1 BIT_MASK 0x01 ECU_ADDRESS 0x70006806 /end MEASUREMENT
/begin MEASUREMENT MAIN_MSGbEMS5_DrivingCycle "..." UBYTE Bool_ON_OFF 1 2 0 1 BIT_MASK 0x01 ECU_ADDRESS 0x70006803 /end MEASUREMENT
/begin MEASUREMENT MAIN_MSGbEMS8_catalystWarmupsta "..." UBYTE Bool_ON_OFF 1 2 0 1 BIT_MASK 0x01 ECU_ADDRESS 0x70006802 /end MEASUREMENT
/begin MEASUREMENT MAIN_MSGbEMS8_engCoolantTempValid "..." UBYTE Bool_ON_OFF 1 2 0 1 BIT_MASK 0x01 ECU_ADDRESS 0x70006801 /end MEASUREMENT
/begin MEASUREMENT MAIN_MSGbFMCU1_ActTrqValid "BSW Power on check finish flag." UBYTE Bool_ON_OFF 1 2 0 1 BIT_MASK 0x01 ECU_ADDRESS 0x70006800 /end MEASUREMENT
/begin MEASUREMENT MAIN_MSGbFMCU2_DischrgAllowed "BSW Power on check finish flag." UBYTE Bool_ON_OFF 1 2 0 1 BIT_MASK 0x01 ECU_ADDRESS 0x700067FF /end MEASUREMENT
/begin MEASUREMENT MAIN_MSGbGCU2_GenSpdVld "..." UBYTE Bool_ON_OFF 1 2 0 1 BIT_MASK 0x01 ECU_ADDRESS 0x700067FE /end MEASUREMENT
/begin MEASUREMENT MAIN_MSGbIPB4_wheelSpdRLValid "..." UBYTE Bool_ON_OFF 1 2 0 1 BIT_MASK 0x01 ECU_ADDRESS 0x700067FD /end MEASUREMENT
/begin MEASUREMENT MAIN_MSGbIPB4_wheelSpdRRValid "..." UBYTE Bool_ON_OFF 1 2 0 1 BIT_MASK 0x01 ECU_ADDRESS 0x700067FC /end MEASUREMENT
/begin MEASUREMENT MAIN_MSGbIPB5_wheelSpdFLValid "..." UBYTE Bool_ON_OFF 1 2 0 1 BIT_MASK 0x01 ECU_ADDRESS 0x700067FB /end MEASUREMENT
/begin MEASUREMENT MAIN_MSGbIPB5_wheelSpdFRValid "..." UBYTE Bool_ON_OFF 1 2 0 1 BIT_MASK 0x01 ECU_ADDRESS 0x700067FA /end MEASUREMENT
/begin MEASUREMENT MAIN_MSGbIPB7_absActive "..." UBYTE Bool_ON_OFF 1 2 0 1 BIT_MASK 0x01 ECU_ADDRESS 0x700067F9 /end MEASUREMENT
/begin MEASUREMENT MAIN_MSGbIPB7_absFault "..." UBYTE Bool_ON_OFF 1 2 0 1 BIT_MASK 0x01 ECU_ADDRESS 0x700067F8 /end MEASUREMENT
/begin MEASUREMENT MAIN_MSGbIPB7_vehicleSpdValid "..." UBYTE Bool_ON_OFF 1 2 0 1 BIT_MASK 0x01 ECU_ADDRESS 0x700067F7 /end MEASUREMENT
/begin MEASUREMENT MAIN_MSGbIPK_TimeValid "..." UBYTE Bool_ON_OFF 1 2 0 1 BIT_MASK 0x01 ECU_ADDRESS 0x700067F6 /end MEASUREMENT
/begin MEASUREMENT MAIN_MSGbMCUF1_MotorSpdValid "..." UBYTE Bool_ON_OFF 1 2 0 1 BIT_MASK 0x01 ECU_ADDRESS 0x700067F5 /end MEASUREMENT
/begin MEASUREMENT MAIN_MSGbMCUF1_SelfheatAllow "..." UBYTE Bool_ON_OFF 1 2 0 1 BIT_MASK 0x01 ECU_ADDRESS 0x700067F4 /end MEASUREMENT
/begin MEASUREMENT MAIN_MSGbMCUF1_SelfheatMod "..." UBYTE Bool_ON_OFF 1 2 0 1 BIT_MASK 0x01 ECU_ADDRESS 0x700067F3 /end MEASUREMENT
/begin MEASUREMENT MAIN_MSGbMCUF2_AS_Activ "..." UBYTE Bool_ON_OFF 1 2 0 1 BIT_MASK 0x01 ECU_ADDRESS 0x700067F2 /end MEASUREMENT
/begin MEASUREMENT MAIN_MSGbMCUF2_Fault_ASC "..." UBYTE Bool_ON_OFF 1 2 0 1 BIT_MASK 0x01 ECU_ADDRESS 0x700067F1 /end MEASUREMENT
/begin MEASUREMENT MAIN_MSGbMCUF2_Fault_ShutOffHvReq "..." UBYTE Bool_ON_OFF 1 2 0 1 BIT_MASK 0x01 ECU_ADDRESS 0x700067F0 /end MEASUREMENT
/begin MEASUREMENT MAIN_MSGbMCUF2_TMReq_ASC "..." UBYTE Bool_ON_OFF 1 2 0 1 BIT_MASK 0x01 ECU_ADDRESS 0x700067EF /end MEASUREMENT
/begin MEASUREMENT MAIN_MSGbMCUF6_Fault_ActDischg "..." UBYTE Bool_ON_OFF 1 2 0 1 BIT_MASK 0x01 ECU_ADDRESS 0x700067EE /end MEASUREMENT
/begin MEASUREMENT MAIN_MSGbMCUF6_Fault_PwrDerat "..." UBYTE Bool_ON_OFF 1 2 0 1 BIT_MASK 0x01 ECU_ADDRESS 0x700067ED /end MEASUREMENT
/begin MEASUREMENT MAIN_MSGbMCUF6_Status_ActDischg "..." UBYTE Bool_ON_OFF 1 2 0 1 BIT_MASK 0x01 ECU_ADDRESS 0x700067EC /end MEASUREMENT
/begin MEASUREMENT MAIN_MSGbMCUF8_DeratOverTmp "..." UBYTE Bool_ON_OFF 1 2 0 1 BIT_MASK 0x01 ECU_ADDRESS 0x700067EB /end MEASUREMENT
/begin MEASUREMENT MAIN_MSGbPDCM10_ACCDrvAst_allow "..." UBYTE Bool_ON_OFF 1 2 0 1 BIT_MASK 0x01 ECU_ADDRESS 0x700067DE /end MEASUREMENT
/begin MEASUREMENT MAIN_MSGbPDCM10_APADrvAst_allow "..." UBYTE Bool_ON_OFF 1 2 0 1 BIT_MASK 0x01 ECU_ADDRESS 0x700067DB /end MEASUREMENT
/begin MEASUREMENT MAIN_MSGbPDCM10_AccelPedal_Valid "..." UBYTE Bool_ON_OFF 1 2 0 1 BIT_MASK 0x01 ECU_ADDRESS 0x700067DD /end MEASUREMENT
/begin MEASUREMENT MAIN_MSGbPDCM10_BrakePedal_PressRmd "..." UBYTE Bool_ON_OFF 1 2 0 1 BIT_MASK 0x01 ECU_ADDRESS 0x700067DA /end MEASUREMENT
/begin MEASUREMENT MAIN_MSGbPDCM10_BrakePedal_Status "..." UBYTE Bool_ON_OFF 1 2 0 1 BIT_MASK 0x01 ECU_ADDRESS 0x700067D9 /end MEASUREMENT
/begin MEASUREMENT MAIN_MSGbPDCM10_BrakePedal_Valid "..." UBYTE Bool_ON_OFF 1 2 0 1 BIT_MASK 0x01 ECU_ADDRESS 0x700067D8 /end MEASUREMENT
/begin MEASUREMENT MAIN_MSGbPDCM10_Gear_intervention "..." UBYTE Bool_ON_OFF 1 2 0 1 BIT_MASK 0x01 ECU_ADDRESS 0x700067D7 /end MEASUREMENT
/begin MEASUREMENT MAIN_MSGbPDCM10_HV_Network_Fault "..." UBYTE Bool_ON_OFF 1 2 0 1 BIT_MASK 0x01 ECU_ADDRESS 0x700067D5 /end MEASUREMENT
/begin MEASUREMENT MAIN_MSGbPDCM10_HV_Network_active "..." UBYTE Bool_ON_OFF 1 2 0 1 BIT_MASK 0x01 ECU_ADDRESS 0x700067D6 /end MEASUREMENT
/begin MEASUREMENT MAIN_MSGbPDCM10_actualGearValid "..." UBYTE Bool_ON_OFF 1 2 0 1 BIT_MASK 0x01 ECU_ADDRESS 0x700067DC /end MEASUREMENT
/begin MEASUREMENT MAIN_MSGbPDCM10_targetGearValid "..." UBYTE Bool_ON_OFF 1 2 0 1 BIT_MASK 0x01 ECU_ADDRESS 0x700067D4 /end MEASUREMENT
/begin MEASUREMENT MAIN_MSGbPDCM1_HVReq "BSW Power on check finish flag." UBYTE Bool_ON_OFF 1 2 0 1 BIT_MASK 0x01 ECU_ADDRESS 0x70006234 /end MEASUREMENT
/begin MEASUREMENT MAIN_MSGbPDCM21_MFAntiJerk "..." UBYTE Bool_ON_OFF 1 2 0 1 BIT_MASK 0x01 ECU_ADDRESS 0x700067D3 /end MEASUREMENT
/begin MEASUREMENT MAIN_MSGbPDCM21_SelfheatReq "..." UBYTE Bool_ON_OFF 1 2 0 1 BIT_MASK 0x01 ECU_ADDRESS 0x700067D2 /end MEASUREMENT
/begin MEASUREMENT MAIN_MSGbPDCM22_MR_AntiJerk "..." UBYTE Bool_ON_OFF 1 2 0 1 BIT_MASK 0x01 ECU_ADDRESS 0x700067D1 /end MEASUREMENT
/begin MEASUREMENT MAIN_MSGbPDCM22_SelfheatReqMR "..." UBYTE Bool_ON_OFF 1 2 0 1 BIT_MASK 0x01 ECU_ADDRESS 0x700067D0 /end MEASUREMENT
/begin MEASUREMENT MAIN_MSGbPDCM24_Dcy_valid "..." UBYTE Bool_ON_OFF 1 2 0 1 BIT_MASK 0x01 ECU_ADDRESS 0x700067CF /end MEASUREMENT
/begin MEASUREMENT MAIN_MSGbPDCM24_DrivingCycle "..." UBYTE Bool_ON_OFF 1 2 0 1 BIT_MASK 0x01 ECU_ADDRESS 0x700067CE /end MEASUREMENT
/begin MEASUREMENT MAIN_MSGbPDCM24_HVCO_ActDischg_Req "..." UBYTE Bool_ON_OFF 1 2 0 1 BIT_MASK 0x01 ECU_ADDRESS 0x700067CD /end MEASUREMENT
/begin MEASUREMENT MAIN_MSGbPDCM5_ChargePlugUnlockReq "BSW Power on check finish flag." UBYTE Bool_ON_OFF 1 2 0 1 BIT_MASK 0x01 ECU_ADDRESS 0x70006221 /end MEASUREMENT
/begin MEASUREMENT MAIN_MSGbPDCM5_HVReq "BSW Power on check finish flag." UBYTE Bool_ON_OFF 1 2 0 1 BIT_MASK 0x01 ECU_ADDRESS 0x70006220 /end MEASUREMENT
/begin MEASUREMENT MAIN_MSGbPDCM_ACU_EPS_sasSteeAngVld "..." UBYTE Bool_ON_OFF 1 2 0 1 BIT_MASK 0x01 ECU_ADDRESS 0x700067EA /end MEASUREMENT
/begin MEASUREMENT MAIN_MSGbPDCM_BodyICAC_ambTmpValid "..." UBYTE Bool_ON_OFF 1 2 0 1 BIT_MASK 0x01 ECU_ADDRESS 0x700067E9 /end MEASUREMENT
/begin MEASUREMENT MAIN_MSGbPDCM_IC_ACUic_totalMilValid "..." UBYTE Bool_ON_OFF 1 2 0 1 BIT_MASK 0x01 ECU_ADDRESS 0x700067E8 /end MEASUREMENT
/begin MEASUREMENT MAIN_MSGbPDCM_OBD_DenoGenValid "..." UBYTE Bool_ON_OFF 1 2 0 1 BIT_MASK 0x01 ECU_ADDRESS 0x700067E6 /end MEASUREMENT
/begin MEASUREMENT MAIN_MSGbPDCM_OBD_DenoGeneral "..." UBYTE Bool_ON_OFF 1 2 0 1 BIT_MASK 0x01 ECU_ADDRESS 0x700067E7 /end MEASUREMENT
/begin MEASUREMENT MAIN_MSGbPDCM_OBD_DenoSpecValid "..." UBYTE Bool_ON_OFF 1 2 0 1 BIT_MASK 0x01 ECU_ADDRESS 0x700067E4 /end MEASUREMENT
/begin MEASUREMENT MAIN_MSGbPDCM_OBD_DenoSpecial "..." UBYTE Bool_ON_OFF 1 2 0 1 BIT_MASK 0x01 ECU_ADDRESS 0x700067E5 /end MEASUREMENT
/begin MEASUREMENT MAIN_MSGbPDCM_OBD_FaultClrInhibit "..." UBYTE Bool_ON_OFF 1 2 0 1 BIT_MASK 0x01 ECU_ADDRESS 0x700067E3 /end MEASUREMENT
/begin MEASUREMENT MAIN_MSGbPDCM_OBD_FaultClrReq "..." UBYTE Bool_ON_OFF 1 2 0 1 BIT_MASK 0x01 ECU_ADDRESS 0x700067E2 /end MEASUREMENT
/begin MEASUREMENT MAIN_MSGbPDCM_OBD_PDTCClrSts "..." UBYTE Bool_ON_OFF 1 2 0 1 BIT_MASK 0x01 ECU_ADDRESS 0x700067E1 /end MEASUREMENT
/begin MEASUREMENT MAIN_MSGbPDCM_OBD_WarmCycleSts "..." UBYTE Bool_ON_OFF 1 2 0 1 BIT_MASK 0x01 ECU_ADDRESS 0x700067E0 /end MEASUREMENT
/begin MEASUREMENT MAIN_MSGbPDCM_SelfheatMode "..." UBYTE Bool_ON_OFF 1 2 0 1 BIT_MASK 0x01 ECU_ADDRESS 0x700067DF /end MEASUREMENT
/begin MEASUREMENT MAIN_MSGbRMCU4_McuOverTemp "BSW Power on check finish flag." UBYTE Bool_ON_OFF 1 2 0 1 BIT_MASK 0x01 ECU_ADDRESS 0x700067CC /end MEASUREMENT
/begin MEASUREMENT MAIN_MSGbRMCU4_MilReq "BSW Power on check finish flag." UBYTE Bool_ON_OFF 1 2 0 1 BIT_MASK 0x01 ECU_ADDRESS 0x700067CB /end MEASUREMENT
/begin MEASUREMENT MAIN_MSGbRMCU4_MoterFault "BSW Power on check finish flag." UBYTE Bool_ON_OFF 1 2 0 1 BIT_MASK 0x01 ECU_ADDRESS 0x700067CA /end MEASUREMENT
/begin MEASUREMENT MAIN_MSGbRMCU4_MoterOverTemp "BSW Power on check finish flag." UBYTE Bool_ON_OFF 1 2 0 1 BIT_MASK 0x01 ECU_ADDRESS 0x700067C9 /end MEASUREMENT
/begin MEASUREMENT MAIN_MSGbTCU1_GearEngageAvail "..." UBYTE Bool_ON_OFF 1 2 0 1 BIT_MASK 0x01 ECU_ADDRESS 0x700067C5 /end MEASUREMENT
/begin MEASUREMENT MAIN_MSGbTCU_P1OverTempWarn "BSW Power on check finish flag." UBYTE Bool_ON_OFF 1 2 0 1 BIT_MASK 0x01 ECU_ADDRESS 0x700067C7 /end MEASUREMENT
/begin MEASUREMENT MAIN_MSGbTCU_P3OverTempWarn "BSW Power on check finish flag." UBYTE Bool_ON_OFF 1 2 0 1 BIT_MASK 0x01 ECU_ADDRESS 0x700067C6 /end MEASUREMENT
/begin MEASUREMENT MAIN_MSGbTbox_engOffTimeValid "..." UBYTE Bool_ON_OFF 1 2 0 1 BIT_MASK 0x01 ECU_ADDRESS 0x700067C8 /end MEASUREMENT
/begin MEASUREMENT MAIN_MSGbVCU_FmcuAkdReq "BSW Power on check finish flag." UBYTE Bool_ON_OFF 1 2 0 1 BIT_MASK 0x01 ECU_ADDRESS 0x700067C4 /end MEASUREMENT
/begin MEASUREMENT MAIN_MSGf32CAP_PhsCurLoadPhys "..." FLOAT32_IEEE I_87 1 2 -3.402823466E+038 3.402823466E+038 ECU_ADDRESS 0x70006724 /end MEASUREMENT
/begin MEASUREMENT MAIN_MSGf32CCP_5VSupplyPhys "..." FLOAT32_IEEE I_87 1 2 -3.402823466E+038 3.402823466E+038 ECU_ADDRESS 0x70006720 /end MEASUREMENT
/begin MEASUREMENT MAIN_MSGf32CCP_AvrgCurrentPhys "..." FLOAT32_IEEE I_87 1 2 -3.402823466E+038 3.402823466E+038 ECU_ADDRESS 0x7000671C /end MEASUREMENT
/begin MEASUREMENT MAIN_MSGf32CCP_BenchDutyCyclePhys "..." FLOAT32_IEEE I_1 1 2 -3.402823466E+038 3.402823466E+038 ECU_ADDRESS 0x700066FC /end MEASUREMENT
/begin MEASUREMENT MAIN_MSGf32CCP_DcCurrentPhys "..." FLOAT32_IEEE I_87 1 2 -3.402823466E+038 3.402823466E+038 ECU_ADDRESS 0x70006718 /end MEASUREMENT
/begin MEASUREMENT MAIN_MSGf32CCP_DutyCyclePhys "..." FLOAT32_IEEE I_87 1 2 -3.402823466E+038 3.402823466E+038 ECU_ADDRESS 0x70006714 /end MEASUREMENT
/begin MEASUREMENT MAIN_MSGf32CCP_MotSpeedPhys "..." FLOAT32_IEEE I_87 1 2 -3.402823466E+038 3.402823466E+038 ECU_ADDRESS 0x70006710 /end MEASUREMENT
/begin MEASUREMENT MAIN_MSGf32CCP_PhsCurLoadPhys "..." FLOAT32_IEEE I_87 1 2 -3.402823466E+038 3.402823466E+038 ECU_ADDRESS 0x7000670C /end MEASUREMENT
/begin MEASUREMENT MAIN_MSGf32CCP_PwrStgActPosIncPhys "..." FLOAT32_IEEE I_87 1 2 -3.402823466E+038 3.402823466E+038 ECU_ADDRESS 0x70006708 /end MEASUREMENT
/begin MEASUREMENT MAIN_MSGf32CCP_PwrStgTempPhys "..." FLOAT32_IEEE I_87 1 2 -3.402823466E+038 3.402823466E+038 ECU_ADDRESS 0x70006704 /end MEASUREMENT
/begin MEASUREMENT MAIN_MSGf32CCP_TargetDutyCyclePhys "..." FLOAT32_IEEE I_88 1 2 -3.402823466E+038 3.402823466E+038 ECU_ADDRESS 0x70006700 /end MEASUREMENT
/begin MEASUREMENT MAIN_MSGf32DCU_OilPressurePhys "..." FLOAT32_IEEE F_1_p0_89 1 2 -3.402823466E+038 3.402823466E+038 ECU_ADDRESS 0x700066F8 /end MEASUREMENT
/begin MEASUREMENT MAIN_MSGf32EMS1_EngSpdPhys "..." FLOAT32_IEEE I_90 1 2 -3.402823466E+038 3.402823466E+038 ECU_ADDRESS 0x700066F0 /end MEASUREMENT
/begin MEASUREMENT MAIN_MSGf32EMS1_TgtIdlEngSpdPhys "..." FLOAT32_IEEE I_90 1 2 -3.402823466E+038 3.402823466E+038 ECU_ADDRESS 0x700066EC /end MEASUREMENT
/begin MEASUREMENT MAIN_MSGf32EMS1_calLoadValPhys "..." FLOAT32_IEEE I_1 1 2 -3.402823466E+038 3.402823466E+038 ECU_ADDRESS 0x700066F4 /end MEASUREMENT
/begin MEASUREMENT MAIN_MSGf32EMS3_EngFlywhPhys "..." FLOAT32_IEEE I_1 1 2 -3.402823466E+038 3.402823466E+038 ECU_ADDRESS 0x700066E8 /end MEASUREMENT
/begin MEASUREMENT MAIN_MSGf32EMS3_FrictionTorquePhys "..." FLOAT32_IEEE I_1 1 2 -3.402823466E+038 3.402823466E+038 ECU_ADDRESS 0x700066E4 /end MEASUREMENT
/begin MEASUREMENT MAIN_MSGf32EMS5_altitudeFactorPhys "..." FLOAT32_IEEE I_1 1 2 -3.402823466E+038 3.402823466E+038 ECU_ADDRESS 0x700066E0 /end MEASUREMENT
/begin MEASUREMENT MAIN_MSGf32EMS8_CoolantTempPhys "..." FLOAT32_IEEE I_1 1 2 -3.402823466E+038 3.402823466E+038 ECU_ADDRESS 0x700066DC /end MEASUREMENT
/begin MEASUREMENT MAIN_MSGf32EMS8_OilTempPhys "..." FLOAT32_IEEE I_1 1 2 -3.402823466E+038 3.402823466E+038 ECU_ADDRESS 0x700066D8 /end MEASUREMENT
/begin MEASUREMENT MAIN_MSGf32EMS8_StartCoolantTempPhys "..." FLOAT32_IEEE I_1 1 2 -3.402823466E+038 3.402823466E+038 ECU_ADDRESS 0x700066D4 /end MEASUREMENT
/begin MEASUREMENT MAIN_MSGf32EMS8_thermostat_valvePhys "..." FLOAT32_IEEE I_1 1 2 -3.402823466E+038 3.402823466E+038 ECU_ADDRESS 0x700066D0 /end MEASUREMENT
/begin MEASUREMENT MAIN_MSGf32GCU2_ActTorqPhys "..." FLOAT32_IEEE I_1 1 2 -3.402823466E+038 3.402823466E+038 ECU_ADDRESS 0x700066CC /end MEASUREMENT
/begin MEASUREMENT MAIN_MSGf32GCU2_GenSpdPhys "..." FLOAT32_IEEE I_1 1 2 -3.402823466E+038 3.402823466E+038 ECU_ADDRESS 0x700066C8 /end MEASUREMENT
/begin MEASUREMENT MAIN_MSGf32GCU2_MotPwrPhys "..." FLOAT32_IEEE I_1 1 2 -3.402823466E+038 3.402823466E+038 ECU_ADDRESS 0x700066C4 /end MEASUREMENT
/begin MEASUREMENT MAIN_MSGf32GCU4_CtrlerTmpPhys "..." FLOAT32_IEEE I_1 1 2 -3.402823466E+038 3.402823466E+038 ECU_ADDRESS 0x700066C0 /end MEASUREMENT
/begin MEASUREMENT MAIN_MSGf32GCU4_MotTempPhys "..." FLOAT32_IEEE I_1 1 2 -3.402823466E+038 3.402823466E+038 ECU_ADDRESS 0x700066BC /end MEASUREMENT
/begin MEASUREMENT MAIN_MSGf32IPB4_wheelSpdRLPhys "..." FLOAT32_IEEE I_1 1 2 -3.402823466E+038 3.402823466E+038 ECU_ADDRESS 0x700066B8 /end MEASUREMENT
/begin MEASUREMENT MAIN_MSGf32IPB4_wheelSpdRRPhys "..." FLOAT32_IEEE I_1 1 2 -3.402823466E+038 3.402823466E+038 ECU_ADDRESS 0x700066B4 /end MEASUREMENT
/begin MEASUREMENT MAIN_MSGf32IPB5_wheelSpdFLPhys "..." FLOAT32_IEEE I_1 1 2 -3.402823466E+038 3.402823466E+038 ECU_ADDRESS 0x700066B0 /end MEASUREMENT
/begin MEASUREMENT MAIN_MSGf32IPB5_wheelSpdFRPhys "..." FLOAT32_IEEE I_1 1 2 -3.402823466E+038 3.402823466E+038 ECU_ADDRESS 0x700066AC /end MEASUREMENT
/begin MEASUREMENT MAIN_MSGf32IPB7_vehicleSpdPhys "..." FLOAT32_IEEE I_1 1 2 -3.402823466E+038 3.402823466E+038 ECU_ADDRESS 0x700066A8 /end MEASUREMENT
/begin MEASUREMENT MAIN_MSGf32Ivi_altitudePhys "..." FLOAT32_IEEE I_1 1 2 -3.402823466E+038 3.402823466E+038 ECU_ADDRESS 0x700066A4 /end MEASUREMENT
/begin MEASUREMENT MAIN_MSGf32MCUF1_ActTrqPhys "..." FLOAT32_IEEE I_1 1 2 -3.402823466E+038 3.402823466E+038 ECU_ADDRESS 0x7000669C /end MEASUREMENT
/begin MEASUREMENT MAIN_MSGf32MCUF1_MotorPwrPhys "..." FLOAT32_IEEE I_1 1 2 -3.402823466E+038 3.402823466E+038 ECU_ADDRESS 0x70006698 /end MEASUREMENT
/begin MEASUREMENT MAIN_MSGf32MCUF1_MotorSpdPhys "..." FLOAT32_IEEE I_1 1 2 -3.402823466E+038 3.402823466E+038 ECU_ADDRESS 0x70006694 /end MEASUREMENT
/begin MEASUREMENT MAIN_MSGf32MCUF2_ActVolPhys "..." FLOAT32_IEEE I_1 1 2 -3.402823466E+038 3.402823466E+038 ECU_ADDRESS 0x70006690 /end MEASUREMENT
/begin MEASUREMENT MAIN_MSGf32MCUF2_CurHVPhys "..." FLOAT32_IEEE I_1 1 2 -3.402823466E+038 3.402823466E+038 ECU_ADDRESS 0x7000668C /end MEASUREMENT
/begin MEASUREMENT MAIN_MSGf32MCUF2_MotorMaxSpdPhys "..." FLOAT32_IEEE I_1 1 2 -3.402823466E+038 3.402823466E+038 ECU_ADDRESS 0x70006688 /end MEASUREMENT
/begin MEASUREMENT MAIN_MSGf32MCUF3_MaxTrqTotalPhys "..." FLOAT32_IEEE I_1 1 2 -3.402823466E+038 3.402823466E+038 ECU_ADDRESS 0x70006684 /end MEASUREMENT
/begin MEASUREMENT MAIN_MSGf32MCUF3_MinTrqTotalPhys "..." FLOAT32_IEEE I_1 1 2 -3.402823466E+038 3.402823466E+038 ECU_ADDRESS 0x70006680 /end MEASUREMENT
/begin MEASUREMENT MAIN_MSGf32MCUF3_MotMaxPosTqPhys "..." FLOAT32_IEEE I_1 1 2 -3.402823466E+038 3.402823466E+038 ECU_ADDRESS 0x7000667C /end MEASUREMENT
/begin MEASUREMENT MAIN_MSGf32MCUF3_MotMinNegTqPhys "..." FLOAT32_IEEE I_91 1 2 -3.402823466E+038 3.402823466E+038 ECU_ADDRESS 0x70006678 /end MEASUREMENT
/begin MEASUREMENT MAIN_MSGf32MCUF4_CtrlerTmpPhys "..." FLOAT32_IEEE F_1_p0_92 1 2 -3.402823466E+038 3.402823466E+038 ECU_ADDRESS 0x70006674 /end MEASUREMENT
/begin MEASUREMENT MAIN_MSGf32MCUF4_MotCurPhase_APhys "..." FLOAT32_IEEE I_1 1 2 -3.402823466E+038 3.402823466E+038 ECU_ADDRESS 0x70006670 /end MEASUREMENT
/begin MEASUREMENT MAIN_MSGf32MCUF4_MotCurPhase_BPhys "..." FLOAT32_IEEE I_1 1 2 -3.402823466E+038 3.402823466E+038 ECU_ADDRESS 0x7000666C /end MEASUREMENT
/begin MEASUREMENT MAIN_MSGf32MCUF4_MotCurPhase_CPhys "..." FLOAT32_IEEE I_1 1 2 -3.402823466E+038 3.402823466E+038 ECU_ADDRESS 0x70006668 /end MEASUREMENT
/begin MEASUREMENT MAIN_MSGf32MCUF4_MotTempPhys "..." FLOAT32_IEEE I_1 1 2 -3.402823466E+038 3.402823466E+038 ECU_ADDRESS 0x70006664 /end MEASUREMENT
/begin MEASUREMENT MAIN_MSGf32MCUF6_PerInd_MaxPwrPhys "..." FLOAT32_IEEE I_1 1 2 -3.402823466E+038 3.402823466E+038 ECU_ADDRESS 0x70006660 /end MEASUREMENT
/begin MEASUREMENT MAIN_MSGf32MCUF6_PerInd_MaxTrqPhys "..." FLOAT32_IEEE I_1 1 2 -3.402823466E+038 3.402823466E+038 ECU_ADDRESS 0x7000665C /end MEASUREMENT
/begin MEASUREMENT MAIN_MSGf32MCUF8_EfficiencyPhys "..." FLOAT32_IEEE I_1 1 2 -3.402823466E+038 3.402823466E+038 ECU_ADDRESS 0x70006658 /end MEASUREMENT
/begin MEASUREMENT MAIN_MSGf32MCU_LvVoltPhys "..." FLOAT32_IEEE I_15 1 2 -3.402823466E+038 3.402823466E+038 ECU_ADDRESS 0x700066A0 /end MEASUREMENT
/begin MEASUREMENT MAIN_MSGf32PDCM10_AccPedal_StaPhys "..." FLOAT32_IEEE I_1 1 2 -3.402823466E+038 3.402823466E+038 ECU_ADDRESS 0x7000662C /end MEASUREMENT
/begin MEASUREMENT MAIN_MSGf32PDCM10_VehicleSpeedPhys "..." FLOAT32_IEEE I_1 1 2 -3.402823466E+038 3.402823466E+038 ECU_ADDRESS 0x70006628 /end MEASUREMENT
/begin MEASUREMENT MAIN_MSGf32PDCM1_CurrentHVAuxPhys "..." FLOAT32_IEEE F_1_p0_4 1 2 -3.402823466E+038 3.402823466E+038 ECU_ADDRESS 0x7000622C /end MEASUREMENT
/begin MEASUREMENT MAIN_MSGf32PDCM1_PowerAuxPhys "..." FLOAT32_IEEE F_1_p0_4 1 2 -3.402823466E+038 3.402823466E+038 ECU_ADDRESS 0x70006230 /end MEASUREMENT
/begin MEASUREMENT MAIN_MSGf32PDCM1_SOCPhys "..." FLOAT32_IEEE I_93 1 2 -3.402823466E+038 3.402823466E+038 ECU_ADDRESS 0x70006630 /end MEASUREMENT
/begin MEASUREMENT MAIN_MSGf32PDCM21_GCU_MaxPwrPhys "..." FLOAT32_IEEE I_1 1 2 -3.402823466E+038 3.402823466E+038 ECU_ADDRESS 0x70006624 /end MEASUREMENT
/begin MEASUREMENT MAIN_MSGf32PDCM21_MFSpeedReqPhys "..." FLOAT32_IEEE I_1 1 2 -3.402823466E+038 3.402823466E+038 ECU_ADDRESS 0x70006620 /end MEASUREMENT
/begin MEASUREMENT MAIN_MSGf32PDCM21_MFTorqueReqPhys "..." FLOAT32_IEEE I_1 1 2 -3.402823466E+038 3.402823466E+038 ECU_ADDRESS 0x7000661C /end MEASUREMENT
/begin MEASUREMENT MAIN_MSGf32PDCM22_GCU_MaxPwrGPhys "..." FLOAT32_IEEE I_1 1 2 -3.402823466E+038 3.402823466E+038 ECU_ADDRESS 0x70006618 /end MEASUREMENT
/begin MEASUREMENT MAIN_MSGf32PDCM22_MR_SpdReqPhys "..." FLOAT32_IEEE I_1 1 2 -3.402823466E+038 3.402823466E+038 ECU_ADDRESS 0x70006614 /end MEASUREMENT
/begin MEASUREMENT MAIN_MSGf32PDCM22_MR_TorqueReqPhys "..." FLOAT32_IEEE I_1 1 2 -3.402823466E+038 3.402823466E+038 ECU_ADDRESS 0x70006610 /end MEASUREMENT
/begin MEASUREMENT MAIN_MSGf32PDCM24_ClhCmdTsferTorPhys "..." FLOAT32_IEEE I_1 1 2 -3.402823466E+038 3.402823466E+038 ECU_ADDRESS 0x7000660C /end MEASUREMENT
/begin MEASUREMENT MAIN_MSGf32PDCM24_EngIdleTgtSpdPhys "..." FLOAT32_IEEE I_1 1 2 -3.402823466E+038 3.402823466E+038 ECU_ADDRESS 0x70006608 /end MEASUREMENT
/begin MEASUREMENT MAIN_MSGf32PDCM24_Max_VolPhys "..." FLOAT32_IEEE I_1 1 2 -3.402823466E+038 3.402823466E+038 ECU_ADDRESS 0x70006604 /end MEASUREMENT
/begin MEASUREMENT MAIN_MSGf32PDCM24_Min_VolPhys "..." FLOAT32_IEEE I_1 1 2 -3.402823466E+038 3.402823466E+038 ECU_ADDRESS 0x70006600 /end MEASUREMENT
/begin MEASUREMENT MAIN_MSGf32PDCM30MF_MaxPwrDPhys "..." FLOAT32_IEEE F_0v1_p0_2 1 2 -3.402823466E+038 3.402823466E+038 ECU_ADDRESS 0x700065FC /end MEASUREMENT
/begin MEASUREMENT MAIN_MSGf32PDCM30MF_MaxPwrGPhys "..." FLOAT32_IEEE F_0v1_m300_94 1 2 -3.402823466E+038 3.402823466E+038 ECU_ADDRESS 0x700065F8 /end MEASUREMENT
/begin MEASUREMENT MAIN_MSGf32PDCM30MR_MaxPwrDPhys "..." FLOAT32_IEEE F_0v1_p0_2 1 2 -3.402823466E+038 3.402823466E+038 ECU_ADDRESS 0x700065F4 /end MEASUREMENT
/begin MEASUREMENT MAIN_MSGf32PDCM30MR_MaxPwrGPhys "..." FLOAT32_IEEE F_0v1_m300_94 1 2 -3.402823466E+038 3.402823466E+038 ECU_ADDRESS 0x700065F0 /end MEASUREMENT
/begin MEASUREMENT MAIN_MSGf32PDCM38TM_TmpSenser1Phys "..." FLOAT32_IEEE I_1 1 2 -3.402823466E+038 3.402823466E+038 ECU_ADDRESS 0x700065EC /end MEASUREMENT
/begin MEASUREMENT MAIN_MSGf32PDCM38TM_TmpSenser2Phys "..." FLOAT32_IEEE I_1 1 2 -3.402823466E+038 3.402823466E+038 ECU_ADDRESS 0x700065E8 /end MEASUREMENT
/begin MEASUREMENT MAIN_MSGf32PDCM5_RestchargingTimePhys "..." FLOAT32_IEEE F_1_p0_4 1 2 -3.402823466E+038 3.402823466E+038 ECU_ADDRESS 0x70006218 /end MEASUREMENT
/begin MEASUREMENT MAIN_MSGf32PDCM5_maxChargeSOCPhys "..." FLOAT32_IEEE F_1_p0_4 1 2 -3.402823466E+038 3.402823466E+038 ECU_ADDRESS 0x7000621C /end MEASUREMENT
/begin MEASUREMENT MAIN_MSGf32PDCM_ACU_EPSsasSteAnglePhys "..." FLOAT32_IEEE I_1 1 2 -3.402823466E+038 3.402823466E+038 ECU_ADDRESS 0x70006654 /end MEASUREMENT
/begin MEASUREMENT MAIN_MSGf32PDCM_BodyICAC_ambTmpPhys "..." FLOAT32_IEEE I_95 1 2 -3.402823466E+038 3.402823466E+038 ECU_ADDRESS 0x70006650 /end MEASUREMENT
/begin MEASUREMENT MAIN_MSGf32PDCM_BodyICebs_U_BATPhys "..." FLOAT32_IEEE I_15 1 2 -3.402823466E+038 3.402823466E+038 ECU_ADDRESS 0x7000664C /end MEASUREMENT
/begin MEASUREMENT MAIN_MSGf32PDCM_GCU_SpeedReqPhys "..." FLOAT32_IEEE I_1 1 2 -3.402823466E+038 3.402823466E+038 ECU_ADDRESS 0x70006648 /end MEASUREMENT
/begin MEASUREMENT MAIN_MSGf32PDCM_GCU_TorqueReqPhys "..." FLOAT32_IEEE I_1 1 2 -3.402823466E+038 3.402823466E+038 ECU_ADDRESS 0x70006640 /end MEASUREMENT
/begin MEASUREMENT MAIN_MSGf32PDCM_GCU_Torque_RefPhys "..." FLOAT32_IEEE I_1 1 2 -3.402823466E+038 3.402823466E+038 ECU_ADDRESS 0x70006644 /end MEASUREMENT
/begin MEASUREMENT MAIN_MSGf32PDCM_IC_ACULgtAPhys "..." FLOAT32_IEEE I_96 1 2 -3.402823466E+038 3.402823466E+038 ECU_ADDRESS 0x70006638 /end MEASUREMENT
/begin MEASUREMENT MAIN_MSGf32PDCM_IC_ACUic_totalMileagePhys "..." FLOAT32_IEEE I_97 1 2 -3.402823466E+038 3.402823466E+038 ECU_ADDRESS 0x7000663C /end MEASUREMENT
/begin MEASUREMENT MAIN_MSGf32PDCM_OBD_AccPedal_PosPhys "..." FLOAT32_IEEE I_1 1 2 -3.402823466E+038 3.402823466E+038 ECU_ADDRESS 0x70006634 /end MEASUREMENT
/begin MEASUREMENT MAIN_MSGf32SelfHeat_MCUF_BusCurPhys "..." FLOAT32_IEEE I_1 1 2 -3.402823466E+038 3.402823466E+038 ECU_ADDRESS 0x700065E4 /end MEASUREMENT
/begin MEASUREMENT MAIN_MSGf32SelfHeat_MCUF_BusFreqPhys "..." FLOAT32_IEEE I_1 1 2 -3.402823466E+038 3.402823466E+038 ECU_ADDRESS 0x700065E0 /end MEASUREMENT
/begin MEASUREMENT MAIN_MSGf32SelfHeat_MCUF_UdFreqPhys "..." FLOAT32_IEEE I_1 1 2 -3.402823466E+038 3.402823466E+038 ECU_ADDRESS 0x700065DC /end MEASUREMENT
/begin MEASUREMENT MAIN_MSGf32SelfHeat_MCUF_UdVoltPhys "..." FLOAT32_IEEE I_1 1 2 -3.402823466E+038 3.402823466E+038 ECU_ADDRESS 0x700065D8 /end MEASUREMENT
/begin MEASUREMENT MAIN_MSGf32TCU1_ClutchAvailMaxTrqPhys "..." FLOAT32_IEEE I_1 1 2 -3.402823466E+038 3.402823466E+038 ECU_ADDRESS 0x700065CC /end MEASUREMENT
/begin MEASUREMENT MAIN_MSGf32TCU1_ClutchAvailMinTrqPhys "..." FLOAT32_IEEE I_1 1 2 -3.402823466E+038 3.402823466E+038 ECU_ADDRESS 0x700065C8 /end MEASUREMENT
/begin MEASUREMENT MAIN_MSGf32TCU1_ClutchCapActPhys "..." FLOAT32_IEEE I_1 1 2 -3.402823466E+038 3.402823466E+038 ECU_ADDRESS 0x700065C4 /end MEASUREMENT
/begin MEASUREMENT MAIN_MSGf32TCU2_MaxFrtMotPwrReqPhys "..." FLOAT32_IEEE I_1 1 2 -3.402823466E+038 3.402823466E+038 ECU_ADDRESS 0x700065C0 /end MEASUREMENT
/begin MEASUREMENT MAIN_MSGf32TCU2_MaxGCUPwrReqPhys "..." FLOAT32_IEEE I_1 1 2 -3.402823466E+038 3.402823466E+038 ECU_ADDRESS 0x700065BC /end MEASUREMENT
/begin MEASUREMENT MAIN_MSGf32TCU3_AirFlowReqPhys "..." FLOAT32_IEEE I_1 1 2 -3.402823466E+038 3.402823466E+038 ECU_ADDRESS 0x700065B8 /end MEASUREMENT
/begin MEASUREMENT MAIN_MSGf32TCU3_TransFluidTmpPhys "..." FLOAT32_IEEE I_1 1 2 -3.402823466E+038 3.402823466E+038 ECU_ADDRESS 0x700065B4 /end MEASUREMENT
/begin MEASUREMENT MAIN_MSGf32Tbox_OTATimeSetPhys "..." FLOAT32_IEEE I_1 1 2 -3.402823466E+038 3.402823466E+038 ECU_ADDRESS 0x700065D0 /end MEASUREMENT
/begin MEASUREMENT MAIN_MSGf32Tbox_engOffTimePhys "..." FLOAT32_IEEE I_98 1 2 -3.402823466E+038 3.402823466E+038 ECU_ADDRESS 0x700065D4 /end MEASUREMENT
/begin MEASUREMENT MAIN_MSGf32VCU7_12VBatVoltPhys "..." FLOAT32_IEEE F_1_p0_49 1 2 -3.402823466E+038 3.402823466E+038 ECU_ADDRESS 0x700065A8 /end MEASUREMENT
/begin MEASUREMENT MAIN_MSGf32VCU_AccPedPosPhys "..." FLOAT32_IEEE F_1_p0_99 1 2 -3.402823466E+038 3.402823466E+038 ECU_ADDRESS 0x700065B0 /end MEASUREMENT
/begin MEASUREMENT MAIN_MSGf32VCU_BrakPedPosPhys "..." FLOAT32_IEEE I_88 1 2 -3.402823466E+038 3.402823466E+038 ECU_ADDRESS 0x700065AC /end MEASUREMENT
/begin MEASUREMENT MAIN_MSGu16CCp_AvrgCurrentRaw "..." UWORD I_1 1 2 0 65535 ECU_ADDRESS 0x7000646C /end MEASUREMENT
/begin MEASUREMENT MAIN_MSGu16CCp_DcCurrentRaw "..." UWORD I_1 1 2 0 65535 ECU_ADDRESS 0x7000646A /end MEASUREMENT
/begin MEASUREMENT MAIN_MSGu16CCp_DutyCycleRaw "..." UWORD I_1 1 2 0 65535 ECU_ADDRESS 0x70006468 /end MEASUREMENT
/begin MEASUREMENT MAIN_MSGu16CCp_MotSpeedRaw "..." UWORD I_1 1 2 0 65535 ECU_ADDRESS 0x70006466 /end MEASUREMENT
/begin MEASUREMENT MAIN_MSGu16CCp_PhsCurLoadRaw "..." UWORD I_1 1 2 0 65535 ECU_ADDRESS 0x70006464 /end MEASUREMENT
/begin MEASUREMENT MAIN_MSGu16CCp_PwrStgActPosIncRaw "..." UWORD I_1 1 2 0 65535 ECU_ADDRESS 0x70006462 /end MEASUREMENT
/begin MEASUREMENT MAIN_MSGu16DCU_OilPressureRaw "..." UWORD I_1 1 2 0 65535 ECU_ADDRESS 0x70006460 /end MEASUREMENT
/begin MEASUREMENT MAIN_MSGu16EMS_EngActualFlwTorqueRaw "..." UWORD I_1 1 2 0 65535 ECU_ADDRESS 0x7000645E /end MEASUREMENT
/begin MEASUREMENT MAIN_MSGu16EOL1_CCPcontrolDCRaw "..." UWORD I_1 1 2 0 65535 ECU_ADDRESS 0x700063A4 /end MEASUREMENT
/begin MEASUREMENT MAIN_MSGu16EOL1_CCPcontrolflowRaw "..." UWORD I_1 1 2 0 65535 ECU_ADDRESS 0x700063A8 /end MEASUREMENT
/begin MEASUREMENT MAIN_MSGu16EOL1_CCPcontrolspeedRaw "..." UWORD I_1 1 2 0 65535 ECU_ADDRESS 0x700063AA /end MEASUREMENT
/begin MEASUREMENT MAIN_MSGu16EOL2_CAPcontrolDCRaw "..." UWORD I_1 1 2 0 65535 ECU_ADDRESS 0x7000639E /end MEASUREMENT
/begin MEASUREMENT MAIN_MSGu16EOL2_CAPcontrolpresRaw "..." UWORD I_1 1 2 0 65535 ECU_ADDRESS 0x700063A0 /end MEASUREMENT
/begin MEASUREMENT MAIN_MSGu16EOL2_CAPcontrolspeedRaw "..." UWORD I_1 1 2 0 65535 ECU_ADDRESS 0x700063A2 /end MEASUREMENT
/begin MEASUREMENT MAIN_MSGu16EOL3_CAPDCRaw "..." UWORD I_1 1 2 0 65535 ECU_ADDRESS 0x7000639A /end MEASUREMENT
/begin MEASUREMENT MAIN_MSGu16EOL3_CAPcurrentRaw "..." UWORD I_1 1 2 0 65535 ECU_ADDRESS 0x70006398 /end MEASUREMENT
/begin MEASUREMENT MAIN_MSGu16EOL3_CAPspeedRaw "..." UWORD I_1 1 2 0 65535 ECU_ADDRESS 0x70006396 /end MEASUREMENT
/begin MEASUREMENT MAIN_MSGu16EOL4_CCPDCRaw "..." UWORD I_1 1 2 0 65535 ECU_ADDRESS 0x70006392 /end MEASUREMENT
/begin MEASUREMENT MAIN_MSGu16EOL4_CCPcurrentRaw "..." UWORD I_1 1 2 0 65535 ECU_ADDRESS 0x70006390 /end MEASUREMENT
/begin MEASUREMENT MAIN_MSGu16EOL4_CCPflowRaw "..." UWORD I_1 1 2 0 65535 ECU_ADDRESS 0x70006394 /end MEASUREMENT
/begin MEASUREMENT MAIN_MSGu16EOL4_CCPspeedRaw "..." UWORD I_1 1 2 0 65535 ECU_ADDRESS 0x7000638E /end MEASUREMENT
/begin MEASUREMENT MAIN_MSGu16EOL5_clutchpressureRaw "..." UWORD I_1 1 2 0 65535 ECU_ADDRESS 0x70006388 /end MEASUREMENT
/begin MEASUREMENT MAIN_MSGu16EOL5_clutchtargetpressureRaw "..." UWORD I_1 1 2 0 65535 ECU_ADDRESS 0x7000638A /end MEASUREMENT
/begin MEASUREMENT MAIN_MSGu16GCU2_ActTorqRaw "..." UWORD I_1 1 2 0 65535 ECU_ADDRESS 0x7000645C /end MEASUREMENT
/begin MEASUREMENT MAIN_MSGu16GCU2_MotPwrRaw "..." UWORD I_1 1 2 0 65535 ECU_ADDRESS 0x7000645A /end MEASUREMENT
/begin MEASUREMENT MAIN_MSGu16IPK_Year "..." UWORD I_3 1 2 0 65535 ECU_ADDRESS 0x70006458 /end MEASUREMENT
/begin MEASUREMENT MAIN_MSGu16MCUF1_ActTrqRaw "..." UWORD I_1 1 2 0 65535 ECU_ADDRESS 0x70006456 /end MEASUREMENT
/begin MEASUREMENT MAIN_MSGu16MCUF1_MotorPwrRaw "..." UWORD I_1 1 2 0 65535 ECU_ADDRESS 0x70006454 /end MEASUREMENT
/begin MEASUREMENT MAIN_MSGu16MCUF1_MotorSpdRaw "..." UWORD I_1 1 2 0 65535 ECU_ADDRESS 0x70006452 /end MEASUREMENT
/begin MEASUREMENT MAIN_MSGu16MCUF2_ActVolRaw "..." UWORD I_1 1 2 0 65535 ECU_ADDRESS 0x70006450 /end MEASUREMENT
/begin MEASUREMENT MAIN_MSGu16MCUF2_CurHVRaw "..." UWORD I_1 1 2 0 65535 ECU_ADDRESS 0x7000644E /end MEASUREMENT
/begin MEASUREMENT MAIN_MSGu16MCUF2_MotorMaxSpdRaw "..." UWORD I_1 1 2 0 65535 ECU_ADDRESS 0x7000644C /end MEASUREMENT
/begin MEASUREMENT MAIN_MSGu16MCUF3_MaxTrqTotalRaw "..." UWORD I_1 1 2 0 65535 ECU_ADDRESS 0x7000644A /end MEASUREMENT
/begin MEASUREMENT MAIN_MSGu16MCUF3_MinTrqTotalRaw "..." UWORD I_1 1 2 0 65535 ECU_ADDRESS 0x70006448 /end MEASUREMENT
/begin MEASUREMENT MAIN_MSGu16MCUF3_MotMaxPosTqRaw "..." UWORD I_1 1 2 0 65535 ECU_ADDRESS 0x70006446 /end MEASUREMENT
/begin MEASUREMENT MAIN_MSGu16MCUF3_MotMinNegTqRaw "..." UWORD I_1 1 2 0 65535 ECU_ADDRESS 0x70006444 /end MEASUREMENT
/begin MEASUREMENT MAIN_MSGu16MCUF4_MotCurPhase_ARaw "..." UWORD I_1 1 2 0 65535 ECU_ADDRESS 0x70006442 /end MEASUREMENT
/begin MEASUREMENT MAIN_MSGu16MCUF4_MotCurPhase_BRaw "..." UWORD I_1 1 2 0 65535 ECU_ADDRESS 0x70006440 /end MEASUREMENT
/begin MEASUREMENT MAIN_MSGu16MCUF4_MotCurPhase_CRaw "..." UWORD I_1 1 2 0 65535 ECU_ADDRESS 0x7000643E /end MEASUREMENT
/begin MEASUREMENT MAIN_MSGu16MCUF6_PerInd_MaxPwrRaw "..." UWORD I_1 1 2 0 65535 ECU_ADDRESS 0x7000643C /end MEASUREMENT
/begin MEASUREMENT MAIN_MSGu16MCUF6_PerInd_MaxTrqRaw "..." UWORD I_1 1 2 0 65535 ECU_ADDRESS 0x7000643A /end MEASUREMENT
/begin MEASUREMENT MAIN_MSGu16MCUF8_EfficiencyRaw "..." UWORD I_1 1 2 0 65535 ECU_ADDRESS 0x70006438 /end MEASUREMENT
/begin MEASUREMENT MAIN_MSGu16PDCM5_ChargeSpeed "..." UWORD I_1 1 2 0 65535 ECU_ADDRESS 0x7000622A /end MEASUREMENT
/begin MEASUREMENT MAIN_MSGu16SelfHeat_MCUF_BusCurRaw "..." UWORD I_1 1 2 0 65535 ECU_ADDRESS 0x70006436 /end MEASUREMENT
/begin MEASUREMENT MAIN_MSGu16SelfHeat_MCUF_BusFreqRaw "..." UWORD I_1 1 2 0 65535 ECU_ADDRESS 0x70006434 /end MEASUREMENT
/begin MEASUREMENT MAIN_MSGu16SelfHeat_MCUF_UdFreqRaw "..." UWORD I_1 1 2 0 65535 ECU_ADDRESS 0x70006432 /end MEASUREMENT
/begin MEASUREMENT MAIN_MSGu16SelfHeat_MCUF_UdVoltRaw "..." UWORD I_1 1 2 0 65535 ECU_ADDRESS 0x70006430 /end MEASUREMENT
/begin MEASUREMENT MAIN_MSGu16TCU1_ClutchAvailMaxTrqRaw "..." UWORD I_1 1 2 0 65535 ECU_ADDRESS 0x7000642C /end MEASUREMENT
/begin MEASUREMENT MAIN_MSGu16TCU1_ClutchAvailMinTrqRaw "..." UWORD I_1 1 2 0 65535 ECU_ADDRESS 0x7000642A /end MEASUREMENT
/begin MEASUREMENT MAIN_MSGu16TCU1_ClutchCapActRaw "..." UWORD I_1 1 2 0 65535 ECU_ADDRESS 0x70006428 /end MEASUREMENT
/begin MEASUREMENT MAIN_MSGu16TCU2_MaxFrtMotPwrReqRaw "..." UWORD I_1 1 2 0 65535 ECU_ADDRESS 0x70006426 /end MEASUREMENT
/begin MEASUREMENT MAIN_MSGu16TCU2_MaxGCUPwrReqRaw "..." UWORD I_1 1 2 0 65535 ECU_ADDRESS 0x70006424 /end MEASUREMENT
/begin MEASUREMENT MAIN_MSGu16TCU_ClutchActTorqRaw "..." UWORD I_1 1 2 0 65535 ECU_ADDRESS 0x7000642E /end MEASUREMENT
/begin MEASUREMENT MAIN_MSGu32GCU2_GenSpdRaw "..." ULONG I_1 1 2 0 4294967295 ECU_ADDRESS 0x70006594 /end MEASUREMENT
/begin MEASUREMENT MAIN_MSGu8BMS_MainNegConnSts "..." UBYTE I_1 1 2 0 255 ECU_ADDRESS 0x7000653C /end MEASUREMENT
/begin MEASUREMENT MAIN_MSGu8BMS_MainPosConnSts "..." UBYTE I_1 1 2 0 255 ECU_ADDRESS 0x7000653B /end MEASUREMENT
/begin MEASUREMENT MAIN_MSGu8CCP_CurrentSts "..." UBYTE I_1 1 2 0 255 ECU_ADDRESS 0x70006539 /end MEASUREMENT
/begin MEASUREMENT MAIN_MSGu8CCP_FaultCode "..." UBYTE I_1 1 2 0 255 ECU_ADDRESS 0x70006538 /end MEASUREMENT
/begin MEASUREMENT MAIN_MSGu8CCP_FaultLevel "..." UBYTE I_1 1 2 0 255 ECU_ADDRESS 0x70006537 /end MEASUREMENT
/begin MEASUREMENT MAIN_MSGu8CCP_PwrStgMode "..." UBYTE I_1 1 2 0 255 ECU_ADDRESS 0x70006536 /end MEASUREMENT
/begin MEASUREMENT MAIN_MSGu8CCP_PwrStgPosSts "..." UBYTE I_1 1 2 0 255 ECU_ADDRESS 0x70006535 /end MEASUREMENT
/begin MEASUREMENT MAIN_MSGu8CCP_PwrStgSts "..." UBYTE I_1 1 2 0 255 ECU_ADDRESS 0x70006534 /end MEASUREMENT
/begin MEASUREMENT MAIN_MSGu8CCP_TargetMotSts "..." UBYTE I_1 1 2 0 255 ECU_ADDRESS 0x70006532 /end MEASUREMENT
/begin MEASUREMENT MAIN_MSGu8CCp_5VSupplyRaw "..." UBYTE I_1 1 2 0 255 ECU_ADDRESS 0x7000653A /end MEASUREMENT
/begin MEASUREMENT MAIN_MSGu8CCp_PwrStgTempRaw "..." UBYTE I_1 1 2 0 255 ECU_ADDRESS 0x70006533 /end MEASUREMENT
/begin MEASUREMENT MAIN_MSGu8CompileDay "..." UBYTE I_1 1 2 0 255 ECU_ADDRESS 0x70006531 /end MEASUREMENT
/begin MEASUREMENT MAIN_MSGu8CompileMonth "..." UBYTE I_1 1 2 0 255 ECU_ADDRESS 0x70006530 /end MEASUREMENT
/begin MEASUREMENT MAIN_MSGu8CompileYear "..." UBYTE I_1 1 2 0 255 ECU_ADDRESS 0x7000652F /end MEASUREMENT
/begin MEASUREMENT MAIN_MSGu8DCU_FltLev "..." UBYTE I_1 1 2 0 255 ECU_ADDRESS 0x7000652E /end MEASUREMENT
/begin MEASUREMENT MAIN_MSGu8DCU_OfsAlCalSts "..." UBYTE I_1 1 2 0 255 ECU_ADDRESS 0x7000652D /end MEASUREMENT
/begin MEASUREMENT MAIN_MSGu8DEV_Fault0 "..." UBYTE I_1 1 2 0 255 ECU_ADDRESS 0x7000652C /end MEASUREMENT
/begin MEASUREMENT MAIN_MSGu8DEV_Fault1 "..." UBYTE I_1 1 2 0 255 ECU_ADDRESS 0x7000652B /end MEASUREMENT
/begin MEASUREMENT MAIN_MSGu8DEV_Fault10 "..." UBYTE I_1 1 2 0 255 ECU_ADDRESS 0x7000652A /end MEASUREMENT
/begin MEASUREMENT MAIN_MSGu8DEV_Fault11 "..." UBYTE I_1 1 2 0 255 ECU_ADDRESS 0x70006529 /end MEASUREMENT
/begin MEASUREMENT MAIN_MSGu8DEV_Fault12 "..." UBYTE I_1 1 2 0 255 ECU_ADDRESS 0x70006528 /end MEASUREMENT
/begin MEASUREMENT MAIN_MSGu8DEV_Fault13 "..." UBYTE I_1 1 2 0 255 ECU_ADDRESS 0x70006527 /end MEASUREMENT
/begin MEASUREMENT MAIN_MSGu8DEV_Fault14 "..." UBYTE I_1 1 2 0 255 ECU_ADDRESS 0x70006526 /end MEASUREMENT
/begin MEASUREMENT MAIN_MSGu8DEV_Fault15 "..." UBYTE I_1 1 2 0 255 ECU_ADDRESS 0x70006525 /end MEASUREMENT
/begin MEASUREMENT MAIN_MSGu8DEV_Fault2 "..." UBYTE I_1 1 2 0 255 ECU_ADDRESS 0x70006524 /end MEASUREMENT
/begin MEASUREMENT MAIN_MSGu8DEV_Fault3 "..." UBYTE I_1 1 2 0 255 ECU_ADDRESS 0x70006523 /end MEASUREMENT
/begin MEASUREMENT MAIN_MSGu8DEV_Fault4 "..." UBYTE I_1 1 2 0 255 ECU_ADDRESS 0x70006522 /end MEASUREMENT
/begin MEASUREMENT MAIN_MSGu8DEV_Fault5 "..." UBYTE I_1 1 2 0 255 ECU_ADDRESS 0x70006521 /end MEASUREMENT
/begin MEASUREMENT MAIN_MSGu8DEV_Fault6 "..." UBYTE I_1 1 2 0 255 ECU_ADDRESS 0x70006520 /end MEASUREMENT
/begin MEASUREMENT MAIN_MSGu8DEV_Fault7 "..." UBYTE I_1 1 2 0 255 ECU_ADDRESS 0x7000651F /end MEASUREMENT
/begin MEASUREMENT MAIN_MSGu8DEV_Fault8 "..." UBYTE I_1 1 2 0 255 ECU_ADDRESS 0x7000651E /end MEASUREMENT
/begin MEASUREMENT MAIN_MSGu8DEV_Fault9 "..." UBYTE I_1 1 2 0 255 ECU_ADDRESS 0x7000651D /end MEASUREMENT
/begin MEASUREMENT MAIN_MSGu8EMS1_EngRunStatus "..." UBYTE I_1 1 2 0 255 ECU_ADDRESS 0x7000651C /end MEASUREMENT
/begin MEASUREMENT MAIN_MSGu8EMS8_SysErrLevel "..." UBYTE I_1 1 2 0 255 ECU_ADDRESS 0x7000651B /end MEASUREMENT
/begin MEASUREMENT MAIN_MSGu8EOL1_CCPcontrolEnable "..." UBYTE I_1 1 2 0 255 ECU_ADDRESS 0x700063A6 /end MEASUREMENT
/begin MEASUREMENT MAIN_MSGu8EOL2_CAPcontrolEnable "..." UBYTE I_1 1 2 0 255 ECU_ADDRESS 0x7000639C /end MEASUREMENT
/begin MEASUREMENT MAIN_MSGu8EOL5_oiltempRaw "..." UBYTE I_1 1 2 0 255 ECU_ADDRESS 0x7000638C /end MEASUREMENT
/begin MEASUREMENT MAIN_MSGu8FMCU8_HtcuLimpHomeSts "..." UBYTE I_1 1 2 0 255 ECU_ADDRESS 0x7000651A /end MEASUREMENT
/begin MEASUREMENT MAIN_MSGu8GCU2_State "..." UBYTE I_1 1 2 0 255 ECU_ADDRESS 0x70006519 /end MEASUREMENT
/begin MEASUREMENT MAIN_MSGu8GCU4_ActDischgSta "..." UBYTE I_1 1 2 0 255 ECU_ADDRESS 0x70006518 /end MEASUREMENT
/begin MEASUREMENT MAIN_MSGu8GCU4_GenFaultLmp "..." UBYTE I_1 1 2 0 255 ECU_ADDRESS 0x70006517 /end MEASUREMENT
/begin MEASUREMENT MAIN_MSGu8GCU4_OBD_Lmp_Req "..." UBYTE I_1 1 2 0 255 ECU_ADDRESS 0x70006516 /end MEASUREMENT
/begin MEASUREMENT MAIN_MSGu8GW2_PwrMode "..." UBYTE I_3 1 2 0 255 ECU_ADDRESS 0x70006515 /end MEASUREMENT
/begin MEASUREMENT MAIN_MSGu8IPK_Day "..." UBYTE I_3 1 2 0 255 ECU_ADDRESS 0x70006514 /end MEASUREMENT
/begin MEASUREMENT MAIN_MSGu8IPK_Hour "..." UBYTE I_3 1 2 0 255 ECU_ADDRESS 0x70006513 /end MEASUREMENT
/begin MEASUREMENT MAIN_MSGu8IPK_Minute "..." UBYTE I_3 1 2 0 255 ECU_ADDRESS 0x70006512 /end MEASUREMENT
/begin MEASUREMENT MAIN_MSGu8IPK_Month "..." UBYTE I_3 1 2 0 255 ECU_ADDRESS 0x70006511 /end MEASUREMENT
/begin MEASUREMENT MAIN_MSGu8IPK_Second "..." UBYTE I_3 1 2 0 255 ECU_ADDRESS 0x70006510 /end MEASUREMENT
/begin MEASUREMENT MAIN_MSGu8M2G1_Byte4 "..." UBYTE I_1 1 2 0 255 ECU_ADDRESS 0x7000650F /end MEASUREMENT
/begin MEASUREMENT MAIN_MSGu8M2G1_Byte5 "..." UBYTE I_1 1 2 0 255 ECU_ADDRESS 0x7000650E /end MEASUREMENT
/begin MEASUREMENT MAIN_MSGu8M2G1_Byte6 "..." UBYTE I_1 1 2 0 255 ECU_ADDRESS 0x7000650D /end MEASUREMENT
/begin MEASUREMENT MAIN_MSGu8M2G1_Byte7 "..." UBYTE I_1 1 2 0 255 ECU_ADDRESS 0x7000650C /end MEASUREMENT
/begin MEASUREMENT MAIN_MSGu8M2G2_Byte0 "..." UBYTE I_1 1 2 0 255 ECU_ADDRESS 0x7000650B /end MEASUREMENT
/begin MEASUREMENT MAIN_MSGu8M2G2_Byte1 "..." UBYTE I_1 1 2 0 255 ECU_ADDRESS 0x7000650A /end MEASUREMENT
/begin MEASUREMENT MAIN_MSGu8M2G2_Byte2 "..." UBYTE I_1 1 2 0 255 ECU_ADDRESS 0x70006509 /end MEASUREMENT
/begin MEASUREMENT MAIN_MSGu8M2G2_Byte3 "..." UBYTE I_1 1 2 0 255 ECU_ADDRESS 0x70006508 /end MEASUREMENT
/begin MEASUREMENT MAIN_MSGu8M2G2_Byte4 "..." UBYTE I_1 1 2 0 255 ECU_ADDRESS 0x70006507 /end MEASUREMENT
/begin MEASUREMENT MAIN_MSGu8M2G2_Byte5 "..." UBYTE I_1 1 2 0 255 ECU_ADDRESS 0x70006506 /end MEASUREMENT
/begin MEASUREMENT MAIN_MSGu8M2G2_Byte6 "..." UBYTE I_1 1 2 0 255 ECU_ADDRESS 0x70006505 /end MEASUREMENT
/begin MEASUREMENT MAIN_MSGu8M2G2_Byte7 "..." UBYTE I_1 1 2 0 255 ECU_ADDRESS 0x70006504 /end MEASUREMENT
/begin MEASUREMENT MAIN_MSGu8MCUF1_RC "..." UBYTE I_1 1 2 0 255 ECU_ADDRESS 0x700064DB /end MEASUREMENT
/begin MEASUREMENT MAIN_MSGu8MCUF2_RC "..." UBYTE I_1 1 2 0 255 ECU_ADDRESS 0x700064DA /end MEASUREMENT
/begin MEASUREMENT MAIN_MSGu8MCUF2_State "..." UBYTE I_1 1 2 0 255 ECU_ADDRESS 0x700064D9 /end MEASUREMENT
/begin MEASUREMENT MAIN_MSGu8MCUF3_RC "..." UBYTE I_1 1 2 0 255 ECU_ADDRESS 0x700064D8 /end MEASUREMENT
/begin MEASUREMENT MAIN_MSGu8MCUF4_CtrlerTmpRaw "..." UBYTE I_1 1 2 0 255 ECU_ADDRESS 0x700064D7 /end MEASUREMENT
/begin MEASUREMENT MAIN_MSGu8MCUF4_MotTempRaw "..." UBYTE I_1 1 2 0 255 ECU_ADDRESS 0x700064D6 /end MEASUREMENT
/begin MEASUREMENT MAIN_MSGu8MCUF4_RC "..." UBYTE I_1 1 2 0 255 ECU_ADDRESS 0x700064D5 /end MEASUREMENT
/begin MEASUREMENT MAIN_MSGu8MCUF6_FaultCode "..." UBYTE I_1 1 2 0 255 ECU_ADDRESS 0x700064D4 /end MEASUREMENT
/begin MEASUREMENT MAIN_MSGu8MCUF6_FaultLmpReq "..." UBYTE I_1 1 2 0 255 ECU_ADDRESS 0x700064D3 /end MEASUREMENT
/begin MEASUREMENT MAIN_MSGu8MCUF6_MotorSta "..." UBYTE I_1 1 2 0 255 ECU_ADDRESS 0x700064D2 /end MEASUREMENT
/begin MEASUREMENT MAIN_MSGu8MCUF6_OBDLmpReq "..." UBYTE I_1 1 2 0 255 ECU_ADDRESS 0x700064D1 /end MEASUREMENT
/begin MEASUREMENT MAIN_MSGu8MCUF6_RC "..." UBYTE I_1 1 2 0 255 ECU_ADDRESS 0x700064D0 /end MEASUREMENT
/begin MEASUREMENT MAIN_MSGu8MCUF6_TotalFaultNum "..." UBYTE I_1 1 2 0 255 ECU_ADDRESS 0x700064CF /end MEASUREMENT
/begin MEASUREMENT MAIN_MSGu8MCUF8_HV_VoltFree "..." UBYTE I_1 1 2 0 255 ECU_ADDRESS 0x700064CE /end MEASUREMENT
/begin MEASUREMENT MAIN_MSGu8MCUF8_HWVer "..." UBYTE I_1 1 2 0 255 ECU_ADDRESS 0x700064CD /end MEASUREMENT
/begin MEASUREMENT MAIN_MSGu8MCUF8_RC "..." UBYTE I_1 1 2 0 255 ECU_ADDRESS 0x700064CC /end MEASUREMENT
/begin MEASUREMENT MAIN_MSGu8MCUF8_RTMOverSpd "..." UBYTE I_1 1 2 0 255 ECU_ADDRESS 0x700064C8 /end MEASUREMENT
/begin MEASUREMENT MAIN_MSGu8MCUF8_RTMWarnComm "..." UBYTE I_1 1 2 0 255 ECU_ADDRESS 0x700064C7 /end MEASUREMENT
/begin MEASUREMENT MAIN_MSGu8MCUF8_RTM_OverCur "..." UBYTE I_1 1 2 0 255 ECU_ADDRESS 0x700064CB /end MEASUREMENT
/begin MEASUREMENT MAIN_MSGu8MCUF8_RTM_OverTmpEM "..." UBYTE I_1 1 2 0 255 ECU_ADDRESS 0x700064CA /end MEASUREMENT
/begin MEASUREMENT MAIN_MSGu8MCUF8_RTM_OverTmpMCU "..." UBYTE I_1 1 2 0 255 ECU_ADDRESS 0x700064C9 /end MEASUREMENT
/begin MEASUREMENT MAIN_MSGu8MCUF8_SWMajorVer "..." UBYTE I_1 1 2 0 255 ECU_ADDRESS 0x700064C6 /end MEASUREMENT
/begin MEASUREMENT MAIN_MSGu8MCUF8_SWMinorVer "..." UBYTE I_1 1 2 0 255 ECU_ADDRESS 0x700064C5 /end MEASUREMENT
/begin MEASUREMENT MAIN_MSGu8MCUF8_VehicleType "..." UBYTE I_1 1 2 0 255 ECU_ADDRESS 0x700064C4 /end MEASUREMENT
/begin MEASUREMENT MAIN_MSGu8MCUF_Cali1 "..." UBYTE I_1 1 2 0 255 MATRIX_DIM 8 1 1 ECU_ADDRESS 0x700064F4 /end MEASUREMENT
/begin MEASUREMENT MAIN_MSGu8MCUF_Cali1[0] "MAIN_MSGu8MCUF_Cali1[0]" UBYTE I_1 1 2 0 255 ECU_ADDRESS 0x700064F4 /end MEASUREMENT
/begin MEASUREMENT MAIN_MSGu8MCUF_Cali1[1] "MAIN_MSGu8MCUF_Cali1[1]" UBYTE I_1 1 2 0 255 ECU_ADDRESS 0x700064F5 /end MEASUREMENT
/begin MEASUREMENT MAIN_MSGu8MCUF_Cali1[2] "MAIN_MSGu8MCUF_Cali1[2]" UBYTE I_1 1 2 0 255 ECU_ADDRESS 0x700064F6 /end MEASUREMENT
/begin MEASUREMENT MAIN_MSGu8MCUF_Cali1[3] "MAIN_MSGu8MCUF_Cali1[3]" UBYTE I_1 1 2 0 255 ECU_ADDRESS 0x700064F7 /end MEASUREMENT
/begin MEASUREMENT MAIN_MSGu8MCUF_Cali1[4] "MAIN_MSGu8MCUF_Cali1[4]" UBYTE I_1 1 2 0 255 ECU_ADDRESS 0x700064F8 /end MEASUREMENT
/begin MEASUREMENT MAIN_MSGu8MCUF_Cali1[5] "MAIN_MSGu8MCUF_Cali1[5]" UBYTE I_1 1 2 0 255 ECU_ADDRESS 0x700064F9 /end MEASUREMENT
/begin MEASUREMENT MAIN_MSGu8MCUF_Cali1[6] "MAIN_MSGu8MCUF_Cali1[6]" UBYTE I_1 1 2 0 255 ECU_ADDRESS 0x700064FA /end MEASUREMENT
/begin MEASUREMENT MAIN_MSGu8MCUF_Cali1[7] "MAIN_MSGu8MCUF_Cali1[7]" UBYTE I_1 1 2 0 255 ECU_ADDRESS 0x700064FB /end MEASUREMENT
/begin MEASUREMENT MAIN_MSGu8MCUF_Cali2 "..." UBYTE I_1 1 2 0 255 MATRIX_DIM 8 1 1 ECU_ADDRESS 0x700064EC /end MEASUREMENT
/begin MEASUREMENT MAIN_MSGu8MCUF_Cali2[0] "MAIN_MSGu8MCUF_Cali2[0]" UBYTE I_1 1 2 0 255 ECU_ADDRESS 0x700064EC /end MEASUREMENT
/begin MEASUREMENT MAIN_MSGu8MCUF_Cali2[1] "MAIN_MSGu8MCUF_Cali2[1]" UBYTE I_1 1 2 0 255 ECU_ADDRESS 0x700064ED /end MEASUREMENT
/begin MEASUREMENT MAIN_MSGu8MCUF_Cali2[2] "MAIN_MSGu8MCUF_Cali2[2]" UBYTE I_1 1 2 0 255 ECU_ADDRESS 0x700064EE /end MEASUREMENT
/begin MEASUREMENT MAIN_MSGu8MCUF_Cali2[3] "MAIN_MSGu8MCUF_Cali2[3]" UBYTE I_1 1 2 0 255 ECU_ADDRESS 0x700064EF /end MEASUREMENT
/begin MEASUREMENT MAIN_MSGu8MCUF_Cali2[4] "MAIN_MSGu8MCUF_Cali2[4]" UBYTE I_1 1 2 0 255 ECU_ADDRESS 0x700064F0 /end MEASUREMENT
/begin MEASUREMENT MAIN_MSGu8MCUF_Cali2[5] "MAIN_MSGu8MCUF_Cali2[5]" UBYTE I_1 1 2 0 255 ECU_ADDRESS 0x700064F1 /end MEASUREMENT
/begin MEASUREMENT MAIN_MSGu8MCUF_Cali2[6] "MAIN_MSGu8MCUF_Cali2[6]" UBYTE I_1 1 2 0 255 ECU_ADDRESS 0x700064F2 /end MEASUREMENT
/begin MEASUREMENT MAIN_MSGu8MCUF_Cali2[7] "MAIN_MSGu8MCUF_Cali2[7]" UBYTE I_1 1 2 0 255 ECU_ADDRESS 0x700064F3 /end MEASUREMENT
/begin MEASUREMENT MAIN_MSGu8MCUF_Cali3 "..." UBYTE I_1 1 2 0 255 MATRIX_DIM 8 1 1 ECU_ADDRESS 0x700064E4 /end MEASUREMENT
/begin MEASUREMENT MAIN_MSGu8MCUF_Cali3[0] "MAIN_MSGu8MCUF_Cali3[0]" UBYTE I_1 1 2 0 255 ECU_ADDRESS 0x700064E4 /end MEASUREMENT
/begin MEASUREMENT MAIN_MSGu8MCUF_Cali3[1] "MAIN_MSGu8MCUF_Cali3[1]" UBYTE I_1 1 2 0 255 ECU_ADDRESS 0x700064E5 /end MEASUREMENT
/begin MEASUREMENT MAIN_MSGu8MCUF_Cali3[2] "MAIN_MSGu8MCUF_Cali3[2]" UBYTE I_1 1 2 0 255 ECU_ADDRESS 0x700064E6 /end MEASUREMENT
/begin MEASUREMENT MAIN_MSGu8MCUF_Cali3[3] "MAIN_MSGu8MCUF_Cali3[3]" UBYTE I_1 1 2 0 255 ECU_ADDRESS 0x700064E7 /end MEASUREMENT
/begin MEASUREMENT MAIN_MSGu8MCUF_Cali3[4] "MAIN_MSGu8MCUF_Cali3[4]" UBYTE I_1 1 2 0 255 ECU_ADDRESS 0x700064E8 /end MEASUREMENT
/begin MEASUREMENT MAIN_MSGu8MCUF_Cali3[5] "MAIN_MSGu8MCUF_Cali3[5]" UBYTE I_1 1 2 0 255 ECU_ADDRESS 0x700064E9 /end MEASUREMENT
/begin MEASUREMENT MAIN_MSGu8MCUF_Cali3[6] "MAIN_MSGu8MCUF_Cali3[6]" UBYTE I_1 1 2 0 255 ECU_ADDRESS 0x700064EA /end MEASUREMENT
/begin MEASUREMENT MAIN_MSGu8MCUF_Cali3[7] "MAIN_MSGu8MCUF_Cali3[7]" UBYTE I_1 1 2 0 255 ECU_ADDRESS 0x700064EB /end MEASUREMENT
/begin MEASUREMENT MAIN_MSGu8MCUF_Cali4 "..." UBYTE I_1 1 2 0 255 MATRIX_DIM 8 1 1 ECU_ADDRESS 0x700064DC /end MEASUREMENT
/begin MEASUREMENT MAIN_MSGu8MCUF_Cali4[0] "MAIN_MSGu8MCUF_Cali4[0]" UBYTE I_1 1 2 0 255 ECU_ADDRESS 0x700064DC /end MEASUREMENT
/begin MEASUREMENT MAIN_MSGu8MCUF_Cali4[1] "MAIN_MSGu8MCUF_Cali4[1]" UBYTE I_1 1 2 0 255 ECU_ADDRESS 0x700064DD /end MEASUREMENT
/begin MEASUREMENT MAIN_MSGu8MCUF_Cali4[2] "MAIN_MSGu8MCUF_Cali4[2]" UBYTE I_1 1 2 0 255 ECU_ADDRESS 0x700064DE /end MEASUREMENT
/begin MEASUREMENT MAIN_MSGu8MCUF_Cali4[3] "MAIN_MSGu8MCUF_Cali4[3]" UBYTE I_1 1 2 0 255 ECU_ADDRESS 0x700064DF /end MEASUREMENT
/begin MEASUREMENT MAIN_MSGu8MCUF_Cali4[4] "MAIN_MSGu8MCUF_Cali4[4]" UBYTE I_1 1 2 0 255 ECU_ADDRESS 0x700064E0 /end MEASUREMENT
/begin MEASUREMENT MAIN_MSGu8MCUF_Cali4[5] "MAIN_MSGu8MCUF_Cali4[5]" UBYTE I_1 1 2 0 255 ECU_ADDRESS 0x700064E1 /end MEASUREMENT
/begin MEASUREMENT MAIN_MSGu8MCUF_Cali4[6] "MAIN_MSGu8MCUF_Cali4[6]" UBYTE I_1 1 2 0 255 ECU_ADDRESS 0x700064E2 /end MEASUREMENT
/begin MEASUREMENT MAIN_MSGu8MCUF_Cali4[7] "MAIN_MSGu8MCUF_Cali4[7]" UBYTE I_1 1 2 0 255 ECU_ADDRESS 0x700064E3 /end MEASUREMENT
/begin MEASUREMENT MAIN_MSGu8MCUR_Cali "..." UBYTE I_1 1 2 0 255 MATRIX_DIM 8 1 1 ECU_ADDRESS 0x700064AD /end MEASUREMENT
/begin MEASUREMENT MAIN_MSGu8MCUR_Cali[0] "MAIN_MSGu8MCUR_Cali[0]" UBYTE I_1 1 2 0 255 ECU_ADDRESS 0x700064AD /end MEASUREMENT
/begin MEASUREMENT MAIN_MSGu8MCUR_Cali[1] "MAIN_MSGu8MCUR_Cali[1]" UBYTE I_1 1 2 0 255 ECU_ADDRESS 0x700064AE /end MEASUREMENT
/begin MEASUREMENT MAIN_MSGu8MCUR_Cali[2] "MAIN_MSGu8MCUR_Cali[2]" UBYTE I_1 1 2 0 255 ECU_ADDRESS 0x700064AF /end MEASUREMENT
/begin MEASUREMENT MAIN_MSGu8MCUR_Cali[3] "MAIN_MSGu8MCUR_Cali[3]" UBYTE I_1 1 2 0 255 ECU_ADDRESS 0x700064B0 /end MEASUREMENT
/begin MEASUREMENT MAIN_MSGu8MCUR_Cali[4] "MAIN_MSGu8MCUR_Cali[4]" UBYTE I_1 1 2 0 255 ECU_ADDRESS 0x700064B1 /end MEASUREMENT
/begin MEASUREMENT MAIN_MSGu8MCUR_Cali[5] "MAIN_MSGu8MCUR_Cali[5]" UBYTE I_1 1 2 0 255 ECU_ADDRESS 0x700064B2 /end MEASUREMENT
/begin MEASUREMENT MAIN_MSGu8MCUR_Cali[6] "MAIN_MSGu8MCUR_Cali[6]" UBYTE I_1 1 2 0 255 ECU_ADDRESS 0x700064B3 /end MEASUREMENT
/begin MEASUREMENT MAIN_MSGu8MCUR_Cali[7] "MAIN_MSGu8MCUR_Cali[7]" UBYTE I_1 1 2 0 255 ECU_ADDRESS 0x700064B4 /end MEASUREMENT
/begin MEASUREMENT MAIN_MSGu8MCU_McuEnableSts "..." UBYTE I_1 1 2 0 255 ECU_ADDRESS 0x70006503 /end MEASUREMENT
/begin MEASUREMENT MAIN_MSGu8MCU_McuPrevSlipFlg "..." UBYTE I_1 1 2 0 255 ECU_ADDRESS 0x70006502 /end MEASUREMENT
/begin MEASUREMENT MAIN_MSGu8MCU_PwrActvMod "..." UBYTE I_1 1 2 0 255 ECU_ADDRESS 0x70006501 /end MEASUREMENT
/begin MEASUREMENT MAIN_MSGu8McuActvDischgFlt "..." UBYTE I_1 1 2 0 255 ECU_ADDRESS 0x70006500 /end MEASUREMENT
/begin MEASUREMENT MAIN_MSGu8McuBusUVFlt "..." UBYTE I_1 1 2 0 255 ECU_ADDRESS 0x700064FF /end MEASUREMENT
/begin MEASUREMENT MAIN_MSGu8McuCANComFlt "..." UBYTE I_1 1 2 0 255 ECU_ADDRESS 0x700064FE /end MEASUREMENT
/begin MEASUREMENT MAIN_MSGu8McuDTC "..." UBYTE I_1 1 2 0 255 ECU_ADDRESS 0x700064FC /end MEASUREMENT
/begin MEASUREMENT MAIN_MSGu8McuDcHVCurSensFlt "..." UBYTE I_1 1 2 0 255 ECU_ADDRESS 0x700064FD /end MEASUREMENT
/begin MEASUREMENT MAIN_MSGu8McuHVLoopFlt "..." UBYTE I_1 1 2 0 255 ECU_ADDRESS 0x700064C1 /end MEASUREMENT
/begin MEASUREMENT MAIN_MSGu8McuHardMajorVer "..." UBYTE I_1 1 2 0 255 ECU_ADDRESS 0x700064C3 /end MEASUREMENT
/begin MEASUREMENT MAIN_MSGu8McuHardMinorVer "..." UBYTE I_1 1 2 0 255 ECU_ADDRESS 0x700064C2 /end MEASUREMENT
/begin MEASUREMENT MAIN_MSGu8McuHwCapOVFlt "..." UBYTE I_1 1 2 0 255 ECU_ADDRESS 0x700064C0 /end MEASUREMENT
/begin MEASUREMENT MAIN_MSGu8McuIgbtFlt "..." UBYTE I_1 1 2 0 255 ECU_ADDRESS 0x700064BF /end MEASUREMENT
/begin MEASUREMENT MAIN_MSGu8McuInvtTempSensErr "..." UBYTE I_1 1 2 0 255 ECU_ADDRESS 0x700064BE /end MEASUREMENT
/begin MEASUREMENT MAIN_MSGu8McuLVVoltFlt "..." UBYTE I_1 1 2 0 255 ECU_ADDRESS 0x700064BD /end MEASUREMENT
/begin MEASUREMENT MAIN_MSGu8McuMemoryFlt "..." UBYTE I_1 1 2 0 255 ECU_ADDRESS 0x700064BC /end MEASUREMENT
/begin MEASUREMENT MAIN_MSGu8McuMotLockRotErr "..." UBYTE I_1 1 2 0 255 ECU_ADDRESS 0x700064BB /end MEASUREMENT
/begin MEASUREMENT MAIN_MSGu8McuMotSN "..." UBYTE I_1 1 2 0 255 ECU_ADDRESS 0x700064BA /end MEASUREMENT
/begin MEASUREMENT MAIN_MSGu8McuMotSpdHighAlarm "..." UBYTE I_1 1 2 0 255 ECU_ADDRESS 0x700064B9 /end MEASUREMENT
/begin MEASUREMENT MAIN_MSGu8McuMotSubFltLevel "..." UBYTE I_1 1 2 0 255 ECU_ADDRESS 0x700064B8 /end MEASUREMENT
/begin MEASUREMENT MAIN_MSGu8McuMotSysOVCAlarm "..." UBYTE I_1 1 2 0 255 ECU_ADDRESS 0x700064B7 /end MEASUREMENT
/begin MEASUREMENT MAIN_MSGu8McuMotTempHighAlarm "..." UBYTE I_1 1 2 0 255 ECU_ADDRESS 0x700064B6 /end MEASUREMENT
/begin MEASUREMENT MAIN_MSGu8McuMotTempSensErr "..." UBYTE I_1 1 2 0 255 ECU_ADDRESS 0x700064B5 /end MEASUREMENT
/begin MEASUREMENT MAIN_MSGu8McuResolverFlt "..." UBYTE I_1 1 2 0 255 ECU_ADDRESS 0x700064AC /end MEASUREMENT
/begin MEASUREMENT MAIN_MSGu8McuSoftCapOVFlt "..." UBYTE I_1 1 2 0 255 ECU_ADDRESS 0x700064AB /end MEASUREMENT
/begin MEASUREMENT MAIN_MSGu8McuSoftMajorVer "..." UBYTE I_1 1 2 0 255 ECU_ADDRESS 0x700064AA /end MEASUREMENT
/begin MEASUREMENT MAIN_MSGu8McuSoftMinorVer "..." UBYTE I_1 1 2 0 255 ECU_ADDRESS 0x700064A9 /end MEASUREMENT
/begin MEASUREMENT MAIN_MSGu8McuTempHighAlarm "..." UBYTE I_1 1 2 0 255 ECU_ADDRESS 0x700064A8 /end MEASUREMENT
/begin MEASUREMENT MAIN_MSGu8McuUCurSensFlt "..." UBYTE I_1 1 2 0 255 ECU_ADDRESS 0x700064A7 /end MEASUREMENT
/begin MEASUREMENT MAIN_MSGu8McuVCurSensFlt "..." UBYTE I_1 1 2 0 255 ECU_ADDRESS 0x700064A6 /end MEASUREMENT
/begin MEASUREMENT MAIN_MSGu8McuWCurSensFlt "..." UBYTE I_1 1 2 0 255 ECU_ADDRESS 0x700064A5 /end MEASUREMENT
/begin MEASUREMENT MAIN_MSGu8PDCM10_DriveReady "..." UBYTE I_1 1 2 0 255 ECU_ADDRESS 0x7000649A /end MEASUREMENT
/begin MEASUREMENT MAIN_MSGu8PDCM10_EVMode_Sta "..." UBYTE I_1 1 2 0 255 ECU_ADDRESS 0x70006499 /end MEASUREMENT
/begin MEASUREMENT MAIN_MSGu8PDCM10_actualGear "..." UBYTE I_1 1 2 0 255 ECU_ADDRESS 0x7000649D /end MEASUREMENT
/begin MEASUREMENT MAIN_MSGu8PDCM10_authResult "..." UBYTE I_1 1 2 0 255 ECU_ADDRESS 0x7000649C /end MEASUREMENT
/begin MEASUREMENT MAIN_MSGu8PDCM10_driveMode "..." UBYTE I_1 1 2 0 255 ECU_ADDRESS 0x7000649B /end MEASUREMENT
/begin MEASUREMENT MAIN_MSGu8PDCM10_targetGear "..." UBYTE I_1 1 2 0 255 ECU_ADDRESS 0x70006498 /end MEASUREMENT
/begin MEASUREMENT MAIN_MSGu8PDCM21_HVCO_MFStaCmd "..." UBYTE I_1 1 2 0 255 ECU_ADDRESS 0x70006497 /end MEASUREMENT
/begin MEASUREMENT MAIN_MSGu8PDCM22_HVCO_StaCmdMR "..." UBYTE I_1 1 2 0 255 ECU_ADDRESS 0x70006496 /end MEASUREMENT
/begin MEASUREMENT MAIN_MSGu8PDCM24_ClutchCmd "..." UBYTE I_1 1 2 0 255 ECU_ADDRESS 0x70006495 /end MEASUREMENT
/begin MEASUREMENT MAIN_MSGu8PDCM24_HVCO_EmgShutdnReq "..." UBYTE I_1 1 2 0 255 ECU_ADDRESS 0x70006494 /end MEASUREMENT
/begin MEASUREMENT MAIN_MSGu8PDCM5_AWCAssemblyStatus "..." UBYTE I_1 1 2 0 255 ECU_ADDRESS 0x70006224 /end MEASUREMENT
/begin MEASUREMENT MAIN_MSGu8PDCM5_ChargeReq "..." UBYTE I_1 1 2 0 255 ECU_ADDRESS 0x70006222 /end MEASUREMENT
/begin MEASUREMENT MAIN_MSGu8PDCM5_ChargeSpeedUnit "..." UBYTE I_1 1 2 0 255 ECU_ADDRESS 0x70006228 /end MEASUREMENT
/begin MEASUREMENT MAIN_MSGu8PDCM5_ChargeSpeedValid "..." UBYTE I_1 1 2 0 255 ECU_ADDRESS 0x70006227 /end MEASUREMENT
/begin MEASUREMENT MAIN_MSGu8PDCM5_ChargeState "..." UBYTE I_1 1 2 0 255 ECU_ADDRESS 0x70006223 /end MEASUREMENT
/begin MEASUREMENT MAIN_MSGu8PDCM5_HVCM_ChgSta "..." UBYTE I_1 1 2 0 255 ECU_ADDRESS 0x70006493 /end MEASUREMENT
/begin MEASUREMENT MAIN_MSGu8PDCM5_RestchargingTimeValid "..." UBYTE I_1 1 2 0 255 ECU_ADDRESS 0x70006226 /end MEASUREMENT
/begin MEASUREMENT MAIN_MSGu8PDCM5_VehicleHoldReq "..." UBYTE I_1 1 2 0 255 ECU_ADDRESS 0x70006225 /end MEASUREMENT
/begin MEASUREMENT MAIN_MSGu8PDCM_ACU_EPSacu_crashOputStsVld "..." UBYTE Bool_ON_OFF 1 2 0 1 BIT_MASK 0x01 ECU_ADDRESS 0x700064A4 /end MEASUREMENT
/begin MEASUREMENT MAIN_MSGu8PDCM_ACU_EPSacu_crashOutputSts "..." UBYTE I_1 1 2 0 255 ECU_ADDRESS 0x700064A3 /end MEASUREMENT
/begin MEASUREMENT MAIN_MSGu8PDCM_GCU_StaCmd "..." UBYTE I_1 1 2 0 255 ECU_ADDRESS 0x700064A2 /end MEASUREMENT
/begin MEASUREMENT MAIN_MSGu8PDCM_IC_ACUEPBS_BrakeSwInfo "..." UBYTE I_1 1 2 0 255 ECU_ADDRESS 0x700064A1 /end MEASUREMENT
/begin MEASUREMENT MAIN_MSGu8PDCM_IC_ACUEPBS_FaultLamp "..." UBYTE I_1 1 2 0 255 ECU_ADDRESS 0x700064A0 /end MEASUREMENT
/begin MEASUREMENT MAIN_MSGu8PDCM_IC_ACUEPBS_Sts "..." UBYTE I_1 1 2 0 255 ECU_ADDRESS 0x7000649F /end MEASUREMENT
/begin MEASUREMENT MAIN_MSGu8PDCM_IC_ACULgtAValSts "..." UBYTE I_1 1 2 0 255 ECU_ADDRESS 0x7000649E /end MEASUREMENT
/begin MEASUREMENT MAIN_MSGu8PwModOffCnt "MAIN_MSGu8PwModOffCnt" UBYTE I_1 1 2 0 255 ECU_ADDRESS 0x70006215 /end MEASUREMENT
/begin MEASUREMENT MAIN_MSGu8PwModOnCnt "MAIN_MSGu8PwModOnCnt" UBYTE I_1 1 2 0 255 ECU_ADDRESS 0x70006216 /end MEASUREMENT
/begin MEASUREMENT MAIN_MSGu8TCU1_ClutchSta "..." UBYTE I_1 1 2 0 255 ECU_ADDRESS 0x7000648F /end MEASUREMENT
/begin MEASUREMENT MAIN_MSGu8TCU1_CrankAuthEn "..." UBYTE I_1 1 2 0 255 ECU_ADDRESS 0x7000648E /end MEASUREMENT
/begin MEASUREMENT MAIN_MSGu8TCU1_RC "..." UBYTE I_1 1 2 0 255 ECU_ADDRESS 0x7000648D /end MEASUREMENT
/begin MEASUREMENT MAIN_MSGu8TCU2_FaultReactReq "..." UBYTE I_1 1 2 0 255 ECU_ADDRESS 0x7000648C /end MEASUREMENT
/begin MEASUREMENT MAIN_MSGu8TCU2_RC "..." UBYTE I_1 1 2 0 255 ECU_ADDRESS 0x7000648B /end MEASUREMENT
/begin MEASUREMENT MAIN_MSGu8TCU3_AirFlowReqRaw "..." UBYTE I_1 1 2 0 255 ECU_ADDRESS 0x7000648A /end MEASUREMENT
/begin MEASUREMENT MAIN_MSGu8TCU3_FaultLmpReq "..." UBYTE I_1 1 2 0 255 ECU_ADDRESS 0x70006489 /end MEASUREMENT
/begin MEASUREMENT MAIN_MSGu8TCU3_OBDLmpReq "..." UBYTE I_1 1 2 0 255 ECU_ADDRESS 0x70006488 /end MEASUREMENT
/begin MEASUREMENT MAIN_MSGu8TCU3_RC "..." UBYTE I_1 1 2 0 255 ECU_ADDRESS 0x70006487 /end MEASUREMENT
/begin MEASUREMENT MAIN_MSGu8TCU3_TransFluidTmpRaw "..." UBYTE I_1 1 2 0 255 ECU_ADDRESS 0x70006486 /end MEASUREMENT
/begin MEASUREMENT MAIN_MSGu8TCU_ClutchProgress "..." UBYTE I_1 1 2 0 255 ECU_ADDRESS 0x70006490 /end MEASUREMENT
/begin MEASUREMENT MAIN_MSGu8Tbox_OTAEnergyCtl "..." UBYTE I_1 1 2 0 255 ECU_ADDRESS 0x70006492 /end MEASUREMENT
/begin MEASUREMENT MAIN_MSGu8Tbox_vehicleMode "..." UBYTE I_1 1 2 0 255 ECU_ADDRESS 0x70006491 /end MEASUREMENT
/begin MEASUREMENT MAIN_MSGu8VCU_AccPedPosRaw "..." UBYTE I_1 1 2 0 255 ECU_ADDRESS 0x70006485 /end MEASUREMENT
/begin MEASUREMENT MAIN_MSGu8VCU_EMWorkMod "..." UBYTE I_1 1 2 0 255 ECU_ADDRESS 0x70006484 /end MEASUREMENT
/begin MEASUREMENT MAIN_MSGu8VCU_HandBrakSts "..." UBYTE I_1 1 2 0 255 ECU_ADDRESS 0x70006482 /end MEASUREMENT
/begin MEASUREMENT MAIN_MSGu8VCU_McuEnableReq "..." UBYTE I_1 1 2 0 255 ECU_ADDRESS 0x70006481 /end MEASUREMENT
/begin MEASUREMENT MAIN_MSGu8VCU_ePTReady "..." UBYTE I_1 1 2 0 255 ECU_ADDRESS 0x70006483 /end MEASUREMENT
/begin MEASUREMENT MAIN_MSGu8bcm_12VBatterySOC "..." UBYTE I_1 1 2 0 255 ECU_ADDRESS 0x7000653F /end MEASUREMENT
/begin MEASUREMENT MAIN_MSGu8bcm_pepsPwrMode "..." UBYTE I_1 1 2 0 255 ECU_ADDRESS 0x7000653E /end MEASUREMENT
/begin MEASUREMENT MAIN_MSGu8bcm_pepsRmtMode "..." UBYTE I_1 1 2 0 255 ECU_ADDRESS 0x7000653D /end MEASUREMENT
/begin MEASUREMENT MAIN_TCUf32CAP_AvrgCurrentPhys "..." FLOAT32_IEEE I_87 1 2 -3.402823466E+038 3.402823466E+038 ECU_ADDRESS 0x700065A4 /end MEASUREMENT
/begin MEASUREMENT MAIN_TCUf32CAP_DutyCyclePhys "..." FLOAT32_IEEE I_87 1 2 -3.402823466E+038 3.402823466E+038 ECU_ADDRESS 0x700065A0 /end MEASUREMENT
/begin MEASUREMENT MAIN_TCUf32CAP_MotSpeedPhys "..." FLOAT32_IEEE I_87 1 2 -3.402823466E+038 3.402823466E+038 ECU_ADDRESS 0x7000659C /end MEASUREMENT
/begin MEASUREMENT MAIN_TCUf32CAP_TargetDutyCyclePhys "..." FLOAT32_IEEE I_88 1 2 -3.402823466E+038 3.402823466E+038 ECU_ADDRESS 0x70006598 /end MEASUREMENT
/begin MEASUREMENT MAIN_TCUu8CAP_TargetMotSts "..." UBYTE I_1 1 2 0 255 ECU_ADDRESS 0x70006480 /end MEASUREMENT
/begin MEASUREMENT MAIN_TotalTime "MAIN_TotalTime" ULONG I_1 1 2 0 4294967295 ECU_ADDRESS 0x70006318 /end MEASUREMENT
/begin MEASUREMENT MAIN_VSITxsPwmUl "MAIN_VSITxsPwmUl" UWORD F_0v0061035156_p0_101 1 2 0 399.9938965 ECU_ADDRESS 0x700063BC /end MEASUREMENT
/begin MEASUREMENT MAIN_VSITxsPwmUlOn "MAIN_VSITxsPwmUlOn" UBYTE Bool_ON_OFF 1 2 0 1 BIT_MASK 0x01 ECU_ADDRESS 0x700067C3 /end MEASUREMENT
/begin MEASUREMENT MAIN_VSITxsPwmUr "MAIN_VSITxsPwmUr" UWORD F_0v0061035156_p0_101 1 2 0 399.9938965 ECU_ADDRESS 0x700063BA /end MEASUREMENT
/begin MEASUREMENT MAIN_VSITxsPwmUrOn "MAIN_VSITxsPwmUrOn" UBYTE Bool_ON_OFF 1 2 0 1 BIT_MASK 0x01 ECU_ADDRESS 0x700067C2 /end MEASUREMENT
/begin MEASUREMENT MAIN_VSITxsPwmVl "MAIN_VSITxsPwmVl" UWORD F_0v0061035156_p0_101 1 2 0 399.9938965 ECU_ADDRESS 0x700063B8 /end MEASUREMENT
/begin MEASUREMENT MAIN_VSITxsPwmVlOn "MAIN_VSITxsPwmVlOn" UBYTE Bool_ON_OFF 1 2 0 1 BIT_MASK 0x01 ECU_ADDRESS 0x700067C1 /end MEASUREMENT
/begin MEASUREMENT MAIN_VSITxsPwmVr "MAIN_VSITxsPwmVr" UWORD F_0v0061035156_p0_101 1 2 0 399.9938965 ECU_ADDRESS 0x700063B6 /end MEASUREMENT
/begin MEASUREMENT MAIN_VSITxsPwmVrOn "MAIN_VSITxsPwmVrOn" UBYTE Bool_ON_OFF 1 2 0 1 BIT_MASK 0x01 ECU_ADDRESS 0x700067C0 /end MEASUREMENT
/begin MEASUREMENT MAIN_VSITxsPwmWl "MAIN_VSITxsPwmWl" UWORD F_0v0061035156_p0_101 1 2 0 399.9938965 ECU_ADDRESS 0x700063B4 /end MEASUREMENT
/begin MEASUREMENT MAIN_VSITxsPwmWlOn "MAIN_VSITxsPwmWlOn" UBYTE Bool_ON_OFF 1 2 0 1 BIT_MASK 0x01 ECU_ADDRESS 0x700067BF /end MEASUREMENT
/begin MEASUREMENT MAIN_VSITxsPwmWr "MAIN_VSITxsPwmWr" UWORD F_0v0061035156_p0_101 1 2 0 399.9938965 ECU_ADDRESS 0x700063B2 /end MEASUREMENT
/begin MEASUREMENT MAIN_VSITxsPwmWrOn "MAIN_VSITxsPwmWrOn" UBYTE Bool_ON_OFF 1 2 0 1 BIT_MASK 0x01 ECU_ADDRESS 0x700067BE /end MEASUREMENT
/begin MEASUREMENT MAIN_as32OCTrimNvm "-" SLONG Id_0x00 1 2 -2147483648 2147483647 MATRIX_DIM 5 1 1 ECU_ADDRESS 0x7000624C /end MEASUREMENT
/begin MEASUREMENT MAIN_as32OCTrimNvm[0] "MAIN_as32OCTrimNvm[0]" SLONG Id_0x00 1 2 -2147483648 2147483647 ECU_ADDRESS 0x7000624C /end MEASUREMENT
/begin MEASUREMENT MAIN_as32OCTrimNvm[1] "MAIN_as32OCTrimNvm[1]" SLONG Id_0x00 1 2 -2147483648 2147483647 ECU_ADDRESS 0x70006250 /end MEASUREMENT
/begin MEASUREMENT MAIN_as32OCTrimNvm[2] "MAIN_as32OCTrimNvm[2]" SLONG Id_0x00 1 2 -2147483648 2147483647 ECU_ADDRESS 0x70006254 /end MEASUREMENT
/begin MEASUREMENT MAIN_as32OCTrimNvm[3] "MAIN_as32OCTrimNvm[3]" SLONG Id_0x00 1 2 -2147483648 2147483647 ECU_ADDRESS 0x70006258 /end MEASUREMENT
/begin MEASUREMENT MAIN_as32OCTrimNvm[4] "MAIN_as32OCTrimNvm[4]" SLONG Id_0x00 1 2 -2147483648 2147483647 ECU_ADDRESS 0x7000625C /end MEASUREMENT
/begin MEASUREMENT MAIN_au8ErrCode "-" UBYTE F_1_p0_4 1 2 0 255 MATRIX_DIM 20 1 1 ECU_ADDRESS 0x70006540 /end MEASUREMENT
/begin MEASUREMENT MAIN_au8ErrCode[0] "MAIN_au8ErrCode[0]" UBYTE F_1_p0_4 1 2 0 255 ECU_ADDRESS 0x70006540 /end MEASUREMENT
/begin MEASUREMENT MAIN_au8ErrCode[10] "MAIN_au8ErrCode[10]" UBYTE F_1_p0_4 1 2 0 255 ECU_ADDRESS 0x7000654A /end MEASUREMENT
/begin MEASUREMENT MAIN_au8ErrCode[11] "MAIN_au8ErrCode[11]" UBYTE F_1_p0_4 1 2 0 255 ECU_ADDRESS 0x7000654B /end MEASUREMENT
/begin MEASUREMENT MAIN_au8ErrCode[12] "MAIN_au8ErrCode[12]" UBYTE F_1_p0_4 1 2 0 255 ECU_ADDRESS 0x7000654C /end MEASUREMENT
/begin MEASUREMENT MAIN_au8ErrCode[13] "MAIN_au8ErrCode[13]" UBYTE F_1_p0_4 1 2 0 255 ECU_ADDRESS 0x7000654D /end MEASUREMENT
/begin MEASUREMENT MAIN_au8ErrCode[14] "MAIN_au8ErrCode[14]" UBYTE F_1_p0_4 1 2 0 255 ECU_ADDRESS 0x7000654E /end MEASUREMENT
/begin MEASUREMENT MAIN_au8ErrCode[15] "MAIN_au8ErrCode[15]" UBYTE F_1_p0_4 1 2 0 255 ECU_ADDRESS 0x7000654F /end MEASUREMENT
/begin MEASUREMENT MAIN_au8ErrCode[16] "MAIN_au8ErrCode[16]" UBYTE F_1_p0_4 1 2 0 255 ECU_ADDRESS 0x70006550 /end MEASUREMENT
/begin MEASUREMENT MAIN_au8ErrCode[17] "MAIN_au8ErrCode[17]" UBYTE F_1_p0_4 1 2 0 255 ECU_ADDRESS 0x70006551 /end MEASUREMENT
/begin MEASUREMENT MAIN_au8ErrCode[18] "MAIN_au8ErrCode[18]" UBYTE F_1_p0_4 1 2 0 255 ECU_ADDRESS 0x70006552 /end MEASUREMENT
/begin MEASUREMENT MAIN_au8ErrCode[19] "MAIN_au8ErrCode[19]" UBYTE F_1_p0_4 1 2 0 255 ECU_ADDRESS 0x70006553 /end MEASUREMENT
/begin MEASUREMENT MAIN_au8ErrCode[1] "MAIN_au8ErrCode[1]" UBYTE F_1_p0_4 1 2 0 255 ECU_ADDRESS 0x70006541 /end MEASUREMENT
/begin MEASUREMENT MAIN_au8ErrCode[2] "MAIN_au8ErrCode[2]" UBYTE F_1_p0_4 1 2 0 255 ECU_ADDRESS 0x70006542 /end MEASUREMENT
/begin MEASUREMENT MAIN_au8ErrCode[3] "MAIN_au8ErrCode[3]" UBYTE F_1_p0_4 1 2 0 255 ECU_ADDRESS 0x70006543 /end MEASUREMENT
/begin MEASUREMENT MAIN_au8ErrCode[4] "MAIN_au8ErrCode[4]" UBYTE F_1_p0_4 1 2 0 255 ECU_ADDRESS 0x70006544 /end MEASUREMENT
/begin MEASUREMENT MAIN_au8ErrCode[5] "MAIN_au8ErrCode[5]" UBYTE F_1_p0_4 1 2 0 255 ECU_ADDRESS 0x70006545 /end MEASUREMENT
/begin MEASUREMENT MAIN_au8ErrCode[6] "MAIN_au8ErrCode[6]" UBYTE F_1_p0_4 1 2 0 255 ECU_ADDRESS 0x70006546 /end MEASUREMENT
/begin MEASUREMENT MAIN_au8ErrCode[7] "MAIN_au8ErrCode[7]" UBYTE F_1_p0_4 1 2 0 255 ECU_ADDRESS 0x70006547 /end MEASUREMENT
/begin MEASUREMENT MAIN_au8ErrCode[8] "MAIN_au8ErrCode[8]" UBYTE F_1_p0_4 1 2 0 255 ECU_ADDRESS 0x70006548 /end MEASUREMENT
/begin MEASUREMENT MAIN_au8ErrCode[9] "MAIN_au8ErrCode[9]" UBYTE F_1_p0_4 1 2 0 255 ECU_ADDRESS 0x70006549 /end MEASUREMENT
/begin MEASUREMENT MAIN_bAkdAfterAscReq "..." UBYTE Bool_ON_OFF 1 2 0 1 BIT_MASK 0x01 ECU_ADDRESS 0x70006834 /end MEASUREMENT
/begin MEASUREMENT MAIN_bAntiSlopGearEna "..." UBYTE Bool_ON_OFF 1 2 0 1 BIT_MASK 0x01 ECU_ADDRESS 0x70006833 /end MEASUREMENT
/begin MEASUREMENT MAIN_bAscFlag "Flag ESM started" UBYTE Bool_ON_OFF 1 2 0 1 BIT_MASK 0x01 ECU_ADDRESS 0x70006832 /end MEASUREMENT
/begin MEASUREMENT MAIN_bBswReadySts "BSW Power on check finish flag." UBYTE Bool_ON_OFF 1 2 0 1 BIT_MASK 0x01 ECU_ADDRESS 0x70006831 /end MEASUREMENT
/begin MEASUREMENT MAIN_bESMStarted "Flag ESM started" UBYTE Bool_ON_OFF 1 2 0 1 BIT_MASK 0x01 ECU_ADDRESS 0x70006830 /end MEASUREMENT
/begin MEASUREMENT MAIN_bFTInitFinshFlg "FT Initilize finished flag" UBYTE Bool_ON_OFF 1 2 0 1 BIT_MASK 0x01 ECU_ADDRESS 0x7000682F /end MEASUREMENT
/begin MEASUREMENT MAIN_bMcuMilStatus "..." UBYTE Bool_ON_OFF 1 2 0 1 BIT_MASK 0x01 ECU_ADDRESS 0x7000682E /end MEASUREMENT
/begin MEASUREMENT MAIN_bOcDataStoreEna "..." UBYTE Bool_ON_OFF 1 2 0 1 BIT_MASK 0x01 ECU_ADDRESS 0x700061FC /end MEASUREMENT
/begin MEASUREMENT MAIN_bOcFailureFlg "..." UBYTE Bool_ON_OFF 1 2 0 1 BIT_MASK 0x01 ECU_ADDRESS 0x7000682D /end MEASUREMENT
/begin MEASUREMENT MAIN_bOcFinshFlg "..." UBYTE Bool_ON_OFF 1 2 0 1 BIT_MASK 0x01 ECU_ADDRESS 0x7000682C /end MEASUREMENT
/begin MEASUREMENT MAIN_bOcModeEna "OC mode enable flag" UBYTE Bool_ON_OFF 1 2 0 1 BIT_MASK 0x01 ECU_ADDRESS 0x7000682B /end MEASUREMENT
/begin MEASUREMENT MAIN_bOcNotRatFlg "..." UBYTE Bool_ON_OFF 1 2 0 1 BIT_MASK 0x01 ECU_ADDRESS 0x7000682A /end MEASUREMENT
/begin MEASUREMENT MAIN_bOcRdResultFlag "..." UBYTE Bool_ON_OFF 1 2 0 1 BIT_MASK 0x01 ECU_ADDRESS 0x70006829 /end MEASUREMENT
/begin MEASUREMENT MAIN_bOcStartFlag "..." UBYTE Bool_ON_OFF 1 2 0 1 BIT_MASK 0x01 ECU_ADDRESS 0x70006828 /end MEASUREMENT
/begin MEASUREMENT MAIN_bPosAccessLock "Must be Volatile variable." UBYTE Bool_ON_OFF 1 2 0 1 BIT_MASK 0x01 ECU_ADDRESS 0x70006827 /end MEASUREMENT
/begin MEASUREMENT MAIN_bProgConditionOk "..." UBYTE Bool_ON_OFF 1 2 0 1 BIT_MASK 0x01 ECU_ADDRESS 0x700067B8 /end MEASUREMENT
/begin MEASUREMENT MAIN_bResExcFltDetEna "..." UBYTE Bool_ON_OFF 1 2 0 1 BIT_MASK 0x01 ECU_ADDRESS 0x70006826 /end MEASUREMENT
/begin MEASUREMENT MAIN_bSlopSlideTimoutFlg "..." UBYTE Bool_ON_OFF 1 2 0 1 BIT_MASK 0x01 ECU_ADDRESS 0x70006825 /end MEASUREMENT
/begin MEASUREMENT MAIN_bSoftOvBhvFlg "..." UBYTE Bool_ON_OFF 1 2 0 1 BIT_MASK 0x01 ECU_ADDRESS 0x70006824 /end MEASUREMENT
/begin MEASUREMENT MAIN_bSoftOvCurrPhsUFlg "..." UBYTE Bool_ON_OFF 1 2 0 1 BIT_MASK 0x01 ECU_ADDRESS 0x70006823 /end MEASUREMENT
/begin MEASUREMENT MAIN_bSoftOvCurrPhsVFlg "..." UBYTE Bool_ON_OFF 1 2 0 1 BIT_MASK 0x01 ECU_ADDRESS 0x70006822 /end MEASUREMENT
/begin MEASUREMENT MAIN_bSoftOvCurrPhsWFlg "..." UBYTE Bool_ON_OFF 1 2 0 1 BIT_MASK 0x01 ECU_ADDRESS 0x70006821 /end MEASUREMENT
/begin MEASUREMENT MAIN_bSpdReadyEst "..." UBYTE Bool_ON_OFF 1 2 0 1 BIT_MASK 0x01 ECU_ADDRESS 0x70006820 /end MEASUREMENT
/begin MEASUREMENT MAIN_bSpeedReadyFlg "..." UBYTE Bool_ON_OFF 1 2 0 1 BIT_MASK 0x01 ECU_ADDRESS 0x7000681F /end MEASUREMENT
/begin MEASUREMENT MAIN_bTcuStuckFlag "..." UBYTE Bool_ON_OFF 1 2 0 1 BIT_MASK 0x01 ECU_ADDRESS 0x700067BD /end MEASUREMENT
/begin MEASUREMENT MAIN_bTeachInCompleteFlg "..." UBYTE Bool_ON_OFF 1 2 0 1 BIT_MASK 0x01 ECU_ADDRESS 0x7000681E /end MEASUREMENT
/begin MEASUREMENT MAIN_bTrigOcByUser "..." UBYTE Bool_ON_OFF 1 2 0 1 BIT_MASK 0x01 ECU_ADDRESS 0x7000681D /end MEASUREMENT
/begin MEASUREMENT MAIN_bVSIStarted "Flag VSI started" UBYTE Bool_ON_OFF 1 2 0 1 BIT_MASK 0x01 ECU_ADDRESS 0x7000681C /end MEASUREMENT
/begin MEASUREMENT MAIN_f32AntiSsEnaBrakPos "..." FLOAT32_IEEE I_93 1 2 -3.402823466E+038 3.402823466E+038 ECU_ADDRESS 0x700067B4 /end MEASUREMENT
/begin MEASUREMENT MAIN_f32BldcCurrentPos "..." FLOAT32_IEEE F_100_p0_5 1 2 -3.402823466E+038 3.402823466E+038 ECU_ADDRESS 0x700067B0 /end MEASUREMENT
/begin MEASUREMENT MAIN_f32BldcCurrentPosRolCnt "..." FLOAT32_IEEE F_100_p0_5 1 2 -3.402823466E+038 3.402823466E+038 ECU_ADDRESS 0x700067AC /end MEASUREMENT
/begin MEASUREMENT MAIN_f32BldcDuty "..." FLOAT32_IEEE F_100_p0_5 1 2 -3.402823466E+038 3.402823466E+038 ECU_ADDRESS 0x700067A8 /end MEASUREMENT
/begin MEASUREMENT MAIN_f32BldcHallCapPos "..." FLOAT32_IEEE F_100_p0_5 1 2 -3.402823466E+038 3.402823466E+038 ECU_ADDRESS 0x700067A4 /end MEASUREMENT
/begin MEASUREMENT MAIN_f32BldcHallCapPosErr "..." FLOAT32_IEEE F_100_p0_5 1 2 -3.402823466E+038 3.402823466E+038 ECU_ADDRESS 0x700067A0 /end MEASUREMENT
/begin MEASUREMENT MAIN_f32BldcHallCapPosPre "..." FLOAT32_IEEE F_100_p0_5 1 2 -3.402823466E+038 3.402823466E+038 ECU_ADDRESS 0x7000679C /end MEASUREMENT
/begin MEASUREMENT MAIN_f32BldcPositionDuty "..." FLOAT32_IEEE F_100_p0_5 1 2 -3.402823466E+038 3.402823466E+038 ECU_ADDRESS 0x70006798 /end MEASUREMENT
/begin MEASUREMENT MAIN_f32CpuLoadCore0 "..." FLOAT32_IEEE F_1_p0_21 1 2 -3.402823466E+038 3.402823466E+038 ECU_ADDRESS 0x70006274 /end MEASUREMENT
/begin MEASUREMENT MAIN_f32CpuLoadCore1 "..." FLOAT32_IEEE F_1_p0_21 1 2 -3.402823466E+038 3.402823466E+038 ECU_ADDRESS 0x70006270 /end MEASUREMENT
/begin MEASUREMENT MAIN_f32CpuLoadCore2 "..." FLOAT32_IEEE F_1_p0_21 1 2 -3.402823466E+038 3.402823466E+038 ECU_ADDRESS 0x7000626C /end MEASUREMENT
/begin MEASUREMENT MAIN_f32CpuLoadMaxCore0 "..." FLOAT32_IEEE F_1_p0_21 1 2 -3.402823466E+038 3.402823466E+038 ECU_ADDRESS 0x70006268 /end MEASUREMENT
/begin MEASUREMENT MAIN_f32CpuLoadMaxCore1 "..." FLOAT32_IEEE F_1_p0_21 1 2 -3.402823466E+038 3.402823466E+038 ECU_ADDRESS 0x70006264 /end MEASUREMENT
/begin MEASUREMENT MAIN_f32CpuLoadMaxCore2 "..." FLOAT32_IEEE F_1_p0_21 1 2 -3.402823466E+038 3.402823466E+038 ECU_ADDRESS 0x70006260 /end MEASUREMENT
/begin MEASUREMENT MAIN_f32ElecSpeedRds "..." FLOAT32_IEEE F_1_p0_21 1 2 -3.402823466E+038 3.402823466E+038 ECU_ADDRESS 0x70006794 /end MEASUREMENT
/begin MEASUREMENT MAIN_f32EmailElecSpeedRds "..." FLOAT32_IEEE F_1_p0_21 1 2 -3.402823466E+038 3.402823466E+038 ECU_ADDRESS 0x70006790 /end MEASUREMENT
/begin MEASUREMENT MAIN_f32EmailErrThetaRdSurPi "..." FLOAT32_IEEE F_1_p0_21 1 2 -3.402823466E+038 3.402823466E+038 ECU_ADDRESS 0x7000678C /end MEASUREMENT
/begin MEASUREMENT MAIN_f32EmailMecaSpeedRds "..." FLOAT32_IEEE F_1_p0_21 1 2 -3.402823466E+038 3.402823466E+038 ECU_ADDRESS 0x70006788 /end MEASUREMENT
/begin MEASUREMENT MAIN_f32EmailMecaSpeedRpm "..." FLOAT32_IEEE F_1_p0_21 1 2 -3.402823466E+038 3.402823466E+038 ECU_ADDRESS 0x70006784 /end MEASUREMENT
/begin MEASUREMENT MAIN_f32EmailNextThetaElecRdSurPi "..." FLOAT32_IEEE F_1_p0_21 1 2 -3.402823466E+038 3.402823466E+038 ECU_ADDRESS 0x70006780 /end MEASUREMENT
/begin MEASUREMENT MAIN_f32EmailThetaElecRdSurPi "..." FLOAT32_IEEE F_1_p0_21 1 2 -3.402823466E+038 3.402823466E+038 ECU_ADDRESS 0x7000677C /end MEASUREMENT
/begin MEASUREMENT MAIN_f32ErrThetaRdSurPi "..." FLOAT32_IEEE F_1_p0_21 1 2 -3.402823466E+038 3.402823466E+038 ECU_ADDRESS 0x70006778 /end MEASUREMENT
/begin MEASUREMENT MAIN_f32EstTempRatioScale "..." FLOAT32_IEEE F_1_p0_4 1 2 -3.402823466E+038 3.402823466E+038 ECU_ADDRESS 0x70006774 /end MEASUREMENT
/begin MEASUREMENT MAIN_f32IdDeltaAvg "..." FLOAT32_IEEE F_1_p0_4 1 2 -3.402823466E+038 3.402823466E+038 ECU_ADDRESS 0x70006770 /end MEASUREMENT
/begin MEASUREMENT MAIN_f32IdDeltaSum "..." FLOAT32_IEEE F_1_p0_4 1 2 -3.402823466E+038 3.402823466E+038 ECU_ADDRESS 0x7000676C /end MEASUREMENT
/begin MEASUREMENT MAIN_f32IdQuality "..." FLOAT32_IEEE F_1_p0_99 1 2 -3.402823466E+038 3.402823466E+038 ECU_ADDRESS 0x70006768 /end MEASUREMENT
/begin MEASUREMENT MAIN_f32IqDeltaAvg "..." FLOAT32_IEEE F_1_p0_4 1 2 -3.402823466E+038 3.402823466E+038 ECU_ADDRESS 0x70006764 /end MEASUREMENT
/begin MEASUREMENT MAIN_f32IqDeltaSum "..." FLOAT32_IEEE F_1_p0_4 1 2 -3.402823466E+038 3.402823466E+038 ECU_ADDRESS 0x70006760 /end MEASUREMENT
/begin MEASUREMENT MAIN_f32IqQuality "..." FLOAT32_IEEE F_1_p0_99 1 2 -3.402823466E+038 3.402823466E+038 ECU_ADDRESS 0x7000675C /end MEASUREMENT
/begin MEASUREMENT MAIN_f32IuFrequency "..." FLOAT32_IEEE F_1_p0_35 1 2 -3.402823466E+038 3.402823466E+038 ECU_ADDRESS 0x70006758 /end MEASUREMENT
/begin MEASUREMENT MAIN_f32IuPeriod "..." FLOAT32_IEEE F_1_p0_53 1 2 -3.402823466E+038 3.402823466E+038 ECU_ADDRESS 0x70006754 /end MEASUREMENT
/begin MEASUREMENT MAIN_f32MecaSpeedRds "..." FLOAT32_IEEE F_1_p0_21 1 2 -3.402823466E+038 3.402823466E+038 ECU_ADDRESS 0x70006750 /end MEASUREMENT
/begin MEASUREMENT MAIN_f32MecaSpeedRpm "..." FLOAT32_IEEE F_1_p0_21 1 2 -3.402823466E+038 3.402823466E+038 ECU_ADDRESS 0x7000674C /end MEASUREMENT
/begin MEASUREMENT MAIN_f32MotSpdEst "..." FLOAT32_IEEE F_1_p0_53 1 2 -3.402823466E+038 3.402823466E+038 ECU_ADDRESS 0x70006748 /end MEASUREMENT
/begin MEASUREMENT MAIN_f32PWMDutyUPhys "..." FLOAT32_IEEE F_100_p0_5 1 2 -3.402823466E+038 3.402823466E+038 ECU_ADDRESS 0x70006744 /end MEASUREMENT
/begin MEASUREMENT MAIN_f32PWMDutyVPhys "..." FLOAT32_IEEE F_100_p0_5 1 2 -3.402823466E+038 3.402823466E+038 ECU_ADDRESS 0x70006740 /end MEASUREMENT
/begin MEASUREMENT MAIN_f32PWMDutyWPhys "..." FLOAT32_IEEE F_100_p0_5 1 2 -3.402823466E+038 3.402823466E+038 ECU_ADDRESS 0x7000673C /end MEASUREMENT
/begin MEASUREMENT MAIN_f32ShiftDrumInitPos "..." FLOAT32_IEEE F_100_p0_5 1 2 -3.402823466E+038 3.402823466E+038 ECU_ADDRESS 0x70006738 /end MEASUREMENT
/begin MEASUREMENT MAIN_f32ShiftDrumTermPos "..." FLOAT32_IEEE F_100_p0_5 1 2 -3.402823466E+038 3.402823466E+038 ECU_ADDRESS 0x70006734 /end MEASUREMENT
/begin MEASUREMENT MAIN_f32TcReadPosDuty "..." FLOAT32_IEEE F_100_p0_5 1 2 -3.402823466E+038 3.402823466E+038 ECU_ADDRESS 0x70006730 /end MEASUREMENT
/begin MEASUREMENT MAIN_f32ThetaElecRdSurPi "..." FLOAT32_IEEE F_1_p0_21 1 2 -3.402823466E+038 3.402823466E+038 ECU_ADDRESS 0x7000672C /end MEASUREMENT
/begin MEASUREMENT MAIN_f32VsiPwmPeriod "..." FLOAT32_IEEE F_1000000_p0_102 1 2 -3.402823466E+038 3.402823466E+038 ECU_ADDRESS 0x70006728 /end MEASUREMENT
/begin MEASUREMENT MAIN_s16BldcHallDirFdb "MAIN_s16BldcHallDirFdb" SBYTE I_1 1 2 -128 127 ECU_ADDRESS 0x70006554 /end MEASUREMENT
/begin MEASUREMENT MAIN_s32DeltTimDiff "..." SLONG F_0v01_p0_103 1 2 -21474836.48 21474836.47 ECU_ADDRESS 0x70006248 /end MEASUREMENT
/begin MEASUREMENT MAIN_s32Email2PosTreqDiff "..." SLONG I_1 1 2 -2147483648 2147483647 ECU_ADDRESS 0x70006244 /end MEASUREMENT
/begin MEASUREMENT MAIN_s32PosA2BDeltTimMax "..." SLONG F_0v01_p0_103 1 2 -21474836.48 21474836.47 ECU_ADDRESS 0x7000623C /end MEASUREMENT
/begin MEASUREMENT MAIN_s32PosA2BDeltTimMin "..." SLONG F_0v01_p0_103 1 2 -21474836.48 21474836.47 ECU_ADDRESS 0x70006238 /end MEASUREMENT
/begin MEASUREMENT MAIN_s32PosA2BDeltTime "..." SLONG F_0v01_p0_103 1 2 -21474836.48 21474836.47 ECU_ADDRESS 0x70006240 /end MEASUREMENT
/begin MEASUREMENT MAIN_u16AntiSsBrakTimCnt "..." UWORD I_1 1 2 0 65535 ECU_ADDRESS 0x70006422 /end MEASUREMENT
/begin MEASUREMENT MAIN_u16AntiSsEnaBrakCnt "..." UWORD I_1 1 2 0 65535 ECU_ADDRESS 0x70006420 /end MEASUREMENT
/begin MEASUREMENT MAIN_u16AntiSsValidCnt "..." UWORD I_1 1 2 0 65535 ECU_ADDRESS 0x7000641E /end MEASUREMENT
/begin MEASUREMENT MAIN_u16BldcIbatAdcV01 "MAIN_u16BldcIbatAdcV01" UWORD I_1 1 2 0 65535 ECU_ADDRESS 0x7000641C /end MEASUREMENT
/begin MEASUREMENT MAIN_u16BldcIbatAdcVR0 "MAIN_u16BldcIbatAdcVR0" UWORD I_1 1 2 0 65535 ECU_ADDRESS 0x7000641A /end MEASUREMENT
/begin MEASUREMENT MAIN_u16BldcOilPressAdc "MAIN_u16BldcOilPressAdc" UWORD I_1 1 2 0 65535 ECU_ADDRESS 0x70006418 /end MEASUREMENT
/begin MEASUREMENT MAIN_u16BldcOilTempAdc "MAIN_u16BldcOilTempAdc" UWORD I_1 1 2 0 65535 ECU_ADDRESS 0x70006416 /end MEASUREMENT
/begin MEASUREMENT MAIN_u16BrakRelsDelayCnt "..." UWORD I_1 1 2 0 65535 ECU_ADDRESS 0x70006414 /end MEASUREMENT
/begin MEASUREMENT MAIN_u16Cnt100 "MAIN_u16Cnt100" UWORD I_1 1 2 0 65535 ECU_ADDRESS 0x7000640A /end MEASUREMENT
/begin MEASUREMENT MAIN_u16Cnt1000 "MAIN_u16Cnt1000" UWORD I_1 1 2 0 65535 ECU_ADDRESS 0x70006408 /end MEASUREMENT
/begin MEASUREMENT MAIN_u16Cnt20 "MAIN_u16Cnt20" UWORD I_1 1 2 0 65535 ECU_ADDRESS 0x70006406 /end MEASUREMENT
/begin MEASUREMENT MAIN_u16Cnt2000 "MAIN_u16Cnt2000" UWORD I_1 1 2 0 65535 ECU_ADDRESS 0x70006404 /end MEASUREMENT
/begin MEASUREMENT MAIN_u16Cnt30 "MAIN_u16Cnt30" UWORD I_1 1 2 0 65535 ECU_ADDRESS 0x70006402 /end MEASUREMENT
/begin MEASUREMENT MAIN_u16Cnt4 "MAIN_u16Cnt4" UWORD I_1 1 2 0 65535 ECU_ADDRESS 0x70006400 /end MEASUREMENT
/begin MEASUREMENT MAIN_u16Cnt50 "MAIN_u16Cnt50" UWORD I_1 1 2 0 65535 ECU_ADDRESS 0x700063FE /end MEASUREMENT
/begin MEASUREMENT MAIN_u16Cnt500 "MAIN_u16Cnt500" UWORD I_1 1 2 0 65535 ECU_ADDRESS 0x700063FC /end MEASUREMENT
/begin MEASUREMENT MAIN_u16FaultDelayCnt "MAIN_u16FaultDelayCnt" UWORD I_1 1 2 0 65535 ECU_ADDRESS 0x700063F0 /end MEASUREMENT
/begin MEASUREMENT MAIN_u16FpgaFltClrCnt "MAIN_u16FpgaFltClrCnt" UWORD I_1 1 2 0 65535 ECU_ADDRESS 0x700063EE /end MEASUREMENT
/begin MEASUREMENT MAIN_u16HandBrkRelsDelay "..." UWORD I_1 1 2 0 65535 ECU_ADDRESS 0x700063EC /end MEASUREMENT
/begin MEASUREMENT MAIN_u16IdqDeltaSumCnt "MAIN_u16IdqDeltaSumCnt" UWORD I_1 1 2 0 65535 ECU_ADDRESS 0x700063EA /end MEASUREMENT
/begin MEASUREMENT MAIN_u16IuCycleCnt "..." UWORD I_1 1 2 0 65535 ECU_ADDRESS 0x700063E8 /end MEASUREMENT
/begin MEASUREMENT MAIN_u16IuMiddleCnt "..." UWORD I_1 1 2 0 65535 ECU_ADDRESS 0x700063E6 /end MEASUREMENT
/begin MEASUREMENT MAIN_u16IuMiddleSum "..." UWORD I_1 1 2 0 65535 ECU_ADDRESS 0x700063E4 /end MEASUREMENT
/begin MEASUREMENT MAIN_u16IuNegtiveCnt "..." UWORD I_1 1 2 0 65535 ECU_ADDRESS 0x700063E2 /end MEASUREMENT
/begin MEASUREMENT MAIN_u16IuNegtiveSum "..." UWORD I_1 1 2 0 65535 ECU_ADDRESS 0x700063E0 /end MEASUREMENT
/begin MEASUREMENT MAIN_u16IuPositiveCnt "..." UWORD I_1 1 2 0 65535 ECU_ADDRESS 0x700063DE /end MEASUREMENT
/begin MEASUREMENT MAIN_u16IuPositiveSum "..." UWORD I_1 1 2 0 65535 ECU_ADDRESS 0x700063DC /end MEASUREMENT
/begin MEASUREMENT MAIN_u16MotorStallCnt "..." UWORD I_1 1 2 0 65535 ECU_ADDRESS 0x700063DA /end MEASUREMENT
/begin MEASUREMENT MAIN_u16OverVolHighDelay "MAIN_u16OverVolHighDelay" UWORD I_1 1 2 0 65535 ECU_ADDRESS 0x700063D8 /end MEASUREMENT
/begin MEASUREMENT MAIN_u16OverVolLowDelay "MAIN_u16OverVolLowDelay" UWORD I_1 1 2 0 65535 ECU_ADDRESS 0x700063D6 /end MEASUREMENT
/begin MEASUREMENT MAIN_u16OverVolMidDelay "MAIN_u16OverVolMidDelay" UWORD I_1 1 2 0 65535 ECU_ADDRESS 0x700063D4 /end MEASUREMENT
/begin MEASUREMENT MAIN_u16PWMPeriodVal "MAIN_u16PWMPeriodVal" UWORD I_1 1 2 0 65535 ECU_ADDRESS 0x70000AC0 /end MEASUREMENT
/begin MEASUREMENT MAIN_u16RandomNum "MAIN_u16RandomNum" UWORD I_1 1 2 0 65535 ECU_ADDRESS 0x70006386 /end MEASUREMENT
/begin MEASUREMENT MAIN_u16ResCosADVal "MAIN_u16ResCosADVal" UWORD I_1 1 2 0 65535 ECU_ADDRESS 0x700063D2 /end MEASUREMENT
/begin MEASUREMENT MAIN_u16ResSinADVal "MAIN_u16ResSinADVal" UWORD I_1 1 2 0 65535 ECU_ADDRESS 0x700063D0 /end MEASUREMENT
/begin MEASUREMENT MAIN_u16SlopSlideTimCnt "..." UWORD I_1 1 2 0 65535 ECU_ADDRESS 0x700063CE /end MEASUREMENT
/begin MEASUREMENT MAIN_u16SlopSpdConfirmCnt "..." UWORD I_1 1 2 0 65535 ECU_ADDRESS 0x700063CC /end MEASUREMENT
/begin MEASUREMENT MAIN_u16SpdReadyEstCnt "..." UWORD I_1 1 2 0 65535 ECU_ADDRESS 0x700063CA /end MEASUREMENT
/begin MEASUREMENT MAIN_u16T12CntVal "MAIN_u16T12CntVal" UWORD I_1 1 2 0 65535 ECU_ADDRESS 0x700063C8 /end MEASUREMENT
/begin MEASUREMENT MAIN_u16TeachInWrtDelayCnt "MAIN_u16TeachInWrtDelayCnt" UWORD I_1 1 2 0 65535 ECU_ADDRESS 0x700063C6 /end MEASUREMENT
/begin MEASUREMENT MAIN_u16VadcBhv "MAIN_u16VadcBhv" UWORD I_1 1 2 0 65535 ECU_ADDRESS 0x700063C4 /end MEASUREMENT
/begin MEASUREMENT MAIN_u16VadcPhaseCurU "MAIN_u16VadcPhaseCurU" UWORD I_1 1 2 0 65535 ECU_ADDRESS 0x700063C2 /end MEASUREMENT
/begin MEASUREMENT MAIN_u16VadcPhaseCurV "MAIN_u16VadcPhaseCurV" UWORD I_1 1 2 0 65535 ECU_ADDRESS 0x700063C0 /end MEASUREMENT
/begin MEASUREMENT MAIN_u16VadcPhaseCurW "MAIN_u16VadcPhaseCurW" UWORD I_1 1 2 0 65535 ECU_ADDRESS 0x700063BE /end MEASUREMENT
/begin MEASUREMENT MAIN_u32BldcDeltTime "..." ULONG F_0v01_p0_103 1 2 0 42949672.95 ECU_ADDRESS 0x70006590 /end MEASUREMENT
/begin MEASUREMENT MAIN_u32BldcPattnTreatCnt "..." ULONG I_1 1 2 0 4294967295 ECU_ADDRESS 0x7000658C /end MEASUREMENT
/begin MEASUREMENT MAIN_u32BldcPwmTreatCnt "..." ULONG I_1 1 2 0 4294967295 ECU_ADDRESS 0x70006588 /end MEASUREMENT
/begin MEASUREMENT MAIN_u32BldcTimStampA "..." ULONG I_1 1 2 0 4294967295 ECU_ADDRESS 0x70006584 /end MEASUREMENT
/begin MEASUREMENT MAIN_u32BldcTimStampB "..." ULONG I_1 1 2 0 4294967295 ECU_ADDRESS 0x70006580 /end MEASUREMENT
/begin MEASUREMENT MAIN_u32EmailCkreq "..." ULONG I_1 1 2 0 4294967295 ECU_ADDRESS 0x7000657C /end MEASUREMENT
/begin MEASUREMENT MAIN_u32EmailPosATimeStamp "..." ULONG I_1 1 2 0 4294967295 ECU_ADDRESS 0x70006578 /end MEASUREMENT
/begin MEASUREMENT MAIN_u32IuCycleTim "..." ULONG I_1 1 2 0 4294967295 ECU_ADDRESS 0x70006574 /end MEASUREMENT
/begin MEASUREMENT MAIN_u32PosATimeStamp "..." ULONG I_1 1 2 0 4294967295 ECU_ADDRESS 0x70006570 /end MEASUREMENT
/begin MEASUREMENT MAIN_u32PosBTimeStamp "..." ULONG I_1 1 2 0 4294967295 ECU_ADDRESS 0x7000656C /end MEASUREMENT
/begin MEASUREMENT MAIN_u32PosTreatCkreq "..." ULONG I_1 1 2 0 4294967295 ECU_ADDRESS 0x70006568 /end MEASUREMENT
/begin MEASUREMENT MAIN_u32TestVar2 "MAIN_u32TestVar2" ULONG I_1 1 2 0 4294967295 ECU_ADDRESS 0x70006564 /end MEASUREMENT
/begin MEASUREMENT MAIN_u32TestVar4 "MAIN_u32TestVar4" ULONG I_1 1 2 0 4294967295 ECU_ADDRESS 0x70006560 /end MEASUREMENT
/begin MEASUREMENT MAIN_u32WaitValueVSISafeTreatment "Additional wait value for VSISafeTreatment function (debug)" ULONG F_0v055_p0_105 1 2 0 236223201.2 ECU_ADDRESS 0x7000655C /end MEASUREMENT
/begin MEASUREMENT MAIN_u32WaitValueVSITreatment "Additional wait value for VSITreatment function (debug)" ULONG F_0v02_p0_106 1 2 0 85899345.9 ECU_ADDRESS 0x70006558 /end MEASUREMENT
/begin MEASUREMENT MAIN_u8BldcFaultLevel "MAIN_u8BldcFaultLevel" UBYTE I_1 1 2 0 255 ECU_ADDRESS 0x7000647F /end MEASUREMENT
/begin MEASUREMENT MAIN_u8BldcHallStt "MAIN_u8BldcHallStt" UBYTE I_1 1 2 0 255 ECU_ADDRESS 0x7000647E /end MEASUREMENT
/begin MEASUREMENT MAIN_u8BldcHallSttPre "MAIN_u8BldcHallSttPre" UBYTE I_1 1 2 0 255 ECU_ADDRESS 0x7000647D /end MEASUREMENT
/begin MEASUREMENT MAIN_u8BldcMotDir "MAIN_u8BldcMotDir" UBYTE I_1 1 2 0 255 ECU_ADDRESS 0x7000647C /end MEASUREMENT
/begin MEASUREMENT MAIN_u8ErrCodNum "MAIN_u8ErrCodNum" UBYTE I_1 1 2 0 255 ECU_ADDRESS 0x7000647B /end MEASUREMENT
/begin MEASUREMENT MAIN_u8ErrCodRdIdx "MAIN_u8ErrCodRdIdx" UBYTE I_1 1 2 0 255 ECU_ADDRESS 0x7000647A /end MEASUREMENT
/begin MEASUREMENT MAIN_u8ErrCodWrIdx "MAIN_u8ErrCodWrIdx" UBYTE I_1 1 2 0 255 ECU_ADDRESS 0x70006479 /end MEASUREMENT
/begin MEASUREMENT MAIN_u8FaultSum "..." UBYTE I_1 1 2 0 255 ECU_ADDRESS 0x70006478 /end MEASUREMENT
/begin MEASUREMENT MAIN_u8OcState "MAIN_u8OcState" UBYTE I_1 1 2 0 255 ECU_ADDRESS 0x70006477 /end MEASUREMENT
/begin MEASUREMENT MAIN_u8OcStsRptDelayCnt "MAIN_u8OcStsRptDelayCnt" UBYTE I_1 1 2 0 255 ECU_ADDRESS 0x70006476 /end MEASUREMENT
/begin MEASUREMENT MAIN_u8OverVolIndex "MAIN_u8OverVolIndex" UBYTE I_1 1 2 0 255 ECU_ADDRESS 0x70006475 /end MEASUREMENT
/begin MEASUREMENT MAIN_u8PrevGearPos "..." UBYTE I_1 1 2 0 255 ECU_ADDRESS 0x70006474 /end MEASUREMENT
/begin MEASUREMENT MAIN_u8TcFaultCodeL3 "MAIN_u8TcFaultCodeL3" UBYTE I_1 1 2 0 255 ECU_ADDRESS 0x70006473 /end MEASUREMENT
/begin MEASUREMENT MAIN_u8TcFaultCodeL5 "MAIN_u8TcFaultCodeL5" UBYTE I_1 1 2 0 255 ECU_ADDRESS 0x70006472 /end MEASUREMENT
/begin MEASUREMENT MAIN_u8TestVar1 "MAIN_u8TestVar1" UBYTE I_1 1 2 0 255 ECU_ADDRESS 0x70006471 /end MEASUREMENT
/begin MEASUREMENT MAIN_u8UdsSwVerSup "..." UBYTE Id_0x00 1 2 0 255 MATRIX_DIM 21 1 1 ECU_ADDRESS 0x70000A9D /end MEASUREMENT
/begin MEASUREMENT MAIN_u8UdsSwVerSup[0] "MAIN_u8UdsSwVerSup[0]" UBYTE Id_0x00 1 2 0 255 ECU_ADDRESS 0x70000A9D /end MEASUREMENT
/begin MEASUREMENT MAIN_u8UdsSwVerSup[10] "MAIN_u8UdsSwVerSup[10]" UBYTE Id_0x00 1 2 0 255 ECU_ADDRESS 0x70000AA7 /end MEASUREMENT
/begin MEASUREMENT MAIN_u8UdsSwVerSup[11] "MAIN_u8UdsSwVerSup[11]" UBYTE Id_0x00 1 2 0 255 ECU_ADDRESS 0x70000AA8 /end MEASUREMENT
/begin MEASUREMENT MAIN_u8UdsSwVerSup[12] "MAIN_u8UdsSwVerSup[12]" UBYTE Id_0x00 1 2 0 255 ECU_ADDRESS 0x70000AA9 /end MEASUREMENT
/begin MEASUREMENT MAIN_u8UdsSwVerSup[13] "MAIN_u8UdsSwVerSup[13]" UBYTE Id_0x00 1 2 0 255 ECU_ADDRESS 0x70000AAA /end MEASUREMENT
/begin MEASUREMENT MAIN_u8UdsSwVerSup[14] "MAIN_u8UdsSwVerSup[14]" UBYTE Id_0x00 1 2 0 255 ECU_ADDRESS 0x70000AAB /end MEASUREMENT
/begin MEASUREMENT MAIN_u8UdsSwVerSup[15] "MAIN_u8UdsSwVerSup[15]" UBYTE Id_0x00 1 2 0 255 ECU_ADDRESS 0x70000AAC /end MEASUREMENT
/begin MEASUREMENT MAIN_u8UdsSwVerSup[16] "MAIN_u8UdsSwVerSup[16]" UBYTE Id_0x00 1 2 0 255 ECU_ADDRESS 0x70000AAD /end MEASUREMENT
/begin MEASUREMENT MAIN_u8UdsSwVerSup[17] "MAIN_u8UdsSwVerSup[17]" UBYTE Id_0x00 1 2 0 255 ECU_ADDRESS 0x70000AAE /end MEASUREMENT
/begin MEASUREMENT MAIN_u8UdsSwVerSup[18] "MAIN_u8UdsSwVerSup[18]" UBYTE Id_0x00 1 2 0 255 ECU_ADDRESS 0x70000AAF /end MEASUREMENT
/begin MEASUREMENT MAIN_u8UdsSwVerSup[19] "MAIN_u8UdsSwVerSup[19]" UBYTE Id_0x00 1 2 0 255 ECU_ADDRESS 0x70000AB0 /end MEASUREMENT
/begin MEASUREMENT MAIN_u8UdsSwVerSup[1] "MAIN_u8UdsSwVerSup[1]" UBYTE Id_0x00 1 2 0 255 ECU_ADDRESS 0x70000A9E /end MEASUREMENT
/begin MEASUREMENT MAIN_u8UdsSwVerSup[20] "MAIN_u8UdsSwVerSup[20]" UBYTE Id_0x00 1 2 0 255 ECU_ADDRESS 0x70000AB1 /end MEASUREMENT
/begin MEASUREMENT MAIN_u8UdsSwVerSup[2] "MAIN_u8UdsSwVerSup[2]" UBYTE Id_0x00 1 2 0 255 ECU_ADDRESS 0x70000A9F /end MEASUREMENT
/begin MEASUREMENT MAIN_u8UdsSwVerSup[3] "MAIN_u8UdsSwVerSup[3]" UBYTE Id_0x00 1 2 0 255 ECU_ADDRESS 0x70000AA0 /end MEASUREMENT
/begin MEASUREMENT MAIN_u8UdsSwVerSup[4] "MAIN_u8UdsSwVerSup[4]" UBYTE Id_0x00 1 2 0 255 ECU_ADDRESS 0x70000AA1 /end MEASUREMENT
/begin MEASUREMENT MAIN_u8UdsSwVerSup[5] "MAIN_u8UdsSwVerSup[5]" UBYTE Id_0x00 1 2 0 255 ECU_ADDRESS 0x70000AA2 /end MEASUREMENT
/begin MEASUREMENT MAIN_u8UdsSwVerSup[6] "MAIN_u8UdsSwVerSup[6]" UBYTE Id_0x00 1 2 0 255 ECU_ADDRESS 0x70000AA3 /end MEASUREMENT
/begin MEASUREMENT MAIN_u8UdsSwVerSup[7] "MAIN_u8UdsSwVerSup[7]" UBYTE Id_0x00 1 2 0 255 ECU_ADDRESS 0x70000AA4 /end MEASUREMENT
/begin MEASUREMENT MAIN_u8UdsSwVerSup[8] "MAIN_u8UdsSwVerSup[8]" UBYTE Id_0x00 1 2 0 255 ECU_ADDRESS 0x70000AA5 /end MEASUREMENT
/begin MEASUREMENT MAIN_u8UdsSwVerSup[9] "MAIN_u8UdsSwVerSup[9]" UBYTE Id_0x00 1 2 0 255 ECU_ADDRESS 0x70000AA6 /end MEASUREMENT
/begin MEASUREMENT MAIN_u8UdsSwVerVeh "..." UBYTE Id_0x00 1 2 0 255 MATRIX_DIM 13 1 1 ECU_ADDRESS 0x70000AB2 /end MEASUREMENT
/begin MEASUREMENT MAIN_u8UdsSwVerVeh[0] "MAIN_u8UdsSwVerVeh[0]" UBYTE Id_0x00 1 2 0 255 ECU_ADDRESS 0x70000AB2 /end MEASUREMENT
/begin MEASUREMENT MAIN_u8UdsSwVerVeh[10] "MAIN_u8UdsSwVerVeh[10]" UBYTE Id_0x00 1 2 0 255 ECU_ADDRESS 0x70000ABC /end MEASUREMENT
/begin MEASUREMENT MAIN_u8UdsSwVerVeh[11] "MAIN_u8UdsSwVerVeh[11]" UBYTE Id_0x00 1 2 0 255 ECU_ADDRESS 0x70000ABD /end MEASUREMENT
/begin MEASUREMENT MAIN_u8UdsSwVerVeh[12] "MAIN_u8UdsSwVerVeh[12]" UBYTE Id_0x00 1 2 0 255 ECU_ADDRESS 0x70000ABE /end MEASUREMENT
/begin MEASUREMENT MAIN_u8UdsSwVerVeh[1] "MAIN_u8UdsSwVerVeh[1]" UBYTE Id_0x00 1 2 0 255 ECU_ADDRESS 0x70000AB3 /end MEASUREMENT
/begin MEASUREMENT MAIN_u8UdsSwVerVeh[2] "MAIN_u8UdsSwVerVeh[2]" UBYTE Id_0x00 1 2 0 255 ECU_ADDRESS 0x70000AB4 /end MEASUREMENT
/begin MEASUREMENT MAIN_u8UdsSwVerVeh[3] "MAIN_u8UdsSwVerVeh[3]" UBYTE Id_0x00 1 2 0 255 ECU_ADDRESS 0x70000AB5 /end MEASUREMENT
/begin MEASUREMENT MAIN_u8UdsSwVerVeh[4] "MAIN_u8UdsSwVerVeh[4]" UBYTE Id_0x00 1 2 0 255 ECU_ADDRESS 0x70000AB6 /end MEASUREMENT
/begin MEASUREMENT MAIN_u8UdsSwVerVeh[5] "MAIN_u8UdsSwVerVeh[5]" UBYTE Id_0x00 1 2 0 255 ECU_ADDRESS 0x70000AB7 /end MEASUREMENT
/begin MEASUREMENT MAIN_u8UdsSwVerVeh[6] "MAIN_u8UdsSwVerVeh[6]" UBYTE Id_0x00 1 2 0 255 ECU_ADDRESS 0x70000AB8 /end MEASUREMENT
/begin MEASUREMENT MAIN_u8UdsSwVerVeh[7] "MAIN_u8UdsSwVerVeh[7]" UBYTE Id_0x00 1 2 0 255 ECU_ADDRESS 0x70000AB9 /end MEASUREMENT
/begin MEASUREMENT MAIN_u8UdsSwVerVeh[8] "MAIN_u8UdsSwVerVeh[8]" UBYTE Id_0x00 1 2 0 255 ECU_ADDRESS 0x70000ABA /end MEASUREMENT
/begin MEASUREMENT MAIN_u8UdsSwVerVeh[9] "MAIN_u8UdsSwVerVeh[9]" UBYTE Id_0x00 1 2 0 255 ECU_ADDRESS 0x70000ABB /end MEASUREMENT
/begin MEASUREMENT Os_Task_BackGround_Counter "..." ULONG I_1 1 2 0 4294967295 ECU_ADDRESS 0x7001F510 /end MEASUREMENT
/begin MEASUREMENT Os_Task_Idle_Counter "..." ULONG I_1 1 2 0 4294967295 ECU_ADDRESS 0x70016728 /end MEASUREMENT
/begin COMPU_METHOD I_1 "" RAT_FUNC "%9.2" "-" COEFFS 0 1 0 0 0 1 /end COMPU_METHOD
/begin COMPU_METHOD F_0v1_p0_2 "" RAT_FUNC "%9.2" "-" COEFFS 0 1 0 0 0 0.1 /end COMPU_METHOD
/begin COMPU_METHOD I_3 "" RAT_FUNC "%9.2" "" COEFFS 0 1 0 0 0 1 /end COMPU_METHOD
/begin COMPU_METHOD F_1_p0_4 "" RAT_FUNC "%9.2" "-" COEFFS 0 1 0 0 0 1 /end COMPU_METHOD
/begin COMPU_METHOD F_100_p0_5 "" RAT_FUNC "%9.2" "%" COEFFS 0 1 0 0 0 100 /end COMPU_METHOD
/begin COMPU_METHOD F_0v04_p1_8 "" RAT_FUNC "%9.2" "-" COEFFS 0 1 -1 0 0 0.04 /end COMPU_METHOD
/begin COMPU_METHOD I_15 "" RAT_FUNC "%9.2" "V" COEFFS 0 1 0 0 0 1 /end COMPU_METHOD
/begin COMPU_METHOD F_1_p0_21 "" RAT_FUNC "%9.2" "RPM" COEFFS 0 1 0 0 0 1 /end COMPU_METHOD
/begin COMPU_METHOD F_1_m40_27 "" RAT_FUNC "%9.2" "-" COEFFS 0 1 40 0 0 1 /end COMPU_METHOD
/begin COMPU_METHOD F_1_m20000_33 "" RAT_FUNC "%9.2" "-" COEFFS 0 1 20000 0 0 1 /end COMPU_METHOD
/begin COMPU_METHOD F_1_p0_35 "" RAT_FUNC "%9.2" "Hz" COEFFS 0 1 0 0 0 1 /end COMPU_METHOD
/begin COMPU_METHOD F_1_p0_46 "" RAT_FUNC "%9.2" "A" COEFFS 0 1 0 0 0 1 /end COMPU_METHOD
/begin COMPU_METHOD F_1_p0_49 "" RAT_FUNC "%9.2" "Nm" COEFFS 0 1 0 0 0 1 /end COMPU_METHOD
/begin COMPU_METHOD F_1_p0_52 "" RAT_FUNC "%9.2" "rpm" COEFFS 0 1 0 0 0 1 /end COMPU_METHOD
/begin COMPU_METHOD F_1_p0_53 "" RAT_FUNC "%9.2" "s" COEFFS 0 1 0 0 0 1 /end COMPU_METHOD
/begin COMPU_METHOD F_1_p0_66 "" RAT_FUNC "%9.2" "ms" COEFFS 0 1 0 0 0 1 /end COMPU_METHOD
/begin COMPU_METHOD I_87 "" RAT_FUNC "%9.2" "A" COEFFS 0 1 0 0 0 1 /end COMPU_METHOD
/begin COMPU_METHOD I_88 "" RAT_FUNC "%9.2" "Kmh" COEFFS 0 1 0 0 0 1 /end COMPU_METHOD
/begin COMPU_METHOD F_1_p0_89 "" RAT_FUNC "%9.2" "degree" COEFFS 0 1 0 0 0 1 /end COMPU_METHOD
/begin COMPU_METHOD I_90 "" RAT_FUNC "%9.2" "rpm" COEFFS 0 1 0 0 0 1 /end COMPU_METHOD
/begin COMPU_METHOD I_91 "" RAT_FUNC "%9.2" "Nm" COEFFS 0 1 0 0 0 1 /end COMPU_METHOD
/begin COMPU_METHOD F_1_p0_92 "" RAT_FUNC "%9.2" "Deg" COEFFS 0 1 0 0 0 1 /end COMPU_METHOD
/begin COMPU_METHOD I_93 "" RAT_FUNC "%9.2" "%" COEFFS 0 1 0 0 0 1 /end COMPU_METHOD
/begin COMPU_METHOD F_0v1_m300_94 "" RAT_FUNC "%9.2" "-" COEFFS 0 1 300 0 0 0.1 /end COMPU_METHOD
/begin COMPU_METHOD I_95 "" RAT_FUNC "%9.2" "Deg" COEFFS 0 1 0 0 0 1 /end COMPU_METHOD
/begin COMPU_METHOD I_96 "" RAT_FUNC "%9.2" "g" COEFFS 0 1 0 0 0 1 /end COMPU_METHOD
/begin COMPU_METHOD I_97 "" RAT_FUNC "%9.2" "km" COEFFS 0 1 0 0 0 1 /end COMPU_METHOD
/begin COMPU_METHOD I_98 "" RAT_FUNC "%9.2" "min" COEFFS 0 1 0 0 0 1 /end COMPU_METHOD
/begin COMPU_METHOD F_1_p0_99 "" RAT_FUNC "%9.2" "%" COEFFS 0 1 0 0 0 1 /end COMPU_METHOD
/begin COMPU_METHOD F_0v001_p0_100 "" RAT_FUNC "%9.3" "-" COEFFS 0 1 0 0 0 0.001 /end COMPU_METHOD
/begin COMPU_METHOD F_0v0061035156_p0_101 "" RAT_FUNC "%9.3" "%" COEFFS 0 1 0 0 0 0.00610352 /end COMPU_METHOD
/begin COMPU_METHOD F_1000000_p0_102 "" RAT_FUNC "%9.2" "us" COEFFS 0 1 0 0 0 1e+006 /end COMPU_METHOD
/begin COMPU_METHOD F_0v01_p0_103 "" RAT_FUNC "%9.2" "ï¿½s" COEFFS 0 1 0 0 0 0.01 /end COMPU_METHOD
/begin COMPU_METHOD F_0v04_p1_104 "" RAT_FUNC "%9.2" "us" COEFFS 0 1 -1 0 0 0.04 /end COMPU_METHOD
/begin COMPU_METHOD F_0v055_p0_105 "" RAT_FUNC "%9.2" "ï¿½s" COEFFS 0 1 0 0 0 0.055 /end COMPU_METHOD
/begin COMPU_METHOD F_0v02_p0_106 "" RAT_FUNC "%9.2" "ï¿½s" COEFFS 0 1 0 0 0 0.02 /end COMPU_METHOD
/begin COMPU_METHOD F_0v1_p0_110 "" RAT_FUNC "%9.2" "µs" COEFFS 0 1 0 0 0 0.1 /end COMPU_METHOD
/begin COMPU_METHOD Id_0x00 "" RAT_FUNC "%9.2" "." COEFFS 0 1 0 0 0 1 /end COMPU_METHOD
/begin COMPU_METHOD Bool_ON_OFF "" TAB_VERB "%8.4" "." COMPU_TAB_REF Bool_ON_OFF_table /end COMPU_METHOD
/begin COMPU_VTAB Bool_ON_OFF_table "" TAB_VERB 2 0 "OFF" 1 "ON" /end COMPU_VTAB
/begin FUNCTION MAIN ""
 /begin DEF_CHARACTERISTIC BSW_ku16CCPReinitTriggerC CLPCke_b_CAPM_CommandDBC_Enable FDMAie_b_ForceEngineStop_ob FDMAie_b_ForceEngineStop_ov FDMAie_b_ForceNeutralGear_ob FDMAie_b_ForceNeutralGear_ov MAIN_bBldcBenchOnC MAIN_bMSGRxToutBenchOnC MAIN_bTcuStuckFlagTestOnC MAIN_CCPbBenchTestOnC MAIN_f32AccPosClrSSTimC MAIN_f32AntiSlopExitSpdC MAIN_f32AntiSsGapDrtGainC MAIN_f32AntiSsValidTrqC MAIN_f32BldcDebugDutyC MAIN_f32BrakDeratGainC MAIN_f32BrakPedalPosLowC MAIN_f32BrakPedPosHighC MAIN_f32OcAutophsGainC MAIN_f32OcAutophsOffstC MAIN_f32PowerdownVoltC MAIN_f32PwmFreqHighThrdC MAIN_f32PwmMaxDutyPhysC MAIN_f32PwmMinDutyPhysC MAIN_f32PwmRatioReduceC MAIN_f32RandomFrecMecaSpdMaxC MAIN_f32RandomFrecMecaSpdMinC MAIN_f32SlopOrRoadSpdDiffC MAIN_f32UvwOvCurrThdC MAIN_f32VsiPwmPeriodC MAIN_HARDBenchOnC MAIN_ku16PwmPerdInitValC MAIN_ku16SpdReadyEstConfirmC MAIN_MSGbBenchTestOnC MAIN_MSGbDbgFrameOnC MAIN_MSGRxBenchOnC MAIN_MSGTxBenchOnC MAIN_MSGu8PwModFiltCntC MAIN_s32CurHardDelayC MAIN_s32ResHardDelayC MAIN_s32SampleDelayC MAIN_TCUbHilTestOnC MAIN_TCUs16GcuMotTorqC MAIN_TCUs16McuMotTorqC MAIN_TCUu16OilPresVoltC MAIN_TCUu16OilTempC MAIN_TCUu32GcuMotSpeedC MAIN_TCUu32McuMotSpeedC MAIN_TCUu8GcuTempC MAIN_TCUu8McuTempC MAIN_TSTBenchOnC MAIN_u16AntiSsChkTimC MAIN_u16AntiSsEnaBrakTimC MAIN_u16AntiSsGapTimC MAIN_u16BrakRelsDelayC MAIN_u16DetectSpdTestC MAIN_u16FpgaFltClrTimoutC MAIN_u16IdqDeltaCntMaxC MAIN_u16OverBhvThdC MAIN_u16PwmRatioPerd0C MAIN_u16PwmRatioPerd1C MAIN_u16PwmRatioPerd2C MAIN_u16PwmRatioPerd3C MAIN_u16RandomFrecMaxC MAIN_u16SlopSlideTim1C MAIN_u16SlopSlideTim2C MAIN_u16SlopSlideTimoutC MAIN_u16SlopSpdConfirmC MAIN_u16StuckRecoverTimeStepC MAIN_u16StuckSpdThresholdC MAIN_u16StuckTimeThresholdC MAIN_u32VSICntCkreqESMStartedC MAIN_u32VSICntCkreqVSIStartedC MAIN_VSIBenchOnWriteDataC MAIN_VSIBenchOnWriteEmergSwC MosSWOverCurrentTestOnC RTE_bCCPbTcuStuckFlagTestOnC RTE_bCCPDrvOverCurrentTestOnC RTE_bCCPDrvOverTempTestOnC RTE_bCCPDrvOverVoltageTestOnC RTE_bCCPDrvUnderVoltageTestOnC RTE_bCCPHALOrderInvalidTestOnC RTE_bCCPHALOverVoltTestOnC RTE_bCCPHALUndefinedTestOnC RTE_bCCPHALUnderVoltTestOnC RTE_bCCPPhasePerfTestOnC RTE_bCCPPhaseShortHighTestOnC RTE_bCCPPhaseShortLowTestOnC RTE_bCCPSwOverCurrentTestOnC SBC_bServiceDisableC SBC_f32RecoverThresholdC SBC_f32UnderVolHighThresholdC SBC_f32UnderVolLowThresholdC TCFCke_b_CCPM_CommandDBC_Enable /end DEF_CHARACTERISTIC
 /begin OUT_MEASUREMENT ADCTotalTime ASWNM_bFullComSts ASWNM_u8CurrentState ASWNM_u8CurrentState[0] ASWNM_u8CurrentState[10] ASWNM_u8CurrentState[11] ASWNM_u8CurrentState[12] ASWNM_u8CurrentState[13] ASWNM_u8CurrentState[14] ASWNM_u8CurrentState[15] ASWNM_u8CurrentState[16] ASWNM_u8CurrentState[17] ASWNM_u8CurrentState[18] ASWNM_u8CurrentState[19] ASWNM_u8CurrentState[1] ASWNM_u8CurrentState[20] ASWNM_u8CurrentState[2] ASWNM_u8CurrentState[3] ASWNM_u8CurrentState[4] ASWNM_u8CurrentState[5] ASWNM_u8CurrentState[6] ASWNM_u8CurrentState[7] ASWNM_u8CurrentState[8] ASWNM_u8CurrentState[9] Calibration_debut Core0_f32Asw100msLoad Core0_f32Asw10msLoad Core0_f32Bsw100msLoad Core0_f32Bsw10msLoad Core0_f32Bsw1msLoad Core0_f32Bsw50msLoad Core0_f32ModReqLoad Core0_f32VsiTreatmentLoad Core1_f32Asw10msLoad Core1_f32Asw1msLoad Core1_f32Bsw10msLoad Core1_f32PosTreatmentLoad Core2_f32Asw10msLoad Core2_f32Asw1msLoad Core2_f32BldcTreatmentLoad Core2_f32Bsw10msLoad MAIN_as32OCTrimNvm MAIN_as32OCTrimNvm[0] MAIN_as32OCTrimNvm[1] MAIN_as32OCTrimNvm[2] MAIN_as32OCTrimNvm[3] MAIN_as32OCTrimNvm[4] MAIN_au8ErrCode MAIN_au8ErrCode[0] MAIN_au8ErrCode[10] MAIN_au8ErrCode[11] MAIN_au8ErrCode[12] MAIN_au8ErrCode[13] MAIN_au8ErrCode[14] MAIN_au8ErrCode[15] MAIN_au8ErrCode[16] MAIN_au8ErrCode[17] MAIN_au8ErrCode[18] MAIN_au8ErrCode[19] MAIN_au8ErrCode[1] MAIN_au8ErrCode[2] MAIN_au8ErrCode[3] MAIN_au8ErrCode[4] MAIN_au8ErrCode[5] MAIN_au8ErrCode[6] MAIN_au8ErrCode[7] MAIN_au8ErrCode[8] MAIN_au8ErrCode[9] MAIN_bAkdAfterAscReq MAIN_bAntiSlopGearEna MAIN_bAscFlag MAIN_bBswReadySts MAIN_bESMStarted MAIN_bFTInitFinshFlg MAIN_bMcuMilStatus MAIN_bOcDataStoreEna MAIN_bOcFailureFlg MAIN_bOcFinshFlg MAIN_bOcModeEna MAIN_bOcNotRatFlg MAIN_bOcRdResultFlag MAIN_bOcStartFlag MAIN_bPosAccessLock MAIN_bProgConditionOk MAIN_bResExcFltDetEna MAIN_bSlopSlideTimoutFlg MAIN_bSoftOvBhvFlg MAIN_bSoftOvCurrPhsUFlg MAIN_bSoftOvCurrPhsVFlg MAIN_bSoftOvCurrPhsWFlg MAIN_bSpdReadyEst MAIN_bSpeedReadyFlg MAIN_bTcuStuckFlag MAIN_bTeachInCompleteFlg MAIN_bTrigOcByUser MAIN_bVSIStarted MAIN_ESMGo2StartupIEvent MAIN_f32AntiSsEnaBrakPos MAIN_f32BldcCurrentPos MAIN_f32BldcCurrentPosRolCnt MAIN_f32BldcDuty MAIN_f32BldcHallCapPos MAIN_f32BldcHallCapPosErr MAIN_f32BldcHallCapPosPre MAIN_f32BldcPositionDuty MAIN_f32CpuLoadCore0 MAIN_f32CpuLoadCore1 MAIN_f32CpuLoadCore2 MAIN_f32CpuLoadMaxCore0 MAIN_f32CpuLoadMaxCore1 MAIN_f32CpuLoadMaxCore2 MAIN_f32ElecSpeedRds MAIN_f32EmailElecSpeedRds MAIN_f32EmailErrThetaRdSurPi MAIN_f32EmailMecaSpeedRds MAIN_f32EmailMecaSpeedRpm MAIN_f32EmailNextThetaElecRdSurPi MAIN_f32EmailThetaElecRdSurPi MAIN_f32ErrThetaRdSurPi MAIN_f32EstTempRatioScale MAIN_f32IdDeltaAvg MAIN_f32IdDeltaSum MAIN_f32IdQuality MAIN_f32IqDeltaAvg MAIN_f32IqDeltaSum MAIN_f32IqQuality MAIN_f32IuFrequency MAIN_f32IuPeriod MAIN_f32MecaSpeedRds MAIN_f32MecaSpeedRpm MAIN_f32MotSpdEst MAIN_f32PWMDutyUPhys MAIN_f32PWMDutyVPhys MAIN_f32PWMDutyWPhys MAIN_f32ShiftDrumInitPos MAIN_f32ShiftDrumTermPos MAIN_f32TcReadPosDuty MAIN_f32ThetaElecRdSurPi MAIN_f32VsiPwmPeriod MAIN_MSGbCCP_DrvOverTemp MAIN_MSGbCCP_DrvOverVoltage MAIN_MSGbCCP_DrvUnderVoltage MAIN_MSGbCCP_FetShorted MAIN_MSGbCCP_HALOrderInvalid MAIN_MSGbCCP_HALOverVolt MAIN_MSGbCCP_HALUndefined MAIN_MSGbCCP_HALUnderVolt MAIN_MSGbCCP_HwOverCurrent MAIN_MSGbCCP_PhasePerf MAIN_MSGbCCP_PhaseShortHigh MAIN_MSGbCCP_PhaseShortLow MAIN_MSGbCCP_PhaseVoltHigh MAIN_MSGbCCP_StuckFlag MAIN_MSGbCCP_SwOverCurrent MAIN_MSGbCCP_ThermalShutDown MAIN_MSGbEMS1_CalLoadValValid MAIN_MSGbEMS1_EngRunStatusValid MAIN_MSGbEMS1_EngSpdValid MAIN_MSGbEMS1_engStartfailure MAIN_MSGbEMS1_StartAllowed MAIN_MSGbEMS1_StopAllowed MAIN_MSGbEMS5_DrivingCycle MAIN_MSGbEMS8_catalystWarmupsta MAIN_MSGbEMS8_engCoolantTempValid MAIN_MSGbFMCU1_ActTrqValid MAIN_MSGbFMCU2_DischrgAllowed MAIN_MSGbGCU2_GenSpdVld MAIN_MSGbIPB4_wheelSpdRLValid MAIN_MSGbIPB4_wheelSpdRRValid MAIN_MSGbIPB5_wheelSpdFLValid MAIN_MSGbIPB5_wheelSpdFRValid MAIN_MSGbIPB7_absActive MAIN_MSGbIPB7_absFault MAIN_MSGbIPB7_vehicleSpdValid MAIN_MSGbIPK_TimeValid MAIN_MSGbMCUF1_MotorSpdValid MAIN_MSGbMCUF1_SelfheatAllow MAIN_MSGbMCUF1_SelfheatMod MAIN_MSGbMCUF2_AS_Activ MAIN_MSGbMCUF2_Fault_ASC MAIN_MSGbMCUF2_Fault_ShutOffHvReq MAIN_MSGbMCUF2_TMReq_ASC MAIN_MSGbMCUF6_Fault_ActDischg MAIN_MSGbMCUF6_Fault_PwrDerat MAIN_MSGbMCUF6_Status_ActDischg MAIN_MSGbMCUF8_DeratOverTmp MAIN_MSGbPDCM10_ACCDrvAst_allow MAIN_MSGbPDCM10_AccelPedal_Valid MAIN_MSGbPDCM10_actualGearValid MAIN_MSGbPDCM10_APADrvAst_allow MAIN_MSGbPDCM10_BrakePedal_PressRmd MAIN_MSGbPDCM10_BrakePedal_Status MAIN_MSGbPDCM10_BrakePedal_Valid MAIN_MSGbPDCM10_Gear_intervention MAIN_MSGbPDCM10_HV_Network_active MAIN_MSGbPDCM10_HV_Network_Fault MAIN_MSGbPDCM10_targetGearValid MAIN_MSGbPDCM1_HVReq MAIN_MSGbPDCM21_MFAntiJerk MAIN_MSGbPDCM21_SelfheatReq MAIN_MSGbPDCM22_MR_AntiJerk MAIN_MSGbPDCM22_SelfheatReqMR MAIN_MSGbPDCM24_Dcy_valid MAIN_MSGbPDCM24_DrivingCycle MAIN_MSGbPDCM24_HVCO_ActDischg_Req MAIN_MSGbPDCM5_ChargePlugUnlockReq MAIN_MSGbPDCM5_HVReq MAIN_MSGbPDCM_ACU_EPS_sasSteeAngVld MAIN_MSGbPDCM_BodyICAC_ambTmpValid MAIN_MSGbPDCM_IC_ACUic_totalMilValid MAIN_MSGbPDCM_OBD_DenoGeneral MAIN_MSGbPDCM_OBD_DenoGenValid MAIN_MSGbPDCM_OBD_DenoSpecial MAIN_MSGbPDCM_OBD_DenoSpecValid MAIN_MSGbPDCM_OBD_FaultClrInhibit MAIN_MSGbPDCM_OBD_FaultClrReq MAIN_MSGbPDCM_OBD_PDTCClrSts MAIN_MSGbPDCM_OBD_WarmCycleSts MAIN_MSGbPDCM_SelfheatMode MAIN_MSGbRMCU4_McuOverTemp MAIN_MSGbRMCU4_MilReq MAIN_MSGbRMCU4_MoterFault MAIN_MSGbRMCU4_MoterOverTemp MAIN_MSGbTbox_engOffTimeValid MAIN_MSGbTCU1_GearEngageAvail MAIN_MSGbTCU_P1OverTempWarn MAIN_MSGbTCU_P3OverTempWarn MAIN_MSGbVCU_FmcuAkdReq MAIN_MSGf32CAP_PhsCurLoadPhys MAIN_MSGf32CCP_5VSupplyPhys MAIN_MSGf32CCP_AvrgCurrentPhys MAIN_MSGf32CCP_BenchDutyCyclePhys MAIN_MSGf32CCP_DcCurrentPhys MAIN_MSGf32CCP_DutyCyclePhys MAIN_MSGf32CCP_MotSpeedPhys MAIN_MSGf32CCP_PhsCurLoadPhys MAIN_MSGf32CCP_PwrStgActPosIncPhys MAIN_MSGf32CCP_PwrStgTempPhys MAIN_MSGf32CCP_TargetDutyCyclePhys MAIN_MSGf32DCU_OilPressurePhys MAIN_MSGf32EMS1_calLoadValPhys MAIN_MSGf32EMS1_EngSpdPhys MAIN_MSGf32EMS1_TgtIdlEngSpdPhys MAIN_MSGf32EMS3_EngFlywhPhys MAIN_MSGf32EMS3_FrictionTorquePhys MAIN_MSGf32EMS5_altitudeFactorPhys MAIN_MSGf32EMS8_CoolantTempPhys MAIN_MSGf32EMS8_OilTempPhys MAIN_MSGf32EMS8_StartCoolantTempPhys MAIN_MSGf32EMS8_thermostat_valvePhys MAIN_MSGf32GCU2_ActTorqPhys MAIN_MSGf32GCU2_GenSpdPhys MAIN_MSGf32GCU2_MotPwrPhys MAIN_MSGf32GCU4_CtrlerTmpPhys MAIN_MSGf32GCU4_MotTempPhys MAIN_MSGf32IPB4_wheelSpdRLPhys MAIN_MSGf32IPB4_wheelSpdRRPhys MAIN_MSGf32IPB5_wheelSpdFLPhys MAIN_MSGf32IPB5_wheelSpdFRPhys MAIN_MSGf32IPB7_vehicleSpdPhys MAIN_MSGf32Ivi_altitudePhys MAIN_MSGf32MCU_LvVoltPhys MAIN_MSGf32MCUF1_ActTrqPhys MAIN_MSGf32MCUF1_MotorPwrPhys MAIN_MSGf32MCUF1_MotorSpdPhys MAIN_MSGf32MCUF2_ActVolPhys MAIN_MSGf32MCUF2_CurHVPhys MAIN_MSGf32MCUF2_MotorMaxSpdPhys MAIN_MSGf32MCUF3_MaxTrqTotalPhys MAIN_MSGf32MCUF3_MinTrqTotalPhys MAIN_MSGf32MCUF3_MotMaxPosTqPhys MAIN_MSGf32MCUF3_MotMinNegTqPhys MAIN_MSGf32MCUF4_CtrlerTmpPhys MAIN_MSGf32MCUF4_MotCurPhase_APhys MAIN_MSGf32MCUF4_MotCurPhase_BPhys MAIN_MSGf32MCUF4_MotCurPhase_CPhys MAIN_MSGf32MCUF4_MotTempPhys MAIN_MSGf32MCUF6_PerInd_MaxPwrPhys MAIN_MSGf32MCUF6_PerInd_MaxTrqPhys MAIN_MSGf32MCUF8_EfficiencyPhys MAIN_MSGf32PDCM10_AccPedal_StaPhys MAIN_MSGf32PDCM10_VehicleSpeedPhys MAIN_MSGf32PDCM1_CurrentHVAuxPhys MAIN_MSGf32PDCM1_PowerAuxPhys MAIN_MSGf32PDCM1_SOCPhys MAIN_MSGf32PDCM21_GCU_MaxPwrPhys MAIN_MSGf32PDCM21_MFSpeedReqPhys MAIN_MSGf32PDCM21_MFTorqueReqPhys MAIN_MSGf32PDCM22_GCU_MaxPwrGPhys MAIN_MSGf32PDCM22_MR_SpdReqPhys MAIN_MSGf32PDCM22_MR_TorqueReqPhys MAIN_MSGf32PDCM24_ClhCmdTsferTorPhys MAIN_MSGf32PDCM24_EngIdleTgtSpdPhys MAIN_MSGf32PDCM24_Max_VolPhys MAIN_MSGf32PDCM24_Min_VolPhys MAIN_MSGf32PDCM30MF_MaxPwrDPhys MAIN_MSGf32PDCM30MF_MaxPwrGPhys MAIN_MSGf32PDCM30MR_MaxPwrDPhys MAIN_MSGf32PDCM30MR_MaxPwrGPhys MAIN_MSGf32PDCM38TM_TmpSenser1Phys MAIN_MSGf32PDCM38TM_TmpSenser2Phys MAIN_MSGf32PDCM5_maxChargeSOCPhys MAIN_MSGf32PDCM5_RestchargingTimePhys MAIN_MSGf32PDCM_ACU_EPSsasSteAnglePhys MAIN_MSGf32PDCM_BodyICAC_ambTmpPhys MAIN_MSGf32PDCM_BodyICebs_U_BATPhys MAIN_MSGf32PDCM_GCU_SpeedReqPhys MAIN_MSGf32PDCM_GCU_Torque_RefPhys MAIN_MSGf32PDCM_GCU_TorqueReqPhys MAIN_MSGf32PDCM_IC_ACUic_totalMileagePhys MAIN_MSGf32PDCM_IC_ACULgtAPhys MAIN_MSGf32PDCM_OBD_AccPedal_PosPhys MAIN_MSGf32SelfHeat_MCUF_BusCurPhys MAIN_MSGf32SelfHeat_MCUF_BusFreqPhys MAIN_MSGf32SelfHeat_MCUF_UdFreqPhys MAIN_MSGf32SelfHeat_MCUF_UdVoltPhys MAIN_MSGf32Tbox_engOffTimePhys MAIN_MSGf32Tbox_OTATimeSetPhys MAIN_MSGf32TCU1_ClutchAvailMaxTrqPhys MAIN_MSGf32TCU1_ClutchAvailMinTrqPhys MAIN_MSGf32TCU1_ClutchCapActPhys MAIN_MSGf32TCU2_MaxFrtMotPwrReqPhys MAIN_MSGf32TCU2_MaxGCUPwrReqPhys MAIN_MSGf32TCU3_AirFlowReqPhys MAIN_MSGf32TCU3_TransFluidTmpPhys MAIN_MSGf32VCU7_12VBatVoltPhys MAIN_MSGf32VCU_AccPedPosPhys MAIN_MSGf32VCU_BrakPedPosPhys MAIN_MSGu16CCp_AvrgCurrentRaw MAIN_MSGu16CCp_DcCurrentRaw MAIN_MSGu16CCp_DutyCycleRaw MAIN_MSGu16CCp_MotSpeedRaw MAIN_MSGu16CCp_PhsCurLoadRaw MAIN_MSGu16CCp_PwrStgActPosIncRaw MAIN_MSGu16DCU_OilPressureRaw MAIN_MSGu16EMS_EngActualFlwTorqueRaw MAIN_MSGu16EOL1_CCPcontrolDCRaw MAIN_MSGu16EOL1_CCPcontrolflowRaw MAIN_MSGu16EOL1_CCPcontrolspeedRaw MAIN_MSGu16EOL2_CAPcontrolDCRaw MAIN_MSGu16EOL2_CAPcontrolpresRaw MAIN_MSGu16EOL2_CAPcontrolspeedRaw MAIN_MSGu16EOL3_CAPcurrentRaw MAIN_MSGu16EOL3_CAPDCRaw MAIN_MSGu16EOL3_CAPspeedRaw MAIN_MSGu16EOL4_CCPcurrentRaw MAIN_MSGu16EOL4_CCPDCRaw MAIN_MSGu16EOL4_CCPflowRaw MAIN_MSGu16EOL4_CCPspeedRaw MAIN_MSGu16EOL5_clutchpressureRaw MAIN_MSGu16EOL5_clutchtargetpressureRaw MAIN_MSGu16GCU2_ActTorqRaw MAIN_MSGu16GCU2_MotPwrRaw MAIN_MSGu16IPK_Year MAIN_MSGu16MCUF1_ActTrqRaw MAIN_MSGu16MCUF1_MotorPwrRaw MAIN_MSGu16MCUF1_MotorSpdRaw MAIN_MSGu16MCUF2_ActVolRaw MAIN_MSGu16MCUF2_CurHVRaw MAIN_MSGu16MCUF2_MotorMaxSpdRaw MAIN_MSGu16MCUF3_MaxTrqTotalRaw MAIN_MSGu16MCUF3_MinTrqTotalRaw MAIN_MSGu16MCUF3_MotMaxPosTqRaw MAIN_MSGu16MCUF3_MotMinNegTqRaw MAIN_MSGu16MCUF4_MotCurPhase_ARaw MAIN_MSGu16MCUF4_MotCurPhase_BRaw MAIN_MSGu16MCUF4_MotCurPhase_CRaw MAIN_MSGu16MCUF6_PerInd_MaxPwrRaw MAIN_MSGu16MCUF6_PerInd_MaxTrqRaw MAIN_MSGu16MCUF8_EfficiencyRaw MAIN_MSGu16PDCM5_ChargeSpeed MAIN_MSGu16SelfHeat_MCUF_BusCurRaw MAIN_MSGu16SelfHeat_MCUF_BusFreqRaw MAIN_MSGu16SelfHeat_MCUF_UdFreqRaw MAIN_MSGu16SelfHeat_MCUF_UdVoltRaw MAIN_MSGu16TCU1_ClutchAvailMaxTrqRaw MAIN_MSGu16TCU1_ClutchAvailMinTrqRaw MAIN_MSGu16TCU1_ClutchCapActRaw MAIN_MSGu16TCU2_MaxFrtMotPwrReqRaw MAIN_MSGu16TCU2_MaxGCUPwrReqRaw MAIN_MSGu16TCU_ClutchActTorqRaw MAIN_MSGu32GCU2_GenSpdRaw MAIN_MSGu8bcm_12VBatterySOC MAIN_MSGu8bcm_pepsPwrMode MAIN_MSGu8bcm_pepsRmtMode MAIN_MSGu8BMS_MainNegConnSts MAIN_MSGu8BMS_MainPosConnSts MAIN_MSGu8CCp_5VSupplyRaw MAIN_MSGu8CCP_CurrentSts MAIN_MSGu8CCP_FaultCode MAIN_MSGu8CCP_FaultLevel MAIN_MSGu8CCP_PwrStgMode MAIN_MSGu8CCP_PwrStgPosSts MAIN_MSGu8CCP_PwrStgSts MAIN_MSGu8CCp_PwrStgTempRaw MAIN_MSGu8CCP_TargetMotSts MAIN_MSGu8CompileDay MAIN_MSGu8CompileMonth MAIN_MSGu8CompileYear MAIN_MSGu8DCU_FltLev MAIN_MSGu8DCU_OfsAlCalSts MAIN_MSGu8DEV_Fault0 MAIN_MSGu8DEV_Fault1 MAIN_MSGu8DEV_Fault10 MAIN_MSGu8DEV_Fault11 MAIN_MSGu8DEV_Fault12 MAIN_MSGu8DEV_Fault13 MAIN_MSGu8DEV_Fault14 MAIN_MSGu8DEV_Fault15 MAIN_MSGu8DEV_Fault2 MAIN_MSGu8DEV_Fault3 MAIN_MSGu8DEV_Fault4 MAIN_MSGu8DEV_Fault5 MAIN_MSGu8DEV_Fault6 MAIN_MSGu8DEV_Fault7 MAIN_MSGu8DEV_Fault8 MAIN_MSGu8DEV_Fault9 MAIN_MSGu8EMS1_EngRunStatus MAIN_MSGu8EMS8_SysErrLevel MAIN_MSGu8EOL1_CCPcontrolEnable MAIN_MSGu8EOL2_CAPcontrolEnable MAIN_MSGu8EOL5_oiltempRaw MAIN_MSGu8FMCU8_HtcuLimpHomeSts MAIN_MSGu8GCU2_State MAIN_MSGu8GCU4_ActDischgSta MAIN_MSGu8GCU4_GenFaultLmp MAIN_MSGu8GCU4_OBD_Lmp_Req MAIN_MSGu8GW2_PwrMode MAIN_MSGu8IPK_Day MAIN_MSGu8IPK_Hour MAIN_MSGu8IPK_Minute MAIN_MSGu8IPK_Month MAIN_MSGu8IPK_Second MAIN_MSGu8M2G1_Byte4 MAIN_MSGu8M2G1_Byte5 MAIN_MSGu8M2G1_Byte6 MAIN_MSGu8M2G1_Byte7 MAIN_MSGu8M2G2_Byte0 MAIN_MSGu8M2G2_Byte1 MAIN_MSGu8M2G2_Byte2 MAIN_MSGu8M2G2_Byte3 MAIN_MSGu8M2G2_Byte4 MAIN_MSGu8M2G2_Byte5 MAIN_MSGu8M2G2_Byte6 MAIN_MSGu8M2G2_Byte7 MAIN_MSGu8MCU_McuEnableSts MAIN_MSGu8MCU_McuPrevSlipFlg MAIN_MSGu8MCU_PwrActvMod MAIN_MSGu8McuActvDischgFlt MAIN_MSGu8McuBusUVFlt MAIN_MSGu8McuCANComFlt MAIN_MSGu8McuDcHVCurSensFlt MAIN_MSGu8McuDTC MAIN_MSGu8MCUF1_RC MAIN_MSGu8MCUF2_RC MAIN_MSGu8MCUF2_State MAIN_MSGu8MCUF3_RC MAIN_MSGu8MCUF4_CtrlerTmpRaw MAIN_MSGu8MCUF4_MotTempRaw MAIN_MSGu8MCUF4_RC MAIN_MSGu8MCUF6_FaultCode MAIN_MSGu8MCUF6_FaultLmpReq MAIN_MSGu8MCUF6_MotorSta MAIN_MSGu8MCUF6_OBDLmpReq MAIN_MSGu8MCUF6_RC MAIN_MSGu8MCUF6_TotalFaultNum MAIN_MSGu8MCUF8_HV_VoltFree MAIN_MSGu8MCUF8_HWVer MAIN_MSGu8MCUF8_RC MAIN_MSGu8MCUF8_RTM_OverCur MAIN_MSGu8MCUF8_RTM_OverTmpEM MAIN_MSGu8MCUF8_RTM_OverTmpMCU MAIN_MSGu8MCUF8_RTMOverSpd MAIN_MSGu8MCUF8_RTMWarnComm MAIN_MSGu8MCUF8_SWMajorVer MAIN_MSGu8MCUF8_SWMinorVer MAIN_MSGu8MCUF8_VehicleType MAIN_MSGu8MCUF_Cali1 MAIN_MSGu8MCUF_Cali1[0] MAIN_MSGu8MCUF_Cali1[1] MAIN_MSGu8MCUF_Cali1[2] MAIN_MSGu8MCUF_Cali1[3] MAIN_MSGu8MCUF_Cali1[4] MAIN_MSGu8MCUF_Cali1[5] MAIN_MSGu8MCUF_Cali1[6] MAIN_MSGu8MCUF_Cali1[7] MAIN_MSGu8MCUF_Cali2 MAIN_MSGu8MCUF_Cali2[0] MAIN_MSGu8MCUF_Cali2[1] MAIN_MSGu8MCUF_Cali2[2] MAIN_MSGu8MCUF_Cali2[3] MAIN_MSGu8MCUF_Cali2[4] MAIN_MSGu8MCUF_Cali2[5] MAIN_MSGu8MCUF_Cali2[6] MAIN_MSGu8MCUF_Cali2[7] MAIN_MSGu8MCUF_Cali3 MAIN_MSGu8MCUF_Cali3[0] MAIN_MSGu8MCUF_Cali3[1] MAIN_MSGu8MCUF_Cali3[2] MAIN_MSGu8MCUF_Cali3[3] MAIN_MSGu8MCUF_Cali3[4] MAIN_MSGu8MCUF_Cali3[5] MAIN_MSGu8MCUF_Cali3[6] MAIN_MSGu8MCUF_Cali3[7] MAIN_MSGu8MCUF_Cali4 MAIN_MSGu8MCUF_Cali4[0] MAIN_MSGu8MCUF_Cali4[1] MAIN_MSGu8MCUF_Cali4[2] MAIN_MSGu8MCUF_Cali4[3] MAIN_MSGu8MCUF_Cali4[4] MAIN_MSGu8MCUF_Cali4[5] MAIN_MSGu8MCUF_Cali4[6] MAIN_MSGu8MCUF_Cali4[7] MAIN_MSGu8McuHardMajorVer MAIN_MSGu8McuHardMinorVer MAIN_MSGu8McuHVLoopFlt MAIN_MSGu8McuHwCapOVFlt MAIN_MSGu8McuIgbtFlt MAIN_MSGu8McuInvtTempSensErr MAIN_MSGu8McuLVVoltFlt MAIN_MSGu8McuMemoryFlt MAIN_MSGu8McuMotLockRotErr MAIN_MSGu8McuMotSN MAIN_MSGu8McuMotSpdHighAlarm MAIN_MSGu8McuMotSubFltLevel MAIN_MSGu8McuMotSysOVCAlarm MAIN_MSGu8McuMotTempHighAlarm MAIN_MSGu8McuMotTempSensErr MAIN_MSGu8MCUR_Cali MAIN_MSGu8MCUR_Cali[0] MAIN_MSGu8MCUR_Cali[1] MAIN_MSGu8MCUR_Cali[2] MAIN_MSGu8MCUR_Cali[3] MAIN_MSGu8MCUR_Cali[4] MAIN_MSGu8MCUR_Cali[5] MAIN_MSGu8MCUR_Cali[6] MAIN_MSGu8MCUR_Cali[7] MAIN_MSGu8McuResolverFlt MAIN_MSGu8McuSoftCapOVFlt MAIN_MSGu8McuSoftMajorVer MAIN_MSGu8McuSoftMinorVer MAIN_MSGu8McuTempHighAlarm MAIN_MSGu8McuUCurSensFlt MAIN_MSGu8McuVCurSensFlt MAIN_MSGu8McuWCurSensFlt MAIN_MSGu8PDCM10_actualGear MAIN_MSGu8PDCM10_authResult MAIN_MSGu8PDCM10_driveMode MAIN_MSGu8PDCM10_DriveReady MAIN_MSGu8PDCM10_EVMode_Sta MAIN_MSGu8PDCM10_targetGear MAIN_MSGu8PDCM21_HVCO_MFStaCmd MAIN_MSGu8PDCM22_HVCO_StaCmdMR MAIN_MSGu8PDCM24_ClutchCmd MAIN_MSGu8PDCM24_HVCO_EmgShutdnReq MAIN_MSGu8PDCM5_AWCAssemblyStatus MAIN_MSGu8PDCM5_ChargeReq MAIN_MSGu8PDCM5_ChargeSpeedUnit MAIN_MSGu8PDCM5_ChargeSpeedValid MAIN_MSGu8PDCM5_ChargeState MAIN_MSGu8PDCM5_HVCM_ChgSta MAIN_MSGu8PDCM5_RestchargingTimeValid MAIN_MSGu8PDCM5_VehicleHoldReq MAIN_MSGu8PDCM_ACU_EPSacu_crashOputStsVld MAIN_MSGu8PDCM_ACU_EPSacu_crashOutputSts MAIN_MSGu8PDCM_GCU_StaCmd MAIN_MSGu8PDCM_IC_ACUEPBS_BrakeSwInfo MAIN_MSGu8PDCM_IC_ACUEPBS_FaultLamp MAIN_MSGu8PDCM_IC_ACUEPBS_Sts MAIN_MSGu8PDCM_IC_ACULgtAValSts MAIN_MSGu8PwModOffCnt MAIN_MSGu8PwModOnCnt MAIN_MSGu8Tbox_OTAEnergyCtl MAIN_MSGu8Tbox_vehicleMode MAIN_MSGu8TCU1_ClutchSta MAIN_MSGu8TCU1_CrankAuthEn MAIN_MSGu8TCU1_RC MAIN_MSGu8TCU2_FaultReactReq MAIN_MSGu8TCU2_RC MAIN_MSGu8TCU3_AirFlowReqRaw MAIN_MSGu8TCU3_FaultLmpReq MAIN_MSGu8TCU3_OBDLmpReq MAIN_MSGu8TCU3_RC MAIN_MSGu8TCU3_TransFluidTmpRaw MAIN_MSGu8TCU_ClutchProgress MAIN_MSGu8VCU_AccPedPosRaw MAIN_MSGu8VCU_EMWorkMod MAIN_MSGu8VCU_ePTReady MAIN_MSGu8VCU_HandBrakSts MAIN_MSGu8VCU_McuEnableReq MAIN_s16BldcHallDirFdb MAIN_s32DeltTimDiff MAIN_s32Email2PosTreqDiff MAIN_s32PosA2BDeltTime MAIN_s32PosA2BDeltTimMax MAIN_s32PosA2BDeltTimMin MAIN_TCUf32CAP_AvrgCurrentPhys MAIN_TCUf32CAP_DutyCyclePhys MAIN_TCUf32CAP_MotSpeedPhys MAIN_TCUf32CAP_TargetDutyCyclePhys MAIN_TCUu8CAP_TargetMotSts MAIN_TotalTime MAIN_u16AntiSsBrakTimCnt MAIN_u16AntiSsEnaBrakCnt MAIN_u16AntiSsValidCnt MAIN_u16BldcIbatAdcV01 MAIN_u16BldcIbatAdcVR0 MAIN_u16BldcOilPressAdc MAIN_u16BldcOilTempAdc MAIN_u16BrakRelsDelayCnt MAIN_u16Cnt100 MAIN_u16Cnt1000 MAIN_u16Cnt20 MAIN_u16Cnt2000 MAIN_u16Cnt30 MAIN_u16Cnt4 MAIN_u16Cnt50 MAIN_u16Cnt500 MAIN_u16FaultDelayCnt MAIN_u16FpgaFltClrCnt MAIN_u16HandBrkRelsDelay MAIN_u16IdqDeltaSumCnt MAIN_u16IuCycleCnt MAIN_u16IuMiddleCnt MAIN_u16IuMiddleSum MAIN_u16IuNegtiveCnt MAIN_u16IuNegtiveSum MAIN_u16IuPositiveCnt MAIN_u16IuPositiveSum MAIN_u16MotorStallCnt MAIN_u16OverVolHighDelay MAIN_u16OverVolLowDelay MAIN_u16OverVolMidDelay MAIN_u16PWMPeriodVal MAIN_u16RandomNum MAIN_u16ResCosADVal MAIN_u16ResSinADVal MAIN_u16SlopSlideTimCnt MAIN_u16SlopSpdConfirmCnt MAIN_u16SpdReadyEstCnt MAIN_u16T12CntVal MAIN_u16TeachInWrtDelayCnt MAIN_u16VadcBhv MAIN_u16VadcPhaseCurU MAIN_u16VadcPhaseCurV MAIN_u16VadcPhaseCurW MAIN_u32BldcDeltTime MAIN_u32BldcPattnTreatCnt MAIN_u32BldcPwmTreatCnt MAIN_u32BldcTimStampA MAIN_u32BldcTimStampB MAIN_u32EmailCkreq MAIN_u32EmailPosATimeStamp MAIN_u32IuCycleTim MAIN_u32PosATimeStamp MAIN_u32PosBTimeStamp MAIN_u32PosTreatCkreq MAIN_u32TestVar2 MAIN_u32TestVar4 MAIN_u32WaitValueVSISafeTreatment MAIN_u32WaitValueVSITreatment MAIN_u8BldcFaultLevel MAIN_u8BldcHallStt MAIN_u8BldcHallSttPre MAIN_u8BldcMotDir MAIN_u8ErrCodNum MAIN_u8ErrCodRdIdx MAIN_u8ErrCodWrIdx MAIN_u8FaultSum MAIN_u8OcState MAIN_u8OcStsRptDelayCnt MAIN_u8OverVolIndex MAIN_u8PrevGearPos MAIN_u8TcFaultCodeL3 MAIN_u8TcFaultCodeL5 MAIN_u8TestVar1 MAIN_u8UdsSwVerSup MAIN_u8UdsSwVerSup[0] MAIN_u8UdsSwVerSup[10] MAIN_u8UdsSwVerSup[11] MAIN_u8UdsSwVerSup[12] MAIN_u8UdsSwVerSup[13] MAIN_u8UdsSwVerSup[14] MAIN_u8UdsSwVerSup[15] MAIN_u8UdsSwVerSup[16] MAIN_u8UdsSwVerSup[17] MAIN_u8UdsSwVerSup[18] MAIN_u8UdsSwVerSup[19] MAIN_u8UdsSwVerSup[1] MAIN_u8UdsSwVerSup[20] MAIN_u8UdsSwVerSup[2] MAIN_u8UdsSwVerSup[3] MAIN_u8UdsSwVerSup[4] MAIN_u8UdsSwVerSup[5] MAIN_u8UdsSwVerSup[6] MAIN_u8UdsSwVerSup[7] MAIN_u8UdsSwVerSup[8] MAIN_u8UdsSwVerSup[9] MAIN_u8UdsSwVerVeh MAIN_u8UdsSwVerVeh[0] MAIN_u8UdsSwVerVeh[10] MAIN_u8UdsSwVerVeh[11] MAIN_u8UdsSwVerVeh[12] MAIN_u8UdsSwVerVeh[1] MAIN_u8UdsSwVerVeh[2] MAIN_u8UdsSwVerVeh[3] MAIN_u8UdsSwVerVeh[4] MAIN_u8UdsSwVerVeh[5] MAIN_u8UdsSwVerVeh[6] MAIN_u8UdsSwVerVeh[7] MAIN_u8UdsSwVerVeh[8] MAIN_u8UdsSwVerVeh[9] MAIN_VSITxsPwmUl MAIN_VSITxsPwmUlOn MAIN_VSITxsPwmUr MAIN_VSITxsPwmUrOn MAIN_VSITxsPwmVl MAIN_VSITxsPwmVlOn MAIN_VSITxsPwmVr MAIN_VSITxsPwmVrOn MAIN_VSITxsPwmWl MAIN_VSITxsPwmWlOn MAIN_VSITxsPwmWr MAIN_VSITxsPwmWrOn Os_Task_BackGround_Counter Os_Task_Idle_Counter /end OUT_MEASUREMENT
/end FUNCTION
/begin FUNCTION RES ""
 /begin DEF_CHARACTERISTIC RES_bGenerateSyncPosC RES_u16ExcitDelayC RES_u16SyncDelayC RES_u16VSICkreqPeriodDefC RES_u8ExcitDutyPercentC RES_u8SyncDutyPercentC /end DEF_CHARACTERISTIC
/end FUNCTION
/begin RECORD_LAYOUT Scalar_BOOLEAN FNC_VALUES 1 UBYTE COLUMN_DIR DIRECT /end RECORD_LAYOUT
/begin COMPU_METHOD CM_T_BOOLEAN "Q = V" RAT_FUNC "%1.0" "Bool" COEFFS 0 1 0 0 0 1 /end COMPU_METHOD
/* EOF SWIN.a2l */
/begin RECORD_LAYOUT Scalar_BOOLEAN FNC_VALUES 1 UBYTE COLUMN_DIR DIRECT /end RECORD_LAYOUT
/begin COMPU_METHOD CM_T_BOOLEAN "Q = V" RAT_FUNC "%1.0" "Bool" COEFFS 0 1 0 0 0 1 /end COMPU_METHOD
/* EOF TAMD.a2l */
/begin RECORD_LAYOUT Scalar_BOOLEAN FNC_VALUES 1 UBYTE COLUMN_DIR DIRECT /end RECORD_LAYOUT
/begin COMPU_METHOD CM_T_BOOLEAN "Q = V" RAT_FUNC "%1.0" "Bool" COEFFS 0 1 0 0 0 1 /end COMPU_METHOD
/* EOF TCFC.a2l */
/begin RECORD_LAYOUT Scalar_BOOLEAN FNC_VALUES 1 UBYTE COLUMN_DIR DIRECT /end RECORD_LAYOUT
/begin COMPU_METHOD CM_T_BOOLEAN "Q = V" RAT_FUNC "%1.0" "Bool" COEFFS 0 1 0 0 0 1 /end COMPU_METHOD
/* EOF TCFR.a2l */
/begin RECORD_LAYOUT Scalar_BOOLEAN FNC_VALUES 1 UBYTE COLUMN_DIR DIRECT /end RECORD_LAYOUT
/begin COMPU_METHOD CM_T_BOOLEAN "Q = V" RAT_FUNC "%1.0" "Bool" COEFFS 0 1 0 0 0 1 /end COMPU_METHOD
/* EOF TCMD.a2l */
/begin RECORD_LAYOUT Scalar_BOOLEAN FNC_VALUES 1 UBYTE COLUMN_DIR DIRECT /end RECORD_LAYOUT
/begin COMPU_METHOD CM_T_BOOLEAN "Q = V" RAT_FUNC "%1.0" "Bool" COEFFS 0 1 0 0 0 1 /end COMPU_METHOD
/* EOF TCPD.a2l */
/begin RECORD_LAYOUT Scalar_BOOLEAN FNC_VALUES 1 UBYTE COLUMN_DIR DIRECT /end RECORD_LAYOUT
/begin COMPU_METHOD CM_T_BOOLEAN "Q = V" RAT_FUNC "%1.0" "Bool" COEFFS 0 1 0 0 0 1 /end COMPU_METHOD
/* EOF TLMD.a2l */
/begin RECORD_LAYOUT Scalar_BOOLEAN FNC_VALUES 1 UBYTE COLUMN_DIR DIRECT /end RECORD_LAYOUT
/begin COMPU_METHOD CM_T_BOOLEAN "Q = V" RAT_FUNC "%1.0" "Bool" COEFFS 0 1 0 0 0 1 /end COMPU_METHOD
/* EOF TOTD.a2l */
/begin RECORD_LAYOUT Scalar_BOOLEAN FNC_VALUES 1 UBYTE COLUMN_DIR DIRECT /end RECORD_LAYOUT
/begin COMPU_METHOD CM_T_BOOLEAN "Q = V" RAT_FUNC "%1.0" "Bool" COEFFS 0 1 0 0 0 1 /end COMPU_METHOD
/* EOF TSPC.a2l */
/begin RECORD_LAYOUT Scalar_BOOLEAN FNC_VALUES 1 UBYTE COLUMN_DIR DIRECT /end RECORD_LAYOUT
/begin COMPU_METHOD CM_T_BOOLEAN "Q = V" RAT_FUNC "%1.0" "Bool" COEFFS 0 1 0 0 0 1 /end COMPU_METHOD
/* EOF TSSD.a2l */
/begin RECORD_LAYOUT Scalar_BOOLEAN FNC_VALUES 1 UBYTE COLUMN_DIR DIRECT /end RECORD_LAYOUT
/begin COMPU_METHOD CM_T_BOOLEAN "Q = V" RAT_FUNC "%1.0" "Bool" COEFFS 0 1 0 0 0 1 /end COMPU_METHOD
/* EOF V5RD.a2l */
/begin RECORD_LAYOUT Scalar_BOOLEAN FNC_VALUES 1 UBYTE COLUMN_DIR DIRECT /end RECORD_LAYOUT
/begin COMPU_METHOD CM_T_BOOLEAN "Q = V" RAT_FUNC "%1.0" "Bool" COEFFS 0 1 0 0 0 1 /end COMPU_METHOD
/end MODULE
/end PROJECT
