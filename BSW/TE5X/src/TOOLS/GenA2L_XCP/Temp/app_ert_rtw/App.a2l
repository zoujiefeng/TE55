ASAP2_VERSION 1 31
/begin PROJECT ProjectName "Project Comment Goes Here"
/begin HEADER "Header Comments go here" /end HEADER
/begin MODULE ModuleName "Module Comment Goes Here"
/begin MOD_COMMON "Mod Common Comment Here" BYTE_ORDER MSB_FIRST /end MOD_COMMON
/begin RECORD_LAYOUT Scalar_BOOLEAN FNC_VALUES 1 UBYTE COLUMN_DIR DIRECT /end RECORD_LAYOUT
/begin RECORD_LAYOUT Scalar_UBYTE FNC_VALUES 1 UBYTE COLUMN_DIR DIRECT /end RECORD_LAYOUT
/begin RECORD_LAYOUT Scalar_UWORD FNC_VALUES 1 UWORD COLUMN_DIR DIRECT /end RECORD_LAYOUT
/begin RECORD_LAYOUT Scalar_SWORD FNC_VALUES 1 SWORD COLUMN_DIR DIRECT /end RECORD_LAYOUT
/begin RECORD_LAYOUT Lookup1D_WORD FNC_VALUES 1 SWORD COLUMN_DIR DIRECT /end RECORD_LAYOUT
/begin RECORD_LAYOUT Lookup1D_X_WORD AXIS_PTS_X 1 SWORD INDEX_INCR DIRECT /end RECORD_LAYOUT
/begin RECORD_LAYOUT Lookup1D_ULONG FNC_VALUES 1 ULONG COLUMN_DIR DIRECT /end RECORD_LAYOUT
/begin RECORD_LAYOUT Lookup1D_X_ULONG AXIS_PTS_X 1 ULONG INDEX_INCR DIRECT /end RECORD_LAYOUT
/begin RECORD_LAYOUT Lookup1D_SLONG FNC_VALUES 1 SLONG COLUMN_DIR DIRECT /end RECORD_LAYOUT
/begin RECORD_LAYOUT Lookup1D_X_LONG AXIS_PTS_X 1 SLONG INDEX_INCR DIRECT /end RECORD_LAYOUT
/begin RECORD_LAYOUT Lookup1D_FLOAT32_IEEE FNC_VALUES 1 FLOAT32_IEEE COLUMN_DIR DIRECT /end RECORD_LAYOUT
/begin RECORD_LAYOUT Lookup1D_X_FLOAT32_IEEE AXIS_PTS_X 1 FLOAT32_IEEE INDEX_INCR DIRECT /end RECORD_LAYOUT
/begin RECORD_LAYOUT Lookup1D_FLOAT64_IEEE FNC_VALUES 1 FLOAT64_IEEE COLUMN_DIR DIRECT /end RECORD_LAYOUT
/begin RECORD_LAYOUT Lookup1D_X_FLOAT64_IEEE AXIS_PTS_X 1 FLOAT64_IEEE INDEX_INCR DIRECT /end RECORD_LAYOUT
/begin RECORD_LAYOUT Lookup2D_UBYTE FNC_VALUES 1 UBYTE COLUMN_DIR DIRECT /end RECORD_LAYOUT
/begin RECORD_LAYOUT Lookup2D_X_UBYTE AXIS_PTS_X 1 UBYTE INDEX_INCR DIRECT /end RECORD_LAYOUT
/begin RECORD_LAYOUT Lookup2D_BYTE FNC_VALUES 1 SBYTE COLUMN_DIR DIRECT /end RECORD_LAYOUT
/begin RECORD_LAYOUT Lookup2D_X_BYTE AXIS_PTS_X 1 SBYTE INDEX_INCR DIRECT /end RECORD_LAYOUT
/begin RECORD_LAYOUT Lookup2D_ULONG FNC_VALUES 1 ULONG COLUMN_DIR DIRECT /end RECORD_LAYOUT
/begin RECORD_LAYOUT Lookup2D_X_ULONG AXIS_PTS_X 1 ULONG INDEX_INCR DIRECT /end RECORD_LAYOUT
/begin RECORD_LAYOUT Lookup2D_LONG FNC_VALUES 1 SLONG COLUMN_DIR DIRECT /end RECORD_LAYOUT
/begin RECORD_LAYOUT Lookup2D_X_LONG AXIS_PTS_X 1 SLONG INDEX_INCR DIRECT /end RECORD_LAYOUT
/begin RECORD_LAYOUT Lookup2D_FLOAT32_IEEE FNC_VALUES 1 FLOAT32_IEEE COLUMN_DIR DIRECT /end RECORD_LAYOUT
/begin RECORD_LAYOUT Lookup2D_X_FLOAT32_IEEE AXIS_PTS_X 1 FLOAT32_IEEE INDEX_INCR DIRECT /end RECORD_LAYOUT
/begin RECORD_LAYOUT Lookup2D_FLOAT64_IEEE FNC_VALUES 1 FLOAT64_IEEE COLUMN_DIR DIRECT /end RECORD_LAYOUT
/begin RECORD_LAYOUT Lookup2D_X_FLOAT64_IEEE AXIS_PTS_X 1 FLOAT64_IEEE INDEX_INCR DIRECT /end RECORD_LAYOUT
/begin CHARACTERISTIC CANDke_Cnt_ID_VCU_DiagCounts "Number of diagnostic cycles before reporting PASS to DEM." VALUE 0x0000 /* @ECU_Address@CANDke_Cnt_ID_VCU_DiagCounts@ */ Scalar_UWORD 0 CM_T_Cnt_Num_1_1_u16 0.0 65535.0 /end CHARACTERISTIC
/begin CHARACTERISTIC CANDke_Cnt_VCUFAULT_DiagCounts "Diagagnostic evaluations before PASS" VALUE 0x0000 /* @ECU_Address@CANDke_Cnt_VCUFAULT_DiagCounts@ */ Scalar_UWORD 0 CM_T_Cnt_Num_1_1_u16 0.0 65535.0 /end CHARACTERISTIC
/begin CHARACTERISTIC CANDke_r_ID_VCU_RatioToFail "Number of failed cycles before reporting FAIL to DEM. As a ratio of CANDke_Cnt_ID_VCU_DiagCounts." VALUE 0x0000 /* @ECU_Address@CANDke_r_ID_VCU_RatioToFail@ */ Scalar_UWORD 0 CM_T_r_NA_256_1_u16 0.0 1.0 EXTENDED_LIMITS 0.0 255.99609375 /end CHARACTERISTIC
/begin CHARACTERISTIC CANDke_r_VCUFAULT_RatioToFail "Number of failed diagnostic evaluations before FAIL. As a ratio to CANDke_Cnt_VCUFAULT_DiagCounts." VALUE 0x0000 /* @ECU_Address@CANDke_r_VCUFAULT_RatioToFail@ */ Scalar_UWORD 0 CM_T_r_NA_256_1_u16 0.0 1.0 EXTENDED_LIMITS 0.0 255.99609375 /end CHARACTERISTIC
/begin CHARACTERISTIC CANDie_y_HTCU_Fault_OV "Override value for the HTCU_Fault signal." VALUE 0x0000 /* @ECU_Address@CANDie_y_HTCU_Fault_OV@ */ Scalar_UBYTE 0 CM_T_y_BitField8 0.0 255.0 /end CHARACTERISTIC
/begin CHARACTERISTIC CANDie_y_HTCU_State_OV "Override value for the HTCU_State signal." VALUE 0x0000 /* @ECU_Address@CANDie_y_HTCU_State_OV@ */ Scalar_UBYTE 0 CM_T_y_BitField8 0.0 1.0 EXTENDED_LIMITS 0.0 255.0 /end CHARACTERISTIC
/begin CHARACTERISTIC CANDke_Cnt_CtrlMon_10ms_Index "This is the index reported to the control flow function. It should be unique and in the correct order of execution according to the scheduler." VALUE 0x0000 /* @ECU_Address@CANDke_Cnt_CtrlMon_10ms_Index@ */ Scalar_UBYTE 0 CM_T_Cnt_Num_1_1_u8 0.0 255.0 /end CHARACTERISTIC
/begin CHARACTERISTIC CANDke_Cnt_ID_ClutchCmdMaxLim "Maximum allowed value for the clutch command data." VALUE 0x0000 /* @ECU_Address@CANDke_Cnt_ID_ClutchCmdMaxLim@ */ Scalar_UBYTE 0 CM_T_Cnt_Num_1_1_u8 0.0 255.0 /end CHARACTERISTIC
/begin CHARACTERISTIC CANDke_Cnt_ID_ClutchCmdMinLim "Minimum allowed value for the clutch command data." VALUE 0x0000 /* @ECU_Address@CANDke_Cnt_ID_ClutchCmdMinLim@ */ Scalar_UBYTE 0 CM_T_Cnt_Num_1_1_u8 0.0 255.0 /end CHARACTERISTIC
/begin CHARACTERISTIC CANDke_Cnt_VCUFAULT_FaultLim "If bit 6-7 typecast into a number is greater or equal to this value a fault shall be detected." VALUE 0x0000 /* @ECU_Address@CANDke_Cnt_VCUFAULT_FaultLim@ */ Scalar_UBYTE 0 CM_T_Cnt_Num_1_1_u8 0.0 255.0 /end CHARACTERISTIC
/begin CHARACTERISTIC CANDke_y_BitPat_CCPClear "Bit pattern for ForceOilLubricationToSafeLubricationMode" VALUE 0x0000 /* @ECU_Address@CANDke_y_BitPat_CCPClear@ */ Scalar_UBYTE 0 CM_T_y_BitField8 0.0 255.0 /end CHARACTERISTIC
/begin CHARACTERISTIC CANDke_y_BitPat_CutFuel "bitpattern" VALUE 0x0000 /* @ECU_Address@CANDke_y_BitPat_CutFuel@ */ Scalar_UBYTE 0 CM_T_y_BitField8 0 255 /end CHARACTERISTIC
/begin CHARACTERISTIC CANDke_y_BitPat_EngStop "bitpattern" VALUE 0x0000 /* @ECU_Address@CANDke_y_BitPat_EngStop@ */ Scalar_UBYTE 0 CM_T_y_BitField8 0 255 /end CHARACTERISTIC
/begin CHARACTERISTIC CANDke_y_BitPat_FCNGear "bitpattern" VALUE 0x0000 /* @ECU_Address@CANDke_y_BitPat_FCNGear@ */ Scalar_UBYTE 0 CM_T_y_BitField8 0 255 /end CHARACTERISTIC
/begin CHARACTERISTIC CANDke_y_BitPat_FCOO "Bitpattern for ForceClutchOddOpen" VALUE 0x0000 /* @ECU_Address@CANDke_y_BitPat_FCOO@ */ Scalar_UBYTE 0 CM_T_y_BitField8 0.0 255.0 /end CHARACTERISTIC
/begin CHARACTERISTIC CANDke_y_BitPat_FCOOnorecover "bitpattern" VALUE 0x0000 /* @ECU_Address@CANDke_y_BitPat_FCOOnorecover@ */ Scalar_UBYTE 0 CM_T_y_BitField8 0 255 /end CHARACTERISTIC
/begin CHARACTERISTIC CANDke_y_BitPat_FICTO "Bitpattern for ForceIOCControlToOff" VALUE 0x0000 /* @ECU_Address@CANDke_y_BitPat_FICTO@ */ Scalar_UBYTE 0 CM_T_y_BitField8 0.0 255.0 /end CHARACTERISTIC
/begin CHARACTERISTIC CANDke_y_BitPat_FOCTSCM "Bit pattern for ForceOilCoolingToSafeCoolingMode" VALUE 0x0000 /* @ECU_Address@CANDke_y_BitPat_FOCTSCM@ */ Scalar_UBYTE 0 CM_T_y_BitField8 0.0 255.0 /end CHARACTERISTIC
/begin CHARACTERISTIC CANDke_y_BitPat_HTCU_State "Value for HTCU_State when any of the inputs are TRUE." VALUE 0x0000 /* @ECU_Address@CANDke_y_BitPat_HTCU_State@ */ Scalar_UBYTE 0 CM_T_y_BitField8 0.0 255.0 /end CHARACTERISTIC
/begin CHARACTERISTIC CANDke_y_BitPat_LimitCapability "bitpattern" VALUE 0x0000 /* @ECU_Address@CANDke_y_BitPat_LimitCapability@ */ Scalar_UBYTE 0 CM_T_y_BitField8 0 255 /end CHARACTERISTIC
/begin CHARACTERISTIC CANDke_y_BitPat_LimitSpeed "bitpattern" VALUE 0x0000 /* @ECU_Address@CANDke_y_BitPat_LimitSpeed@ */ Scalar_UBYTE 0 CM_T_y_BitField8 0 255 /end CHARACTERISTIC
/begin CHARACTERISTIC CANDke_y_BitPat_OilTempCrit "Bit pattern for high oil temperature critical signal." VALUE 0x0000 /* @ECU_Address@CANDke_y_BitPat_OilTempCrit@ */ Scalar_UBYTE 0 CM_T_y_BitField8 0.0 255.0 /end CHARACTERISTIC
/begin CHARACTERISTIC CANDke_y_BitPat_OilTempWarn "Bit pattern for high oil temperature warning signal." VALUE 0x0000 /* @ECU_Address@CANDke_y_BitPat_OilTempWarn@ */ Scalar_UBYTE 0 CM_T_y_BitField8 0.0 255.0 /end CHARACTERISTIC
/begin CHARACTERISTIC CANDie_b_ATFailure_OB "Override boolean for ATFaliure" VALUE 0x0000 /* @ECU_Address@CANDie_b_ATFailure_OB@ */ Scalar_BOOLEAN 0 CM_T_BOOLEAN 0.0 1.0 /end CHARACTERISTIC
/begin CHARACTERISTIC CANDie_b_ATFailure_OV "Override value for ATFaliure" VALUE 0x0000 /* @ECU_Address@CANDie_b_ATFailure_OV@ */ Scalar_BOOLEAN 0 CM_T_BOOLEAN 0.0 1.0 /end CHARACTERISTIC
/begin CHARACTERISTIC CANDie_b_CtrlMon_10ms_BlockReport "This override blocks the report of the execution to the monitoring system.
      Should be used during testing to verify correct behaviour of the monitoring system.
      " VALUE 0x0000 /* @ECU_Address@CANDie_b_CtrlMon_10ms_BlockReport@ */ Scalar_BOOLEAN 0 CM_T_BOOLEAN 0.0 1.0 /end CHARACTERISTIC
/begin CHARACTERISTIC CANDie_b_HTCU_Fault_OB "Override boolean for the HTCU_Fault signal." VALUE 0x0000 /* @ECU_Address@CANDie_b_HTCU_Fault_OB@ */ Scalar_BOOLEAN 0 CM_T_BOOLEAN 0.0 1.0 /end CHARACTERISTIC
/begin CHARACTERISTIC CANDie_b_HTCU_State_OB "Override boolean for the HTCU_State signal." VALUE 0x0000 /* @ECU_Address@CANDie_b_HTCU_State_OB@ */ Scalar_BOOLEAN 0 CM_T_BOOLEAN 0.0 1.0 /end CHARACTERISTIC
/begin CHARACTERISTIC CANDke_b_VCUFAULT_DiagEnbl "Enable boolean for the VCU internal fault diagnosis." VALUE 0x0000 /* @ECU_Address@CANDke_b_VCUFAULT_DiagEnbl@ */ Scalar_BOOLEAN 0 CM_T_BOOLEAN 0.0 1.0 /end CHARACTERISTIC
/begin CHARACTERISTIC CANDke_b_VCU_ID_DiagEnbl "Enable boolean for the invalid data diagnosis." VALUE 0x0000 /* @ECU_Address@CANDke_b_VCU_ID_DiagEnbl@ */ Scalar_BOOLEAN 0 CM_T_BOOLEAN 0.0 1.0 /end CHARACTERISTIC
/begin MEASUREMENT CANDve_Cnt_VCUFAULT_FailLim "Fail limit" UWORD CM_T_Cnt_Num_1_1_u16 0 0 0 65535 ECU_ADDRESS 0x0000 /* @ECU_Address@CANDve_Cnt_VCUFAULT_FailLim@ */ /end MEASUREMENT
/begin MEASUREMENT CANDve_Cnt_ID_FailLim "Fail limit for the invalid data diagnosis." UWORD CM_T_Cnt_Num_1_1_u16 0 0 0 65535 ECU_ADDRESS 0x0000 /* @ECU_Address@CANDve_Cnt_ID_FailLim@ */ /end MEASUREMENT
/begin MEASUREMENT CANDve_y_ResetByBSW "ResetByBSW event status" UBYTE CM_T_y_BitField8 0 0 0 255 ECU_ADDRESS 0x0000 /* @ECU_Address@CANDve_y_ResetByBSW@ */ /end MEASUREMENT
/begin MEASUREMENT CANDve_y_ResetByASW "ResetByASW event status" UBYTE CM_T_y_BitField8 0 0 0 255 ECU_ADDRESS 0x0000 /* @ECU_Address@CANDve_y_ResetByASW@ */ /end MEASUREMENT
/begin MEASUREMENT CANDve_y_ResetByHW "ResetByHW event status" UBYTE CM_T_y_BitField8 0 0 0 255 ECU_ADDRESS 0x0000 /* @ECU_Address@CANDve_y_ResetByHW@ */ /end MEASUREMENT
/begin MEASUREMENT CANDve_y_XCPBusOff "XCPBusOFF event status" UBYTE CM_T_y_BitField8 0 0 0 255 ECU_ADDRESS 0x0000 /* @ECU_Address@CANDve_y_XCPBusOff@ */ /end MEASUREMENT
/begin MEASUREMENT CANDve_b_VCUFAULT_FaultFound "A fault has been detected on the VCU" UBYTE CM_T_BOOLEAN 0 0 0 1 ECU_ADDRESS 0x0000 /* @ECU_Address@CANDve_b_VCUFAULT_FaultFound@ */ /end MEASUREMENT
/begin MEASUREMENT CANDve_b_ID_NotEqual "TRUE if the CAN signal and SWIN conversion does not match." UBYTE CM_T_BOOLEAN 0 0 0 1 ECU_ADDRESS 0x0000 /* @ECU_Address@CANDve_b_ID_NotEqual@ */ /end MEASUREMENT
/begin MEASUREMENT CANDve_b_ID_SWINsigOutOfRange "TRUE if the SWIN signal is outside accepted range." UBYTE CM_T_BOOLEAN 0 0 0 1 ECU_ADDRESS 0x0000 /* @ECU_Address@CANDve_b_ID_SWINsigOutOfRange@ */ /end MEASUREMENT
/begin MEASUREMENT CANDve_b_ID_CANsigOutOfRange "TRUE if the CAN signal is outside accepted range." UBYTE CM_T_BOOLEAN 0 0 0 1 ECU_ADDRESS 0x0000 /* @ECU_Address@CANDve_b_ID_CANsigOutOfRange@ */ /end MEASUREMENT
/begin MEASUREMENT CANDve_b_ID_FaultFound "TRUE if an invalid data fault has been found." UBYTE CM_T_BOOLEAN 0 0 0 1 ECU_ADDRESS 0x0000 /* @ECU_Address@CANDve_b_ID_FaultFound@ */ /end MEASUREMENT
/begin COMPU_METHOD CM_T_Cnt_Num_1_1_u16 "Q = V" RAT_FUNC "%5.0" "Num (counts)" COEFFS 0 1 0 0 0 1 /end COMPU_METHOD
/begin COMPU_METHOD CM_T_r_NA_256_1_u16 "Q = V*256.000000" RAT_FUNC "%11.8" "NA (none)" COEFFS 0 256 0 0 0 1 /end COMPU_METHOD
/begin COMPU_METHOD CM_T_y_BitField8 "Q = V" RAT_FUNC "%3.0" "BitField" COEFFS 0 1 0 0 0 1 /end COMPU_METHOD
/begin COMPU_METHOD CM_T_Cnt_Num_1_1_u8 "Q = V" RAT_FUNC "%3.0" "Num (counts)" COEFFS 0 1 0 0 0 1 /end COMPU_METHOD
/begin COMPU_METHOD CM_T_BOOLEAN "Q = V" RAT_FUNC "%1.0" "Bool" COEFFS 0 1 0 0 0 1 /end COMPU_METHOD
/* (add any file trailer comments here) */ /* EOF CAND.a2l */
/begin RECORD_LAYOUT Scalar_BOOLEAN FNC_VALUES 1 UBYTE COLUMN_DIR DIRECT /end RECORD_LAYOUT
/begin RECORD_LAYOUT Scalar_UBYTE FNC_VALUES 1 UBYTE COLUMN_DIR DIRECT /end RECORD_LAYOUT
/begin RECORD_LAYOUT Scalar_BYTE FNC_VALUES 1 SBYTE COLUMN_DIR DIRECT /end RECORD_LAYOUT
/begin RECORD_LAYOUT Scalar_UWORD FNC_VALUES 1 UWORD COLUMN_DIR DIRECT /end RECORD_LAYOUT
/begin RECORD_LAYOUT Scalar_SWORD FNC_VALUES 1 SWORD COLUMN_DIR DIRECT /end RECORD_LAYOUT
/begin RECORD_LAYOUT Scalar_LONG FNC_VALUES 1 SLONG COLUMN_DIR DIRECT /end RECORD_LAYOUT
/begin RECORD_LAYOUT Scalar_FLOAT64_IEEE FNC_VALUES 1 FLOAT64_IEEE COLUMN_DIR DIRECT /end RECORD_LAYOUT
/begin RECORD_LAYOUT Lookup1D_BYTE FNC_VALUES 1 SBYTE COLUMN_DIR DIRECT /end RECORD_LAYOUT
/begin RECORD_LAYOUT Lookup1D_X_BYTE AXIS_PTS_X 1 SBYTE INDEX_INCR DIRECT /end RECORD_LAYOUT
/begin RECORD_LAYOUT Lookup1D_X_UBYTE AXIS_PTS_X 1 UBYTE INDEX_INCR DIRECT /end RECORD_LAYOUT
/begin RECORD_LAYOUT Lookup1D_WORD FNC_VALUES 1 SWORD COLUMN_DIR DIRECT /end RECORD_LAYOUT
/begin RECORD_LAYOUT Lookup1D_X_WORD AXIS_PTS_X 1 SWORD INDEX_INCR DIRECT /end RECORD_LAYOUT
/begin RECORD_LAYOUT Lookup1D_ULONG FNC_VALUES 1 ULONG COLUMN_DIR DIRECT /end RECORD_LAYOUT
/begin RECORD_LAYOUT Lookup1D_X_ULONG AXIS_PTS_X 1 ULONG INDEX_INCR DIRECT /end RECORD_LAYOUT
/begin RECORD_LAYOUT Lookup1D_SLONG FNC_VALUES 1 SLONG COLUMN_DIR DIRECT /end RECORD_LAYOUT
/begin RECORD_LAYOUT Lookup1D_X_LONG AXIS_PTS_X 1 SLONG INDEX_INCR DIRECT /end RECORD_LAYOUT
/begin RECORD_LAYOUT Lookup1D_FLOAT32_IEEE FNC_VALUES 1 FLOAT32_IEEE COLUMN_DIR DIRECT /end RECORD_LAYOUT
/begin RECORD_LAYOUT Lookup1D_X_FLOAT32_IEEE AXIS_PTS_X 1 FLOAT32_IEEE INDEX_INCR DIRECT /end RECORD_LAYOUT
/begin RECORD_LAYOUT Lookup1D_FLOAT64_IEEE FNC_VALUES 1 FLOAT64_IEEE COLUMN_DIR DIRECT /end RECORD_LAYOUT
/begin RECORD_LAYOUT Lookup1D_X_FLOAT64_IEEE AXIS_PTS_X 1 FLOAT64_IEEE INDEX_INCR DIRECT /end RECORD_LAYOUT
/begin RECORD_LAYOUT Lookup2D_UBYTE FNC_VALUES 1 UBYTE COLUMN_DIR DIRECT /end RECORD_LAYOUT
/begin RECORD_LAYOUT Lookup2D_X_UBYTE AXIS_PTS_X 1 UBYTE INDEX_INCR DIRECT /end RECORD_LAYOUT
/begin RECORD_LAYOUT Lookup2D_BYTE FNC_VALUES 1 SBYTE COLUMN_DIR DIRECT /end RECORD_LAYOUT
/begin RECORD_LAYOUT Lookup2D_X_BYTE AXIS_PTS_X 1 SBYTE INDEX_INCR DIRECT /end RECORD_LAYOUT
/begin RECORD_LAYOUT Lookup2D_ULONG FNC_VALUES 1 ULONG COLUMN_DIR DIRECT /end RECORD_LAYOUT
/begin RECORD_LAYOUT Lookup2D_X_ULONG AXIS_PTS_X 1 ULONG INDEX_INCR DIRECT /end RECORD_LAYOUT
/begin RECORD_LAYOUT Lookup2D_LONG FNC_VALUES 1 SLONG COLUMN_DIR DIRECT /end RECORD_LAYOUT
/begin RECORD_LAYOUT Lookup2D_X_LONG AXIS_PTS_X 1 SLONG INDEX_INCR DIRECT /end RECORD_LAYOUT
/begin RECORD_LAYOUT Lookup2D_FLOAT32_IEEE FNC_VALUES 1 FLOAT32_IEEE COLUMN_DIR DIRECT /end RECORD_LAYOUT
/begin RECORD_LAYOUT Lookup2D_X_FLOAT32_IEEE AXIS_PTS_X 1 FLOAT32_IEEE INDEX_INCR DIRECT /end RECORD_LAYOUT
/begin RECORD_LAYOUT Lookup2D_FLOAT64_IEEE FNC_VALUES 1 FLOAT64_IEEE COLUMN_DIR DIRECT /end RECORD_LAYOUT
/begin RECORD_LAYOUT Lookup2D_X_FLOAT64_IEEE AXIS_PTS_X 1 FLOAT64_IEEE INDEX_INCR DIRECT /end RECORD_LAYOUT
/begin CHARACTERISTIC CCAPie_e_ClutchState_ov "Override value." VALUE 0x0000 /* @ECU_Address@CCAPie_e_ClutchState_ov@ */ Scalar_UBYTE 0 CM_CCAPte_e_ClutchState 0 4 EXTENDED_LIMITS 0 0 /end CHARACTERISTIC
/begin CHARACTERISTIC CCAPie_e_EvenClutchState_ov "Override value." VALUE 0x0000 /* @ECU_Address@CCAPie_e_EvenClutchState_ov@ */ Scalar_UBYTE 0 CM_CCAPte_e_ClutchState 0 4 EXTENDED_LIMITS 0 0 /end CHARACTERISTIC
/begin CHARACTERISTIC CCAPie_e_OddClutchState_ov "Override value." VALUE 0x0000 /* @ECU_Address@CCAPie_e_OddClutchState_ov@ */ Scalar_UBYTE 0 CM_CCAPte_e_ClutchState 0 4 EXTENDED_LIMITS 0 0 /end CHARACTERISTIC
/begin CHARACTERISTIC CCAPie_p_ReturnSpringEven_ov "Override value." VALUE 0x0000 /* @ECU_Address@CCAPie_p_ReturnSpringEven_ov@ */ Scalar_SWORD 0 CM_T_p_kPa_1_1_s16 0.0 300.0 EXTENDED_LIMITS -32768.0 32767.0 /end CHARACTERISTIC
/begin CHARACTERISTIC CCAPie_p_ReturnSpringOdd_ov "Override value." VALUE 0x0000 /* @ECU_Address@CCAPie_p_ReturnSpringOdd_ov@ */ Scalar_SWORD 0 CM_T_p_kPa_1_1_s16 0.0 300.0 EXTENDED_LIMITS -32768.0 32767.0 /end CHARACTERISTIC
/begin CHARACTERISTIC CCAPke_n_DeadBand "Deadband (from zero diff speed) calibration used in clutch temperature model algo." VALUE 0x0000 /* @ECU_Address@CCAPke_n_DeadBand@ */ Scalar_SWORD 0 CM_T_n_rpm_1_1_s16 0.0 1000.0 EXTENDED_LIMITS -32768.0 32767.0 /end CHARACTERISTIC
/begin CHARACTERISTIC CCAPke_p_ReturnSpringEven "Pressure required to overwin the pre-load force of the return spring (clutch kisspoint)." VALUE 0x0000 /* @ECU_Address@CCAPke_p_ReturnSpringEven@ */ Scalar_SWORD 0 CM_T_p_kPa_1_1_s16 0.0 300.0 EXTENDED_LIMITS -32768.0 32767.0 /end CHARACTERISTIC
/begin CHARACTERISTIC CCAPke_p_ReturnSpringOdd "Pressure required to overwin the pre-load force of the return spring (clutch kisspoint)." VALUE 0x0000 /* @ECU_Address@CCAPke_p_ReturnSpringOdd@ */ Scalar_SWORD 0 CM_T_p_kPa_1_1_s16 0.0 300.0 EXTENDED_LIMITS -32768.0 32767.0 /end CHARACTERISTIC
/begin CHARACTERISTIC CCAPke_rpm_ClutchClosedSlipHystLSP "Hysterisis left switching point for determining clutch as closed." VALUE 0x0000 /* @ECU_Address@CCAPke_rpm_ClutchClosedSlipHystLSP@ */ Scalar_SWORD 0 CM_T_n_rpm_1_1_s16 0.0 500.0 EXTENDED_LIMITS -32768.0 32767.0 /end CHARACTERISTIC
/begin CHARACTERISTIC CCAPke_rpm_ClutchClosedSlipHystRSP "Hysterisis right switching point for determining clutch as closed." VALUE 0x0000 /* @ECU_Address@CCAPke_rpm_ClutchClosedSlipHystRSP@ */ Scalar_SWORD 0 CM_T_n_rpm_1_1_s16 0.0 500.0 EXTENDED_LIMITS -32768.0 32767.0 /end CHARACTERISTIC
/begin CHARACTERISTIC CCAPke_Cnt_ClutchOpenDebounceSamples "Debounce samples for determining clutch to be open." VALUE 0x0000 /* @ECU_Address@CCAPke_Cnt_ClutchOpenDebounceSamples@ */ Scalar_UWORD 0 CM_T_Cnt_Num_1_1_u16 0.0 1000.0 EXTENDED_LIMITS 0.0 65535.0 /end CHARACTERISTIC
/begin CHARACTERISTIC CCAPke_Cnt_ClutchSlippingDebounceSamples "Number of debounce samples for determining clutch to be slipping." VALUE 0x0000 /* @ECU_Address@CCAPke_Cnt_ClutchSlippingDebounceSamples@ */ Scalar_UWORD 0 CM_T_Cnt_Num_1_1_u16 0.0 1000.0 EXTENDED_LIMITS 0.0 65535.0 /end CHARACTERISTIC
/begin CHARACTERISTIC CCAPke_rho_OilDensity "Lube oil density." VALUE 0x0000 /* @ECU_Address@CCAPke_rho_OilDensity@ */ Scalar_UWORD 0 CM_T_K_NA_1_1_u16 0.0 2000.0 EXTENDED_LIMITS 0.0 65535.0 /end CHARACTERISTIC
/begin CHARACTERISTIC CCAPie_M_EstClchTrnsfTrq_ov "Override value." VALUE 0x0000 /* @ECU_Address@CCAPie_M_EstClchTrnsfTrq_ov@ */ Scalar_SWORD 0 CM_T_M_Nm_32_1_s16 -1023.0 1023.0 EXTENDED_LIMITS -1024.0 1023.96875 /end CHARACTERISTIC
/begin CHARACTERISTIC CCAPie_M_InstantaneousCapabilityOdd_Offset "" VALUE 0x0000 /* @ECU_Address@CCAPie_M_InstantaneousCapabilityOdd_Offset@ */ Scalar_SWORD 0 CM_T_M_Nm_32_1_s16 -1024.0 1023.96875 /end CHARACTERISTIC
/begin CHARACTERISTIC CCAPie_M_OddClutchMaxTransferTorque_Offset "Offset for throughput of nominal functionality.
      Shall be set to 0 for production intent SW
      " VALUE 0x0000 /* @ECU_Address@CCAPie_M_OddClutchMaxTransferTorque_Offset@ */ Scalar_SWORD 0 CM_T_M_Nm_32_1_s16 -1024.0 1023.96875 /end CHARACTERISTIC
/begin CHARACTERISTIC CCAPke_M_MaxInstantaneousCapabilityOdd "" VALUE 0x0000 /* @ECU_Address@CCAPke_M_MaxInstantaneousCapabilityOdd@ */ Scalar_SWORD 0 CM_T_M_Nm_32_1_s16 -1024.0 1023.96875 /end CHARACTERISTIC
/begin CHARACTERISTIC CCAPke_M_MaxTransferTorqueOdd "" VALUE 0x0000 /* @ECU_Address@CCAPke_M_MaxTransferTorqueOdd@ */ Scalar_SWORD 0 CM_T_M_Nm_32_1_s16 0.0 1023.96875 EXTENDED_LIMITS -1024.0 1023.96875 /end CHARACTERISTIC
/begin CHARACTERISTIC CCAPke_M_MaxTransferTorqueOddRampDown "" VALUE 0x0000 /* @ECU_Address@CCAPke_M_MaxTransferTorqueOddRampDown@ */ Scalar_SWORD 0 CM_T_M_Nm_32_1_s16 -1024.0 0.03125 EXTENDED_LIMITS -1024.0 1023.96875 /end CHARACTERISTIC
/begin CHARACTERISTIC CCAPke_M_MaxTransferTorqueOddRampUp "" VALUE 0x0000 /* @ECU_Address@CCAPke_M_MaxTransferTorqueOddRampUp@ */ Scalar_SWORD 0 CM_T_M_Nm_32_1_s16 0.03125 1023.96875 EXTENDED_LIMITS -1024.0 1023.96875 /end CHARACTERISTIC
/begin CHARACTERISTIC CCAPke_M_MinInstantaneousCapabilityOdd "" VALUE 0x0000 /* @ECU_Address@CCAPke_M_MinInstantaneousCapabilityOdd@ */ Scalar_SWORD 0 CM_T_M_Nm_32_1_s16 -1024.0 1023.96875 /end CHARACTERISTIC
/begin CHARACTERISTIC CCAPie_r_InstantaneousCapabilityOdd_Scaling "" VALUE 0x0000 /* @ECU_Address@CCAPie_r_InstantaneousCapabilityOdd_Scaling@ */ Scalar_SWORD 0 CM_T_r_NA_1024_1_s16 -32.0 31.9990234375 /end CHARACTERISTIC
/begin CHARACTERISTIC CCAPie_r_OddClutchMaxTransferTorque_Scaling "Scaling for throughput of nominal functionality.
      Shall be set to 1 for production intent SW
      " VALUE 0x0000 /* @ECU_Address@CCAPie_r_OddClutchMaxTransferTorque_Scaling@ */ Scalar_SWORD 0 CM_T_r_NA_1024_1_s16 -32.0 31.9990234375 /end CHARACTERISTIC
/begin CHARACTERISTIC CCAPke_m_ClutchWeightEven "Summed weight of the friction plates and clutch plates in the clutch." VALUE 0x0000 /* @ECU_Address@CCAPke_m_ClutchWeightEven@ */ Scalar_SWORD 0 CM_T_m_kg_1024_1_s16 0.0 30.0 EXTENDED_LIMITS -32.0 31.9990234375 /end CHARACTERISTIC
/begin CHARACTERISTIC CCAPke_m_ClutchWeightOdd "Summed weight of the friction plates and clutch plates in the odd clutch." VALUE 0x0000 /* @ECU_Address@CCAPke_m_ClutchWeightOdd@ */ Scalar_SWORD 0 CM_T_m_kg_1024_1_s16 0.0 30.0 EXTENDED_LIMITS -32.0 31.9990234375 /end CHARACTERISTIC
/begin CHARACTERISTIC CCAPie_T_EvenClutchTemp_ov "Override value." VALUE 0x0000 /* @ECU_Address@CCAPie_T_EvenClutchTemp_ov@ */ Scalar_SWORD 0 CM_T_T_degC_16_1_s16 -100.0 1000.0 EXTENDED_LIMITS -2048.0 2047.9375 /end CHARACTERISTIC
/begin CHARACTERISTIC CCAPie_T_OddClutchTemp_ov "Override value." VALUE 0x0000 /* @ECU_Address@CCAPie_T_OddClutchTemp_ov@ */ Scalar_SWORD 0 CM_T_T_degC_16_1_s16 -100.0 1000.0 EXTENDED_LIMITS -2048.0 2047.9375 /end CHARACTERISTIC
/begin CHARACTERISTIC CCAPke_T_ClutchTempMax "This is the maximum value that will be used for calculation of clutch temperature." VALUE 0x0000 /* @ECU_Address@CCAPke_T_ClutchTempMax@ */ Scalar_SWORD 0 CM_T_T_degC_16_1_s16 -500.0 2000.0 EXTENDED_LIMITS -2048.0 2047.9375 /end CHARACTERISTIC
/begin CHARACTERISTIC CCAPke_T_ClutchTempMin "This is the minimum value that will be used for calculation of clutch temperature." VALUE 0x0000 /* @ECU_Address@CCAPke_T_ClutchTempMin@ */ Scalar_SWORD 0 CM_T_T_degC_16_1_s16 -500.0 2000.0 EXTENDED_LIMITS -2048.0 2047.9375 /end CHARACTERISTIC
/begin CHARACTERISTIC CCAPke_c_ClutchSpecificHeatCapacity "Specific heat capacity of the clutch (kJ/kg/K). The term \"clutch\" is in this instance mainly referring to the clutch plates. The plates consist of a steel core, coated with an \"organic\" material." VALUE 0x0000 /* @ECU_Address@CCAPke_c_ClutchSpecificHeatCapacity@ */ Scalar_UWORD 0 CM_T_K_NA_1024_1_u16 0.0 1.0 EXTENDED_LIMITS 0.0 63.9990234375 /end CHARACTERISTIC
/begin CHARACTERISTIC CCAPke_c_OilSpecificHeatCapacity "Specific heat capacity for the transmission oil (kJ/kg/K)." VALUE 0x0000 /* @ECU_Address@CCAPke_c_OilSpecificHeatCapacity@ */ Scalar_UWORD 0 CM_T_K_NA_1024_1_u16 0.0 4.0 EXTENDED_LIMITS 0.0 63.9990234375 /end CHARACTERISTIC
/begin CHARACTERISTIC CCAPke_t_FilterTimeConstant "Time constant for filtration of P1 speed derivative." VALUE 0x0000 /* @ECU_Address@CCAPke_t_FilterTimeConstant@ */ Scalar_SWORD 0 CM_T_t_s_1000_1_s16 0.01 0.1 EXTENDED_LIMITS -32.768 32.767 /end CHARACTERISTIC
/begin CHARACTERISTIC CCAPke_t_dt "Execution time period of this SWU." VALUE 0x0000 /* @ECU_Address@CCAPke_t_dt@ */ Scalar_SWORD 0 CM_T_t_s_1000_1_s16 0.001 1.0 EXTENDED_LIMITS -32.768 32.767 /end CHARACTERISTIC
/begin CHARACTERISTIC CCAPke_J_P1Total "Total moment of inertia for P1 axle." VALUE 0x0000 /* @ECU_Address@CCAPke_J_P1Total@ */ Scalar_UWORD 0 CM_T_J_kgpm2_128_1_u16 0.0 10.0 EXTENDED_LIMITS 0.0 511.9921875 /end CHARACTERISTIC
/begin CHARACTERISTIC CCAPke_r_SmoothSwitchRate "This calibration affects ramping rate in a ramping function that ramps the estimated clutch transferred torque upon detection of system state changes (closed or slipping clutch etc.).
      
      Ramping time = Task execution rate/ThisCal
      " VALUE 0x0000 /* @ECU_Address@CCAPke_r_SmoothSwitchRate@ */ Scalar_SWORD 0 CM_T_r_NA_16384_1_s16 0.0 1.0 EXTENDED_LIMITS -2.0 1.99993896484375 /end CHARACTERISTIC
/begin CHARACTERISTIC CCAPie_M_EstClchTrnsfTrq_ob "Enables override." VALUE 0x0000 /* @ECU_Address@CCAPie_M_EstClchTrnsfTrq_ob@ */ Scalar_BOOLEAN 0 CM_T_BOOLEAN 0.0 1.0 /end CHARACTERISTIC
/begin CHARACTERISTIC CCAPie_T_EvenClutchTemp_ob "Enables override." VALUE 0x0000 /* @ECU_Address@CCAPie_T_EvenClutchTemp_ob@ */ Scalar_BOOLEAN 0 CM_T_BOOLEAN 0.0 1.0 /end CHARACTERISTIC
/begin CHARACTERISTIC CCAPie_T_OddClutchTemp_ob "Enables override." VALUE 0x0000 /* @ECU_Address@CCAPie_T_OddClutchTemp_ob@ */ Scalar_BOOLEAN 0 CM_T_BOOLEAN 0.0 1.0 /end CHARACTERISTIC
/begin CHARACTERISTIC CCAPie_b_ClutchState_ob "Enables override." VALUE 0x0000 /* @ECU_Address@CCAPie_b_ClutchState_ob@ */ Scalar_BOOLEAN 0 CM_T_BOOLEAN 0.0 1.0 /end CHARACTERISTIC
/begin CHARACTERISTIC CCAPie_b_EvenClutchState_ob "Enables override." VALUE 0x0000 /* @ECU_Address@CCAPie_b_EvenClutchState_ob@ */ Scalar_BOOLEAN 0 CM_T_BOOLEAN 0.0 1.0 /end CHARACTERISTIC
/begin CHARACTERISTIC CCAPie_b_OddClutchState_ob "Enables override." VALUE 0x0000 /* @ECU_Address@CCAPie_b_OddClutchState_ob@ */ Scalar_BOOLEAN 0 CM_T_BOOLEAN 0.0 1.0 /end CHARACTERISTIC
/begin CHARACTERISTIC CCAPie_p_ReturnSpringEven_ob "Enables override." VALUE 0x0000 /* @ECU_Address@CCAPie_p_ReturnSpringEven_ob@ */ Scalar_BOOLEAN 0 CM_T_BOOLEAN 0.0 1.0 /end CHARACTERISTIC
/begin CHARACTERISTIC CCAPie_p_ReturnSpringOdd_ob "Enables override." VALUE 0x0000 /* @ECU_Address@CCAPie_p_ReturnSpringOdd_ob@ */ Scalar_BOOLEAN 0 CM_T_BOOLEAN 0.0 1.0 /end CHARACTERISTIC
/begin CHARACTERISTIC CCAPke_b_MaxTransferTorqueFastStepDownToReq "This enables fast step down of the available torque to the requested torque, instead of ramping from a possible much higher value" VALUE 0x0000 /* @ECU_Address@CCAPke_b_MaxTransferTorqueFastStepDownToReq@ */ Scalar_BOOLEAN 0 CM_T_BOOLEAN 0.0 1.0 /end CHARACTERISTIC
/begin CHARACTERISTIC CCAPke_b_Use1stOrderFilter "Enables the use of a first order filter in the calculation of P1 speed derivative." VALUE 0x0000 /* @ECU_Address@CCAPke_b_Use1stOrderFilter@ */ Scalar_BOOLEAN 0 CM_T_BOOLEAN 0.0 1.0 /end CHARACTERISTIC
/begin CHARACTERISTIC CCAPke_b_UseKissPointAdaption "Uses kiss point adaption value from CLCP instead of internal CCAP calibration value for Odd clutch" VALUE 0x0000 /* @ECU_Address@CCAPke_b_UseKissPointAdaption@ */ Scalar_BOOLEAN 0 CM_T_BOOLEAN 0.0 1.0 /end CHARACTERISTIC
/begin CHARACTERISTIC CCAPke_b_UseMedianFilter "Enables the use of a 3-median filter in the calculation of P1 speed derivative." VALUE 0x0000 /* @ECU_Address@CCAPke_b_UseMedianFilter@ */ Scalar_BOOLEAN 0 CM_T_BOOLEAN 0.0 1.0 /end CHARACTERISTIC
/begin MEASUREMENT CCAPve_n_ClutchRotationalSpeed "Clutch input rotational speed" SWORD CM_T_p_kPa_1_1_s16 0 0 -32000.0 32000.0 ECU_ADDRESS 0x0000 /* @ECU_Address@CCAPve_n_ClutchRotationalSpeed@ */ /end MEASUREMENT
/begin MEASUREMENT CCAPve_dn_P1 "P1 (engine crankshaft) speed derivative." SWORD CM_T_dn_rpmps_1_1_s16 0 0 -32000.0 32000.0 ECU_ADDRESS 0x0000 /* @ECU_Address@CCAPve_dn_P1@ */ /end MEASUREMENT
/begin MEASUREMENT CCAPve_M_InstantaneousCapabilityEven "Instantaneous clutch torque capability, given the current clutch hydraulic pressure." SWORD CM_T_M_Nm_32_1_s16 0 0 0.0 1023.0 ECU_ADDRESS 0x0000 /* @ECU_Address@CCAPve_M_InstantaneousCapabilityEven@ */ /end MEASUREMENT
/begin MEASUREMENT CCAPve_M_P1IncludingInertiaAtClutch "Total P1 torque including inertia (at Clutch)" SWORD CM_T_M_Nm_32_1_s16 0 0 -1024.0 1023.96875 ECU_ADDRESS 0x0000 /* @ECU_Address@CCAPve_M_P1IncludingInertiaAtClutch@ */ /end MEASUREMENT
/begin MEASUREMENT CCAPve_M_OddClutchMaxTransferTorqueRaw "" SWORD CM_T_M_Nm_32_1_s16 0 0 0.0 1023.96875 ECU_ADDRESS 0x0000 /* @ECU_Address@CCAPve_M_OddClutchMaxTransferTorqueRaw@ */ /end MEASUREMENT
/begin MEASUREMENT CCAPva_P_ClutchCoolingEffect "The power of which the lube flow is cooling the clutches." SWORD CM_T_P_kW_128_1_s16 0 0 0.0 255.0 ARRAY_SIZE 2 ECU_ADDRESS 0x0000 /* @ECU_Address@CCAPva_P_ClutchCoolingEffect@ */ /end MEASUREMENT
/begin MEASUREMENT CCAPva_P_ClutchSlipHeatingEffect "Heat contribution due to slipping clutch." SWORD CM_T_P_kW_128_1_s16 0 0 0.0 255.0 ARRAY_SIZE 2 ECU_ADDRESS 0x0000 /* @ECU_Address@CCAPva_P_ClutchSlipHeatingEffect@ */ /end MEASUREMENT
/begin MEASUREMENT CCAPve_M_TransferredTorqueTO_DmnOdd "Estimated clutch transferred torque in Trans Output domain (after gearing but before final drive)." SWORD CM_T_M_Nm_16_1_s16 0 0 -2047.0 2047.0 ECU_ADDRESS 0x0000 /* @ECU_Address@CCAPve_M_TransferredTorqueTO_DmnOdd@ */ /end MEASUREMENT
/begin MEASUREMENT CCAPve_M_TransferredTorqueTO_DmnEven "Estimated clutch transferred torque in Trans Output domain (after gearing but before final drive)." SWORD CM_T_M_Nm_16_1_s16 0 0 -2047.0 2047.0 ECU_ADDRESS 0x0000 /* @ECU_Address@CCAPve_M_TransferredTorqueTO_DmnEven@ */ /end MEASUREMENT
/begin MEASUREMENT CCAPve_M_TransferredTorqueTO_Dmn "Estimated summed clutch transferred torque in Trans Output domain (after gearing but before final drive)." SWORD CM_T_M_Nm_16_1_s16 0 0 -2047.0 2047.0 ECU_ADDRESS 0x0000 /* @ECU_Address@CCAPve_M_TransferredTorqueTO_Dmn@ */ /end MEASUREMENT
/begin MEASUREMENT CCAPva_M_TransferredTorquesUnramped "Clutch transferred torque array (Odd, Even). These values come from the state machine and are non-ramped." SWORD CM_T_M_Nm_32_1_s16 0 0 -1023.0 1023.0 ARRAY_SIZE 2 ECU_ADDRESS 0x0000 /* @ECU_Address@CCAPva_M_TransferredTorquesUnramped@ */ /end MEASUREMENT
/begin MEASUREMENT CCAPva_M_TransferredTorques "Estimated clutch transferred torques after ramping function, odd and even respectively." SWORD CM_T_M_Nm_32_1_s16 0 0 -1023.0 1023.0 ARRAY_SIZE 2 ECU_ADDRESS 0x0000 /* @ECU_Address@CCAPva_M_TransferredTorques@ */ /end MEASUREMENT
/begin MEASUREMENT CCAPva_T_ClutchTemperatures "Modeled clutch temperatures." SWORD CM_T_T_degC_16_1_s16 0 0 -100.0 1000.0 ARRAY_SIZE 2 ECU_ADDRESS 0x0000 /* @ECU_Address@CCAPva_T_ClutchTemperatures@ */ /end MEASUREMENT
/begin COMPU_METHOD CM_CCAPte_e_ClutchState "Enumerated data type: CCAPte_e_ClutchState" TAB_VERB "%0.6" "" COMPU_TAB_REF VTAB_FOR_CM_CCAPte_e_ClutchState /end COMPU_METHOD
/begin COMPU_VTAB VTAB_FOR_CM_CCAPte_e_ClutchState "Enumerated data type: CCAPte_e_ClutchState" TAB_VERB 5 0 "CCAPce_e_ClutchUndefined" 1 "CCAPce_e_ClutchOpen" 2 "CCAPce_e_ClutchClosed" 3 "CCAPce_e_ClutchSlipping" 4 "CCAPce_e_ClutchSynchronize" /end COMPU_VTAB
/begin COMPU_METHOD CM_T_p_kPa_1_1_s16 "Q = V" RAT_FUNC "%5.0" "kPa (kiloPascals  (kPa))" COEFFS 0 1 0 0 0 1 /end COMPU_METHOD
/begin COMPU_METHOD CM_T_n_rpm_1_1_s16 "Q = V" RAT_FUNC "%5.0" "rpm (revolutions / minute  (rpm))" COEFFS 0 1 0 0 0 1 /end COMPU_METHOD
/begin COMPU_METHOD CM_T_Cnt_Num_1_1_u16 "Q = V" RAT_FUNC "%5.0" "Num (counts)" COEFFS 0 1 0 0 0 1 /end COMPU_METHOD
/begin COMPU_METHOD CM_T_K_NA_1_1_u16 "Q = V" RAT_FUNC "%5.0" "NA (dependent upon the gain)" COEFFS 0 1 0 0 0 1 /end COMPU_METHOD
/begin COMPU_METHOD CM_T_M_Nm_32_1_s16 "Q = V*32.000000" RAT_FUNC "%9.5" "Nm (newton-meters  (Nm))" COEFFS 0 32 0 0 0 1 /end COMPU_METHOD
/begin COMPU_METHOD CM_T_r_NA_1024_1_s16 "Q = V*1024.000000" RAT_FUNC "%12.10" "NA (none)" COEFFS 0 1024 0 0 0 1 /end COMPU_METHOD
/begin COMPU_METHOD CM_T_m_kg_1024_1_s16 "Q = V*1024.000000" RAT_FUNC "%12.10" "kg (kilograms  (kg))" COEFFS 0 1024 0 0 0 1 /end COMPU_METHOD
/begin COMPU_METHOD CM_T_T_degC_16_1_s16 "Q = V*16.000000" RAT_FUNC "%8.4" "degC (degrees Celsius  (deg C))" COEFFS 0 16 0 0 0 1 /end COMPU_METHOD
/begin COMPU_METHOD CM_T_K_NA_1024_1_u16 "Q = V*1024.000000" RAT_FUNC "%12.10" "NA (dependent upon the gain)" COEFFS 0 1024 0 0 0 1 /end COMPU_METHOD
/begin COMPU_METHOD CM_T_t_s_1000_1_s16 "Q = V*1000.000000" RAT_FUNC "%0.6" "s (seconds  (s))" COEFFS 0 1000 0 0 0 1 /end COMPU_METHOD
/begin COMPU_METHOD CM_T_J_kgpm2_128_1_u16 "Q = V*128.000000" RAT_FUNC "%10.7" "kgpm2 (kilograms-square meters  (kg m2))" COEFFS 0 128 0 0 0 1 /end COMPU_METHOD
/begin COMPU_METHOD CM_T_r_NA_16384_1_s16 "Q = V*16384.000000" RAT_FUNC "%15.14" "NA (none)" COEFFS 0 16384 0 0 0 1 /end COMPU_METHOD
/begin COMPU_METHOD CM_T_BOOLEAN "Q = V" RAT_FUNC "%1.0" "Bool" COEFFS 0 1 0 0 0 1 /end COMPU_METHOD
/begin COMPU_METHOD CM_T_dn_rpmps_1_1_s16 "Q = V" RAT_FUNC "%5.0" "rpmps (revolutions / minute / second  (rpm/s))" COEFFS 0 1 0 0 0 1 /end COMPU_METHOD
/begin COMPU_METHOD CM_T_P_kW_128_1_s16 "Q = V*128.000000" RAT_FUNC "%10.7" "kW (kilowatts  (kW))" COEFFS 0 128 0 0 0 1 /end COMPU_METHOD
/begin COMPU_METHOD CM_T_M_Nm_16_1_s16 "Q = V*16.000000" RAT_FUNC "%8.4" "Nm (newton-meters  (Nm))" COEFFS 0 16 0 0 0 1 /end COMPU_METHOD
/* EOF CCAP.a2l */
/begin RECORD_LAYOUT Scalar_BOOLEAN FNC_VALUES 1 UBYTE COLUMN_DIR DIRECT /end RECORD_LAYOUT
/begin RECORD_LAYOUT Scalar_UBYTE FNC_VALUES 1 UBYTE COLUMN_DIR DIRECT /end RECORD_LAYOUT
/begin RECORD_LAYOUT Scalar_BYTE FNC_VALUES 1 SBYTE COLUMN_DIR DIRECT /end RECORD_LAYOUT
/begin RECORD_LAYOUT Scalar_UWORD FNC_VALUES 1 UWORD COLUMN_DIR DIRECT /end RECORD_LAYOUT
/begin RECORD_LAYOUT Scalar_SWORD FNC_VALUES 1 SWORD COLUMN_DIR DIRECT /end RECORD_LAYOUT
/begin RECORD_LAYOUT Scalar_LONG FNC_VALUES 1 SLONG COLUMN_DIR DIRECT /end RECORD_LAYOUT
/begin RECORD_LAYOUT Scalar_FLOAT64_IEEE FNC_VALUES 1 FLOAT64_IEEE COLUMN_DIR DIRECT /end RECORD_LAYOUT
/begin RECORD_LAYOUT Lookup1D_BYTE FNC_VALUES 1 SBYTE COLUMN_DIR DIRECT /end RECORD_LAYOUT
/begin RECORD_LAYOUT Lookup1D_X_BYTE AXIS_PTS_X 1 SBYTE INDEX_INCR DIRECT /end RECORD_LAYOUT
/begin RECORD_LAYOUT Lookup1D_X_UBYTE AXIS_PTS_X 1 UBYTE INDEX_INCR DIRECT /end RECORD_LAYOUT
/begin RECORD_LAYOUT Lookup1D_WORD FNC_VALUES 1 SWORD COLUMN_DIR DIRECT /end RECORD_LAYOUT
/begin RECORD_LAYOUT Lookup1D_X_WORD AXIS_PTS_X 1 SWORD INDEX_INCR DIRECT /end RECORD_LAYOUT
/begin RECORD_LAYOUT Lookup1D_ULONG FNC_VALUES 1 ULONG COLUMN_DIR DIRECT /end RECORD_LAYOUT
/begin RECORD_LAYOUT Lookup1D_X_ULONG AXIS_PTS_X 1 ULONG INDEX_INCR DIRECT /end RECORD_LAYOUT
/begin RECORD_LAYOUT Lookup1D_SLONG FNC_VALUES 1 SLONG COLUMN_DIR DIRECT /end RECORD_LAYOUT
/begin RECORD_LAYOUT Lookup1D_X_LONG AXIS_PTS_X 1 SLONG INDEX_INCR DIRECT /end RECORD_LAYOUT
/begin RECORD_LAYOUT Lookup1D_FLOAT32_IEEE FNC_VALUES 1 FLOAT32_IEEE COLUMN_DIR DIRECT /end RECORD_LAYOUT
/begin RECORD_LAYOUT Lookup1D_X_FLOAT32_IEEE AXIS_PTS_X 1 FLOAT32_IEEE INDEX_INCR DIRECT /end RECORD_LAYOUT
/begin RECORD_LAYOUT Lookup1D_FLOAT64_IEEE FNC_VALUES 1 FLOAT64_IEEE COLUMN_DIR DIRECT /end RECORD_LAYOUT
/begin RECORD_LAYOUT Lookup1D_X_FLOAT64_IEEE AXIS_PTS_X 1 FLOAT64_IEEE INDEX_INCR DIRECT /end RECORD_LAYOUT
/begin RECORD_LAYOUT Lookup2D_UBYTE FNC_VALUES 1 UBYTE COLUMN_DIR DIRECT /end RECORD_LAYOUT
/begin RECORD_LAYOUT Lookup2D_X_UBYTE AXIS_PTS_X 1 UBYTE INDEX_INCR DIRECT /end RECORD_LAYOUT
/begin RECORD_LAYOUT Lookup2D_BYTE FNC_VALUES 1 SBYTE COLUMN_DIR DIRECT /end RECORD_LAYOUT
/begin RECORD_LAYOUT Lookup2D_X_BYTE AXIS_PTS_X 1 SBYTE INDEX_INCR DIRECT /end RECORD_LAYOUT
/begin RECORD_LAYOUT Lookup2D_ULONG FNC_VALUES 1 ULONG COLUMN_DIR DIRECT /end RECORD_LAYOUT
/begin RECORD_LAYOUT Lookup2D_X_ULONG AXIS_PTS_X 1 ULONG INDEX_INCR DIRECT /end RECORD_LAYOUT
/begin RECORD_LAYOUT Lookup2D_LONG FNC_VALUES 1 SLONG COLUMN_DIR DIRECT /end RECORD_LAYOUT
/begin RECORD_LAYOUT Lookup2D_X_LONG AXIS_PTS_X 1 SLONG INDEX_INCR DIRECT /end RECORD_LAYOUT
/begin RECORD_LAYOUT Lookup2D_FLOAT32_IEEE FNC_VALUES 1 FLOAT32_IEEE COLUMN_DIR DIRECT /end RECORD_LAYOUT
/begin RECORD_LAYOUT Lookup2D_X_FLOAT32_IEEE AXIS_PTS_X 1 FLOAT32_IEEE INDEX_INCR DIRECT /end RECORD_LAYOUT
/begin RECORD_LAYOUT Lookup2D_FLOAT64_IEEE FNC_VALUES 1 FLOAT64_IEEE COLUMN_DIR DIRECT /end RECORD_LAYOUT
/begin RECORD_LAYOUT Lookup2D_X_FLOAT64_IEEE AXIS_PTS_X 1 FLOAT64_IEEE INDEX_INCR DIRECT /end RECORD_LAYOUT
/begin CHARACTERISTIC CLCOkt_M_OddInProgRampOnRateOld "Ramp in rate as function of old clutch torque, makes it possible to request toque faster after clutch is closed.
      
      Fix solution to engage gear faster in PHEV2 project where it is important to request 0.8 A when clutch is closed...
      " CURVE 0x0000 /* @ECU_Address@CLCOkt_M_OddInProgRampOnRateOld@ */ Lookup1D_WORD 0 CM_T_M_Nm_32_1_s16 0.0 100.0 EXTENDED_LIMITS -1024.0 1023.96875
 /begin AXIS_DESCR COM_AXIS CLCOve_M_A6 CM_T_M_Nm_32_1_s16 3 0.0 100.0 AXIS_PTS_REF CLCOkn_M_InProgRampRateOld /end AXIS_DESCR
/end CHARACTERISTIC
/begin AXIS_PTS CLCOkn_M_InProgRampRateOld "In progress state ramp rate previouse value." 0x0000 /* @ECU_Address@CLCOkn_M_InProgRampRateOld@ */ CLCOve_M_A6 Lookup1D_X_WORD 0 CM_T_M_Nm_32_1_s16 3 0.0 100.0 EXTENDED_LIMITS -1024.0 1023.96875 /end AXIS_PTS
/begin CHARACTERISTIC CLCOkt_M_OddInProgRampOnRate "Initial progress state ramp up rate odd clutch." CURVE 0x0000 /* @ECU_Address@CLCOkt_M_OddInProgRampOnRate@ */ Lookup1D_WORD 0 CM_T_M_Nm_32_1_s16 -100.0 1023.96875 EXTENDED_LIMITS -1024.0 1023.96875
 /begin AXIS_DESCR COM_AXIS NO_INPUT_QUANTITY CM_T_M_Nm_32_1_s16 7 -300.0 300.0 AXIS_PTS_REF CLCOkn_M_InProgRampRate /end AXIS_DESCR
/end CHARACTERISTIC
/begin AXIS_PTS CLCOkn_M_InProgRampRate "Initial progress state ramp rate axis." 0x0000 /* @ECU_Address@CLCOkn_M_InProgRampRate@ */ NO_INPUT_QUANTITY Lookup1D_X_WORD 0 CM_T_M_Nm_32_1_s16 7 -300.0 300.0 EXTENDED_LIMITS -1024.0 1023.96875 /end AXIS_PTS
/begin CHARACTERISTIC CLCOkt_M_OddInProgRampOffRate "Initial progress state ramp down rate odd clutch." CURVE 0x0000 /* @ECU_Address@CLCOkt_M_OddInProgRampOffRate@ */ Lookup1D_WORD 0 CM_T_M_Nm_32_1_s16 -100.0 100.0 EXTENDED_LIMITS -1024.0 1023.96875
 /begin AXIS_DESCR COM_AXIS NO_INPUT_QUANTITY CM_T_M_Nm_32_1_s16 7 -300.0 300.0 AXIS_PTS_REF CLCOkn_M_InProgRampRate /end AXIS_DESCR
/end CHARACTERISTIC
/begin CHARACTERISTIC CLCOkt_r_OddLaunchIGain "Odd clutch launch I-part gain." CURVE 0x0000 /* @ECU_Address@CLCOkt_r_OddLaunchIGain@ */ Lookup1D_WORD 0 CM_T_r_NA_16384_1_s16 0.0 1.9 EXTENDED_LIMITS -2.0 1.99993896484375
 /begin AXIS_DESCR COM_AXIS CLCOve_n_EvenSpeedError CM_T_n_rpm_1_1_s16 9 -6000.0 6000.0 AXIS_PTS_REF CLCOkn_n_SpeedError /end AXIS_DESCR
/end CHARACTERISTIC
/begin AXIS_PTS CLCOkn_n_SpeedError "Speed error axis." 0x0000 /* @ECU_Address@CLCOkn_n_SpeedError@ */ CLCOve_n_EvenSpeedError Lookup1D_X_WORD 0 CM_T_n_rpm_1_1_s16 9 -6000.0 6000.0 EXTENDED_LIMITS -32768.0 32767.0 /end AXIS_PTS
/begin CHARACTERISTIC CLCOkt_r_OddLaunchIGainTrq "Odd clutch launch I-gain in torque mode." CURVE 0x0000 /* @ECU_Address@CLCOkt_r_OddLaunchIGainTrq@ */ Lookup1D_WORD 0 CM_T_r_NA_16384_1_s16 0.0 1.9 EXTENDED_LIMITS -2.0 1.99993896484375
 /begin AXIS_DESCR COM_AXIS CLCOve_n_EvenSpeedError CM_T_n_rpm_1_1_s16 9 -6000.0 6000.0 AXIS_PTS_REF CLCOkn_n_SpeedError /end AXIS_DESCR
/end CHARACTERISTIC
/begin CHARACTERISTIC CLCOkt_r_OddLaunchPGain "Odd clutch P-part gain." CURVE 0x0000 /* @ECU_Address@CLCOkt_r_OddLaunchPGain@ */ Lookup1D_WORD 0 CM_T_r_NA_16384_1_s16 0.0 1.9 EXTENDED_LIMITS -2.0 1.99993896484375
 /begin AXIS_DESCR COM_AXIS CLCOve_n_EvenSpeedError CM_T_n_rpm_1_1_s16 9 -6000.0 6000.0 AXIS_PTS_REF CLCOkn_n_SpeedError /end AXIS_DESCR
/end CHARACTERISTIC
/begin CHARACTERISTIC CLCOkt_r_OddLaunchPGainTrq "Odd clutch P-gain in torque mode." CURVE 0x0000 /* @ECU_Address@CLCOkt_r_OddLaunchPGainTrq@ */ Lookup1D_WORD 0 CM_T_r_NA_16384_1_s16 0.0 1.9 EXTENDED_LIMITS -2.0 1.99993896484375
 /begin AXIS_DESCR COM_AXIS CLCOve_n_EvenSpeedError CM_T_n_rpm_1_1_s16 9 -6000.0 6000.0 AXIS_PTS_REF CLCOkn_n_SpeedError /end AXIS_DESCR
/end CHARACTERISTIC
/begin CHARACTERISTIC CLCOkt_r_OddLaunchDGain "Odd clutch D-part gain." CURVE 0x0000 /* @ECU_Address@CLCOkt_r_OddLaunchDGain@ */ Lookup1D_WORD 0 CM_T_r_NA_16384_1_s16 0.0 1.9 EXTENDED_LIMITS -2.0 1.99993896484375
 /begin AXIS_DESCR COM_AXIS CLCOve_n_EvenSpeedError CM_T_n_rpm_1_1_s16 9 -6000.0 6000.0 AXIS_PTS_REF CLCOkn_n_SpeedError /end AXIS_DESCR
/end CHARACTERISTIC
/begin CHARACTERISTIC CLCOkt_r_OddLaunchDGainTrq "Odd clutch D-gain in torque mode." CURVE 0x0000 /* @ECU_Address@CLCOkt_r_OddLaunchDGainTrq@ */ Lookup1D_WORD 0 CM_T_r_NA_16384_1_s16 0.0 1.9 EXTENDED_LIMITS -2.0 1.99993896484375
 /begin AXIS_DESCR COM_AXIS CLCOve_n_EvenSpeedError CM_T_n_rpm_1_1_s16 9 -6000.0 6000.0 AXIS_PTS_REF CLCOkn_n_SpeedError /end AXIS_DESCR
/end CHARACTERISTIC
/begin CHARACTERISTIC CLCOkt_M_OddPIDMinSaturation "Odd clutch min PID saturation." CURVE 0x0000 /* @ECU_Address@CLCOkt_M_OddPIDMinSaturation@ */ Lookup1D_WORD 0 CM_T_M_Nm_32_1_s16 -100.0 0.0 EXTENDED_LIMITS -1024.0 1023.96875
 /begin AXIS_DESCR COM_AXIS NO_INPUT_QUANTITY CM_T_M_Nm_32_1_s16 7 0.0 300.0 AXIS_PTS_REF CLCOkn_M_PIDSaturationIn /end AXIS_DESCR
/end CHARACTERISTIC
/begin AXIS_PTS CLCOkn_M_PIDSaturationIn "PID saturation torque axis." 0x0000 /* @ECU_Address@CLCOkn_M_PIDSaturationIn@ */ NO_INPUT_QUANTITY Lookup1D_X_WORD 0 CM_T_M_Nm_32_1_s16 7 0.0 300.0 EXTENDED_LIMITS -1024.0 1023.96875 /end AXIS_PTS
/begin CHARACTERISTIC CLCOkt_M_OddPIDMinSaturationTrq "Odd clutch min PID saturation in torque mode." CURVE 0x0000 /* @ECU_Address@CLCOkt_M_OddPIDMinSaturationTrq@ */ Lookup1D_WORD 0 CM_T_M_Nm_32_1_s16 -100.0 0.0 EXTENDED_LIMITS -1024.0 1023.96875
 /begin AXIS_DESCR COM_AXIS NO_INPUT_QUANTITY CM_T_M_Nm_32_1_s16 7 0.0 300.0 AXIS_PTS_REF CLCOkn_M_PIDSaturationInTrq /end AXIS_DESCR
/end CHARACTERISTIC
/begin AXIS_PTS CLCOkn_M_PIDSaturationInTrq "PID saturation torque in torque mode axis." 0x0000 /* @ECU_Address@CLCOkn_M_PIDSaturationInTrq@ */ NO_INPUT_QUANTITY Lookup1D_X_WORD 0 CM_T_M_Nm_32_1_s16 7 0.0 300.0 EXTENDED_LIMITS -1024.0 1023.96875 /end AXIS_PTS
/begin CHARACTERISTIC CLCOkt_M_OddPIDMaxSaturation "Odd clutch max PID saturation." CURVE 0x0000 /* @ECU_Address@CLCOkt_M_OddPIDMaxSaturation@ */ Lookup1D_WORD 0 CM_T_M_Nm_32_1_s16 0.0 400.0 EXTENDED_LIMITS -1024.0 1023.96875
 /begin AXIS_DESCR COM_AXIS NO_INPUT_QUANTITY CM_T_M_Nm_32_1_s16 7 0.0 300.0 AXIS_PTS_REF CLCOkn_M_PIDSaturationIn /end AXIS_DESCR
/end CHARACTERISTIC
/begin CHARACTERISTIC CLCOkt_M_OddPIDMaxSaturationTrq "Odd clutch max PID saturation in torque mode." CURVE 0x0000 /* @ECU_Address@CLCOkt_M_OddPIDMaxSaturationTrq@ */ Lookup1D_WORD 0 CM_T_M_Nm_32_1_s16 0.0 100.0 EXTENDED_LIMITS -1024.0 1023.96875
 /begin AXIS_DESCR COM_AXIS NO_INPUT_QUANTITY CM_T_M_Nm_32_1_s16 7 0.0 300.0 AXIS_PTS_REF CLCOkn_M_PIDSaturationInTrq /end AXIS_DESCR
/end CHARACTERISTIC
/begin CHARACTERISTIC CLCOkt_M_SpeedDiffOddClutchRampOnRate "This is the maximum ramp on rate for Odd clutch as a function of absolute speed difference for odd clutch" CURVE 0x0000 /* @ECU_Address@CLCOkt_M_SpeedDiffOddClutchRampOnRate@ */ Lookup1D_WORD 0 CM_T_M_Nm_32_1_s16 0.0 1023.96875 EXTENDED_LIMITS -1024.0 1023.96875
 /begin AXIS_DESCR COM_AXIS NO_INPUT_QUANTITY CM_T_n_rpm_1_1_s16 4 0.0 32767 AXIS_PTS_REF CLCOkn_n_SpeedDiffOddClutchRampOnRate /end AXIS_DESCR
/end CHARACTERISTIC
/begin AXIS_PTS CLCOkn_n_SpeedDiffOddClutchRampOnRate "This is the support points for absolute speed difference used by maximum ramp on rate for Odd clutch" 0x0000 /* @ECU_Address@CLCOkn_n_SpeedDiffOddClutchRampOnRate@ */ NO_INPUT_QUANTITY Lookup1D_X_WORD 0 CM_T_n_rpm_1_1_s16 4 0.0 32767 EXTENDED_LIMITS -32768.0 32767.0 /end AXIS_PTS
/begin CHARACTERISTIC CLCOkt_r_IntLimFromDerivOdd "Initial limit from derivative odd clutch." CURVE 0x0000 /* @ECU_Address@CLCOkt_r_IntLimFromDerivOdd@ */ Lookup1D_WORD 0 CM_T_r_NA_16384_1_s16 -2.0 1.99993896484375
 /begin AXIS_DESCR COM_AXIS NO_INPUT_QUANTITY CM_T_dn_rpmps_1_1_s16 5 -32768 32767 AXIS_PTS_REF CLCOkn_dn_IntLimFromDeriv /end AXIS_DESCR
/end CHARACTERISTIC
/begin AXIS_PTS CLCOkn_dn_IntLimFromDeriv "Initial limit from derivative axis." 0x0000 /* @ECU_Address@CLCOkn_dn_IntLimFromDeriv@ */ NO_INPUT_QUANTITY Lookup1D_X_WORD 0 CM_T_dn_rpmps_1_1_s16 5 -32768 32767 /end AXIS_PTS
/begin CHARACTERISTIC CLCOkt_M_EvenInProgRampOnRate "Initial progress state ramp up rate even clutch." CURVE 0x0000 /* @ECU_Address@CLCOkt_M_EvenInProgRampOnRate@ */ Lookup1D_WORD 0 CM_T_M_Nm_32_1_s16 -100.0 100.0 EXTENDED_LIMITS -1024.0 1023.96875
 /begin AXIS_DESCR COM_AXIS NO_INPUT_QUANTITY CM_T_M_Nm_32_1_s16 7 -300.0 300.0 AXIS_PTS_REF CLCOkn_M_InProgRampRate /end AXIS_DESCR
/end CHARACTERISTIC
/begin CHARACTERISTIC CLCOkt_M_EvenInProgRampOffRate "Initial progress state ramp down rate even clutch." CURVE 0x0000 /* @ECU_Address@CLCOkt_M_EvenInProgRampOffRate@ */ Lookup1D_WORD 0 CM_T_M_Nm_32_1_s16 -100.0 100.0 EXTENDED_LIMITS -1024.0 1023.96875
 /begin AXIS_DESCR COM_AXIS NO_INPUT_QUANTITY CM_T_M_Nm_32_1_s16 7 -300.0 300.0 AXIS_PTS_REF CLCOkn_M_InProgRampRate /end AXIS_DESCR
/end CHARACTERISTIC
/begin CHARACTERISTIC CLCOkt_r_EvenLaunchIGain "Even clutch I-part launch gain." CURVE 0x0000 /* @ECU_Address@CLCOkt_r_EvenLaunchIGain@ */ Lookup1D_WORD 0 CM_T_r_NA_16384_1_s16 0.0 1.9 EXTENDED_LIMITS -2.0 1.99993896484375
 /begin AXIS_DESCR COM_AXIS CLCOve_n_OddSpeedError CM_T_n_rpm_1_1_s16 9 -6000.0 6000.0 AXIS_PTS_REF CLCOkn_n_SpeedError /end AXIS_DESCR
/end CHARACTERISTIC
/begin CHARACTERISTIC CLCOkt_r_EvenLaunchIGainTrq "Even clutch launch I-gain in torque mode." CURVE 0x0000 /* @ECU_Address@CLCOkt_r_EvenLaunchIGainTrq@ */ Lookup1D_WORD 0 CM_T_r_NA_16384_1_s16 0.0 1.9 EXTENDED_LIMITS -2.0 1.99993896484375
 /begin AXIS_DESCR COM_AXIS CLCOve_n_OddSpeedError CM_T_n_rpm_1_1_s16 9 -6000.0 6000.0 AXIS_PTS_REF CLCOkn_n_SpeedError /end AXIS_DESCR
/end CHARACTERISTIC
/begin CHARACTERISTIC CLCOkt_M_EvenPIDMinSaturation "Even clutch min PID saturation." CURVE 0x0000 /* @ECU_Address@CLCOkt_M_EvenPIDMinSaturation@ */ Lookup1D_WORD 0 CM_T_M_Nm_32_1_s16 -100.0 0.0 EXTENDED_LIMITS -1024.0 1023.96875
 /begin AXIS_DESCR COM_AXIS NO_INPUT_QUANTITY CM_T_M_Nm_32_1_s16 7 0.0 300.0 AXIS_PTS_REF CLCOkn_M_PIDSaturationIn /end AXIS_DESCR
/end CHARACTERISTIC
/begin CHARACTERISTIC CLCOkt_M_EvenPIDMinSaturationTrq "Even clutch min PID saturation in torque mode." CURVE 0x0000 /* @ECU_Address@CLCOkt_M_EvenPIDMinSaturationTrq@ */ Lookup1D_WORD 0 CM_T_M_Nm_32_1_s16 -100.0 0.0 EXTENDED_LIMITS -1024.0 1023.96875
 /begin AXIS_DESCR COM_AXIS NO_INPUT_QUANTITY CM_T_M_Nm_32_1_s16 7 0.0 300.0 AXIS_PTS_REF CLCOkn_M_PIDSaturationInTrq /end AXIS_DESCR
/end CHARACTERISTIC
/begin CHARACTERISTIC CLCOkt_M_EvenPIDMaxSaturation "Even clutch max PID saturation." CURVE 0x0000 /* @ECU_Address@CLCOkt_M_EvenPIDMaxSaturation@ */ Lookup1D_WORD 0 CM_T_M_Nm_32_1_s16 0.0 300.0 EXTENDED_LIMITS -1024.0 1023.96875
 /begin AXIS_DESCR COM_AXIS NO_INPUT_QUANTITY CM_T_M_Nm_32_1_s16 7 0.0 300.0 AXIS_PTS_REF CLCOkn_M_PIDSaturationIn /end AXIS_DESCR
/end CHARACTERISTIC
/begin CHARACTERISTIC CLCOkt_M_EvenPIDMaxSaturationTrq "Even clutch max PID saturation in torque mode." CURVE 0x0000 /* @ECU_Address@CLCOkt_M_EvenPIDMaxSaturationTrq@ */ Lookup1D_WORD 0 CM_T_M_Nm_32_1_s16 0.0 100.0 EXTENDED_LIMITS -1024.0 1023.96875
 /begin AXIS_DESCR COM_AXIS NO_INPUT_QUANTITY CM_T_M_Nm_32_1_s16 7 0.0 300.0 AXIS_PTS_REF CLCOkn_M_PIDSaturationInTrq /end AXIS_DESCR
/end CHARACTERISTIC
/begin CHARACTERISTIC CLCOkt_r_EvenLaunchPGain "Even clutch Launch P-gain." CURVE 0x0000 /* @ECU_Address@CLCOkt_r_EvenLaunchPGain@ */ Lookup1D_WORD 0 CM_T_r_NA_16384_1_s16 0.0 1.9 EXTENDED_LIMITS -2.0 1.99993896484375
 /begin AXIS_DESCR COM_AXIS CLCOve_n_OddSpeedError CM_T_n_rpm_1_1_s16 9 -6000.0 6000.0 AXIS_PTS_REF CLCOkn_n_SpeedError /end AXIS_DESCR
/end CHARACTERISTIC
/begin CHARACTERISTIC CLCOkt_r_EvenLaunchPGainTrq "Even clutch launch P-gain in torque mode." CURVE 0x0000 /* @ECU_Address@CLCOkt_r_EvenLaunchPGainTrq@ */ Lookup1D_WORD 0 CM_T_r_NA_16384_1_s16 0.0 1.9 EXTENDED_LIMITS -2.0 1.99993896484375
 /begin AXIS_DESCR COM_AXIS CLCOve_n_OddSpeedError CM_T_n_rpm_1_1_s16 9 -6000.0 6000.0 AXIS_PTS_REF CLCOkn_n_SpeedError /end AXIS_DESCR
/end CHARACTERISTIC
/begin CHARACTERISTIC CLCOkt_r_EvenLaunchDGain "Even Clutch launch D-gain." CURVE 0x0000 /* @ECU_Address@CLCOkt_r_EvenLaunchDGain@ */ Lookup1D_WORD 0 CM_T_r_NA_16384_1_s16 0.0 1.9 EXTENDED_LIMITS -2.0 1.99993896484375
 /begin AXIS_DESCR COM_AXIS CLCOve_n_OddSpeedError CM_T_n_rpm_1_1_s16 9 -6000.0 6000.0 AXIS_PTS_REF CLCOkn_n_SpeedError /end AXIS_DESCR
/end CHARACTERISTIC
/begin CHARACTERISTIC CLCOkt_r_EvenLaunchDGainTrq "Even clutch launch D-gain in torque mode." CURVE 0x0000 /* @ECU_Address@CLCOkt_r_EvenLaunchDGainTrq@ */ Lookup1D_WORD 0 CM_T_r_NA_16384_1_s16 0.0 1.9 EXTENDED_LIMITS -2.0 1.99993896484375
 /begin AXIS_DESCR COM_AXIS CLCOve_n_OddSpeedError CM_T_n_rpm_1_1_s16 9 -6000.0 6000.0 AXIS_PTS_REF CLCOkn_n_SpeedError /end AXIS_DESCR
/end CHARACTERISTIC
/begin CHARACTERISTIC CLCOkt_r_IntLimFromDerivEven "Initial limit from derivative even clutch." CURVE 0x0000 /* @ECU_Address@CLCOkt_r_IntLimFromDerivEven@ */ Lookup1D_WORD 0 CM_T_r_NA_16384_1_s16 -2.0 1.99993896484375
 /begin AXIS_DESCR COM_AXIS NO_INPUT_QUANTITY CM_T_dn_rpmps_1_1_s16 5 -32768 32767 AXIS_PTS_REF CLCOkn_dn_IntLimFromDeriv /end AXIS_DESCR
/end CHARACTERISTIC
/begin CHARACTERISTIC CLCOkt_M_MinTargetTorque "Min target torque as a function of secondary side odd clutch speed.
      To be able to keep the minimum engage presssure above the clutch knee point pressure
      " CURVE 0x0000 /* @ECU_Address@CLCOkt_M_MinTargetTorque@ */ Lookup1D_WORD 0 CM_T_M_Nm_32_1_s16 0.0 1023.96875 EXTENDED_LIMITS -1024.0 1023.96875
 /begin AXIS_DESCR COM_AXIS NO_INPUT_QUANTITY CM_T_n_rpm_1_1_s16 18 0.0 32767 AXIS_PTS_REF CLCOke_n_MinTargetTorque /end AXIS_DESCR
/end CHARACTERISTIC
/begin AXIS_PTS CLCOke_n_MinTargetTorque "Support point axis for min target torque, relative to absolute speed of odd clutch secondary side" 0x0000 /* @ECU_Address@CLCOke_n_MinTargetTorque@ */ NO_INPUT_QUANTITY Lookup1D_X_WORD 0 CM_T_n_rpm_1_1_s16 18 0.0 32767 EXTENDED_LIMITS -32768.0 32767.0 /end AXIS_PTS
/begin CHARACTERISTIC CLCOke_e_EvenActualClutchStateOV "Even actual clutch state OV." VALUE 0x0000 /* @ECU_Address@CLCOke_e_EvenActualClutchStateOV@ */ Scalar_UBYTE 0 CM_CLCOte_e_ActualClutchState 0 5 EXTENDED_LIMITS 0 0 /end CHARACTERISTIC
/begin CHARACTERISTIC CLCOke_e_OddActualClutchStateOV "Odd  actual clutch state OV." VALUE 0x0000 /* @ECU_Address@CLCOke_e_OddActualClutchStateOV@ */ Scalar_UBYTE 0 CM_CLCOte_e_ActualClutchState 0 5 EXTENDED_LIMITS 0 0 /end CHARACTERISTIC
/begin CHARACTERISTIC CLCOke_e_EvenClutchProgressOV "Even clutch progress OV." VALUE 0x0000 /* @ECU_Address@CLCOke_e_EvenClutchProgressOV@ */ Scalar_UBYTE 0 CM_CLCOte_e_ClutchProgress 0 2 EXTENDED_LIMITS 0 0 /end CHARACTERISTIC
/begin CHARACTERISTIC CLCOke_e_OddClutchProgressOV "Odd clutch progress OV." VALUE 0x0000 /* @ECU_Address@CLCOke_e_OddClutchProgressOV@ */ Scalar_UBYTE 0 CM_CLCOte_e_ClutchProgress 0 2 EXTENDED_LIMITS 0 0 /end CHARACTERISTIC
/begin CHARACTERISTIC CLCOke_Cnt_EvenProgressComplDelay "Can be used to delay the report of that the clutch progress is complete for the even clutch when the control of the clutch torque is poor in order to make sure that the clutch is closed " VALUE 0x0000 /* @ECU_Address@CLCOke_Cnt_EvenProgressComplDelay@ */ Scalar_SWORD 0 CM_T_Cnt_Num_1_1_s16 0.0 10.0 EXTENDED_LIMITS -32768.0 32767.0 /end CHARACTERISTIC
/begin CHARACTERISTIC CLCOke_Cnt_SamplesToDelayFFTrq "Delay torque request for FF" VALUE 0x0000 /* @ECU_Address@CLCOke_Cnt_SamplesToDelayFFTrq@ */ Scalar_SWORD 0 CM_T_Cnt_Num_1_1_s16 0.0 6.0 EXTENDED_LIMITS -32768.0 32767.0 /end CHARACTERISTIC
/begin CHARACTERISTIC CLCOke_Cnt_SamplesToDelayTrgtSpd "Samples to delay target speed." VALUE 0x0000 /* @ECU_Address@CLCOke_Cnt_SamplesToDelayTrgtSpd@ */ Scalar_SWORD 0 CM_T_Cnt_Num_1_1_s16 0.0 6.0 EXTENDED_LIMITS -32768.0 32767.0 /end CHARACTERISTIC
/begin CHARACTERISTIC CLCOke_n_ClutchErrorDetectionSlipLimit "The speed difference (slip) for setting ClutchError when InGear is requested" VALUE 0x0000 /* @ECU_Address@CLCOke_n_ClutchErrorDetectionSlipLimit@ */ Scalar_SWORD 0 CM_T_n_rpm_1_1_s16 0.0 32767 EXTENDED_LIMITS -32768.0 32767.0 /end CHARACTERISTIC
/begin CHARACTERISTIC CLCOke_n_ClutchSlipIncreaseMargin "The speed difference (slip) for increasing torque margin when InGear is requested" VALUE 0x0000 /* @ECU_Address@CLCOke_n_ClutchSlipIncreaseMargin@ */ Scalar_SWORD 0 CM_T_n_rpm_1_1_s16 0.0 32767 EXTENDED_LIMITS -32768.0 32767.0 /end CHARACTERISTIC
/begin CHARACTERISTIC CLCOke_n_MaxEngageGearSpeedDiff "Maximum speed difference (over clutch) for passing trough a new request for applied clutch (i.e. InGear or TrqMode)" VALUE 0x0000 /* @ECU_Address@CLCOke_n_MaxEngageGearSpeedDiff@ */ Scalar_SWORD 0 CM_T_n_rpm_1_1_s16 -32768 32767 /end CHARACTERISTIC
/begin CHARACTERISTIC CLCOke_Cnt_ClutchErrorDetectionDly "The delay in 10ms samples before indicating ClutchError (for measurement only)" VALUE 0x0000 /* @ECU_Address@CLCOke_Cnt_ClutchErrorDetectionDly@ */ Scalar_UWORD 0 CM_T_Cnt_Num_1_1_u16 0 65535 /end CHARACTERISTIC
/begin CHARACTERISTIC CLCOke_Cnt_DisEngageCompleteDelay "Delay tp report that clutch is disengaged after torque request has been ramped to zero" VALUE 0x0000 /* @ECU_Address@CLCOke_Cnt_DisEngageCompleteDelay@ */ Scalar_UWORD 0 CM_T_Cnt_Num_1_1_u16 0.0 50.0 EXTENDED_LIMITS 0.0 65535.0 /end CHARACTERISTIC
/begin CHARACTERISTIC CLCOke_Cnt_DisableClutchReqWhenNotAvailable "If GearAvailable have been false for this amount of counts, then new clutch requests won't be acknowledged.
      Set to maximum valeu (65535) to not consider GearAvailable
      " VALUE 0x0000 /* @ECU_Address@CLCOke_Cnt_DisableClutchReqWhenNotAvailable@ */ Scalar_UWORD 0 CM_T_Cnt_Num_1_1_u16 0 65535 /end CHARACTERISTIC
/begin CHARACTERISTIC CLCOke_Cnt_NeturalDelay "Calibrate the time to enter netural after disengagement complete" VALUE 0x0000 /* @ECU_Address@CLCOke_Cnt_NeturalDelay@ */ Scalar_UWORD 0 CM_T_Cnt_Num_1_1_u16 0.0 65535.0 /end CHARACTERISTIC
/begin CHARACTERISTIC CLCOke_Cnt_OddProgressComplDelay "Can be used to delay the report of that the clutch progress is complete for the odd clutch when the control of the clutch torque is poor in order to make sure that the clutch is closed " VALUE 0x0000 /* @ECU_Address@CLCOke_Cnt_OddProgressComplDelay@ */ Scalar_UWORD 0 CM_T_Cnt_Num_1_1_u16 0.0 10.0 EXTENDED_LIMITS 0.0 65535.0 /end CHARACTERISTIC
/begin CHARACTERISTIC CLCOke_Cnt_PrepareCompleteDelay "Time delay after prepare complete" VALUE 0x0000 /* @ECU_Address@CLCOke_Cnt_PrepareCompleteDelay@ */ Scalar_UWORD 0 CM_T_Cnt_Num_1_1_u16 0.0 65535.0 /end CHARACTERISTIC
/begin CHARACTERISTIC CLCOke_M_DisablePIDThrhld "When below this value PID Controler is disabled." VALUE 0x0000 /* @ECU_Address@CLCOke_M_DisablePIDThrhld@ */ Scalar_SWORD 0 CM_T_M_Nm_32_1_s16 0.0 50.0 EXTENDED_LIMITS -1024.0 1023.96875 /end CHARACTERISTIC
/begin CHARACTERISTIC CLCOke_M_EvenDesiredClutchTrqOV "Even desired clutch torque OV." VALUE 0x0000 /* @ECU_Address@CLCOke_M_EvenDesiredClutchTrqOV@ */ Scalar_SWORD 0 CM_T_M_Nm_32_1_s16 0.0 200.0 EXTENDED_LIMITS -1024.0 1023.96875 /end CHARACTERISTIC
/begin CHARACTERISTIC CLCOke_M_EvenTrqRampOffRateCompl "Ramp down rate for odd clutch torque in torque mode." VALUE 0x0000 /* @ECU_Address@CLCOke_M_EvenTrqRampOffRateCompl@ */ Scalar_SWORD 0 CM_T_M_Nm_32_1_s16 -50.0 0.0 EXTENDED_LIMITS -1024.0 1023.96875 /end CHARACTERISTIC
/begin CHARACTERISTIC CLCOke_M_EvenTrqRampOffRateDE "Even clutch torque ramp down limit" VALUE 0x0000 /* @ECU_Address@CLCOke_M_EvenTrqRampOffRateDE@ */ Scalar_SWORD 0 CM_T_M_Nm_32_1_s16 -50.0 0.0 EXTENDED_LIMITS -1024.0 1023.96875 /end CHARACTERISTIC
/begin CHARACTERISTIC CLCOke_M_EvenTrqRampOnRateCompl "Ramp up rate for even clutch torque in torque mode." VALUE 0x0000 /* @ECU_Address@CLCOke_M_EvenTrqRampOnRateCompl@ */ Scalar_SWORD 0 CM_T_M_Nm_32_1_s16 0.0 50.0 EXTENDED_LIMITS -1024.0 1023.96875 /end CHARACTERISTIC
/begin CHARACTERISTIC CLCOke_M_EvenTrqRampOnRateProg "Ramp up rate for even clutch torque in progress mode." VALUE 0x0000 /* @ECU_Address@CLCOke_M_EvenTrqRampOnRateProg@ */ Scalar_SWORD 0 CM_T_M_Nm_32_1_s16 0.0 50.0 EXTENDED_LIMITS -1024.0 1023.96875 /end CHARACTERISTIC
/begin CHARACTERISTIC CLCOke_M_IncreaseTorqueMarginAfterSlipping "The incrementation of torque margin after clutch slipping has been detected while InGear" VALUE 0x0000 /* @ECU_Address@CLCOke_M_IncreaseTorqueMarginAfterSlipping@ */ Scalar_SWORD 0 CM_T_M_Nm_32_1_s16 0.0 1023.96875 EXTENDED_LIMITS -1024.0 1023.96875 /end CHARACTERISTIC
/begin CHARACTERISTIC CLCOke_M_OddDesiredClutchTrqOV "Odd desired clutch torque OV." VALUE 0x0000 /* @ECU_Address@CLCOke_M_OddDesiredClutchTrqOV@ */ Scalar_SWORD 0 CM_T_M_Nm_32_1_s16 0.0 200.0 EXTENDED_LIMITS -1024.0 1023.96875 /end CHARACTERISTIC
/begin CHARACTERISTIC CLCOke_M_OddTrqRampOffRateCompl "Ramp down rate for odd clutch torque in torque mode." VALUE 0x0000 /* @ECU_Address@CLCOke_M_OddTrqRampOffRateCompl@ */ Scalar_SWORD 0 CM_T_M_Nm_32_1_s16 -50.0 0.0 EXTENDED_LIMITS -1024.0 1023.96875 /end CHARACTERISTIC
/begin CHARACTERISTIC CLCOke_M_OddTrqRampOffRateDE "Odd clutch torque ramp down limit." VALUE 0x0000 /* @ECU_Address@CLCOke_M_OddTrqRampOffRateDE@ */ Scalar_SWORD 0 CM_T_M_Nm_32_1_s16 -50.0 0.0 EXTENDED_LIMITS -1024.0 1023.96875 /end CHARACTERISTIC
/begin CHARACTERISTIC CLCOke_M_OddTrqRampOnRateCompl "Ramp up rate for odd clutch torque in torque mode." VALUE 0x0000 /* @ECU_Address@CLCOke_M_OddTrqRampOnRateCompl@ */ Scalar_SWORD 0 CM_T_M_Nm_32_1_s16 0.0 1023.96875 EXTENDED_LIMITS -1024.0 1023.96875 /end CHARACTERISTIC
/begin CHARACTERISTIC CLCOke_M_OddTrqRampOnRateProg "Ramp up rate for odd clutch torque in progress mode." VALUE 0x0000 /* @ECU_Address@CLCOke_M_OddTrqRampOnRateProg@ */ Scalar_SWORD 0 CM_T_M_Nm_32_1_s16 0.0 50.0 EXTENDED_LIMITS -1024.0 1023.96875 /end CHARACTERISTIC
/begin CHARACTERISTIC CLCOke_M_P1TrqFilterCoef "P1 Torque input Filter Coefficient, lower value gets harder filtration." VALUE 0x0000 /* @ECU_Address@CLCOke_M_P1TrqFilterCoef@ */ Scalar_SWORD 0 CM_T_M_Nm_32_1_s16 0.0 1000.0 EXTENDED_LIMITS -1024.0 1023.96875 /end CHARACTERISTIC
/begin CHARACTERISTIC CLCOke_M_TargetTorqueOffset "Offset for target torque, if clutch can be kept close with a torque margin." VALUE 0x0000 /* @ECU_Address@CLCOke_M_TargetTorqueOffset@ */ Scalar_SWORD 0 CM_T_M_Nm_32_1_s16 0.0 1023.96875 EXTENDED_LIMITS -1024.0 1023.96875 /end CHARACTERISTIC
/begin CHARACTERISTIC CLCOke_r_MaxActualTorqueRelativeTIRC_ReqAtLash "Enables usage of max of actual total P1 torque and TIRC ReqAtLash.
      If set to any value less tan or equal to 1, then the target won't be greater then TIRC ReqAtLash
      Set to any value greater than 1, then actual torque can increase the target with that factor (if actual torque is that high)
      
      By setting it to 2, then actual torque can raise the target to twice the TIRC ReqAtLash torque.
      " VALUE 0x0000 /* @ECU_Address@CLCOke_r_MaxActualTorqueRelativeTIRC_ReqAtLash@ */ Scalar_UWORD 0 CM_T_r_NA_8192_1_u16 0 7.9998779296875 /end CHARACTERISTIC
/begin CHARACTERISTIC CLCOke_r_P1SpeedFilterCoef "P1 Speed filter coefficient." VALUE 0x0000 /* @ECU_Address@CLCOke_r_P1SpeedFilterCoef@ */ Scalar_SWORD 0 CM_T_r_NA_16384_1_s16 0.0 1.0 EXTENDED_LIMITS -2.0 1.99993896484375 /end CHARACTERISTIC
/begin CHARACTERISTIC CLCOke_t_D_PartFilterTimeConstant "Time constant for 1st order low pass filtration of PID error in D part calculation." VALUE 0x0000 /* @ECU_Address@CLCOke_t_D_PartFilterTimeConstant@ */ Scalar_SWORD 0 CM_T_t_s_100_1_s16 0.01 10.0 EXTENDED_LIMITS -327.68 327.67 /end CHARACTERISTIC
/begin CHARACTERISTIC CLCOke_t_SampleTime "SWU sample time, 0.01s" VALUE 0x0000 /* @ECU_Address@CLCOke_t_SampleTime@ */ Scalar_SWORD 0 CM_T_t_s_100_1_s16 0.01 1.0 EXTENDED_LIMITS -327.68 327.67 /end CHARACTERISTIC
/begin CHARACTERISTIC CLCOke_b_DisableClutchReqFromNotAppliedWhenNotAvailable "Selects if disabling of clutch requst die to not GearAvailable shall be done when in a not applied state (i.e. not InGear/Torque/Disengage) or only not be allowed from Neutral.
      
      Set to true to prevent new request (i.e. set to Neutral) when previous request wasn't applied.
      Set to false to prevent new request (i.e. set to Neutral) when previous request is Neutral.
      
      Will only have affect if the Disable time is set to a enabled value.
      When triggered, will require extrernal request to go to Neutral before accepting New request even if Gear becomes available
      " VALUE 0x0000 /* @ECU_Address@CLCOke_b_DisableClutchReqFromNotAppliedWhenNotAvailable@ */ Scalar_BOOLEAN 0 CM_T_BOOLEAN 0.0 1.0 /end CHARACTERISTIC
/begin CHARACTERISTIC CLCOke_b_EnableTIRCTrqNeeded "Enable TIRC torque." VALUE 0x0000 /* @ECU_Address@CLCOke_b_EnableTIRCTrqNeeded@ */ Scalar_BOOLEAN 0 CM_T_BOOLEAN 0.0 1.0 /end CHARACTERISTIC
/begin CHARACTERISTIC CLCOke_b_EnableTorqueRateForProgress "Enable Torque Rate For Progress" VALUE 0x0000 /* @ECU_Address@CLCOke_b_EnableTorqueRateForProgress@ */ Scalar_BOOLEAN 0 CM_T_BOOLEAN 0 1 /end CHARACTERISTIC
/begin CHARACTERISTIC CLCOke_b_EvenActualClutchStateOB "Even actual clutch state OB." VALUE 0x0000 /* @ECU_Address@CLCOke_b_EvenActualClutchStateOB@ */ Scalar_BOOLEAN 0 CM_T_BOOLEAN 0.0 1.0 /end CHARACTERISTIC
/begin CHARACTERISTIC CLCOke_b_EvenClutchOpenReqOB "Even clutch open request OB." VALUE 0x0000 /* @ECU_Address@CLCOke_b_EvenClutchOpenReqOB@ */ Scalar_BOOLEAN 0 CM_T_BOOLEAN 0.0 1.0 /end CHARACTERISTIC
/begin CHARACTERISTIC CLCOke_b_EvenClutchOpenReqOV "Even clutch open request OV." VALUE 0x0000 /* @ECU_Address@CLCOke_b_EvenClutchOpenReqOV@ */ Scalar_BOOLEAN 0 CM_T_BOOLEAN 0.0 1.0 /end CHARACTERISTIC
/begin CHARACTERISTIC CLCOke_b_EvenClutchProgressOB "Even clutch progress OB." VALUE 0x0000 /* @ECU_Address@CLCOke_b_EvenClutchProgressOB@ */ Scalar_BOOLEAN 0 CM_T_BOOLEAN 0.0 1.0 /end CHARACTERISTIC
/begin CHARACTERISTIC CLCOke_b_EvenDesiredClutchTrqOB "Even Desired Clutch torque OB." VALUE 0x0000 /* @ECU_Address@CLCOke_b_EvenDesiredClutchTrqOB@ */ Scalar_BOOLEAN 0 CM_T_BOOLEAN 0.0 1.0 /end CHARACTERISTIC
/begin CHARACTERISTIC CLCOke_b_EvenEnableLaunch "Enable even clutch PID in launch." VALUE 0x0000 /* @ECU_Address@CLCOke_b_EvenEnableLaunch@ */ Scalar_BOOLEAN 0 CM_T_BOOLEAN 0.0 1.0 /end CHARACTERISTIC
/begin CHARACTERISTIC CLCOke_b_EvenEnablePIDAtTrqMode "If true PID controler for even clutch is enabled in torque mode." VALUE 0x0000 /* @ECU_Address@CLCOke_b_EvenEnablePIDAtTrqMode@ */ Scalar_BOOLEAN 0 CM_T_BOOLEAN 0.0 1.0 /end CHARACTERISTIC
/begin CHARACTERISTIC CLCOke_b_FilterFeedForwardTrq "If true feed forward torque is filtered." VALUE 0x0000 /* @ECU_Address@CLCOke_b_FilterFeedForwardTrq@ */ Scalar_BOOLEAN 0 CM_T_BOOLEAN 0.0 1.0 /end CHARACTERISTIC
/begin CHARACTERISTIC CLCOke_b_IncreaseTorqueMarginIfSlipping "Enable of increasing torque margin when/if detecting clutch slippage" VALUE 0x0000 /* @ECU_Address@CLCOke_b_IncreaseTorqueMarginIfSlipping@ */ Scalar_BOOLEAN 0 CM_T_BOOLEAN 0.0 1.0 /end CHARACTERISTIC
/begin CHARACTERISTIC CLCOke_b_OddActualClutchStateOB "Odd actual clutch state OB." VALUE 0x0000 /* @ECU_Address@CLCOke_b_OddActualClutchStateOB@ */ Scalar_BOOLEAN 0 CM_T_BOOLEAN 0.0 1.0 /end CHARACTERISTIC
/begin CHARACTERISTIC CLCOke_b_OddClutchOpenReqOB "Odd clutch open request OB." VALUE 0x0000 /* @ECU_Address@CLCOke_b_OddClutchOpenReqOB@ */ Scalar_BOOLEAN 0 CM_T_BOOLEAN 0.0 1.0 /end CHARACTERISTIC
/begin CHARACTERISTIC CLCOke_b_OddClutchOpenReqOV "Odd clutch open request OV." VALUE 0x0000 /* @ECU_Address@CLCOke_b_OddClutchOpenReqOV@ */ Scalar_BOOLEAN 0 CM_T_BOOLEAN 0.0 1.0 /end CHARACTERISTIC
/begin CHARACTERISTIC CLCOke_b_OddClutchProgressOB "Odd clutch progress OB." VALUE 0x0000 /* @ECU_Address@CLCOke_b_OddClutchProgressOB@ */ Scalar_BOOLEAN 0 CM_T_BOOLEAN 0.0 1.0 /end CHARACTERISTIC
/begin CHARACTERISTIC CLCOke_b_OddDesiredClutchTrqOB "Odd desired clutch torque OB." VALUE 0x0000 /* @ECU_Address@CLCOke_b_OddDesiredClutchTrqOB@ */ Scalar_BOOLEAN 0 CM_T_BOOLEAN 0.0 1.0 /end CHARACTERISTIC
/begin CHARACTERISTIC CLCOke_b_OddEnableLaunch "Enable Odd clutch PID in launch." VALUE 0x0000 /* @ECU_Address@CLCOke_b_OddEnableLaunch@ */ Scalar_BOOLEAN 0 CM_T_BOOLEAN 0.0 1.0 /end CHARACTERISTIC
/begin CHARACTERISTIC CLCOke_b_OddEnablePIDAtTrqMode "If true PID controler for odd clutch is enabled in torque mode." VALUE 0x0000 /* @ECU_Address@CLCOke_b_OddEnablePIDAtTrqMode@ */ Scalar_BOOLEAN 0 CM_T_BOOLEAN 0.0 1.0 /end CHARACTERISTIC
/begin CHARACTERISTIC CLCOke_b_RequireIgnitionOnForClutchReq "When enabled odd clutch request will only be acknowledged when Ignition is on, and if ignition is turned on while there's a clutch request other than neutral, neutral will be selected until request has gone to Neutral" VALUE 0x0000 /* @ECU_Address@CLCOke_b_RequireIgnitionOnForClutchReq@ */ Scalar_BOOLEAN 0 CM_T_BOOLEAN 0.0 1.0 /end CHARACTERISTIC
/begin CHARACTERISTIC CLCOke_b_ResetIncreasedTorqueMarginAtReleasedClutch "Sets if the increased torque margin due to clutch slippage shall be reset when not requesting InGear anymore" VALUE 0x0000 /* @ECU_Address@CLCOke_b_ResetIncreasedTorqueMarginAtReleasedClutch@ */ Scalar_BOOLEAN 0 CM_T_BOOLEAN 0.0 1.0 /end CHARACTERISTIC
/begin CHARACTERISTIC CLCOke_b_TIRCTrqForPIDSat "If True the saturation lookup tables will have TIRC torque as input instead of the TTSS limited torque. " VALUE 0x0000 /* @ECU_Address@CLCOke_b_TIRCTrqForPIDSat@ */ Scalar_BOOLEAN 0 CM_T_BOOLEAN 0.0 1.0 /end CHARACTERISTIC
/begin CHARACTERISTIC CLCOke_b_UseD_Part1stOrderFilter "Enables the use of 1st order low pass filter in the filtration of pressure controller error derivative (PID D-part)." VALUE 0x0000 /* @ECU_Address@CLCOke_b_UseD_Part1stOrderFilter@ */ Scalar_BOOLEAN 0 CM_T_BOOLEAN 0.0 1.0 /end CHARACTERISTIC
/begin CHARACTERISTIC CLCOke_b_UseForYoyan "Set to 1 , Use for Voyan
      Set to 0, use for normal HD150
      " VALUE 0x0000 /* @ECU_Address@CLCOke_b_UseForYoyan@ */ Scalar_BOOLEAN 0 CM_T_BOOLEAN 0.0 1.0 /end CHARACTERISTIC
/begin CHARACTERISTIC CLCOke_b_UseTIRCTrqForRampOnRate "If true TIRC torque is used for ramp up rate." VALUE 0x0000 /* @ECU_Address@CLCOke_b_UseTIRCTrqForRampOnRate@ */ Scalar_BOOLEAN 0 CM_T_BOOLEAN 0.0 1.0 /end CHARACTERISTIC
/begin CHARACTERISTIC CLCOke_b_UseTorqueRateForProgress "UseTorqueRateForProgress" VALUE 0x0000 /* @ECU_Address@CLCOke_b_UseTorqueRateForProgress@ */ Scalar_BOOLEAN 0 CM_T_BOOLEAN 0.0 1.0 /end CHARACTERISTIC
/begin MEASUREMENT CLCOve_e_OddClutchStateReq "Odd Clutch State Request after inhibits" UBYTE CM_CLCOte_e_ActualClutchState 0 0 0 5 ECU_ADDRESS 0x0000 /* @ECU_Address@CLCOve_e_OddClutchStateReq@ */ /end MEASUREMENT
/begin MEASUREMENT CLCOve_e_A17 "A17" UBYTE CM_CLCOte_e_ActualClutchState 0 0 0 5 ECU_ADDRESS 0x0000 /* @ECU_Address@CLCOve_e_A17@ */ /end MEASUREMENT
/begin MEASUREMENT CLCOve_n_TargetSpeed "clutch target speed." SWORD CM_T_n_rpm_1_1_s16 0 0 -32768 32767 ECU_ADDRESS 0x0000 /* @ECU_Address@CLCOve_n_TargetSpeed@ */ /end MEASUREMENT
/begin MEASUREMENT CLCOve_n_EvenSpeedError "The speed error over even clutch." SWORD CM_T_n_rpm_1_1_s16 0 0 0.0 1.0 ECU_ADDRESS 0x0000 /* @ECU_Address@CLCOve_n_EvenSpeedError@ */ /end MEASUREMENT
/begin MEASUREMENT CLCOve_n_OddSpeedError "Odd clutch speed error." SWORD CM_T_n_rpm_1_1_s16 0 0 -1000.0 1000.0 ECU_ADDRESS 0x0000 /* @ECU_Address@CLCOve_n_OddSpeedError@ */ /end MEASUREMENT
/begin MEASUREMENT CLCOve_Cnt_A10 "A10" UWORD CM_uint16 0 0 0 65535 ECU_ADDRESS 0x0000 /* @ECU_Address@CLCOve_Cnt_A10@ */ /end MEASUREMENT
/begin MEASUREMENT CLCOve_M_ExtraTorqueMarginDueToSlip "The extra torque margin due to slip" SWORD CM_T_M_Nm_32_1_s16 0 0 0.0 1023.96875 ECU_ADDRESS 0x0000 /* @ECU_Address@CLCOve_M_ExtraTorqueMarginDueToSlip@ */ /end MEASUREMENT
/begin MEASUREMENT CLCOve_M_FilteredP1TrqRequest "Filtered P1 Torque Request." SWORD CM_T_M_Nm_32_1_s16 0 0 -1024.0 1023.96875 ECU_ADDRESS 0x0000 /* @ECU_Address@CLCOve_M_FilteredP1TrqRequest@ */ /end MEASUREMENT
/begin COMPU_METHOD CM_T_M_Nm_32_1_s16 "Q = V*32.000000" RAT_FUNC "%9.5" "Nm (newton-meters  (Nm))" COEFFS 0 32 0 0 0 1 /end COMPU_METHOD
/begin COMPU_METHOD CM_T_r_NA_16384_1_s16 "Q = V*16384.000000" RAT_FUNC "%15.14" "NA (none)" COEFFS 0 16384 0 0 0 1 /end COMPU_METHOD
/begin COMPU_METHOD CM_T_n_rpm_1_1_s16 "Q = V" RAT_FUNC "%5.0" "rpm (revolutions / minute  (rpm))" COEFFS 0 1 0 0 0 1 /end COMPU_METHOD
/begin COMPU_METHOD CM_T_dn_rpmps_1_1_s16 "Q = V" RAT_FUNC "%5.0" "rpmps (revolutions / minute / second  (rpm/s))" COEFFS 0 1 0 0 0 1 /end COMPU_METHOD
/begin COMPU_METHOD CM_CLCOte_e_ActualClutchState "Enumerated data type: CLCOte_e_ActualClutchState" TAB_VERB "%0.6" "" COMPU_TAB_REF VTAB_FOR_CM_CLCOte_e_ActualClutchState /end COMPU_METHOD
/begin COMPU_VTAB VTAB_FOR_CM_CLCOte_e_ActualClutchState "Enumerated data type: CLCOte_e_ActualClutchState" TAB_VERB 6 0 "CLCOce_e_ClutchNeutral" 1 "CLCOce_e_ClutchDisengage" 2 "CLCOce_e_ClutchInGear" 3 "CLCOce_e_ClutchPrepare" 4 "CLCOce_e_ClutchTrqMode" 5 "CLCOce_e_ClutchSpdMode" /end COMPU_VTAB
/begin COMPU_METHOD CM_CLCOte_e_ClutchProgress "Enumerated data type: CLCOte_e_ClutchProgress" TAB_VERB "%0.6" "" COMPU_TAB_REF VTAB_FOR_CM_CLCOte_e_ClutchProgress /end COMPU_METHOD
/begin COMPU_VTAB VTAB_FOR_CM_CLCOte_e_ClutchProgress "Enumerated data type: CLCOte_e_ClutchProgress" TAB_VERB 3 0 "CLCOce_e_ClutchPrgrsFailed" 1 "CLCOce_e_ClutchInPrgrs" 2 "CLCOce_e_ClutchPrgrsComplete" /end COMPU_VTAB
/begin COMPU_METHOD CM_T_Cnt_Num_1_1_s16 "Q = V" RAT_FUNC "%5.0" "Num (counts)" COEFFS 0 1 0 0 0 1 /end COMPU_METHOD
/begin COMPU_METHOD CM_T_Cnt_Num_1_1_u16 "Q = V" RAT_FUNC "%5.0" "Num (counts)" COEFFS 0 1 0 0 0 1 /end COMPU_METHOD
/begin COMPU_METHOD CM_T_r_NA_8192_1_u16 "Q = V*8192.000000" RAT_FUNC "%14.13" "NA (none)" COEFFS 0 8192 0 0 0 1 /end COMPU_METHOD
/begin COMPU_METHOD CM_T_t_s_100_1_s16 "Q = V*100.000000" RAT_FUNC "%0.6" "s (seconds  (s))" COEFFS 0 100 0 0 0 1 /end COMPU_METHOD
/begin COMPU_METHOD CM_T_BOOLEAN "Q = V" RAT_FUNC "%1.0" "Bool" COEFFS 0 1 0 0 0 1 /end COMPU_METHOD
/begin COMPU_METHOD CM_uint16 "Q = V" RAT_FUNC "%5.0" "Num (counts)" COEFFS 0 1 0 0 0 1 /end COMPU_METHOD
/* EOF CLCO.a2l */
/begin RECORD_LAYOUT Scalar_BOOLEAN FNC_VALUES 1 UBYTE COLUMN_DIR DIRECT /end RECORD_LAYOUT
/begin RECORD_LAYOUT Scalar_UBYTE FNC_VALUES 1 UBYTE COLUMN_DIR DIRECT /end RECORD_LAYOUT
/begin RECORD_LAYOUT Scalar_BYTE FNC_VALUES 1 SBYTE COLUMN_DIR DIRECT /end RECORD_LAYOUT
/begin RECORD_LAYOUT Scalar_UWORD FNC_VALUES 1 UWORD COLUMN_DIR DIRECT /end RECORD_LAYOUT
/begin RECORD_LAYOUT Scalar_SWORD FNC_VALUES 1 SWORD COLUMN_DIR DIRECT /end RECORD_LAYOUT
/begin RECORD_LAYOUT Scalar_LONG FNC_VALUES 1 SLONG COLUMN_DIR DIRECT /end RECORD_LAYOUT
/begin RECORD_LAYOUT Scalar_FLOAT64_IEEE FNC_VALUES 1 FLOAT64_IEEE COLUMN_DIR DIRECT /end RECORD_LAYOUT
/begin RECORD_LAYOUT Lookup1D_WORD FNC_VALUES 1 SWORD COLUMN_DIR DIRECT /end RECORD_LAYOUT
/begin RECORD_LAYOUT Lookup1D_X_WORD AXIS_PTS_X 1 SWORD INDEX_INCR DIRECT /end RECORD_LAYOUT
/begin COMPU_METHOD CM_T_n_rpm_1_1_s16 "Q = V" RAT_FUNC "%5.0" "rpm (revolutions / minute  (rpm))" COEFFS 0 1 0 0 0 1 /end COMPU_METHOD
/begin COMPU_METHOD CM_T_T_degC_16_1_s16 "Q = V*16.000000" RAT_FUNC "%8.4" "degC (degrees Celsius  (deg C))" COEFFS 0 16 0 0 0 1 /end COMPU_METHOD
/begin COMPU_METHOD CM_T_p_kPa_1_1_s16 "Q = V" RAT_FUNC "%5.0" "kPa (kiloPascals  (kPa))" COEFFS 0 1 0 0 0 1 /end COMPU_METHOD
/begin COMPU_METHOD CM_T_K_NA_1024_1_u16 "Q = V*1024.000000" RAT_FUNC "%12.10" "NA (dependent upon the gain)" COEFFS 0 1024 0 0 0 1 /end COMPU_METHOD
/begin COMPU_METHOD CM_T_Cnt_Num_1_1_u16 "Q = V" RAT_FUNC "%5.0" "Num (counts)" COEFFS 0 1 0 0 0 1 /end COMPU_METHOD
/begin COMPU_METHOD CM_T_M_Nm_32_1_s16 "Q = V*32.000000" RAT_FUNC "%9.5" "Nm (newton-meters  (Nm))" COEFFS 0 32 0 0 0 1 /end COMPU_METHOD
/begin COMPU_METHOD CM_T_r_NA_1024_1_s16 "Q = V*1024.000000" RAT_FUNC "%12.10" "NA (none)" COEFFS 0 1024 0 0 0 1 /end COMPU_METHOD
/begin COMPU_METHOD CM_T_Cnt_Num_1_1_u8 "Q = V" RAT_FUNC "%3.0" "Num (counts)" COEFFS 0 1 0 0 0 1 /end COMPU_METHOD
/begin COMPU_METHOD CM_T_BOOLEAN "Q = V" RAT_FUNC "%1.0" "Bool" COEFFS 0 1 0 0 0 1 /end COMPU_METHOD
/begin COMPU_METHOD CM_T_Cnt_Num_1_1_s16 "Q = V" RAT_FUNC "%5.0" "Num (counts)" COEFFS 0 1 0 0 0 1 /end COMPU_METHOD
/begin COMPU_METHOD CM_uint16 "Q = V" RAT_FUNC "%5.0" "NA (dependent upon the gain)" COEFFS 0 1 0 0 0 1 /end COMPU_METHOD
/* EOF CLPC.a2l */
/begin RECORD_LAYOUT Scalar_BOOLEAN FNC_VALUES 1 UBYTE COLUMN_DIR DIRECT /end RECORD_LAYOUT
/begin RECORD_LAYOUT Scalar_UBYTE FNC_VALUES 1 UBYTE COLUMN_DIR DIRECT /end RECORD_LAYOUT
/begin RECORD_LAYOUT Scalar_UWORD FNC_VALUES 1 UWORD COLUMN_DIR DIRECT /end RECORD_LAYOUT
/begin RECORD_LAYOUT Scalar_SWORD FNC_VALUES 1 SWORD COLUMN_DIR DIRECT /end RECORD_LAYOUT
/begin RECORD_LAYOUT Lookup1D_WORD FNC_VALUES 1 SWORD COLUMN_DIR DIRECT /end RECORD_LAYOUT
/begin RECORD_LAYOUT Lookup1D_X_WORD AXIS_PTS_X 1 SWORD INDEX_INCR DIRECT /end RECORD_LAYOUT
/begin COMPU_METHOD CM_T_Cnt_Num_1_1_s16 "Q = V" RAT_FUNC "%5.0" "Num (counts)" COEFFS 0 1 0 0 0 1 /end COMPU_METHOD
/begin COMPU_METHOD CM_T_t_s_1000_1_s16 "Q = V*1000.000000" RAT_FUNC "%0.6" "s (seconds  (s))" COEFFS 0 1000 0 0 0 1 /end COMPU_METHOD
/begin COMPU_METHOD CM_T_Cnt_Num_1_1_u8 "Q = V" RAT_FUNC "%3.0" "Num (counts)" COEFFS 0 1 0 0 0 1 /end COMPU_METHOD
/begin COMPU_METHOD CM_T_BOOLEAN "Q = V" RAT_FUNC "%1.0" "Bool" COEFFS 0 1 0 0 0 1 /end COMPU_METHOD
/* EOF FDMA.a2l */
/begin RECORD_LAYOUT Scalar_BOOLEAN FNC_VALUES 1 UBYTE COLUMN_DIR DIRECT /end RECORD_LAYOUT
/begin RECORD_LAYOUT Scalar_UBYTE FNC_VALUES 1 UBYTE COLUMN_DIR DIRECT /end RECORD_LAYOUT
/begin RECORD_LAYOUT Scalar_UWORD FNC_VALUES 1 UWORD COLUMN_DIR DIRECT /end RECORD_LAYOUT
/begin RECORD_LAYOUT Scalar_SWORD FNC_VALUES 1 SWORD COLUMN_DIR DIRECT /end RECORD_LAYOUT
/begin RECORD_LAYOUT Lookup1D_WORD FNC_VALUES 1 SWORD COLUMN_DIR DIRECT /end RECORD_LAYOUT
/begin RECORD_LAYOUT Lookup1D_X_WORD AXIS_PTS_X 1 SWORD INDEX_INCR DIRECT /end RECORD_LAYOUT
/begin COMPU_METHOD CM_T_n_rpm_1_1_s16 "Q = V" RAT_FUNC "%5.0" "rpm (revolutions / minute  (rpm))" COEFFS 0 1 0 0 0 1 /end COMPU_METHOD
/begin COMPU_METHOD CM_T_t_s_100_1_s16 "Q = V*100.000000" RAT_FUNC "%0.6" "s (seconds  (s))" COEFFS 0 100 0 0 0 1 /end COMPU_METHOD
/begin COMPU_METHOD CM_T_Cnt_Num_1_1_u8 "Q = V" RAT_FUNC "%3.0" "Num (counts)" COEFFS 0 1 0 0 0 1 /end COMPU_METHOD
/begin COMPU_METHOD CM_T_BOOLEAN "Q = V" RAT_FUNC "%1.0" "Bool" COEFFS 0 1 0 0 0 1 /end COMPU_METHOD
/* EOF PORS.a2l */
/begin RECORD_LAYOUT DATA_RECORD_UBYTE FNC_VALUES 1 UBYTE ROW_DIR DIRECT /end RECORD_LAYOUT
/begin RECORD_LAYOUT DATA_RECORD_UWORD FNC_VALUES 1 UWORD ROW_DIR DIRECT /end RECORD_LAYOUT
/begin RECORD_LAYOUT DATA_RECORD_ULONG FNC_VALUES 1 ULONG ROW_DIR DIRECT /end RECORD_LAYOUT
/begin RECORD_LAYOUT DATA_RECORD_FLOAT32_IEEE FNC_VALUES 1 FLOAT32_IEEE ROW_DIR DIRECT /end RECORD_LAYOUT
/begin CHARACTERISTIC FTCMTCS_LutOutTorqueMinC "FTCMTCS_LutOutTorqueMinC" MAP 0x8008EB60 DATA_RECORD_FLOAT32_IEEE 3.402823466E+038 F_1_p0_56 -3.402823466E+038 3.402823466E+038
 /begin AXIS_DESCR FIX_AXIS NO_INPUT_QUANTITY Id_0x00 6 0 5 MAX_GRAD 100.0 FIX_AXIS_PAR_DIST 0 1 6 /end AXIS_DESCR
 /begin AXIS_DESCR FIX_AXIS NO_INPUT_QUANTITY Id_0x00 32 0 31 MAX_GRAD 100.0 FIX_AXIS_PAR_DIST 0 1 32 /end AXIS_DESCR
/end CHARACTERISTIC
/begin CHARACTERISTIC FTCMTCS_LutOutVolMarginGenC "FTCMTCS_LutOutVolMarginGenC" MAP 0x80063B08 DATA_RECORD_FLOAT32_IEEE 3.402823466E+038 F_1_p0_4 -3.402823466E+038 3.402823466E+038
 /begin AXIS_DESCR FIX_AXIS NO_INPUT_QUANTITY Id_0x00 5 0 4 MAX_GRAD 100.0 FIX_AXIS_PAR_DIST 0 1 5 /end AXIS_DESCR
 /begin AXIS_DESCR FIX_AXIS NO_INPUT_QUANTITY Id_0x00 11 0 10 MAX_GRAD 100.0 FIX_AXIS_PAR_DIST 0 1 11 /end AXIS_DESCR
/end CHARACTERISTIC
/begin CHARACTERISTIC FTCMTCS_LutOutVolMarginMotC "FTCMTCS_LutOutVolMarginMotC" MAP 0x80063A2C DATA_RECORD_FLOAT32_IEEE 3.402823466E+038 F_1_p0_4 -3.402823466E+038 3.402823466E+038
 /begin AXIS_DESCR FIX_AXIS NO_INPUT_QUANTITY Id_0x00 5 0 4 MAX_GRAD 100.0 FIX_AXIS_PAR_DIST 0 1 5 /end AXIS_DESCR
 /begin AXIS_DESCR FIX_AXIS NO_INPUT_QUANTITY Id_0x00 11 0 10 MAX_GRAD 100.0 FIX_AXIS_PAR_DIST 0 1 11 /end AXIS_DESCR
/end CHARACTERISTIC
/begin CHARACTERISTIC FTCMTCS_MaxErrorFor100C "FTCMTCS_MaxErrorFor100C" VALUE 0x80063A28 DATA_RECORD_FLOAT32_IEEE 3.402823466E+038 F_1_p0_4 -3.402823466E+038 3.402823466E+038 /end CHARACTERISTIC
/begin CHARACTERISTIC FTCMTCS_ParkCurrentMaxC "FTCMTCS_ParkCurrentMaxC" VALUE 0x80063A24 DATA_RECORD_FLOAT32_IEEE 3.402823466E+038 F_1_p0_46 -3.402823466E+038 3.402823466E+038 /end CHARACTERISTIC
/begin CHARACTERISTIC FTCMTCS_SlideSpdRpmC "FTCMTCS_SlideSpdRpmC" VALUE 0x80063A20 DATA_RECORD_FLOAT32_IEEE 3.402823466E+038 F_1_p0_50 -3.402823466E+038 3.402823466E+038 /end CHARACTERISTIC
/begin CHARACTERISTIC FTCMTCS_SwitchElecTorqueRangeC "FTCMTCS_SwitchElecTorqueRangeC" VALUE 0x80063A1C DATA_RECORD_FLOAT32_IEEE 3.402823466E+038 F_1_p0_49 -3.402823466E+038 3.402823466E+038 /end CHARACTERISTIC
/begin CHARACTERISTIC FTCMTCS_SwitchElecTrqRange0C "FTCMTCS_SwitchElecTrqRange0C" VALUE 0x80063A18 DATA_RECORD_FLOAT32_IEEE 3.402823466E+038 F_1_p0_4 -3.402823466E+038 3.402823466E+038 /end CHARACTERISTIC
/begin CHARACTERISTIC FTCMTCS_VoltMarginCtrlOnOffC "FTCMTCS_VoltMarginCtrlOnOffC" VALUE 0x80063A14 DATA_RECORD_UBYTE 1 Bool_ON_OFF 0 1 BIT_MASK 0x01 /end CHARACTERISTIC
/begin CHARACTERISTIC FTCMTCS_VoltageLimiterOnOffC "FTCMTCS_VoltageLimiterOnOffC" VALUE 0x80063A10 DATA_RECORD_UBYTE 1 Bool_ON_OFF 0 1 BIT_MASK 0x01 /end CHARACTERISTIC
/begin CHARACTERISTIC FTCMTCS_VoltageMarginC "FTCMTCS_VoltageMarginC" VALUE 0x80063A0C DATA_RECORD_FLOAT32_IEEE 3.402823466E+038 F_1_p0_4 -3.402823466E+038 3.402823466E+038 /end CHARACTERISTIC
/begin CHARACTERISTIC FTCMTTC_AntiJerkMecaTorqueMaxC "FTCMTTC_AntiJerkMecaTorqueMaxC" VALUE 0x8006451C DATA_RECORD_FLOAT32_IEEE 3.402823466E+038 F_1_p0_4 -3.402823466E+038 3.402823466E+038 /end CHARACTERISTIC
/begin CHARACTERISTIC FTCMTTC_AntiJerkMecaTorqueMinC "FTCMTTC_AntiJerkMecaTorqueMinC" VALUE 0x80064518 DATA_RECORD_FLOAT32_IEEE 3.402823466E+038 F_1_p0_4 -3.402823466E+038 3.402823466E+038 /end CHARACTERISTIC
/begin CHARACTERISTIC FTCMTTC_BpAccHighCutOffFrequencyC "FTCMTTC_BpAccHighCutOffFrequencyC" VALUE 0x80064514 DATA_RECORD_FLOAT32_IEEE 3.402823466E+038 F_1_p0_4 -3.402823466E+038 3.402823466E+038 /end CHARACTERISTIC
/begin CHARACTERISTIC FTCMTTC_DampTorqTgtHighThdC "FTCMTTC_DampTorqTgtHighThdC" VALUE 0x80064510 DATA_RECORD_FLOAT32_IEEE 3.402823466E+038 F_1_p0_4 -3.402823466E+038 3.402823466E+038 /end CHARACTERISTIC
/begin CHARACTERISTIC FTCMTTC_DampTorqueTargetThdC "FTCMTTC_DampTorqueTargetThdC" VALUE 0x8006450C DATA_RECORD_FLOAT32_IEEE 3.402823466E+038 F_1_p0_4 -3.402823466E+038 3.402823466E+038 /end CHARACTERISTIC
/begin CHARACTERISTIC FTCMTTC_DampingEnableC "FTCMTTC_DampingEnableC" VALUE 0x80064508 DATA_RECORD_UBYTE 1 Bool_ON_OFF 0 1 BIT_MASK 0x01 /end CHARACTERISTIC
/begin CHARACTERISTIC FTCMTTC_DampingSpdHighC "FTCMTTC_DampingSpdHighC" VALUE 0x80064504 DATA_RECORD_FLOAT32_IEEE 3.402823466E+038 F_1_p0_4 -3.402823466E+038 3.402823466E+038 /end CHARACTERISTIC
/begin CHARACTERISTIC FTCMTTC_DampingSpdLowC "FTCMTTC_DampingSpdLowC" VALUE 0x80064500 DATA_RECORD_FLOAT32_IEEE 3.402823466E+038 F_1_p0_4 -3.402823466E+038 3.402823466E+038 /end CHARACTERISTIC
/begin CHARACTERISTIC FTCMTTC_Lut3InMecaSpeedRpmC "FTCMTTC_Lut3InMecaSpeedRpmC" CURVE 0x800644B8 DATA_RECORD_FLOAT32_IEEE 3.402823466E+038 F_1_p0_4 -3.402823466E+038 3.402823466E+038
 /begin AXIS_DESCR FIX_AXIS NO_INPUT_QUANTITY Id_0x00 18 0 17 MAX_GRAD 100.0 FIX_AXIS_PAR_DIST 0 1 18 /end AXIS_DESCR
/end CHARACTERISTIC
/begin CHARACTERISTIC FTCMTTC_Lut3InTorqueTgtC "FTCMTTC_Lut3InTorqueTgtC" CURVE 0x800643AC DATA_RECORD_FLOAT32_IEEE 3.402823466E+038 F_1_p0_4 -3.402823466E+038 3.402823466E+038
 /begin AXIS_DESCR FIX_AXIS NO_INPUT_QUANTITY Id_0x00 67 0 66 MAX_GRAD 100.0 FIX_AXIS_PAR_DIST 0 1 67 /end AXIS_DESCR
/end CHARACTERISTIC
/begin CHARACTERISTIC FTCMTTC_Lut3InUbatC "FTCMTTC_Lut3InUbatC" CURVE 0x80064394 DATA_RECORD_FLOAT32_IEEE 3.402823466E+038 F_1_p0_4 -3.402823466E+038 3.402823466E+038
 /begin AXIS_DESCR FIX_AXIS NO_INPUT_QUANTITY Id_0x00 6 0 5 MAX_GRAD 100.0 FIX_AXIS_PAR_DIST 0 1 6 /end AXIS_DESCR
/end CHARACTERISTIC
/begin CHARACTERISTIC FTCMTTC_LutInMecaSpeedRpmC "FTCMTTC_LutInMecaSpeedRpmC" CURVE 0x8008F544 DATA_RECORD_FLOAT32_IEEE 20000 F_1_p0_52 0 20000
 /begin AXIS_DESCR FIX_AXIS NO_INPUT_QUANTITY Id_0x00 19 0 18 MAX_GRAD 100.0 FIX_AXIS_PAR_DIST 0 1 19 /end AXIS_DESCR
/end CHARACTERISTIC
/begin CHARACTERISTIC FTCMTTC_LutInSpdRpmAtjkDeltaC "FTCMTTC_LutInSpdRpmAtjkDeltaC" CURVE 0x80064378 DATA_RECORD_FLOAT32_IEEE 3.402823466E+038 F_1_p0_4 -3.402823466E+038 3.402823466E+038
 /begin AXIS_DESCR FIX_AXIS NO_INPUT_QUANTITY Id_0x00 7 0 6 MAX_GRAD 100.0 FIX_AXIS_PAR_DIST 0 1 7 /end AXIS_DESCR
/end CHARACTERISTIC
/begin CHARACTERISTIC FTCMTTC_LutInSpdRpmBaseC "FTCMTTC_LutInSpdRpmBaseC" CURVE 0x8006435C DATA_RECORD_FLOAT32_IEEE 3.402823466E+038 F_1_p0_4 -3.402823466E+038 3.402823466E+038
 /begin AXIS_DESCR FIX_AXIS NO_INPUT_QUANTITY Id_0x00 7 0 6 MAX_GRAD 100.0 FIX_AXIS_PAR_DIST 0 1 7 /end AXIS_DESCR
/end CHARACTERISTIC
/begin CHARACTERISTIC FTCMTTC_LutInSpeedRpmBpTrqHacC "FTCMTTC_LutInSpeedRpmBpTrqHacC" CURVE 0x8006434C DATA_RECORD_FLOAT32_IEEE 3.402823466E+038 F_1_p0_52 -3.402823466E+038 3.402823466E+038
 /begin AXIS_DESCR FIX_AXIS NO_INPUT_QUANTITY Id_0x00 4 0 3 MAX_GRAD 100.0 FIX_AXIS_PAR_DIST 0 1 4 /end AXIS_DESCR
/end CHARACTERISTIC
/begin CHARACTERISTIC FTCMTTC_LutInSpeedRpmDampingC "FTCMTTC_LutInSpeedRpmDampingC" CURVE 0x80064330 DATA_RECORD_FLOAT32_IEEE 3.402823466E+038 F_1_p0_45 -3.402823466E+038 3.402823466E+038
 /begin AXIS_DESCR FIX_AXIS NO_INPUT_QUANTITY Id_0x00 7 0 6 MAX_GRAD 100.0 FIX_AXIS_PAR_DIST 0 1 7 /end AXIS_DESCR
/end CHARACTERISTIC
/begin CHARACTERISTIC FTCMTTC_LutInUbatC "FTCMTTC_LutInUbatC" CURVE 0x8008F52C DATA_RECORD_FLOAT32_IEEE 3.402823466E+038 F_1_p0_38 -3.402823466E+038 3.402823466E+038
 /begin AXIS_DESCR FIX_AXIS NO_INPUT_QUANTITY Id_0x00 6 0 5 MAX_GRAD 100.0 FIX_AXIS_PAR_DIST 0 1 6 /end AXIS_DESCR
/end CHARACTERISTIC
/begin CHARACTERISTIC FTCMTTC_LutOutAntiJerkBaseGainC "FTCMTTC_LutOutAntiJerkBaseGainC" CURVE 0x80064314 DATA_RECORD_FLOAT32_IEEE 3.402823466E+038 F_1_p0_45 -3.402823466E+038 3.402823466E+038
 /begin AXIS_DESCR FIX_AXIS NO_INPUT_QUANTITY Id_0x00 7 0 6 MAX_GRAD 100.0 FIX_AXIS_PAR_DIST 0 1 7 /end AXIS_DESCR
/end CHARACTERISTIC
/begin CHARACTERISTIC FTCMTTC_LutOutAntiJerkBaseGainHacC "FTCMTTC_LutOutAntiJerkBaseGainHacC" CURVE 0x80064304 DATA_RECORD_FLOAT32_IEEE 3.402823466E+038 F_1_p0_52 -3.402823466E+038 3.402823466E+038
 /begin AXIS_DESCR FIX_AXIS NO_INPUT_QUANTITY Id_0x00 4 0 3 MAX_GRAD 100.0 FIX_AXIS_PAR_DIST 0 1 4 /end AXIS_DESCR
/end CHARACTERISTIC
/begin CHARACTERISTIC FTCMTTC_LutOutAtjkDeltaGainC "FTCMTTC_LutOutAtjkDeltaGainC" CURVE 0x800642E8 DATA_RECORD_FLOAT32_IEEE 3.402823466E+038 F_1_p0_4 -3.402823466E+038 3.402823466E+038
 /begin AXIS_DESCR FIX_AXIS NO_INPUT_QUANTITY Id_0x00 7 0 6 MAX_GRAD 100.0 FIX_AXIS_PAR_DIST 0 1 7 /end AXIS_DESCR
/end CHARACTERISTIC
/begin CHARACTERISTIC FTCMTTC_LutOutCutOffFrequencyC "FTCMTTC_LutOutCutOffFrequencyC" CURVE 0x800642CC DATA_RECORD_FLOAT32_IEEE 3.402823466E+038 F_1_p0_35 -3.402823466E+038 3.402823466E+038
 /begin AXIS_DESCR FIX_AXIS NO_INPUT_QUANTITY Id_0x00 7 0 6 MAX_GRAD 100.0 FIX_AXIS_PAR_DIST 0 1 7 /end AXIS_DESCR
/end CHARACTERISTIC
/begin CHARACTERISTIC FTCMTTC_LutOutMecaPowerC "FTCMTTC_LutOutMecaPowerC" MAP 0x8008F364 DATA_RECORD_FLOAT32_IEEE 250000 F_1_p0_69 0 250000
 /begin AXIS_DESCR FIX_AXIS NO_INPUT_QUANTITY Id_0x00 6 0 5 MAX_GRAD 100.0 FIX_AXIS_PAR_DIST 0 1 6 /end AXIS_DESCR
 /begin AXIS_DESCR FIX_AXIS NO_INPUT_QUANTITY Id_0x00 19 0 18 MAX_GRAD 100.0 FIX_AXIS_PAR_DIST 0 1 19 /end AXIS_DESCR
/end CHARACTERISTIC
/begin CHARACTERISTIC FTCMTTC_PowerLimtEnableC "FTCMTTC_PowerLimtEnableC" VALUE 0x800642C8 DATA_RECORD_UBYTE 1 Bool_ON_OFF 0 1 BIT_MASK 0x01 /end CHARACTERISTIC
/begin CHARACTERISTIC FTCMTTC_PreTorqTrasRangeC "FTCMTTC_PreTorqTrasRangeC" VALUE 0x800642C4 DATA_RECORD_FLOAT32_IEEE 3.402823466E+038 F_1_p0_4 -3.402823466E+038 3.402823466E+038 /end CHARACTERISTIC
/begin CHARACTERISTIC FTCMTTC_PreTorqTrasStep2C "FTCMTTC_PreTorqTrasStep2C" VALUE 0x800642C0 DATA_RECORD_FLOAT32_IEEE 3.402823466E+038 F_1_p0_4 -3.402823466E+038 3.402823466E+038 /end CHARACTERISTIC
/begin CHARACTERISTIC FTCMTTC_PreTorqTrasStepMaxC "FTCMTTC_PreTorqTrasStepMaxC" VALUE 0x800642BC DATA_RECORD_FLOAT32_IEEE 3.402823466E+038 F_1_p0_4 -3.402823466E+038 3.402823466E+038 /end CHARACTERISTIC
/begin CHARACTERISTIC FTCMTTC_PreTorqTrasStepMinC "FTCMTTC_PreTorqTrasStepMinC" VALUE 0x800642B8 DATA_RECORD_FLOAT32_IEEE 3.402823466E+038 F_1_p0_4 -3.402823466E+038 3.402823466E+038 /end CHARACTERISTIC
/begin CHARACTERISTIC FTCMTTC_PreTorqueC "FTCMTTC_PreTorqueC" VALUE 0x800642B4 DATA_RECORD_FLOAT32_IEEE 3.402823466E+038 F_1_p0_4 -3.402823466E+038 3.402823466E+038 /end CHARACTERISTIC
/begin CHARACTERISTIC FTCMTTC_PreTorqueEnableC "FTCMTTC_PreTorqueEnableC" VALUE 0x800642B0 DATA_RECORD_UBYTE 1 Bool_ON_OFF 0 1 BIT_MASK 0x01 /end CHARACTERISTIC
/begin CHARACTERISTIC FTCMTTC_PreTorqueStartC "FTCMTTC_PreTorqueStartC" VALUE 0x800642AC DATA_RECORD_FLOAT32_IEEE 3.402823466E+038 F_1_p0_4 -3.402823466E+038 3.402823466E+038 /end CHARACTERISTIC
/begin CHARACTERISTIC FTCMTTC_PreTorqueTimeC "FTCMTTC_PreTorqueTimeC" VALUE 0x800642A8 DATA_RECORD_UWORD 65535 F_1_p0_4 0 65535 /end CHARACTERISTIC
/begin CHARACTERISTIC FTCMTTC_Rpm2RdsC "FTCMTTC_Rpm2RdsC" VALUE 0x800642A4 DATA_RECORD_FLOAT32_IEEE 3.402823466E+038 F_1_p0_4 -3.402823466E+038 3.402823466E+038 /end CHARACTERISTIC
/begin CHARACTERISTIC FTCMTTC_SpeedHysteresisRangeC "FTCMTTC_SpeedHysteresisRangeC" VALUE 0x800642A0 DATA_RECORD_FLOAT32_IEEE 3.402823466E+038 F_1_p0_45 -3.402823466E+038 3.402823466E+038 /end CHARACTERISTIC
/begin CHARACTERISTIC FTCMTTC_SpeedThdC "FTCMTTC_SpeedThdC" VALUE 0x8006429C DATA_RECORD_FLOAT32_IEEE 3.402823466E+038 F_1_p0_52 -3.402823466E+038 3.402823466E+038 /end CHARACTERISTIC
/begin CHARACTERISTIC FTCMTTC_TolTqrLmtEnC "FTCMTTC_TolTqrLmtEnC" VALUE 0x80064298 DATA_RECORD_UBYTE 1 Bool_ON_OFF 0 1 BIT_MASK 0x01 /end CHARACTERISTIC
/begin CHARACTERISTIC FTCMTTC_ToqueHpFilterSpdThrdC "FTCMTTC_ToqueHpFilterSpdThrdC" VALUE 0x80064294 DATA_RECORD_FLOAT32_IEEE 3.402823466E+038 F_1_p0_4 -3.402823466E+038 3.402823466E+038 /end CHARACTERISTIC
/begin CHARACTERISTIC FTCMTTC_TorMaxC "FTCMTTC_TorMaxC" VALUE 0x80064290 DATA_RECORD_FLOAT32_IEEE 3.402823466E+038 F_1_p0_49 -3.402823466E+038 3.402823466E+038 /end CHARACTERISTIC
/begin CHARACTERISTIC FTCMTTC_TorqCorEnableC "FTCMTTC_TorqCorEnableC" VALUE 0x8006428C DATA_RECORD_UBYTE 1 Bool_ON_OFF 0 1 BIT_MASK 0x01 /end CHARACTERISTIC
/begin CHARACTERISTIC FTCMTTC_TorqueBySecondNegC "FTCMTTC_TorqueBySecondNegC" VALUE 0x80064288 DATA_RECORD_FLOAT32_IEEE 3.402823466E+038 F_1_p0_4 -3.402823466E+038 3.402823466E+038 /end CHARACTERISTIC
/begin CHARACTERISTIC FTCMTTC_TorqueBySecondPosC "FTCMTTC_TorqueBySecondPosC" VALUE 0x80064284 DATA_RECORD_FLOAT32_IEEE 3.402823466E+038 F_1_p0_4 -3.402823466E+038 3.402823466E+038 /end CHARACTERISTIC
/begin CHARACTERISTIC FTCMTTC_TorqueCutOffFrequencyC "FTCMTTC_TorqueCutOffFrequencyC" VALUE 0x80064280 DATA_RECORD_FLOAT32_IEEE 3.402823466E+038 F_1_p0_4 -3.402823466E+038 3.402823466E+038 /end CHARACTERISTIC
/begin CHARACTERISTIC FTCMTTC_TorqueFildTrC "FTCMTTC_TorqueFildTrC" VALUE 0x8006427C DATA_RECORD_FLOAT32_IEEE 3.402823466E+038 F_1_p0_4 -3.402823466E+038 3.402823466E+038 /end CHARACTERISTIC
/begin CHARACTERISTIC FTCMTTC_TorqueHpFilterSpdHystRgC "FTCMTTC_TorqueHpFilterSpdHystRgC" VALUE 0x80064278 DATA_RECORD_FLOAT32_IEEE 3.402823466E+038 F_1_p0_4 -3.402823466E+038 3.402823466E+038 /end CHARACTERISTIC
/begin CHARACTERISTIC FTCMTTC_TrqHpCutOffFrequencyC "FTCMTTC_TrqHpCutOffFrequencyC" VALUE 0x80064274 DATA_RECORD_FLOAT32_IEEE 3.402823466E+038 F_1_p0_4 -3.402823466E+038 3.402823466E+038 /end CHARACTERISTIC
/begin CHARACTERISTIC FTCMTTC_TrqSatThrdC "FTCMTTC_TrqSatThrdC" VALUE 0x80064270 DATA_RECORD_FLOAT32_IEEE 3.402823466E+038 F_1_p0_4 -3.402823466E+038 3.402823466E+038 /end CHARACTERISTIC
/begin CHARACTERISTIC FTCMTTC_ZeroSpdC "FTCMTTC_ZeroSpdC" VALUE 0x8006426C DATA_RECORD_FLOAT32_IEEE 3.402823466E+038 F_1_p0_4 -3.402823466E+038 3.402823466E+038 /end CHARACTERISTIC
/begin CHARACTERISTIC FTDDLMP_I0LimitMaxC "The maximum current of I0 limit value in limp control mode." VALUE 0x80064548 DATA_RECORD_FLOAT32_IEEE 2000 F_1_p0_46 -1000 1000 /end CHARACTERISTIC
/begin CHARACTERISTIC FTDDLMP_I0LimitMinC "The minimum current of I0 limit value in limp control mode." VALUE 0x80064544 DATA_RECORD_FLOAT32_IEEE 2000 F_1_p0_46 -1000 1000 /end CHARACTERISTIC
/begin CHARACTERISTIC FTDDLMP_IdLimitMaxC "The maximum current of Id limit value in limp control mode." VALUE 0x80064540 DATA_RECORD_FLOAT32_IEEE 2000 F_1_p0_46 -1000 1000 /end CHARACTERISTIC
/begin CHARACTERISTIC FTDDLMP_IdLimitMinC "The minimum current of Id limit value in limp control mode." VALUE 0x8006453C DATA_RECORD_FLOAT32_IEEE 2000 F_1_p0_46 -1000 1000 /end CHARACTERISTIC
/begin CHARACTERISTIC FTDDLMP_IqLimitMaxC "The maximum current of Iq limit value in limp control mode." VALUE 0x80064538 DATA_RECORD_FLOAT32_IEEE 2000 F_1_p0_46 -1000 1000 /end CHARACTERISTIC
/begin CHARACTERISTIC FTDDLMP_IqLimitMinC "The minimum current of Iq limit value in limp control mode." VALUE 0x80064534 DATA_RECORD_FLOAT32_IEEE 2000 F_1_p0_46 -1000 1000 /end CHARACTERISTIC
/begin CHARACTERISTIC FTDDLMP_PowerLimC "FTDDLMP_PowerLimC" VALUE 0x80064530 DATA_RECORD_FLOAT32_IEEE 3.402823466E+038 F_1_p0_69 -3.402823466E+038 3.402823466E+038 /end CHARACTERISTIC
/begin CHARACTERISTIC FTDDLMP_SpeedLimitMaxC "The maximum speed limit value in limp control mode." VALUE 0x8006452C DATA_RECORD_FLOAT32_IEEE 40000 F_1_p0_52 -20000 20000 /end CHARACTERISTIC
/begin CHARACTERISTIC FTDDLMP_SpeedLimitMinC "The minimum speed limit value in limp control mode." VALUE 0x80064528 DATA_RECORD_FLOAT32_IEEE 40000 F_1_p0_52 -20000 20000 /end CHARACTERISTIC
/begin CHARACTERISTIC FTDDLMP_TorqLimitMaxC "The maximum torque limit value in limp control mode." VALUE 0x80064524 DATA_RECORD_FLOAT32_IEEE 1000 F_1_p0_56 -500 500 /end CHARACTERISTIC
/begin CHARACTERISTIC FTDDLMP_TorqLimitMinC "The minimum torque limit value in limp control mode." VALUE 0x80064520 DATA_RECORD_FLOAT32_IEEE 1000 F_1_p0_56 -500 500 /end CHARACTERISTIC
/begin CHARACTERISTIC FTEVEIT_CommutDataCoeffC "Data for commutation losses estimation : ( floor(ModuleFunctionCallPeriod / SwitchingPeriod) * floor(CommutationNberPerSwtchT / 2) ) / ModuleFunctionCallPeriod." VALUE 0x80064ACC DATA_RECORD_FLOAT32_IEEE 1000000 F_1_p0_35 0 1000000 /end CHARACTERISTIC
/begin CHARACTERISTIC FTEVEIT_EoffICurrentsC "IGBT Eoff = f(Current) cartography input vector." CURVE 0x80064AA8 DATA_RECORD_FLOAT32_IEEE 1000000 F_1_p0_70 0 1000000
 /begin AXIS_DESCR FIX_AXIS NO_INPUT_QUANTITY Id_0x00 9 0 8 MAX_GRAD 100.0 FIX_AXIS_PAR_DIST 0 1 9 /end AXIS_DESCR
/end CHARACTERISTIC
/begin CHARACTERISTIC FTEVEIT_EoffIEnergiesC "IGBT Eoff = f(Current) cartography output vector." CURVE 0x80064A84 DATA_RECORD_FLOAT32_IEEE 1000000 F_1_p0_71 0 1000000
 /begin AXIS_DESCR FIX_AXIS NO_INPUT_QUANTITY Id_0x00 9 0 8 MAX_GRAD 100.0 FIX_AXIS_PAR_DIST 0 1 9 /end AXIS_DESCR
/end CHARACTERISTIC
/begin CHARACTERISTIC FTEVEIT_EonICurrentsC "IGBT Eon = f(Current) cartography input vector." CURVE 0x80064A60 DATA_RECORD_FLOAT32_IEEE 1000000 F_1_p0_70 0 1000000
 /begin AXIS_DESCR FIX_AXIS NO_INPUT_QUANTITY Id_0x00 9 0 8 MAX_GRAD 100.0 FIX_AXIS_PAR_DIST 0 1 9 /end AXIS_DESCR
/end CHARACTERISTIC
/begin CHARACTERISTIC FTEVEIT_EonIEnergiesC "IGBT Eon = f(Current) cartography output vector." CURVE 0x80064A3C DATA_RECORD_FLOAT32_IEEE 1000000 F_1_p0_71 0 1000000
 /begin AXIS_DESCR FIX_AXIS NO_INPUT_QUANTITY Id_0x00 9 0 8 MAX_GRAD 100.0 FIX_AXIS_PAR_DIST 0 1 9 /end AXIS_DESCR
/end CHARACTERISTIC
/begin CHARACTERISTIC FTEVEIT_ErecICurrentsC "Diode Erec = f(Current) cartography input vector." CURVE 0x80064A18 DATA_RECORD_FLOAT32_IEEE 1000000 F_1_p0_70 0 1000000
 /begin AXIS_DESCR FIX_AXIS NO_INPUT_QUANTITY Id_0x00 9 0 8 MAX_GRAD 100.0 FIX_AXIS_PAR_DIST 0 1 9 /end AXIS_DESCR
/end CHARACTERISTIC
/begin CHARACTERISTIC FTEVEIT_ErecIEnergiesC "Diode Erec = f(Current) cartography output vector." CURVE 0x800649F4 DATA_RECORD_FLOAT32_IEEE 1000000 F_1_p0_71 0 1000000
 /begin AXIS_DESCR FIX_AXIS NO_INPUT_QUANTITY Id_0x00 9 0 8 MAX_GRAD 100.0 FIX_AXIS_PAR_DIST 0 1 9 /end AXIS_DESCR
/end CHARACTERISTIC
/begin CHARACTERISTIC FTEVEIT_KoffUdcCoeffsC "IGBT Koff = f(Udc) table output vector." CURVE 0x800649B0 DATA_RECORD_FLOAT32_IEEE 100 F_1_p0_36 0 100
 /begin AXIS_DESCR FIX_AXIS NO_INPUT_QUANTITY Id_0x00 17 0 16 MAX_GRAD 100.0 FIX_AXIS_PAR_DIST 0 1 17 /end AXIS_DESCR
/end CHARACTERISTIC
/begin CHARACTERISTIC FTEVEIT_KoffUdcVoltagesC "IGBT Koff = f(Udc) cartography input vector." CURVE 0x8006496C DATA_RECORD_FLOAT32_IEEE 2000 F_1_p0_39 0 2000
 /begin AXIS_DESCR FIX_AXIS NO_INPUT_QUANTITY Id_0x00 17 0 16 MAX_GRAD 100.0 FIX_AXIS_PAR_DIST 0 1 17 /end AXIS_DESCR
/end CHARACTERISTIC
/begin CHARACTERISTIC FTEVEIT_KonUdcCoeffsC "IGBT Kon = f(Udc) table output vector." CURVE 0x80064928 DATA_RECORD_FLOAT32_IEEE 100 F_1_p0_36 0 100
 /begin AXIS_DESCR FIX_AXIS NO_INPUT_QUANTITY Id_0x00 17 0 16 MAX_GRAD 100.0 FIX_AXIS_PAR_DIST 0 1 17 /end AXIS_DESCR
/end CHARACTERISTIC
/begin CHARACTERISTIC FTEVEIT_KonUdcVoltagesC "IGBT Kon = f(Udc) cartography input vector." CURVE 0x800648E4 DATA_RECORD_FLOAT32_IEEE 2000 F_1_p0_39 0 2000
 /begin AXIS_DESCR FIX_AXIS NO_INPUT_QUANTITY Id_0x00 17 0 16 MAX_GRAD 100.0 FIX_AXIS_PAR_DIST 0 1 17 /end AXIS_DESCR
/end CHARACTERISTIC
/begin CHARACTERISTIC FTEVEIT_KrecUdcCoeffsC "Diode Krec = f(Udc) table output vector." CURVE 0x800648A0 DATA_RECORD_FLOAT32_IEEE 100 F_1_p0_36 0 100
 /begin AXIS_DESCR FIX_AXIS NO_INPUT_QUANTITY Id_0x00 17 0 16 MAX_GRAD 100.0 FIX_AXIS_PAR_DIST 0 1 17 /end AXIS_DESCR
/end CHARACTERISTIC
/begin CHARACTERISTIC FTEVEIT_KrecUdcVoltagesC "Diode Krec = f(Udc) cartography input vector." CURVE 0x8006485C DATA_RECORD_FLOAT32_IEEE 2000 F_1_p0_39 0 2000
 /begin AXIS_DESCR FIX_AXIS NO_INPUT_QUANTITY Id_0x00 17 0 16 MAX_GRAD 100.0 FIX_AXIS_PAR_DIST 0 1 17 /end AXIS_DESCR
/end CHARACTERISTIC
/begin CHARACTERISTIC FTEVEIT_MaxMechaSpdHysteresisC "Hysteresis maximal temperature for estimation enable." VALUE 0x80064858 DATA_RECORD_FLOAT32_IEEE 16000 F_1_p0_21 0 16000 /end CHARACTERISTIC
/begin CHARACTERISTIC FTEVEIT_MaxTempC "Chips maximal allowed temperature." VALUE 0x80064854 DATA_RECORD_FLOAT32_IEEE 240 F_1_p0_73 -40 200 /end CHARACTERISTIC
/begin CHARACTERISTIC FTEVEIT_MinMechaSpdHysteresisC "Hysteresis minimal temperature for estimation enable." VALUE 0x80064850 DATA_RECORD_FLOAT32_IEEE 16000 F_1_p0_21 0 16000 /end CHARACTERISTIC
/begin CHARACTERISTIC FTEVEIT_OverTempThresC "Maximal temperature value for the IGBTs and Diodes maximal estimated temperatures." VALUE 0x8006484C DATA_RECORD_FLOAT32_IEEE 240 F_1_p0_72 -40 200 /end CHARACTERISTIC
/begin CHARACTERISTIC FTEVEIT_PdiodeTdiodeAlphaS1C "Thermal model : Transfert function from diode power losses to diode junction temperature : subsystem 1 pole." VALUE 0x80064848 DATA_RECORD_FLOAT32_IEEE 1 F_1_p0_47 0 1 /end CHARACTERISTIC
/begin CHARACTERISTIC FTEVEIT_PdiodeTdiodeAlphaS2C "Thermal model : Transfert function from diode power losses to diode junction temperature : subsystem 2 pole." VALUE 0x80064844 DATA_RECORD_FLOAT32_IEEE 1 F_1_p0_47 0 1 /end CHARACTERISTIC
/begin CHARACTERISTIC FTEVEIT_PdiodeTdiodeAlphaS3C "Thermal model : Transfert function from diode power losses to diode junction temperature : subsystem 3 pole." VALUE 0x80064840 DATA_RECORD_FLOAT32_IEEE 1 F_1_p0_47 0 1 /end CHARACTERISTIC
/begin CHARACTERISTIC FTEVEIT_PdiodeTdiodeAlphaS4C "Thermal model : Transfert function from diode power losses to diode junction temperature : subsystem 4 pole." VALUE 0x8006483C DATA_RECORD_FLOAT32_IEEE 1 F_1_p0_47 0 1 /end CHARACTERISTIC
/begin CHARACTERISTIC FTEVEIT_PdiodeTdiodeAlphaS5C "Thermal model : Transfert function from diode power losses to diode junction temperature : subsystem 5 pole." VALUE 0x80064838 DATA_RECORD_FLOAT32_IEEE 1 F_1_p0_47 0 1 /end CHARACTERISTIC
/begin CHARACTERISTIC FTEVEIT_PdiodeTdiodeNumS1C "Thermal model : Transfert function from diode power losses to diode junction temperature : subsystem 1 numerator gain." VALUE 0x80064834 DATA_RECORD_FLOAT32_IEEE 1000000 F_1_p0_47 0 1000000 /end CHARACTERISTIC
/begin CHARACTERISTIC FTEVEIT_PdiodeTdiodeNumS2C "Thermal model : Transfert function from diode power losses to diode junction temperature : subsystem 2 numerator gain." VALUE 0x80064830 DATA_RECORD_FLOAT32_IEEE 1000000 F_1_p0_47 0 1000000 /end CHARACTERISTIC
/begin CHARACTERISTIC FTEVEIT_PdiodeTdiodeNumS3C "Thermal model : Transfert function from diode power losses to diode junction temperature : subsystem 3 numerator gain." VALUE 0x8006482C DATA_RECORD_FLOAT32_IEEE 1000000 F_1_p0_47 0 1000000 /end CHARACTERISTIC
/begin CHARACTERISTIC FTEVEIT_PdiodeTdiodeNumS4C "Thermal model : Transfert function from diode power losses to diode junction temperature : subsystem 4 numerator gain." VALUE 0x80064828 DATA_RECORD_FLOAT32_IEEE 1000000 F_1_p0_47 0 1000000 /end CHARACTERISTIC
/begin CHARACTERISTIC FTEVEIT_PdiodeTdiodeNumS5C "Thermal model : Transfert function from diode power losses to diode junction temperature : subsystem 5 numerator gain." VALUE 0x80064824 DATA_RECORD_FLOAT32_IEEE 1000000 F_1_p0_47 0 1000000 /end CHARACTERISTIC
/begin CHARACTERISTIC FTEVEIT_PdiodeTigbtAlphaC "Thermal model : Transfert function from diode power losses to IGBT junction temperature : pole." VALUE 0x80064820 DATA_RECORD_FLOAT32_IEEE 1 F_1_p0_47 0 1 /end CHARACTERISTIC
/begin CHARACTERISTIC FTEVEIT_PdiodeTigbtNumC "Thermal model : Transfert function from diode power losses to IGBT junction temperature : numerator gain." VALUE 0x8006481C DATA_RECORD_FLOAT32_IEEE 1000000 F_1_p0_47 0 1000000 /end CHARACTERISTIC
/begin CHARACTERISTIC FTEVEIT_PigbtTdiodeAlphaC "Thermal model : Transfert function from IGBT power losses to diode junction temperature : pole." VALUE 0x80064818 DATA_RECORD_FLOAT32_IEEE 1 F_1_p0_47 0 1 /end CHARACTERISTIC
/begin CHARACTERISTIC FTEVEIT_PigbtTdiodeNumC "Thermal model : Transfert function from IGBT power losses to diode junction temperature : numerator gain." VALUE 0x80064814 DATA_RECORD_FLOAT32_IEEE 1000000 F_1_p0_47 0 1000000 /end CHARACTERISTIC
/begin CHARACTERISTIC FTEVEIT_PigbtTigbtAlphaS1C "Thermal model : Transfert function from IGBT power losses to IGBT junction temperature : subsystem 1 pole." VALUE 0x80064810 DATA_RECORD_FLOAT32_IEEE 1 F_1_p0_47 0 1 /end CHARACTERISTIC
/begin CHARACTERISTIC FTEVEIT_PigbtTigbtAlphaS2C "Thermal model : Transfert function from IGBT power losses to IGBT junction temperature : subsystem 2 pole." VALUE 0x8006480C DATA_RECORD_FLOAT32_IEEE 1 F_1_p0_47 0 1 /end CHARACTERISTIC
/begin CHARACTERISTIC FTEVEIT_PigbtTigbtAlphaS3C "Thermal model : Transfert function from IGBT power losses to IGBT junction temperature : subsystem 3 pole." VALUE 0x80064808 DATA_RECORD_FLOAT32_IEEE 1 F_1_p0_47 0 1 /end CHARACTERISTIC
/begin CHARACTERISTIC FTEVEIT_PigbtTigbtAlphaS4C "Thermal model : Transfert function from IGBT power losses to IGBT junction temperature : subsystem 4 pole." VALUE 0x80064804 DATA_RECORD_FLOAT32_IEEE 1 F_1_p0_47 0 1 /end CHARACTERISTIC
/begin CHARACTERISTIC FTEVEIT_PigbtTigbtAlphaS5C "Thermal model : Transfert function from IGBT power losses to IGBT junction temperature : subsystem 5 pole." VALUE 0x80064800 DATA_RECORD_FLOAT32_IEEE 1 F_1_p0_47 0 1 /end CHARACTERISTIC
/begin CHARACTERISTIC FTEVEIT_PigbtTigbtNumS1C "Thermal model : Transfert function from IGBT power losses to IGBT junction temperature : subsystem 1 numerator gain." VALUE 0x800647FC DATA_RECORD_FLOAT32_IEEE 1000000 F_1_p0_47 0 1000000 /end CHARACTERISTIC
/begin CHARACTERISTIC FTEVEIT_PigbtTigbtNumS2C "Thermal model : Transfert function from IGBT power losses to IGBT junction temperature : subsystem 2 numerator gain." VALUE 0x800647F8 DATA_RECORD_FLOAT32_IEEE 1000000 F_1_p0_47 0 1000000 /end CHARACTERISTIC
/begin CHARACTERISTIC FTEVEIT_PigbtTigbtNumS3C "Thermal model : Transfert function from IGBT power losses to IGBT junction temperature : subsystem 3 numerator gain." VALUE 0x800647F4 DATA_RECORD_FLOAT32_IEEE 1000000 F_1_p0_47 0 1000000 /end CHARACTERISTIC
/begin CHARACTERISTIC FTEVEIT_PigbtTigbtNumS4C "Thermal model : Transfert function from IGBT power losses to IGBT junction temperature : subsystem 4 numerator gain." VALUE 0x800647F0 DATA_RECORD_FLOAT32_IEEE 1000000 F_1_p0_47 0 1000000 /end CHARACTERISTIC
/begin CHARACTERISTIC FTEVEIT_PigbtTigbtNumS5C "Thermal model : Transfert function from IGBT power losses to IGBT junction temperature : subsystem 5 numerator gain." VALUE 0x800647EC DATA_RECORD_FLOAT32_IEEE 1000000 F_1_p0_47 0 1000000 /end CHARACTERISTIC
/begin CHARACTERISTIC FTEVEIT_TcoolBenchC "Bench mode : demanded cooling temperature asked by the experimenter." VALUE 0x800647E8 DATA_RECORD_FLOAT32_IEEE 400 F_1_p0_72 -200 200 /end CHARACTERISTIC
/begin CHARACTERISTIC FTEVEIT_TcoolChoosePMWC "Set this boolean to 1 to estimate the cooling temperature by using the power module W temperature." VALUE 0x800647E4 DATA_RECORD_UBYTE 1 Bool_ON_OFF 0 1 BIT_MASK 0x01 /end CHARACTERISTIC
/begin CHARACTERISTIC FTEVEIT_TcoolScalingAlphaC "Scaling on the estimated cooling temperature : y = Alpha * x + Beta." VALUE 0x800647E0 DATA_RECORD_FLOAT32_IEEE 2000000 F_1_p0_47 -1000000 1000000 /end CHARACTERISTIC
/begin CHARACTERISTIC FTEVEIT_TcoolScalingBetaC "Scaling on the estimated cooling temperature : y = Alpha * x + Beta." VALUE 0x800647DC DATA_RECORD_FLOAT32_IEEE 2000000 F_1_p0_72 -1000000 1000000 /end CHARACTERISTIC
/begin CHARACTERISTIC FTEVEIT_TempFirstFildTrC "Time response at 95 Percent for the IGBTs and Diodes temperatures estimation first filter." VALUE 0x800647D8 DATA_RECORD_FLOAT32_IEEE 100 F_1_p0_53 0 100 /end CHARACTERISTIC
/begin CHARACTERISTIC FTEVEIT_TempSecFildTrC "Time response at 95 Percent for the IGBTs and Diodes temperatures estimation second filter." VALUE 0x800647D4 DATA_RECORD_FLOAT32_IEEE 100 F_1_p0_53 0 100 /end CHARACTERISTIC
/begin CHARACTERISTIC FTEVEIT_TempVectFildTrC "Time response at 95 Percent for the IGBTs and Diodes temperatures estimation vector filter." VALUE 0x800647D0 DATA_RECORD_FLOAT32_IEEE 100 F_1_p0_53 0 100 /end CHARACTERISTIC
/begin CHARACTERISTIC FTEVEIT_UdICurrentsC "Diode Voltage = f(Current) cartography input vector." CURVE 0x8006478C DATA_RECORD_FLOAT32_IEEE 1000000 F_1_p0_70 0 1000000
 /begin AXIS_DESCR FIX_AXIS NO_INPUT_QUANTITY Id_0x00 17 0 16 MAX_GRAD 100.0 FIX_AXIS_PAR_DIST 0 1 17 /end AXIS_DESCR
/end CHARACTERISTIC
/begin CHARACTERISTIC FTEVEIT_UdIVoltagesC "Diode Voltage = f(Current) cartography output vector." CURVE 0x80064748 DATA_RECORD_FLOAT32_IEEE 1000000 F_1_p0_39 0 1000000
 /begin AXIS_DESCR FIX_AXIS NO_INPUT_QUANTITY Id_0x00 17 0 16 MAX_GRAD 100.0 FIX_AXIS_PAR_DIST 0 1 17 /end AXIS_DESCR
/end CHARACTERISTIC
/begin CHARACTERISTIC FTEVEIT_UtICurrentsC "IGBT Voltage = f(Current) cartography input vector." CURVE 0x80064704 DATA_RECORD_FLOAT32_IEEE 1000000 F_1_p0_70 0 1000000
 /begin AXIS_DESCR FIX_AXIS NO_INPUT_QUANTITY Id_0x00 17 0 16 MAX_GRAD 100.0 FIX_AXIS_PAR_DIST 0 1 17 /end AXIS_DESCR
/end CHARACTERISTIC
/begin CHARACTERISTIC FTEVEIT_UtIVoltagesC "IGBT Voltage = f(Current) cartography output vector." CURVE 0x800646C0 DATA_RECORD_FLOAT32_IEEE 1000000 F_1_p0_39 0 1000000
 /begin AXIS_DESCR FIX_AXIS NO_INPUT_QUANTITY Id_0x00 17 0 16 MAX_GRAD 100.0 FIX_AXIS_PAR_DIST 0 1 17 /end AXIS_DESCR
/end CHARACTERISTIC
/begin CHARACTERISTIC FTMTLCS_A2DGainIsuLC "gain used to correct a sensor linearity error" VALUE 0x80064BA8 DATA_RECORD_FLOAT32_IEEE 3.402823466E+038 F_1_p0_55 -3.402823466E+038 3.402823466E+038 /end CHARACTERISTIC
/begin CHARACTERISTIC FTMTLCS_A2DGainIsvLC "gain used to correct a sensor linearity error" VALUE 0x80064BA4 DATA_RECORD_FLOAT32_IEEE 3.402823466E+038 F_1_p0_55 -3.402823466E+038 3.402823466E+038 /end CHARACTERISTIC
/begin CHARACTERISTIC FTMTLCS_A2DGainIswLC "gain used to correct a sensor linearity error" VALUE 0x80064BA0 DATA_RECORD_FLOAT32_IEEE 3.402823466E+038 F_1_p0_55 -3.402823466E+038 3.402823466E+038 /end CHARACTERISTIC
/begin CHARACTERISTIC FTMTLCS_A2DHighThresholdC "FTMTLCS_A2DHighThresholdC" VALUE 0x80064B9C DATA_RECORD_UWORD 4095 F_1_p0_54 0 4095 /end CHARACTERISTIC
/begin CHARACTERISTIC FTMTLCS_A2DLowThresholdC "FTMTLCS_A2DLowThresholdC" VALUE 0x80064B98 DATA_RECORD_UWORD 4095 F_1_p0_54 0 4095 /end CHARACTERISTIC
/begin CHARACTERISTIC FTMTLCS_A2DOutRngHThresholdHC "FTMTLCS_A2DOutRngHThresholdHC" VALUE 0x80064B94 DATA_RECORD_UWORD 4095 F_1_p0_54 0 4095 /end CHARACTERISTIC
/begin CHARACTERISTIC FTMTLCS_A2DOutRngHThresholdLC "FTMTLCS_A2DOutRngHThresholdLC" VALUE 0x80064B90 DATA_RECORD_UWORD 4095 F_1_p0_54 0 4095 /end CHARACTERISTIC
/begin CHARACTERISTIC FTMTLCS_A2DOutRngLThresholdHC "FTMTLCS_A2DOutRngLThresholdHC" VALUE 0x80064B8C DATA_RECORD_UWORD 4095 F_1_p0_54 0 4095 /end CHARACTERISTIC
/begin CHARACTERISTIC FTMTLCS_A2DOutRngLThresholdLC "FTMTLCS_A2DOutRngLThresholdLC" VALUE 0x80064B88 DATA_RECORD_UWORD 4095 F_1_p0_54 0 4095 /end CHARACTERISTIC
/begin CHARACTERISTIC FTMTLCS_CurrentCalEnableC "FTMTLCS_CurrentCalEnableC" VALUE 0x80064B84 DATA_RECORD_UBYTE 1 Bool_ON_OFF 0 1 BIT_MASK 0x01 /end CHARACTERISTIC
/begin CHARACTERISTIC FTMTLCS_CurrentOffsetInitC "FTMTLCS_CurrentOffsetInitC" VALUE 0x80064B80 DATA_RECORD_FLOAT32_IEEE 3.402823466E+038 F_1_p0_45 -3.402823466E+038 3.402823466E+038 /end CHARACTERISTIC
/begin CHARACTERISTIC FTMTLCS_Init2DurationC "duration of init 2" VALUE 0x80064B7C DATA_RECORD_FLOAT32_IEEE 3.402823466E+038 F_1_p0_53 -3.402823466E+038 3.402823466E+038 /end CHARACTERISTIC
/begin CHARACTERISTIC FTMTLCS_InitIuvw3C "FTMTLCS_InitIuvw3C" CURVE 0x80064B70 DATA_RECORD_FLOAT32_IEEE 3.402823466E+038 F_1_p0_46 -3.402823466E+038 3.402823466E+038
 /begin AXIS_DESCR FIX_AXIS NO_INPUT_QUANTITY Id_0x00 3 0 2 MAX_GRAD 100.0 FIX_AXIS_PAR_DIST 0 1 3 /end AXIS_DESCR
/end CHARACTERISTIC
/begin CHARACTERISTIC FTMTLCS_IuGainC "FTMTLCS_IuGainC" VALUE 0x80064B6C DATA_RECORD_FLOAT32_IEEE 3.402823466E+038 F_1_p0_4 -3.402823466E+038 3.402823466E+038 /end CHARACTERISTIC
/begin CHARACTERISTIC FTMTLCS_IvGainC "FTMTLCS_IvGainC" VALUE 0x80064B68 DATA_RECORD_FLOAT32_IEEE 3.402823466E+038 F_1_p0_4 -3.402823466E+038 3.402823466E+038 /end CHARACTERISTIC
/begin CHARACTERISTIC FTMTLCS_IwGainC "FTMTLCS_IwGainC" VALUE 0x80064B64 DATA_RECORD_FLOAT32_IEEE 3.402823466E+038 F_1_p0_4 -3.402823466E+038 3.402823466E+038 /end CHARACTERISTIC
/begin CHARACTERISTIC FTMTLCS_LostPhaseDelayCntC "FTMTLCS_LostPhaseDelayCntC" VALUE 0x80064B60 DATA_RECORD_UWORD 65535 F_1_p0_54 0 65535 /end CHARACTERISTIC
/begin CHARACTERISTIC FTMTLCS_LostPhaseEnaEleSpdRdsC "FTMTLCS_LostPhaseEnaEleSpdRdsC" VALUE 0x80064B5C DATA_RECORD_FLOAT32_IEEE 3.402823466E+038 F_1_p0_55 -3.402823466E+038 3.402823466E+038 /end CHARACTERISTIC
/begin CHARACTERISTIC FTMTLCS_LostPhaseMaxRateC "FTMTLCS_LostPhaseMaxRateC" VALUE 0x80064B58 DATA_RECORD_FLOAT32_IEEE 3.402823466E+038 F_1_p0_55 -3.402823466E+038 3.402823466E+038 /end CHARACTERISTIC
/begin CHARACTERISTIC FTMTLCS_LostPhaseMinIRmsC "FTMTLCS_LostPhaseMinIRmsC" VALUE 0x80064B54 DATA_RECORD_FLOAT32_IEEE 3.402823466E+038 F_1_p0_55 -3.402823466E+038 3.402823466E+038 /end CHARACTERISTIC
/begin CHARACTERISTIC FTMTLCS_LutInPhaseCurrUC "FTMTLCS_LutInPhaseCurrUC" CURVE 0x80064B40 DATA_RECORD_FLOAT32_IEEE 3.402823466E+038 F_1_p0_4 -3.402823466E+038 3.402823466E+038
 /begin AXIS_DESCR FIX_AXIS NO_INPUT_QUANTITY Id_0x00 5 0 4 MAX_GRAD 100.0 FIX_AXIS_PAR_DIST 0 1 5 /end AXIS_DESCR
/end CHARACTERISTIC
/begin CHARACTERISTIC FTMTLCS_LutInPhaseCurrVC "FTMTLCS_LutInPhaseCurrVC" CURVE 0x80064B2C DATA_RECORD_FLOAT32_IEEE 3.402823466E+038 F_1_p0_4 -3.402823466E+038 3.402823466E+038
 /begin AXIS_DESCR FIX_AXIS NO_INPUT_QUANTITY Id_0x00 5 0 4 MAX_GRAD 100.0 FIX_AXIS_PAR_DIST 0 1 5 /end AXIS_DESCR
/end CHARACTERISTIC
/begin CHARACTERISTIC FTMTLCS_LutInPhaseCurrWC "FTMTLCS_LutInPhaseCurrWC" CURVE 0x80064B18 DATA_RECORD_FLOAT32_IEEE 3.402823466E+038 F_1_p0_4 -3.402823466E+038 3.402823466E+038
 /begin AXIS_DESCR FIX_AXIS NO_INPUT_QUANTITY Id_0x00 5 0 4 MAX_GRAD 100.0 FIX_AXIS_PAR_DIST 0 1 5 /end AXIS_DESCR
/end CHARACTERISTIC
/begin CHARACTERISTIC FTMTLCS_LutOutPhaseCurrUC "FTMTLCS_LutOutPhaseCurrUC" CURVE 0x80064B04 DATA_RECORD_FLOAT32_IEEE 3.402823466E+038 F_1_p0_4 -3.402823466E+038 3.402823466E+038
 /begin AXIS_DESCR FIX_AXIS NO_INPUT_QUANTITY Id_0x00 5 0 4 MAX_GRAD 100.0 FIX_AXIS_PAR_DIST 0 1 5 /end AXIS_DESCR
/end CHARACTERISTIC
/begin CHARACTERISTIC FTMTLCS_LutOutPhaseCurrVC "FTMTLCS_LutOutPhaseCurrVC" CURVE 0x80064AF0 DATA_RECORD_FLOAT32_IEEE 3.402823466E+038 F_1_p0_4 -3.402823466E+038 3.402823466E+038
 /begin AXIS_DESCR FIX_AXIS NO_INPUT_QUANTITY Id_0x00 5 0 4 MAX_GRAD 100.0 FIX_AXIS_PAR_DIST 0 1 5 /end AXIS_DESCR
/end CHARACTERISTIC
/begin CHARACTERISTIC FTMTLCS_LutOutPhaseCurrWC "FTMTLCS_LutOutPhaseCurrWC" CURVE 0x80064ADC DATA_RECORD_FLOAT32_IEEE 3.402823466E+038 F_1_p0_4 -3.402823466E+038 3.402823466E+038
 /begin AXIS_DESCR FIX_AXIS NO_INPUT_QUANTITY Id_0x00 5 0 4 MAX_GRAD 100.0 FIX_AXIS_PAR_DIST 0 1 5 /end AXIS_DESCR
/end CHARACTERISTIC
/begin CHARACTERISTIC FTMTLCS_SpdCutOffFrequencyC "FTMTLCS_SpdCutOffFrequencyC" VALUE 0x80064AD8 DATA_RECORD_FLOAT32_IEEE 3.402823466E+038 F_1_p0_55 -3.402823466E+038 3.402823466E+038 /end CHARACTERISTIC
/begin CHARACTERISTIC FTMTLCS_SumErrorNegThrC "FTMTLCS_SumErrorNegThrC" VALUE 0x80064AD4 DATA_RECORD_FLOAT32_IEEE 200 F_1_p0_46 -200 0 /end CHARACTERISTIC
/begin CHARACTERISTIC FTMTLCS_SumErrorPosThrC "FTMTLCS_SumErrorPosThrC" VALUE 0x80064AD0 DATA_RECORD_FLOAT32_IEEE 200 F_1_p0_46 0 200 /end CHARACTERISTIC
/begin CHARACTERISTIC FTMTSEP_ErrorThetaFactorC "FTMTSEP_ErrorThetaFactorC" VALUE 0x80064BB0 DATA_RECORD_FLOAT32_IEEE 3.402823466E+038 F_1_p0_4 -3.402823466E+038 3.402823466E+038 /end CHARACTERISTIC
/begin CHARACTERISTIC FTMTSEP_TimeAdvanceFactC "FTMTSEP_TimeAdvanceFactC" VALUE 0x80064BAC DATA_RECORD_FLOAT32_IEEE 3.402823466E+038 F_1_p0_4 -3.402823466E+038 3.402823466E+038 /end CHARACTERISTIC
/begin CHARACTERISTIC FTSMACS_AclSpeedThdC "FTSMACS_AclSpeedThdC" VALUE 0x80064564 DATA_RECORD_FLOAT32_IEEE 65535 F_1_p0_4 0 65535 /end CHARACTERISTIC
/begin CHARACTERISTIC FTSMACS_BenchModeC "FTSMACS_BenchModeC" VALUE 0x80064560 DATA_RECORD_UBYTE 1 Bool_ON_OFF 0 1 BIT_MASK 0x01 /end CHARACTERISTIC
/begin CHARACTERISTIC FTSMACS_PwmOffSpeedThdC "FTSMACS_PwmOffSpeedThdC" VALUE 0x8006455C DATA_RECORD_FLOAT32_IEEE 3.402823466E+038 F_1_p0_4 -3.402823466E+038 3.402823466E+038 /end CHARACTERISTIC
/begin CHARACTERISTIC FTSMACS_ReinitFaultC "reinit all fault" VALUE 0x80064558 DATA_RECORD_UBYTE 1 Bool_ON_OFF 0 1 BIT_MASK 0x01 /end CHARACTERISTIC
/begin CHARACTERISTIC FTSMACS_TestFaultC "reinit all fault" VALUE 0x80064554 DATA_RECORD_UBYTE 1 Bool_ON_OFF 0 1 BIT_MASK 0x01 /end CHARACTERISTIC
/begin CHARACTERISTIC FTSMACS_UbatHVMinC "FTSMACS_UbatHVMinC" VALUE 0x80064550 DATA_RECORD_FLOAT32_IEEE 65535 F_1_p0_38 0 65535 /end CHARACTERISTIC
/begin CHARACTERISTIC FTSMACS_VsiTimerFreqRatioRefC "0 =&gt; VSI switching frequency = SPI freq and 1 =&gt; VSI switching frequency = SPI freq / 2" VALUE 0x8006454C DATA_RECORD_UWORD 65535 F_1_p0_55 0 65535 /end CHARACTERISTIC
/begin CHARACTERISTIC FTSMMAM_AclStateBypassOnOffC "FTSMMAM_AclStateBypassOnOffC" VALUE 0x8006457C DATA_RECORD_UBYTE 1 Bool_ON_OFF 0 1 BIT_MASK 0x01 /end CHARACTERISTIC
/begin CHARACTERISTIC FTSMMAM_AclStateBypassValueC "FTSMMAM_AclStateBypassValueC" VALUE 0x80064578 DATA_RECORD_UWORD 65535 F_1_p0_55 0 65535 /end CHARACTERISTIC
/begin CHARACTERISTIC FTSMMAM_CMCCS_M0ConOnoffC "FTSMMAM_CMCCS_M0ConOnoffC" VALUE 0x80064574 DATA_RECORD_UBYTE 1 Bool_ON_OFF 0 1 BIT_MASK 0x01 /end CHARACTERISTIC
/begin CHARACTERISTIC FTSMMAM_FtModeReqBypassOnOffC "FTSMMAM_FtModeReqBypassOnOffC" VALUE 0x80064570 DATA_RECORD_UBYTE 1 Bool_ON_OFF 0 1 BIT_MASK 0x01 /end CHARACTERISTIC
/begin CHARACTERISTIC FTSMMAM_FtModeReqBypassValueC "FTSMMAM_FtModeReqBypassValueC" VALUE 0x8006456C DATA_RECORD_UWORD 65535 F_1_p0_55 0 65535 /end CHARACTERISTIC
/begin CHARACTERISTIC FTSMMAM_MTMEP_StateC "FTSMMAM_MTMEP_StateC" VALUE 0x80064568 DATA_RECORD_UWORD 65535 F_1_p0_4 0 65535 /end CHARACTERISTIC
/begin CHARACTERISTIC FTSMREF_AutoPhasingOutputNumC "FTSMREF_AutoPhasingOutputNumC" VALUE 0x800646BC DATA_RECORD_UWORD 65535 F_1_p0_4 0 65535 /end CHARACTERISTIC
/begin CHARACTERISTIC FTSMREF_CalEnableTimeC "FTSMREF_CalEnableTimeC" VALUE 0x800646B8 DATA_RECORD_FLOAT32_IEEE 3.402823466E+038 F_1_p0_4 -3.402823466E+038 3.402823466E+038 /end CHARACTERISTIC
/begin CHARACTERISTIC FTSMREF_CalFinishTimeC "FTSMREF_CalFinishTimeC" VALUE 0x800646B4 DATA_RECORD_FLOAT32_IEEE 3.402823466E+038 F_1_p0_4 -3.402823466E+038 3.402823466E+038 /end CHARACTERISTIC
/begin CHARACTERISTIC FTSMREF_CalStartTimeMaxC "FTSMREF_CalStartTimeMaxC" VALUE 0x800646B0 DATA_RECORD_FLOAT32_IEEE 3.402823466E+038 F_1_p0_4 -3.402823466E+038 3.402823466E+038 /end CHARACTERISTIC
/begin CHARACTERISTIC FTSMREF_CyclefinishNumC "FTSMREF_CyclefinishNumC" VALUE 0x800646AC DATA_RECORD_UWORD 65535 F_1_p0_4 0 65535 /end CHARACTERISTIC
/begin CHARACTERISTIC FTSMREF_IdrefGainC "FTSMREF_IdrefGainC" VALUE 0x8006461C DATA_RECORD_FLOAT32_IEEE 3.402823466E+038 F_1_p0_4 -3.402823466E+038 3.402823466E+038 /end CHARACTERISTIC
/begin CHARACTERISTIC FTSMREF_Neg0TimerThdHighC "FTSMREF_Neg0TimerThdHighC" VALUE 0x8006458C DATA_RECORD_UWORD 65535 F_1_p0_4 0 65535 /end CHARACTERISTIC
/begin CHARACTERISTIC FTSMREF_Neg0TimerThdLowC "FTSMREF_Neg0TimerThdLowC" VALUE 0x80064588 DATA_RECORD_UWORD 65535 F_1_p0_4 0 65535 /end CHARACTERISTIC
/begin CHARACTERISTIC FTSMREF_Pos0TimerThdHighC "FTSMREF_Pos0TimerThdHighC" VALUE 0x80064584 DATA_RECORD_UWORD 65535 F_1_p0_4 0 65535 /end CHARACTERISTIC
/begin CHARACTERISTIC FTSMREF_Pos0TimerThdLowC "FTSMREF_Pos0TimerThdLowC" VALUE 0x80064580 DATA_RECORD_UWORD 65535 F_1_p0_4 0 65535 /end CHARACTERISTIC
/begin CHARACTERISTIC SDMTLCS_CounterInitC "SDMTLCS_CounterInitC" VALUE 0x80064BC4 DATA_RECORD_ULONG 4294967295 F_1_p0_4 0 4294967295 /end CHARACTERISTIC
/begin CHARACTERISTIC SDMTLCS_CurrentRmsCounterC "SDMTLCS_CurrentRmsCounterC" VALUE 0x80064BC0 DATA_RECORD_ULONG 4294967295 F_1_p0_4 0 4294967295 /end CHARACTERISTIC
/begin CHARACTERISTIC SDMTLCS_CurrentRmsCounterZC "SDMTLCS_CurrentRmsCounterZC" VALUE 0x80064BBC DATA_RECORD_FLOAT32_IEEE 3.402823466E+038 F_1_p0_4 -3.402823466E+038 3.402823466E+038 /end CHARACTERISTIC
/begin CHARACTERISTIC SDMTLCS_CurrentRmsSumInitC "SDMTLCS_CurrentRmsSumInitC" VALUE 0x80064BB8 DATA_RECORD_FLOAT32_IEEE 3.402823466E+038 F_1_p0_4 -3.402823466E+038 3.402823466E+038 /end CHARACTERISTIC
/begin CHARACTERISTIC SDMTLCS_CutOffFrequencyC "SDMTLCS_CutOffFrequencyC" VALUE 0x80064BB4 DATA_RECORD_FLOAT32_IEEE 3.402823466E+038 F_1_p0_4 -3.402823466E+038 3.402823466E+038 /end CHARACTERISTIC
/begin CHARACTERISTIC SDMTMEP_A2DOutRngHighC "SDMTMEP_A2DOutRngHighC" VALUE 0x80064D2C DATA_RECORD_UWORD 65535 F_1_p0_4 0 65535 /end CHARACTERISTIC
/begin CHARACTERISTIC SDMTMEP_A2DOutRngLowC "SDMTMEP_A2DOutRngLowC" VALUE 0x80064D28 DATA_RECORD_UWORD 65535 F_1_p0_4 0 65535 /end CHARACTERISTIC
/begin CHARACTERISTIC SDMTMEP_A2DShortCircuitGndC "SDMTMEP_A2DShortCircuitGndC" VALUE 0x80064D24 DATA_RECORD_UWORD 65535 F_1_p0_4 0 65535 /end CHARACTERISTIC
/begin CHARACTERISTIC SDMTMEP_A2DShortCircuitVccC "SDMTMEP_A2DShortCircuitVccC" VALUE 0x80064D20 DATA_RECORD_UWORD 65535 F_1_p0_4 0 65535 /end CHARACTERISTIC
/begin CHARACTERISTIC SDMTMEP_AutoPhasingAngOnOffC "SDMTMEP_AutoPhasingAngOnOffC" VALUE 0x80064D1C DATA_RECORD_UBYTE 1 Bool_ON_OFF 0 1 BIT_MASK 0x01 /end CHARACTERISTIC
/begin CHARACTERISTIC SDMTMEP_AutoPhasingAngleC "parameter used to adjust the resolver position to the motor position" VALUE 0x80064D18 DATA_RECORD_FLOAT32_IEEE 2 F_1_p0_76 -1 1 /end CHARACTERISTIC
/begin CHARACTERISTIC SDMTMEP_AutophasingThdHighC "SDMTMEP_AutophasingThdHighC" VALUE 0x80064D14 DATA_RECORD_FLOAT32_IEEE 3.402823466E+038 F_1_p0_4 -3.402823466E+038 3.402823466E+038 /end CHARACTERISTIC
/begin CHARACTERISTIC SDMTMEP_AutophasingThdLowC "SDMTMEP_AutophasingThdLowC" VALUE 0x80064D10 DATA_RECORD_FLOAT32_IEEE 3.402823466E+038 F_1_p0_4 -3.402823466E+038 3.402823466E+038 /end CHARACTERISTIC
/begin CHARACTERISTIC SDMTMEP_AvarageGainC "SDMTMEP_AvarageGainC" VALUE 0x80064D0C DATA_RECORD_FLOAT32_IEEE 3.402823466E+038 F_1_p0_4 -3.402823466E+038 3.402823466E+038 /end CHARACTERISTIC
/begin CHARACTERISTIC SDMTMEP_BenchModeValueC "0 = observer / 1 = manual speed" VALUE 0x80064D08 DATA_RECORD_UBYTE 1 Bool_ON_OFF 0 1 BIT_MASK 0x01 /end CHARACTERISTIC
/begin CHARACTERISTIC SDMTMEP_Filter_NumZC "filter parameter" VALUE 0x80064D04 DATA_RECORD_FLOAT32_IEEE 3.402823466E+038 F_1_p0_4 -3.402823466E+038 3.402823466E+038 /end CHARACTERISTIC
/begin CHARACTERISTIC SDMTMEP_GainCosSignAutoEnC "SDMTMEP_GainCosSignAutoEnC" VALUE 0x80064D00 DATA_RECORD_UBYTE 1 Bool_ON_OFF 0 1 BIT_MASK 0x01 /end CHARACTERISTIC
/begin CHARACTERISTIC SDMTMEP_GainCosSignC "SDMTMEP_GainCosSignC" VALUE 0x80064CFC DATA_RECORD_FLOAT32_IEEE 3.402823466E+038 F_1_p0_4 -3.402823466E+038 3.402823466E+038 /end CHARACTERISTIC
/begin CHARACTERISTIC SDMTMEP_GainCosThdHighC "SDMTMEP_GainCosThdHighC" VALUE 0x80064CF8 DATA_RECORD_FLOAT32_IEEE 3.402823466E+038 F_1_p0_4 -3.402823466E+038 3.402823466E+038 /end CHARACTERISTIC
/begin CHARACTERISTIC SDMTMEP_GainCosThdLowC "SDMTMEP_GainCosThdLowC" VALUE 0x80064CF4 DATA_RECORD_FLOAT32_IEEE 3.402823466E+038 F_1_p0_4 -3.402823466E+038 3.402823466E+038 /end CHARACTERISTIC
/begin CHARACTERISTIC SDMTMEP_GainCosTrimC "gain used to correct a sensor linearity error" VALUE 0x80064CF0 DATA_RECORD_FLOAT32_IEEE 3.402823466E+038 F_1_p0_55 -3.402823466E+038 3.402823466E+038 /end CHARACTERISTIC
/begin CHARACTERISTIC SDMTMEP_GainSinHighC "SDMTMEP_GainSinHighC" VALUE 0x80064CEC DATA_RECORD_FLOAT32_IEEE 3.402823466E+038 F_1_p0_4 -3.402823466E+038 3.402823466E+038 /end CHARACTERISTIC
/begin CHARACTERISTIC SDMTMEP_GainSinSignC "SDMTMEP_GainSinSignC" VALUE 0x80064CE8 DATA_RECORD_FLOAT32_IEEE 3.402823466E+038 F_1_p0_4 -3.402823466E+038 3.402823466E+038 /end CHARACTERISTIC
/begin CHARACTERISTIC SDMTMEP_GainSinThdLowC "SDMTMEP_GainSinThdLowC" VALUE 0x80064CE4 DATA_RECORD_FLOAT32_IEEE 3.402823466E+038 F_1_p0_4 -3.402823466E+038 3.402823466E+038 /end CHARACTERISTIC
/begin CHARACTERISTIC SDMTMEP_GainSinTrimC "gain used to correct a sensor linearity error" VALUE 0x80064CE0 DATA_RECORD_FLOAT32_IEEE 3.402823466E+038 F_1_p0_55 -3.402823466E+038 3.402823466E+038 /end CHARACTERISTIC
/begin CHARACTERISTIC SDMTMEP_ImpoedThetaStepC "SDMTMEP_ImpoedThetaStepC" VALUE 0x80064CDC DATA_RECORD_FLOAT32_IEEE 3.402823466E+038 F_1_p0_4 -3.402823466E+038 3.402823466E+038 /end CHARACTERISTIC
/begin CHARACTERISTIC SDMTMEP_ImpoedThetaStepMaxC "SDMTMEP_ImpoedThetaStepMaxC" VALUE 0x80064CD8 DATA_RECORD_FLOAT32_IEEE 3.402823466E+038 F_1_p0_4 -3.402823466E+038 3.402823466E+038 /end CHARACTERISTIC
/begin CHARACTERISTIC SDMTMEP_K1ParameterC "observer parameter (see V03 NT 09 00262)" VALUE 0x80064CD4 DATA_RECORD_FLOAT32_IEEE 3.402823466E+038 F_1_p0_4 -3.402823466E+038 3.402823466E+038 /end CHARACTERISTIC
/begin CHARACTERISTIC SDMTMEP_K2ParameterC "observer parameter (see V03 NT 09 00262)" VALUE 0x80064CD0 DATA_RECORD_FLOAT32_IEEE 3.402823466E+038 F_1_p0_4 -3.402823466E+038 3.402823466E+038 /end CHARACTERISTIC
/begin CHARACTERISTIC SDMTMEP_LutInMecaSpeedRpmC "SDMTMEP_LutInMecaSpeedRpmC" CURVE 0x80064CA8 DATA_RECORD_FLOAT32_IEEE 3.402823466E+038 F_1_p0_4 -3.402823466E+038 3.402823466E+038
 /begin AXIS_DESCR FIX_AXIS NO_INPUT_QUANTITY Id_0x00 10 0 9 MAX_GRAD 100.0 FIX_AXIS_PAR_DIST 0 1 10 /end AXIS_DESCR
/end CHARACTERISTIC
/begin CHARACTERISTIC SDMTMEP_LutInUbatHvC "SDMTMEP_LutInUbatHvC" CURVE 0x80064CA0 DATA_RECORD_FLOAT32_IEEE 3.402823466E+038 F_1_p0_4 -3.402823466E+038 3.402823466E+038
 /begin AXIS_DESCR FIX_AXIS NO_INPUT_QUANTITY Id_0x00 2 0 1 MAX_GRAD 100.0 FIX_AXIS_PAR_DIST 0 1 2 /end AXIS_DESCR
/end CHARACTERISTIC
/begin CHARACTERISTIC SDMTMEP_LutOutAutoPhaseAngleC "SDMTMEP_LutOutAutoPhaseAngleC" MAP 0x80064C50 DATA_RECORD_FLOAT32_IEEE 3.402823466E+038 F_1_p0_4 -3.402823466E+038 3.402823466E+038
 /begin AXIS_DESCR FIX_AXIS NO_INPUT_QUANTITY Id_0x00 2 0 1 MAX_GRAD 100.0 FIX_AXIS_PAR_DIST 0 1 2 /end AXIS_DESCR
 /begin AXIS_DESCR FIX_AXIS NO_INPUT_QUANTITY Id_0x00 10 0 9 MAX_GRAD 100.0 FIX_AXIS_PAR_DIST 0 1 10 /end AXIS_DESCR
/end CHARACTERISTIC
/begin CHARACTERISTIC SDMTMEP_LutSinC "LUT IN resolver sinus theta" CURVE 0x80064C3C DATA_RECORD_FLOAT32_IEEE 3.402823466E+038 F_1_p0_55 -3.402823466E+038 3.402823466E+038
 /begin AXIS_DESCR FIX_AXIS NO_INPUT_QUANTITY Id_0x00 5 0 4 MAX_GRAD 100.0 FIX_AXIS_PAR_DIST 0 1 5 /end AXIS_DESCR
/end CHARACTERISTIC
/begin CHARACTERISTIC SDMTMEP_LutThetaRdSurPiC "LUT OUT resolver angle" CURVE 0x80064C28 DATA_RECORD_FLOAT32_IEEE 3.402823466E+038 F_1_p0_76 -3.402823466E+038 3.402823466E+038
 /begin AXIS_DESCR FIX_AXIS NO_INPUT_QUANTITY Id_0x00 5 0 4 MAX_GRAD 100.0 FIX_AXIS_PAR_DIST 0 1 5 /end AXIS_DESCR
/end CHARACTERISTIC
/begin CHARACTERISTIC SDMTMEP_MecaRpmToElecRdsC "SDMTMEP_MecaRpmToElecRdsC" VALUE 0x80064C24 DATA_RECORD_FLOAT32_IEEE 3.402823466E+038 F_1_p0_55 -3.402823466E+038 3.402823466E+038 /end CHARACTERISTIC
/begin CHARACTERISTIC SDMTMEP_MecaSpeedRpmC "Value of mechanical speed when SDMTMEP_ManualSpeedActivationC = 1" VALUE 0x80064C20 DATA_RECORD_FLOAT32_IEEE 3.402823466E+038 F_1_p0_52 -3.402823466E+038 3.402823466E+038 /end CHARACTERISTIC
/begin CHARACTERISTIC SDMTMEP_OcGainCosTrimC "SDMTMEP_OcGainCosTrimC" VALUE 0x80064C1C DATA_RECORD_FLOAT32_IEEE 3.402823466E+038 F_1_p0_4 -3.402823466E+038 3.402823466E+038 /end CHARACTERISTIC
/begin CHARACTERISTIC SDMTMEP_OcGainSinTrimC "SDMTMEP_OcGainSinTrimC" VALUE 0x80064C18 DATA_RECORD_FLOAT32_IEEE 3.402823466E+038 F_1_p0_4 -3.402823466E+038 3.402823466E+038 /end CHARACTERISTIC
/begin CHARACTERISTIC SDMTMEP_OcOffsetCosTrimC "SDMTMEP_OcOffsetCosTrimC" VALUE 0x80064C14 DATA_RECORD_FLOAT32_IEEE 3.402823466E+038 F_1_p0_4 -3.402823466E+038 3.402823466E+038 /end CHARACTERISTIC
/begin CHARACTERISTIC SDMTMEP_OcOffsetSinTrimC "SDMTMEP_OcOffsetSinTrimC" VALUE 0x80064C10 DATA_RECORD_FLOAT32_IEEE 3.402823466E+038 F_1_p0_4 -3.402823466E+038 3.402823466E+038 /end CHARACTERISTIC
/begin CHARACTERISTIC SDMTMEP_OcRotoringNormalSumC "SDMTMEP_OcSumRangeResThetaC * 2 * 5" VALUE 0x80064C0C DATA_RECORD_FLOAT32_IEEE 3.402823466E+038 F_1_p0_4 -3.402823466E+038 3.402823466E+038 /end CHARACTERISTIC
/begin CHARACTERISTIC SDMTMEP_OcSinCosAdcFilterNumZC "SDMTMEP_OcSinCosAdcFilterNumZC" VALUE 0x80064C08 DATA_RECORD_FLOAT32_IEEE 3.402823466E+038 F_1_p0_4 -3.402823466E+038 3.402823466E+038 /end CHARACTERISTIC
/begin CHARACTERISTIC SDMTMEP_OcSumRangeResThetaC "SDMTMEP_OcSumRangeResThetaC" VALUE 0x80064C04 DATA_RECORD_FLOAT32_IEEE 3.402823466E+038 F_1_p0_4 -3.402823466E+038 3.402823466E+038 /end CHARACTERISTIC
/begin CHARACTERISTIC SDMTMEP_OffsetCosThdHighC "SDMTMEP_OffsetCosThdHighC" VALUE 0x80064C00 DATA_RECORD_FLOAT32_IEEE 3.402823466E+038 F_1_p0_4 -3.402823466E+038 3.402823466E+038 /end CHARACTERISTIC
/begin CHARACTERISTIC SDMTMEP_OffsetCosThdLowC "SDMTMEP_OffsetCosThdLowC" VALUE 0x80064BFC DATA_RECORD_FLOAT32_IEEE 3.402823466E+038 F_1_p0_4 -3.402823466E+038 3.402823466E+038 /end CHARACTERISTIC
/begin CHARACTERISTIC SDMTMEP_OffsetCosTrimC "parameter used to correct the sensor offset error" VALUE 0x80064BF8 DATA_RECORD_FLOAT32_IEEE 3.402823466E+038 F_1_p0_74 -3.402823466E+038 3.402823466E+038 /end CHARACTERISTIC
/begin CHARACTERISTIC SDMTMEP_OffsetSinThdHighC "SDMTMEP_OffsetSinThdHighC" VALUE 0x80064BF4 DATA_RECORD_FLOAT32_IEEE 3.402823466E+038 F_1_p0_4 -3.402823466E+038 3.402823466E+038 /end CHARACTERISTIC
/begin CHARACTERISTIC SDMTMEP_OffsetSinThdLowC "SDMTMEP_OffsetSinThdLowC" VALUE 0x80064BF0 DATA_RECORD_FLOAT32_IEEE 3.402823466E+038 F_1_p0_4 -3.402823466E+038 3.402823466E+038 /end CHARACTERISTIC
/begin CHARACTERISTIC SDMTMEP_OffsetSinTrimC "parameter used to correct the sensor offset error" VALUE 0x80064BEC DATA_RECORD_FLOAT32_IEEE 3.402823466E+038 F_1_p0_74 -3.402823466E+038 3.402823466E+038 /end CHARACTERISTIC
/begin CHARACTERISTIC SDMTMEP_OverSpeedThdC "parameter used to correct the sensor offset error" VALUE 0x80064BE8 DATA_RECORD_FLOAT32_IEEE 3.402823466E+038 F_1_p0_52 -3.402823466E+038 3.402823466E+038 /end CHARACTERISTIC
/begin CHARACTERISTIC SDMTMEP_OverSpeedThdOcC "parameter used to correct the sensor offset error" VALUE 0x80064BE4 DATA_RECORD_FLOAT32_IEEE 3.402823466E+038 F_1_p0_52 -3.402823466E+038 3.402823466E+038 /end CHARACTERISTIC
/begin CHARACTERISTIC SDMTMEP_PositionMarginC "SDMTMEP_PositionMarginC" VALUE 0x80064BE0 DATA_RECORD_FLOAT32_IEEE 1 F_1_p0_43 0 1 /end CHARACTERISTIC
/begin CHARACTERISTIC SDMTMEP_ResolverParamStoreEnC "SDMTMEP_ResolverParamStoreEnC" VALUE 0x80064BDC DATA_RECORD_UBYTE 1 Bool_ON_OFF 0 1 BIT_MASK 0x01 /end CHARACTERISTIC
/begin CHARACTERISTIC SDMTMEP_RotoringPerdCountC "sample time of the function" VALUE 0x80064BD8 DATA_RECORD_UWORD 65535 F_1_p0_53 0 65535 /end CHARACTERISTIC
/begin CHARACTERISTIC SDMTMEP_SpdCompEnableC "SDMTMEP_SpdCompEnableC" VALUE 0x80064BD4 DATA_RECORD_UBYTE 1 Bool_ON_OFF 0 1 BIT_MASK 0x01 /end CHARACTERISTIC
/begin CHARACTERISTIC SDMTMEP_SpeedMarginC "SDMTMEP_SpeedMarginC" VALUE 0x80064BD0 DATA_RECORD_FLOAT32_IEEE 500 F_1_p0_21 0 500 /end CHARACTERISTIC
/begin CHARACTERISTIC SDMTMEP_UnderSpeedThdC "parameter used to correct the sensor offset error" VALUE 0x80064BCC DATA_RECORD_FLOAT32_IEEE 3.402823466E+038 F_1_p0_52 -3.402823466E+038 3.402823466E+038 /end CHARACTERISTIC
/begin CHARACTERISTIC SDMTMEP_UnderSpeedThdOcC "parameter used to correct the sensor offset error" VALUE 0x80064BC8 DATA_RECORD_FLOAT32_IEEE 3.402823466E+038 F_1_p0_52 -3.402823466E+038 3.402823466E+038 /end CHARACTERISTIC
/begin CHARACTERISTIC TLE9180_bDrvOverCurrentTestOnC "TLE9180_bDrvOverCurrentTestOnC" VALUE 0x80060029 DATA_RECORD_UBYTE 1 Bool_ON_OFF 0 1 BIT_MASK 0x01 /end CHARACTERISTIC
/begin CHARACTERISTIC TLE9180_bDrvOverTempTestOnC "TLE9180_bDrvOverTempTestOnC" VALUE 0x8006002C DATA_RECORD_UBYTE 1 Bool_ON_OFF 0 1 BIT_MASK 0x01 /end CHARACTERISTIC
/begin CHARACTERISTIC TLE9180_bDrvOverVoltageTestOnC "TLE9180_bDrvOverVoltageTestOnC" VALUE 0x8006002E DATA_RECORD_UBYTE 1 Bool_ON_OFF 0 1 BIT_MASK 0x01 /end CHARACTERISTIC
/begin CHARACTERISTIC TLE9180_bDrvUnderVoltageTestOnC "TLE9180_bDrvUnderVoltageTestOnC" VALUE 0x8006002D DATA_RECORD_UBYTE 1 Bool_ON_OFF 0 1 BIT_MASK 0x01 /end CHARACTERISTIC
/begin CHARACTERISTIC TLE9180_bManualReadRegC "TLE9180_bManualReadRegC" VALUE 0x8006002F DATA_RECORD_UBYTE 1 Bool_ON_OFF 0 1 BIT_MASK 0x01 /end CHARACTERISTIC
/begin CHARACTERISTIC TLE9180_bPhasePerfTestOnC "TLE9180_bPhasePerfTestOnC" VALUE 0x80060027 DATA_RECORD_UBYTE 1 Bool_ON_OFF 0 1 BIT_MASK 0x01 /end CHARACTERISTIC
/begin CHARACTERISTIC TLE9180_bPhaseShortHighTestOnC "TLE9180_bPhaseShortHighTestOnC" VALUE 0x8006002B DATA_RECORD_UBYTE 1 Bool_ON_OFF 0 1 BIT_MASK 0x01 /end CHARACTERISTIC
/begin CHARACTERISTIC TLE9180_bPhaseShortLowTestOnC "TLE9180_bPhaseShortLowTestOnC" VALUE 0x8006002A DATA_RECORD_UBYTE 1 Bool_ON_OFF 0 1 BIT_MASK 0x01 /end CHARACTERISTIC
/begin CHARACTERISTIC TLE9180_bPhsOverVoltTestOnC "TLE9180_bPhsOverVoltTestOnC" VALUE 0x80060028 DATA_RECORD_UBYTE 1 Bool_ON_OFF 0 1 BIT_MASK 0x01 /end CHARACTERISTIC
/begin CHARACTERISTIC TLE9180_kf32PhsTempFaultC "TLE9180_kf32PhsTempFaultC" VALUE 0x80064D70 DATA_RECORD_FLOAT32_IEEE 3.402823466E+038 I_1 -3.402823466E+038 3.402823466E+038 /end CHARACTERISTIC
/begin CHARACTERISTIC TLE9180_kf32PhsTempFltRecoverC "TLE9180_kf32PhsTempFltRecoverC" VALUE 0x80064D6C DATA_RECORD_FLOAT32_IEEE 3.402823466E+038 I_1 -3.402823466E+038 3.402823466E+038 /end CHARACTERISTIC
/begin CHARACTERISTIC TLE9180_ku16EnaResetTimeC "TLE9180_ku16EnaResetTimeC" VALUE 0x80060AAC DATA_RECORD_UWORD 65535 I_1 0 65535 /end CHARACTERISTIC
/begin CHARACTERISTIC TLE9180_ku16ErrPinChkTimC "TLE9180_ku16ErrPinChkTimC" VALUE 0x80060AAA DATA_RECORD_UWORD 65535 I_1 0 65535 /end CHARACTERISTIC
/begin CHARACTERISTIC TLE9180_ku8EnaResetCntC "TLE9180_ku8EnaResetCntC" VALUE 0x80060036 DATA_RECORD_UBYTE 255 I_1 0 255 /end CHARACTERISTIC
/begin CHARACTERISTIC TLE9180_ku8ErrRecvMaxNumC "TLE9180_ku8ErrRecvMaxNumC" VALUE 0x80060035 DATA_RECORD_UBYTE 255 I_1 0 255 /end CHARACTERISTIC
/begin MEASUREMENT TLE9180_af32ReadPhsTempPhys "TLE9180_af32ReadPhsTempPhys" FLOAT32_IEEE I_1 1 2 -3.402823466E+038 3.402823466E+038 MATRIX_DIM 6 1 1 ECU_ADDRESS 0x7001F7EC /end MEASUREMENT
/begin MEASUREMENT TLE9180_af32ReadPhsTempPhys[0] "TLE9180_af32ReadPhsTempPhys[0]" FLOAT32_IEEE I_1 1 2 -3.402823466E+038 3.402823466E+038 ECU_ADDRESS 0x7001F7EC /end MEASUREMENT
/begin MEASUREMENT TLE9180_af32ReadPhsTempPhys[1] "TLE9180_af32ReadPhsTempPhys[1]" FLOAT32_IEEE I_1 1 2 -3.402823466E+038 3.402823466E+038 ECU_ADDRESS 0x7001F7F0 /end MEASUREMENT
/begin MEASUREMENT TLE9180_af32ReadPhsTempPhys[2] "TLE9180_af32ReadPhsTempPhys[2]" FLOAT32_IEEE I_1 1 2 -3.402823466E+038 3.402823466E+038 ECU_ADDRESS 0x7001F7F4 /end MEASUREMENT
/begin MEASUREMENT TLE9180_af32ReadPhsTempPhys[3] "TLE9180_af32ReadPhsTempPhys[3]" FLOAT32_IEEE I_1 1 2 -3.402823466E+038 3.402823466E+038 ECU_ADDRESS 0x7001F7F8 /end MEASUREMENT
/begin MEASUREMENT TLE9180_af32ReadPhsTempPhys[4] "TLE9180_af32ReadPhsTempPhys[4]" FLOAT32_IEEE I_1 1 2 -3.402823466E+038 3.402823466E+038 ECU_ADDRESS 0x7001F7FC /end MEASUREMENT
/begin MEASUREMENT TLE9180_af32ReadPhsTempPhys[5] "TLE9180_af32ReadPhsTempPhys[5]" FLOAT32_IEEE I_1 1 2 -3.402823466E+038 3.402823466E+038 ECU_ADDRESS 0x7001F800 /end MEASUREMENT
/begin MEASUREMENT TLE9180_au32SpiReadFrame "TLE9180_au32SpiReadFrame" ULONG I_1 1 2 0 4294967295 MATRIX_DIM 30 1 1 ECU_ADDRESS 0x7001F770 /end MEASUREMENT
/begin MEASUREMENT TLE9180_au32SpiReadFrame[0] "TLE9180_au32SpiReadFrame[0]" ULONG I_1 1 2 0 4294967295 ECU_ADDRESS 0x7001F770 /end MEASUREMENT
/begin MEASUREMENT TLE9180_au32SpiReadFrame[10] "TLE9180_au32SpiReadFrame[10]" ULONG I_1 1 2 0 4294967295 ECU_ADDRESS 0x7001F798 /end MEASUREMENT
/begin MEASUREMENT TLE9180_au32SpiReadFrame[11] "TLE9180_au32SpiReadFrame[11]" ULONG I_1 1 2 0 4294967295 ECU_ADDRESS 0x7001F79C /end MEASUREMENT
/begin MEASUREMENT TLE9180_au32SpiReadFrame[12] "TLE9180_au32SpiReadFrame[12]" ULONG I_1 1 2 0 4294967295 ECU_ADDRESS 0x7001F7A0 /end MEASUREMENT
/begin MEASUREMENT TLE9180_au32SpiReadFrame[13] "TLE9180_au32SpiReadFrame[13]" ULONG I_1 1 2 0 4294967295 ECU_ADDRESS 0x7001F7A4 /end MEASUREMENT
/begin MEASUREMENT TLE9180_au32SpiReadFrame[14] "TLE9180_au32SpiReadFrame[14]" ULONG I_1 1 2 0 4294967295 ECU_ADDRESS 0x7001F7A8 /end MEASUREMENT
/begin MEASUREMENT TLE9180_au32SpiReadFrame[15] "TLE9180_au32SpiReadFrame[15]" ULONG I_1 1 2 0 4294967295 ECU_ADDRESS 0x7001F7AC /end MEASUREMENT
/begin MEASUREMENT TLE9180_au32SpiReadFrame[16] "TLE9180_au32SpiReadFrame[16]" ULONG I_1 1 2 0 4294967295 ECU_ADDRESS 0x7001F7B0 /end MEASUREMENT
/begin MEASUREMENT TLE9180_au32SpiReadFrame[17] "TLE9180_au32SpiReadFrame[17]" ULONG I_1 1 2 0 4294967295 ECU_ADDRESS 0x7001F7B4 /end MEASUREMENT
/begin MEASUREMENT TLE9180_au32SpiReadFrame[18] "TLE9180_au32SpiReadFrame[18]" ULONG I_1 1 2 0 4294967295 ECU_ADDRESS 0x7001F7B8 /end MEASUREMENT
/begin MEASUREMENT TLE9180_au32SpiReadFrame[19] "TLE9180_au32SpiReadFrame[19]" ULONG I_1 1 2 0 4294967295 ECU_ADDRESS 0x7001F7BC /end MEASUREMENT
/begin MEASUREMENT TLE9180_au32SpiReadFrame[1] "TLE9180_au32SpiReadFrame[1]" ULONG I_1 1 2 0 4294967295 ECU_ADDRESS 0x7001F774 /end MEASUREMENT
/begin MEASUREMENT TLE9180_au32SpiReadFrame[20] "TLE9180_au32SpiReadFrame[20]" ULONG I_1 1 2 0 4294967295 ECU_ADDRESS 0x7001F7C0 /end MEASUREMENT
/begin MEASUREMENT TLE9180_au32SpiReadFrame[21] "TLE9180_au32SpiReadFrame[21]" ULONG I_1 1 2 0 4294967295 ECU_ADDRESS 0x7001F7C4 /end MEASUREMENT
/begin MEASUREMENT TLE9180_au32SpiReadFrame[22] "TLE9180_au32SpiReadFrame[22]" ULONG I_1 1 2 0 4294967295 ECU_ADDRESS 0x7001F7C8 /end MEASUREMENT
/begin MEASUREMENT TLE9180_au32SpiReadFrame[23] "TLE9180_au32SpiReadFrame[23]" ULONG I_1 1 2 0 4294967295 ECU_ADDRESS 0x7001F7CC /end MEASUREMENT
/begin MEASUREMENT TLE9180_au32SpiReadFrame[24] "TLE9180_au32SpiReadFrame[24]" ULONG I_1 1 2 0 4294967295 ECU_ADDRESS 0x7001F7D0 /end MEASUREMENT
/begin MEASUREMENT TLE9180_au32SpiReadFrame[25] "TLE9180_au32SpiReadFrame[25]" ULONG I_1 1 2 0 4294967295 ECU_ADDRESS 0x7001F7D4 /end MEASUREMENT
/begin MEASUREMENT TLE9180_au32SpiReadFrame[26] "TLE9180_au32SpiReadFrame[26]" ULONG I_1 1 2 0 4294967295 ECU_ADDRESS 0x7001F7D8 /end MEASUREMENT
/begin MEASUREMENT TLE9180_au32SpiReadFrame[27] "TLE9180_au32SpiReadFrame[27]" ULONG I_1 1 2 0 4294967295 ECU_ADDRESS 0x7001F7DC /end MEASUREMENT
/begin MEASUREMENT TLE9180_au32SpiReadFrame[28] "TLE9180_au32SpiReadFrame[28]" ULONG I_1 1 2 0 4294967295 ECU_ADDRESS 0x7001F7E0 /end MEASUREMENT
/begin MEASUREMENT TLE9180_au32SpiReadFrame[29] "TLE9180_au32SpiReadFrame[29]" ULONG I_1 1 2 0 4294967295 ECU_ADDRESS 0x7001F7E4 /end MEASUREMENT
/begin MEASUREMENT TLE9180_au32SpiReadFrame[2] "TLE9180_au32SpiReadFrame[2]" ULONG I_1 1 2 0 4294967295 ECU_ADDRESS 0x7001F778 /end MEASUREMENT
/begin MEASUREMENT TLE9180_au32SpiReadFrame[3] "TLE9180_au32SpiReadFrame[3]" ULONG I_1 1 2 0 4294967295 ECU_ADDRESS 0x7001F77C /end MEASUREMENT
/begin MEASUREMENT TLE9180_au32SpiReadFrame[4] "TLE9180_au32SpiReadFrame[4]" ULONG I_1 1 2 0 4294967295 ECU_ADDRESS 0x7001F780 /end MEASUREMENT
/begin MEASUREMENT TLE9180_au32SpiReadFrame[5] "TLE9180_au32SpiReadFrame[5]" ULONG I_1 1 2 0 4294967295 ECU_ADDRESS 0x7001F784 /end MEASUREMENT
/begin MEASUREMENT TLE9180_au32SpiReadFrame[6] "TLE9180_au32SpiReadFrame[6]" ULONG I_1 1 2 0 4294967295 ECU_ADDRESS 0x7001F788 /end MEASUREMENT
/begin MEASUREMENT TLE9180_au32SpiReadFrame[7] "TLE9180_au32SpiReadFrame[7]" ULONG I_1 1 2 0 4294967295 ECU_ADDRESS 0x7001F78C /end MEASUREMENT
/begin MEASUREMENT TLE9180_au32SpiReadFrame[8] "TLE9180_au32SpiReadFrame[8]" ULONG I_1 1 2 0 4294967295 ECU_ADDRESS 0x7001F790 /end MEASUREMENT
/begin MEASUREMENT TLE9180_au32SpiReadFrame[9] "TLE9180_au32SpiReadFrame[9]" ULONG I_1 1 2 0 4294967295 ECU_ADDRESS 0x7001F794 /end MEASUREMENT
/begin MEASUREMENT TLE9180_au32SpiWriteFrame "TLE9180_au32SpiWriteFrame" ULONG I_1 1 2 0 4294967295 MATRIX_DIM 30 1 1 ECU_ADDRESS 0x7001F6F8 /end MEASUREMENT
/begin MEASUREMENT TLE9180_au32SpiWriteFrame[0] "TLE9180_au32SpiWriteFrame[0]" ULONG I_1 1 2 0 4294967295 ECU_ADDRESS 0x7001F6F8 /end MEASUREMENT
/begin MEASUREMENT TLE9180_au32SpiWriteFrame[10] "TLE9180_au32SpiWriteFrame[10]" ULONG I_1 1 2 0 4294967295 ECU_ADDRESS 0x7001F720 /end MEASUREMENT
/begin MEASUREMENT TLE9180_au32SpiWriteFrame[11] "TLE9180_au32SpiWriteFrame[11]" ULONG I_1 1 2 0 4294967295 ECU_ADDRESS 0x7001F724 /end MEASUREMENT
/begin MEASUREMENT TLE9180_au32SpiWriteFrame[12] "TLE9180_au32SpiWriteFrame[12]" ULONG I_1 1 2 0 4294967295 ECU_ADDRESS 0x7001F728 /end MEASUREMENT
/begin MEASUREMENT TLE9180_au32SpiWriteFrame[13] "TLE9180_au32SpiWriteFrame[13]" ULONG I_1 1 2 0 4294967295 ECU_ADDRESS 0x7001F72C /end MEASUREMENT
/begin MEASUREMENT TLE9180_au32SpiWriteFrame[14] "TLE9180_au32SpiWriteFrame[14]" ULONG I_1 1 2 0 4294967295 ECU_ADDRESS 0x7001F730 /end MEASUREMENT
/begin MEASUREMENT TLE9180_au32SpiWriteFrame[15] "TLE9180_au32SpiWriteFrame[15]" ULONG I_1 1 2 0 4294967295 ECU_ADDRESS 0x7001F734 /end MEASUREMENT
/begin MEASUREMENT TLE9180_au32SpiWriteFrame[16] "TLE9180_au32SpiWriteFrame[16]" ULONG I_1 1 2 0 4294967295 ECU_ADDRESS 0x7001F738 /end MEASUREMENT
/begin MEASUREMENT TLE9180_au32SpiWriteFrame[17] "TLE9180_au32SpiWriteFrame[17]" ULONG I_1 1 2 0 4294967295 ECU_ADDRESS 0x7001F73C /end MEASUREMENT
/begin MEASUREMENT TLE9180_au32SpiWriteFrame[18] "TLE9180_au32SpiWriteFrame[18]" ULONG I_1 1 2 0 4294967295 ECU_ADDRESS 0x7001F740 /end MEASUREMENT
/begin MEASUREMENT TLE9180_au32SpiWriteFrame[19] "TLE9180_au32SpiWriteFrame[19]" ULONG I_1 1 2 0 4294967295 ECU_ADDRESS 0x7001F744 /end MEASUREMENT
/begin MEASUREMENT TLE9180_au32SpiWriteFrame[1] "TLE9180_au32SpiWriteFrame[1]" ULONG I_1 1 2 0 4294967295 ECU_ADDRESS 0x7001F6FC /end MEASUREMENT
/begin MEASUREMENT TLE9180_au32SpiWriteFrame[20] "TLE9180_au32SpiWriteFrame[20]" ULONG I_1 1 2 0 4294967295 ECU_ADDRESS 0x7001F748 /end MEASUREMENT
/begin MEASUREMENT TLE9180_au32SpiWriteFrame[21] "TLE9180_au32SpiWriteFrame[21]" ULONG I_1 1 2 0 4294967295 ECU_ADDRESS 0x7001F74C /end MEASUREMENT
/begin MEASUREMENT TLE9180_au32SpiWriteFrame[22] "TLE9180_au32SpiWriteFrame[22]" ULONG I_1 1 2 0 4294967295 ECU_ADDRESS 0x7001F750 /end MEASUREMENT
/begin MEASUREMENT TLE9180_au32SpiWriteFrame[23] "TLE9180_au32SpiWriteFrame[23]" ULONG I_1 1 2 0 4294967295 ECU_ADDRESS 0x7001F754 /end MEASUREMENT
/begin MEASUREMENT TLE9180_au32SpiWriteFrame[24] "TLE9180_au32SpiWriteFrame[24]" ULONG I_1 1 2 0 4294967295 ECU_ADDRESS 0x7001F758 /end MEASUREMENT
/begin MEASUREMENT TLE9180_au32SpiWriteFrame[25] "TLE9180_au32SpiWriteFrame[25]" ULONG I_1 1 2 0 4294967295 ECU_ADDRESS 0x7001F75C /end MEASUREMENT
/begin MEASUREMENT TLE9180_au32SpiWriteFrame[26] "TLE9180_au32SpiWriteFrame[26]" ULONG I_1 1 2 0 4294967295 ECU_ADDRESS 0x7001F760 /end MEASUREMENT
/begin MEASUREMENT TLE9180_au32SpiWriteFrame[27] "TLE9180_au32SpiWriteFrame[27]" ULONG I_1 1 2 0 4294967295 ECU_ADDRESS 0x7001F764 /end MEASUREMENT
/begin MEASUREMENT TLE9180_au32SpiWriteFrame[28] "TLE9180_au32SpiWriteFrame[28]" ULONG I_1 1 2 0 4294967295 ECU_ADDRESS 0x7001F768 /end MEASUREMENT
/begin MEASUREMENT TLE9180_au32SpiWriteFrame[29] "TLE9180_au32SpiWriteFrame[29]" ULONG I_1 1 2 0 4294967295 ECU_ADDRESS 0x7001F76C /end MEASUREMENT
/begin MEASUREMENT TLE9180_au32SpiWriteFrame[2] "TLE9180_au32SpiWriteFrame[2]" ULONG I_1 1 2 0 4294967295 ECU_ADDRESS 0x7001F700 /end MEASUREMENT
/begin MEASUREMENT TLE9180_au32SpiWriteFrame[3] "TLE9180_au32SpiWriteFrame[3]" ULONG I_1 1 2 0 4294967295 ECU_ADDRESS 0x7001F704 /end MEASUREMENT
/begin MEASUREMENT TLE9180_au32SpiWriteFrame[4] "TLE9180_au32SpiWriteFrame[4]" ULONG I_1 1 2 0 4294967295 ECU_ADDRESS 0x7001F708 /end MEASUREMENT
/begin MEASUREMENT TLE9180_au32SpiWriteFrame[5] "TLE9180_au32SpiWriteFrame[5]" ULONG I_1 1 2 0 4294967295 ECU_ADDRESS 0x7001F70C /end MEASUREMENT
/begin MEASUREMENT TLE9180_au32SpiWriteFrame[6] "TLE9180_au32SpiWriteFrame[6]" ULONG I_1 1 2 0 4294967295 ECU_ADDRESS 0x7001F710 /end MEASUREMENT
/begin MEASUREMENT TLE9180_au32SpiWriteFrame[7] "TLE9180_au32SpiWriteFrame[7]" ULONG I_1 1 2 0 4294967295 ECU_ADDRESS 0x7001F714 /end MEASUREMENT
/begin MEASUREMENT TLE9180_au32SpiWriteFrame[8] "TLE9180_au32SpiWriteFrame[8]" ULONG I_1 1 2 0 4294967295 ECU_ADDRESS 0x7001F718 /end MEASUREMENT
/begin MEASUREMENT TLE9180_au32SpiWriteFrame[9] "TLE9180_au32SpiWriteFrame[9]" ULONG I_1 1 2 0 4294967295 ECU_ADDRESS 0x7001F71C /end MEASUREMENT
/begin MEASUREMENT TLE9180_au8CfgRegReadBk "TLE9180_au8CfgRegReadBk" UBYTE I_1 1 2 0 255 MATRIX_DIM 30 1 1 ECU_ADDRESS 0x7001F644 /end MEASUREMENT
/begin MEASUREMENT TLE9180_au8CfgRegReadBk[0] "TLE9180_au8CfgRegReadBk[0]" UBYTE I_1 1 2 0 255 ECU_ADDRESS 0x7001F644 /end MEASUREMENT
/begin MEASUREMENT TLE9180_au8CfgRegReadBk[10] "TLE9180_au8CfgRegReadBk[10]" UBYTE I_1 1 2 0 255 ECU_ADDRESS 0x7001F64E /end MEASUREMENT
/begin MEASUREMENT TLE9180_au8CfgRegReadBk[11] "TLE9180_au8CfgRegReadBk[11]" UBYTE I_1 1 2 0 255 ECU_ADDRESS 0x7001F64F /end MEASUREMENT
/begin MEASUREMENT TLE9180_au8CfgRegReadBk[12] "TLE9180_au8CfgRegReadBk[12]" UBYTE I_1 1 2 0 255 ECU_ADDRESS 0x7001F650 /end MEASUREMENT
/begin MEASUREMENT TLE9180_au8CfgRegReadBk[13] "TLE9180_au8CfgRegReadBk[13]" UBYTE I_1 1 2 0 255 ECU_ADDRESS 0x7001F651 /end MEASUREMENT
/begin MEASUREMENT TLE9180_au8CfgRegReadBk[14] "TLE9180_au8CfgRegReadBk[14]" UBYTE I_1 1 2 0 255 ECU_ADDRESS 0x7001F652 /end MEASUREMENT
/begin MEASUREMENT TLE9180_au8CfgRegReadBk[15] "TLE9180_au8CfgRegReadBk[15]" UBYTE I_1 1 2 0 255 ECU_ADDRESS 0x7001F653 /end MEASUREMENT
/begin MEASUREMENT TLE9180_au8CfgRegReadBk[16] "TLE9180_au8CfgRegReadBk[16]" UBYTE I_1 1 2 0 255 ECU_ADDRESS 0x7001F654 /end MEASUREMENT
/begin MEASUREMENT TLE9180_au8CfgRegReadBk[17] "TLE9180_au8CfgRegReadBk[17]" UBYTE I_1 1 2 0 255 ECU_ADDRESS 0x7001F655 /end MEASUREMENT
/begin MEASUREMENT TLE9180_au8CfgRegReadBk[18] "TLE9180_au8CfgRegReadBk[18]" UBYTE I_1 1 2 0 255 ECU_ADDRESS 0x7001F656 /end MEASUREMENT
/begin MEASUREMENT TLE9180_au8CfgRegReadBk[19] "TLE9180_au8CfgRegReadBk[19]" UBYTE I_1 1 2 0 255 ECU_ADDRESS 0x7001F657 /end MEASUREMENT
/begin MEASUREMENT TLE9180_au8CfgRegReadBk[1] "TLE9180_au8CfgRegReadBk[1]" UBYTE I_1 1 2 0 255 ECU_ADDRESS 0x7001F645 /end MEASUREMENT
/begin MEASUREMENT TLE9180_au8CfgRegReadBk[20] "TLE9180_au8CfgRegReadBk[20]" UBYTE I_1 1 2 0 255 ECU_ADDRESS 0x7001F658 /end MEASUREMENT
/begin MEASUREMENT TLE9180_au8CfgRegReadBk[21] "TLE9180_au8CfgRegReadBk[21]" UBYTE I_1 1 2 0 255 ECU_ADDRESS 0x7001F659 /end MEASUREMENT
/begin MEASUREMENT TLE9180_au8CfgRegReadBk[22] "TLE9180_au8CfgRegReadBk[22]" UBYTE I_1 1 2 0 255 ECU_ADDRESS 0x7001F65A /end MEASUREMENT
/begin MEASUREMENT TLE9180_au8CfgRegReadBk[23] "TLE9180_au8CfgRegReadBk[23]" UBYTE I_1 1 2 0 255 ECU_ADDRESS 0x7001F65B /end MEASUREMENT
/begin MEASUREMENT TLE9180_au8CfgRegReadBk[24] "TLE9180_au8CfgRegReadBk[24]" UBYTE I_1 1 2 0 255 ECU_ADDRESS 0x7001F65C /end MEASUREMENT
/begin MEASUREMENT TLE9180_au8CfgRegReadBk[25] "TLE9180_au8CfgRegReadBk[25]" UBYTE I_1 1 2 0 255 ECU_ADDRESS 0x7001F65D /end MEASUREMENT
/begin MEASUREMENT TLE9180_au8CfgRegReadBk[26] "TLE9180_au8CfgRegReadBk[26]" UBYTE I_1 1 2 0 255 ECU_ADDRESS 0x7001F65E /end MEASUREMENT
/begin MEASUREMENT TLE9180_au8CfgRegReadBk[27] "TLE9180_au8CfgRegReadBk[27]" UBYTE I_1 1 2 0 255 ECU_ADDRESS 0x7001F65F /end MEASUREMENT
/begin MEASUREMENT TLE9180_au8CfgRegReadBk[28] "TLE9180_au8CfgRegReadBk[28]" UBYTE I_1 1 2 0 255 ECU_ADDRESS 0x7001F660 /end MEASUREMENT
/begin MEASUREMENT TLE9180_au8CfgRegReadBk[29] "TLE9180_au8CfgRegReadBk[29]" UBYTE I_1 1 2 0 255 ECU_ADDRESS 0x7001F661 /end MEASUREMENT
/begin MEASUREMENT TLE9180_au8CfgRegReadBk[2] "TLE9180_au8CfgRegReadBk[2]" UBYTE I_1 1 2 0 255 ECU_ADDRESS 0x7001F646 /end MEASUREMENT
/begin MEASUREMENT TLE9180_au8CfgRegReadBk[3] "TLE9180_au8CfgRegReadBk[3]" UBYTE I_1 1 2 0 255 ECU_ADDRESS 0x7001F647 /end MEASUREMENT
/begin MEASUREMENT TLE9180_au8CfgRegReadBk[4] "TLE9180_au8CfgRegReadBk[4]" UBYTE I_1 1 2 0 255 ECU_ADDRESS 0x7001F648 /end MEASUREMENT
/begin MEASUREMENT TLE9180_au8CfgRegReadBk[5] "TLE9180_au8CfgRegReadBk[5]" UBYTE I_1 1 2 0 255 ECU_ADDRESS 0x7001F649 /end MEASUREMENT
/begin MEASUREMENT TLE9180_au8CfgRegReadBk[6] "TLE9180_au8CfgRegReadBk[6]" UBYTE I_1 1 2 0 255 ECU_ADDRESS 0x7001F64A /end MEASUREMENT
/begin MEASUREMENT TLE9180_au8CfgRegReadBk[7] "TLE9180_au8CfgRegReadBk[7]" UBYTE I_1 1 2 0 255 ECU_ADDRESS 0x7001F64B /end MEASUREMENT
/begin MEASUREMENT TLE9180_au8CfgRegReadBk[8] "TLE9180_au8CfgRegReadBk[8]" UBYTE I_1 1 2 0 255 ECU_ADDRESS 0x7001F64C /end MEASUREMENT
/begin MEASUREMENT TLE9180_au8CfgRegReadBk[9] "TLE9180_au8CfgRegReadBk[9]" UBYTE I_1 1 2 0 255 ECU_ADDRESS 0x7001F64D /end MEASUREMENT
/begin MEASUREMENT TLE9180_au8CfgRegister "TLE9180_au8CfgRegister" UBYTE I_1 1 2 0 255 MATRIX_DIM 30 1 1 ECU_ADDRESS 0x7001F662 /end MEASUREMENT
/begin MEASUREMENT TLE9180_au8CfgRegister[0] "TLE9180_au8CfgRegister[0]" UBYTE I_1 1 2 0 255 ECU_ADDRESS 0x7001F662 /end MEASUREMENT
/begin MEASUREMENT TLE9180_au8CfgRegister[10] "TLE9180_au8CfgRegister[10]" UBYTE I_1 1 2 0 255 ECU_ADDRESS 0x7001F66C /end MEASUREMENT
/begin MEASUREMENT TLE9180_au8CfgRegister[11] "TLE9180_au8CfgRegister[11]" UBYTE I_1 1 2 0 255 ECU_ADDRESS 0x7001F66D /end MEASUREMENT
/begin MEASUREMENT TLE9180_au8CfgRegister[12] "TLE9180_au8CfgRegister[12]" UBYTE I_1 1 2 0 255 ECU_ADDRESS 0x7001F66E /end MEASUREMENT
/begin MEASUREMENT TLE9180_au8CfgRegister[13] "TLE9180_au8CfgRegister[13]" UBYTE I_1 1 2 0 255 ECU_ADDRESS 0x7001F66F /end MEASUREMENT
/begin MEASUREMENT TLE9180_au8CfgRegister[14] "TLE9180_au8CfgRegister[14]" UBYTE I_1 1 2 0 255 ECU_ADDRESS 0x7001F670 /end MEASUREMENT
/begin MEASUREMENT TLE9180_au8CfgRegister[15] "TLE9180_au8CfgRegister[15]" UBYTE I_1 1 2 0 255 ECU_ADDRESS 0x7001F671 /end MEASUREMENT
/begin MEASUREMENT TLE9180_au8CfgRegister[16] "TLE9180_au8CfgRegister[16]" UBYTE I_1 1 2 0 255 ECU_ADDRESS 0x7001F672 /end MEASUREMENT
/begin MEASUREMENT TLE9180_au8CfgRegister[17] "TLE9180_au8CfgRegister[17]" UBYTE I_1 1 2 0 255 ECU_ADDRESS 0x7001F673 /end MEASUREMENT
/begin MEASUREMENT TLE9180_au8CfgRegister[18] "TLE9180_au8CfgRegister[18]" UBYTE I_1 1 2 0 255 ECU_ADDRESS 0x7001F674 /end MEASUREMENT
/begin MEASUREMENT TLE9180_au8CfgRegister[19] "TLE9180_au8CfgRegister[19]" UBYTE I_1 1 2 0 255 ECU_ADDRESS 0x7001F675 /end MEASUREMENT
/begin MEASUREMENT TLE9180_au8CfgRegister[1] "TLE9180_au8CfgRegister[1]" UBYTE I_1 1 2 0 255 ECU_ADDRESS 0x7001F663 /end MEASUREMENT
/begin MEASUREMENT TLE9180_au8CfgRegister[20] "TLE9180_au8CfgRegister[20]" UBYTE I_1 1 2 0 255 ECU_ADDRESS 0x7001F676 /end MEASUREMENT
/begin MEASUREMENT TLE9180_au8CfgRegister[21] "TLE9180_au8CfgRegister[21]" UBYTE I_1 1 2 0 255 ECU_ADDRESS 0x7001F677 /end MEASUREMENT
/begin MEASUREMENT TLE9180_au8CfgRegister[22] "TLE9180_au8CfgRegister[22]" UBYTE I_1 1 2 0 255 ECU_ADDRESS 0x7001F678 /end MEASUREMENT
/begin MEASUREMENT TLE9180_au8CfgRegister[23] "TLE9180_au8CfgRegister[23]" UBYTE I_1 1 2 0 255 ECU_ADDRESS 0x7001F679 /end MEASUREMENT
/begin MEASUREMENT TLE9180_au8CfgRegister[24] "TLE9180_au8CfgRegister[24]" UBYTE I_1 1 2 0 255 ECU_ADDRESS 0x7001F67A /end MEASUREMENT
/begin MEASUREMENT TLE9180_au8CfgRegister[25] "TLE9180_au8CfgRegister[25]" UBYTE I_1 1 2 0 255 ECU_ADDRESS 0x7001F67B /end MEASUREMENT
/begin MEASUREMENT TLE9180_au8CfgRegister[26] "TLE9180_au8CfgRegister[26]" UBYTE I_1 1 2 0 255 ECU_ADDRESS 0x7001F67C /end MEASUREMENT
/begin MEASUREMENT TLE9180_au8CfgRegister[27] "TLE9180_au8CfgRegister[27]" UBYTE I_1 1 2 0 255 ECU_ADDRESS 0x7001F67D /end MEASUREMENT
/begin MEASUREMENT TLE9180_au8CfgRegister[28] "TLE9180_au8CfgRegister[28]" UBYTE I_1 1 2 0 255 ECU_ADDRESS 0x7001F67E /end MEASUREMENT
/begin MEASUREMENT TLE9180_au8CfgRegister[29] "TLE9180_au8CfgRegister[29]" UBYTE I_1 1 2 0 255 ECU_ADDRESS 0x7001F67F /end MEASUREMENT
/begin MEASUREMENT TLE9180_au8CfgRegister[2] "TLE9180_au8CfgRegister[2]" UBYTE I_1 1 2 0 255 ECU_ADDRESS 0x7001F664 /end MEASUREMENT
/begin MEASUREMENT TLE9180_au8CfgRegister[3] "TLE9180_au8CfgRegister[3]" UBYTE I_1 1 2 0 255 ECU_ADDRESS 0x7001F665 /end MEASUREMENT
/begin MEASUREMENT TLE9180_au8CfgRegister[4] "TLE9180_au8CfgRegister[4]" UBYTE I_1 1 2 0 255 ECU_ADDRESS 0x7001F666 /end MEASUREMENT
/begin MEASUREMENT TLE9180_au8CfgRegister[5] "TLE9180_au8CfgRegister[5]" UBYTE I_1 1 2 0 255 ECU_ADDRESS 0x7001F667 /end MEASUREMENT
/begin MEASUREMENT TLE9180_au8CfgRegister[6] "TLE9180_au8CfgRegister[6]" UBYTE I_1 1 2 0 255 ECU_ADDRESS 0x7001F668 /end MEASUREMENT
/begin MEASUREMENT TLE9180_au8CfgRegister[7] "TLE9180_au8CfgRegister[7]" UBYTE I_1 1 2 0 255 ECU_ADDRESS 0x7001F669 /end MEASUREMENT
/begin MEASUREMENT TLE9180_au8CfgRegister[8] "TLE9180_au8CfgRegister[8]" UBYTE I_1 1 2 0 255 ECU_ADDRESS 0x7001F66A /end MEASUREMENT
/begin MEASUREMENT TLE9180_au8CfgRegister[9] "TLE9180_au8CfgRegister[9]" UBYTE I_1 1 2 0 255 ECU_ADDRESS 0x7001F66B /end MEASUREMENT
/begin MEASUREMENT TLE9180_au8ReadPhsTemp "TLE9180_au8ReadPhsTemp" UBYTE I_1 1 2 0 255 MATRIX_DIM 6 1 1 ECU_ADDRESS 0x7001F63E /end MEASUREMENT
/begin MEASUREMENT TLE9180_au8ReadPhsTemp[0] "TLE9180_au8ReadPhsTemp[0]" UBYTE I_1 1 2 0 255 ECU_ADDRESS 0x7001F63E /end MEASUREMENT
/begin MEASUREMENT TLE9180_au8ReadPhsTemp[1] "TLE9180_au8ReadPhsTemp[1]" UBYTE I_1 1 2 0 255 ECU_ADDRESS 0x7001F63F /end MEASUREMENT
/begin MEASUREMENT TLE9180_au8ReadPhsTemp[2] "TLE9180_au8ReadPhsTemp[2]" UBYTE I_1 1 2 0 255 ECU_ADDRESS 0x7001F640 /end MEASUREMENT
/begin MEASUREMENT TLE9180_au8ReadPhsTemp[3] "TLE9180_au8ReadPhsTemp[3]" UBYTE I_1 1 2 0 255 ECU_ADDRESS 0x7001F641 /end MEASUREMENT
/begin MEASUREMENT TLE9180_au8ReadPhsTemp[4] "TLE9180_au8ReadPhsTemp[4]" UBYTE I_1 1 2 0 255 ECU_ADDRESS 0x7001F642 /end MEASUREMENT
/begin MEASUREMENT TLE9180_au8ReadPhsTemp[5] "TLE9180_au8ReadPhsTemp[5]" UBYTE I_1 1 2 0 255 ECU_ADDRESS 0x7001F643 /end MEASUREMENT
/begin MEASUREMENT TLE9180_au8ReadRegs "TLE9180_au8ReadRegs" UBYTE I_1 1 2 0 255 MATRIX_DIM 30 1 1 ECU_ADDRESS 0x7001F620 /end MEASUREMENT
/begin MEASUREMENT TLE9180_au8ReadRegs[0] "TLE9180_au8ReadRegs[0]" UBYTE I_1 1 2 0 255 ECU_ADDRESS 0x7001F620 /end MEASUREMENT
/begin MEASUREMENT TLE9180_au8ReadRegs[10] "TLE9180_au8ReadRegs[10]" UBYTE I_1 1 2 0 255 ECU_ADDRESS 0x7001F62A /end MEASUREMENT
/begin MEASUREMENT TLE9180_au8ReadRegs[11] "TLE9180_au8ReadRegs[11]" UBYTE I_1 1 2 0 255 ECU_ADDRESS 0x7001F62B /end MEASUREMENT
/begin MEASUREMENT TLE9180_au8ReadRegs[12] "TLE9180_au8ReadRegs[12]" UBYTE I_1 1 2 0 255 ECU_ADDRESS 0x7001F62C /end MEASUREMENT
/begin MEASUREMENT TLE9180_au8ReadRegs[13] "TLE9180_au8ReadRegs[13]" UBYTE I_1 1 2 0 255 ECU_ADDRESS 0x7001F62D /end MEASUREMENT
/begin MEASUREMENT TLE9180_au8ReadRegs[14] "TLE9180_au8ReadRegs[14]" UBYTE I_1 1 2 0 255 ECU_ADDRESS 0x7001F62E /end MEASUREMENT
/begin MEASUREMENT TLE9180_au8ReadRegs[15] "TLE9180_au8ReadRegs[15]" UBYTE I_1 1 2 0 255 ECU_ADDRESS 0x7001F62F /end MEASUREMENT
/begin MEASUREMENT TLE9180_au8ReadRegs[16] "TLE9180_au8ReadRegs[16]" UBYTE I_1 1 2 0 255 ECU_ADDRESS 0x7001F630 /end MEASUREMENT
/begin MEASUREMENT TLE9180_au8ReadRegs[17] "TLE9180_au8ReadRegs[17]" UBYTE I_1 1 2 0 255 ECU_ADDRESS 0x7001F631 /end MEASUREMENT
/begin MEASUREMENT TLE9180_au8ReadRegs[18] "TLE9180_au8ReadRegs[18]" UBYTE I_1 1 2 0 255 ECU_ADDRESS 0x7001F632 /end MEASUREMENT
/begin MEASUREMENT TLE9180_au8ReadRegs[19] "TLE9180_au8ReadRegs[19]" UBYTE I_1 1 2 0 255 ECU_ADDRESS 0x7001F633 /end MEASUREMENT
/begin MEASUREMENT TLE9180_au8ReadRegs[1] "TLE9180_au8ReadRegs[1]" UBYTE I_1 1 2 0 255 ECU_ADDRESS 0x7001F621 /end MEASUREMENT
/begin MEASUREMENT TLE9180_au8ReadRegs[20] "TLE9180_au8ReadRegs[20]" UBYTE I_1 1 2 0 255 ECU_ADDRESS 0x7001F634 /end MEASUREMENT
/begin MEASUREMENT TLE9180_au8ReadRegs[21] "TLE9180_au8ReadRegs[21]" UBYTE I_1 1 2 0 255 ECU_ADDRESS 0x7001F635 /end MEASUREMENT
/begin MEASUREMENT TLE9180_au8ReadRegs[22] "TLE9180_au8ReadRegs[22]" UBYTE I_1 1 2 0 255 ECU_ADDRESS 0x7001F636 /end MEASUREMENT
/begin MEASUREMENT TLE9180_au8ReadRegs[23] "TLE9180_au8ReadRegs[23]" UBYTE I_1 1 2 0 255 ECU_ADDRESS 0x7001F637 /end MEASUREMENT
/begin MEASUREMENT TLE9180_au8ReadRegs[24] "TLE9180_au8ReadRegs[24]" UBYTE I_1 1 2 0 255 ECU_ADDRESS 0x7001F638 /end MEASUREMENT
/begin MEASUREMENT TLE9180_au8ReadRegs[25] "TLE9180_au8ReadRegs[25]" UBYTE I_1 1 2 0 255 ECU_ADDRESS 0x7001F639 /end MEASUREMENT
/begin MEASUREMENT TLE9180_au8ReadRegs[26] "TLE9180_au8ReadRegs[26]" UBYTE I_1 1 2 0 255 ECU_ADDRESS 0x7001F63A /end MEASUREMENT
/begin MEASUREMENT TLE9180_au8ReadRegs[27] "TLE9180_au8ReadRegs[27]" UBYTE I_1 1 2 0 255 ECU_ADDRESS 0x7001F63B /end MEASUREMENT
/begin MEASUREMENT TLE9180_au8ReadRegs[28] "TLE9180_au8ReadRegs[28]" UBYTE I_1 1 2 0 255 ECU_ADDRESS 0x7001F63C /end MEASUREMENT
/begin MEASUREMENT TLE9180_au8ReadRegs[29] "TLE9180_au8ReadRegs[29]" UBYTE I_1 1 2 0 255 ECU_ADDRESS 0x7001F63D /end MEASUREMENT
/begin MEASUREMENT TLE9180_au8ReadRegs[2] "TLE9180_au8ReadRegs[2]" UBYTE I_1 1 2 0 255 ECU_ADDRESS 0x7001F622 /end MEASUREMENT
/begin MEASUREMENT TLE9180_au8ReadRegs[3] "TLE9180_au8ReadRegs[3]" UBYTE I_1 1 2 0 255 ECU_ADDRESS 0x7001F623 /end MEASUREMENT
/begin MEASUREMENT TLE9180_au8ReadRegs[4] "TLE9180_au8ReadRegs[4]" UBYTE I_1 1 2 0 255 ECU_ADDRESS 0x7001F624 /end MEASUREMENT
/begin MEASUREMENT TLE9180_au8ReadRegs[5] "TLE9180_au8ReadRegs[5]" UBYTE I_1 1 2 0 255 ECU_ADDRESS 0x7001F625 /end MEASUREMENT
/begin MEASUREMENT TLE9180_au8ReadRegs[6] "TLE9180_au8ReadRegs[6]" UBYTE I_1 1 2 0 255 ECU_ADDRESS 0x7001F626 /end MEASUREMENT
/begin MEASUREMENT TLE9180_au8ReadRegs[7] "TLE9180_au8ReadRegs[7]" UBYTE I_1 1 2 0 255 ECU_ADDRESS 0x7001F627 /end MEASUREMENT
/begin MEASUREMENT TLE9180_au8ReadRegs[8] "TLE9180_au8ReadRegs[8]" UBYTE I_1 1 2 0 255 ECU_ADDRESS 0x7001F628 /end MEASUREMENT
/begin MEASUREMENT TLE9180_au8ReadRegs[9] "TLE9180_au8ReadRegs[9]" UBYTE I_1 1 2 0 255 ECU_ADDRESS 0x7001F629 /end MEASUREMENT
/begin MEASUREMENT TLE9180_bDataTransferDone "..." UBYTE Bool_ON_OFF 1 2 0 1 BIT_MASK 0x01 ECU_ADDRESS 0x7001F817 /end MEASUREMENT
/begin MEASUREMENT TLE9180_bDrvOverCurrent "..." UBYTE Bool_ON_OFF 1 2 0 1 BIT_MASK 0x01 ECU_ADDRESS 0x7001F816 /end MEASUREMENT
/begin MEASUREMENT TLE9180_bDrvOverTemp "..." UBYTE Bool_ON_OFF 1 2 0 1 BIT_MASK 0x01 ECU_ADDRESS 0x7001F815 /end MEASUREMENT
/begin MEASUREMENT TLE9180_bDrvOverVoltage "..." UBYTE Bool_ON_OFF 1 2 0 1 BIT_MASK 0x01 ECU_ADDRESS 0x7001F814 /end MEASUREMENT
/begin MEASUREMENT TLE9180_bDrvUnderVoltage "..." UBYTE Bool_ON_OFF 1 2 0 1 BIT_MASK 0x01 ECU_ADDRESS 0x7001F813 /end MEASUREMENT
/begin MEASUREMENT TLE9180_bErrorFlag "..." UBYTE Bool_ON_OFF 1 2 0 1 BIT_MASK 0x01 ECU_ADDRESS 0x7001F812 /end MEASUREMENT
/begin MEASUREMENT TLE9180_bErrorPinLevel "..." UBYTE Bool_ON_OFF 1 2 0 1 BIT_MASK 0x01 ECU_ADDRESS 0x7001F811 /end MEASUREMENT
/begin MEASUREMENT TLE9180_bHALOverVolt "..." UBYTE Bool_ON_OFF 1 2 0 1 BIT_MASK 0x01 ECU_ADDRESS 0x7001F80F /end MEASUREMENT
/begin MEASUREMENT TLE9180_bHALUnderVolt "..." UBYTE Bool_ON_OFF 1 2 0 1 BIT_MASK 0x01 ECU_ADDRESS 0x7001F80E /end MEASUREMENT
/begin MEASUREMENT TLE9180_bInitFailFlg "..." UBYTE Bool_ON_OFF 1 2 0 1 BIT_MASK 0x01 ECU_ADDRESS 0x7001F80D /end MEASUREMENT
/begin MEASUREMENT TLE9180_bPhasePerf "..." UBYTE Bool_ON_OFF 1 2 0 1 BIT_MASK 0x01 ECU_ADDRESS 0x7001F80C /end MEASUREMENT
/begin MEASUREMENT TLE9180_bPhaseShortHigh "..." UBYTE Bool_ON_OFF 1 2 0 1 BIT_MASK 0x01 ECU_ADDRESS 0x7001F80B /end MEASUREMENT
/begin MEASUREMENT TLE9180_bPhaseShortLow "..." UBYTE Bool_ON_OFF 1 2 0 1 BIT_MASK 0x01 ECU_ADDRESS 0x7001F80A /end MEASUREMENT
/begin MEASUREMENT TLE9180_bPhsOverVolt "..." UBYTE Bool_ON_OFF 1 2 0 1 BIT_MASK 0x01 ECU_ADDRESS 0x7001F809 /end MEASUREMENT
/begin MEASUREMENT TLE9180_bReadErrInfoFlg "..." UBYTE Bool_ON_OFF 1 2 0 1 BIT_MASK 0x01 ECU_ADDRESS 0x7001F808 /end MEASUREMENT
/begin MEASUREMENT TLE9180_bTempWarning "..." UBYTE Bool_ON_OFF 1 2 0 1 BIT_MASK 0x01 ECU_ADDRESS 0x7001F807 /end MEASUREMENT
/begin MEASUREMENT TLE9180_bTestReadErrRegs "..." UBYTE Bool_ON_OFF 1 2 0 1 BIT_MASK 0x01 ECU_ADDRESS 0x7001F806 /end MEASUREMENT
/begin MEASUREMENT TLE9180_bTestReadReg "..." UBYTE Bool_ON_OFF 1 2 0 1 BIT_MASK 0x01 ECU_ADDRESS 0x7001F805 /end MEASUREMENT
/begin MEASUREMENT TLE9180_bTestWriteReg "..." UBYTE Bool_ON_OFF 1 2 0 1 BIT_MASK 0x01 ECU_ADDRESS 0x7001F804 /end MEASUREMENT
/begin MEASUREMENT TLE9180_f32MaxPhsTempPhys "..." FLOAT32_IEEE I_1 1 2 -3.402823466E+038 3.402823466E+038 ECU_ADDRESS 0x7001F7E8 /end MEASUREMENT
/begin MEASUREMENT TLE9180_u16EnaResetTime "..." UWORD I_1 1 2 0 65535 ECU_ADDRESS 0x7001F60C /end MEASUREMENT
/begin MEASUREMENT TLE9180_u16ErrPinChkCnt "..." UWORD I_1 1 2 0 65535 ECU_ADDRESS 0x7001F60A /end MEASUREMENT
/begin MEASUREMENT TLE9180_u16HallSupVolt "..." UWORD I_1 1 2 0 65535 ECU_ADDRESS 0x7001F608 /end MEASUREMENT
/begin MEASUREMENT TLE9180_u8CurOperMode "..." UBYTE I_1 1 2 0 255 ECU_ADDRESS 0x7001F61E /end MEASUREMENT
/begin MEASUREMENT TLE9180_u8EnaResetCnt "..." UBYTE I_1 1 2 0 255 ECU_ADDRESS 0x7001F61F /end MEASUREMENT
/begin MEASUREMENT TLE9180_u8ErrRecoverCnt "..." UBYTE I_1 1 2 0 255 ECU_ADDRESS 0x7001F61C /end MEASUREMENT
/begin MEASUREMENT TLE9180_u8ErrorFrameCnt "..." UBYTE I_1 1 2 0 255 ECU_ADDRESS 0x7001F61D /end MEASUREMENT
/begin MEASUREMENT TLE9180_u8FeedBackAddr "..." UBYTE I_1 1 2 0 255 ECU_ADDRESS 0x7001F61B /end MEASUREMENT
/begin MEASUREMENT TLE9180_u8FeedBackData "..." UBYTE I_1 1 2 0 255 ECU_ADDRESS 0x7001F61A /end MEASUREMENT
/begin MEASUREMENT TLE9180_u8FeedBackStatus "..." UBYTE I_1 1 2 0 255 ECU_ADDRESS 0x7001F619 /end MEASUREMENT
/begin MEASUREMENT TLE9180_u8HallSupVolt "..." UBYTE I_1 1 2 0 255 ECU_ADDRESS 0x7001F618 /end MEASUREMENT
/begin MEASUREMENT TLE9180_u8IndexFrame "..." UBYTE I_1 1 2 0 255 ECU_ADDRESS 0x7001F617 /end MEASUREMENT
/begin MEASUREMENT TLE9180_u8Mode "..." UBYTE I_1 1 2 0 255 ECU_ADDRESS 0x7001F616 /end MEASUREMENT
/begin MEASUREMENT TLE9180_u8RdRegTimCnt "..." UBYTE I_1 1 2 0 255 ECU_ADDRESS 0x7001F615 /end MEASUREMENT
/begin MEASUREMENT TLE9180_u8ReadRegAddr "..." UBYTE I_1 1 2 0 255 ECU_ADDRESS 0x7001F614 /end MEASUREMENT
/begin MEASUREMENT TLE9180_u8SelfTestStep "..." UBYTE I_1 1 2 0 255 ECU_ADDRESS 0x7001F613 /end MEASUREMENT
/begin MEASUREMENT TLE9180_u8SelfTstModChk "..." UBYTE I_1 1 2 0 255 ECU_ADDRESS 0x7001F612 /end MEASUREMENT
/begin MEASUREMENT TLE9180_u8SpiTxFrameMaxNb "..." UBYTE I_1 1 2 0 255 ECU_ADDRESS 0x7001F611 /end MEASUREMENT
/begin MEASUREMENT TLE9180_u8TestMode "..." UBYTE I_1 1 2 0 255 ECU_ADDRESS 0x7001F610 /end MEASUREMENT
/begin MEASUREMENT TLE9180_u8WriteData "..." UBYTE I_1 1 2 0 255 ECU_ADDRESS 0x7001F60F /end MEASUREMENT
/begin MEASUREMENT TLE9180_u8WriteRegAddr "..." UBYTE I_1 1 2 0 255 ECU_ADDRESS 0x7001F60E /end MEASUREMENT
/begin COMPU_METHOD I_1 "" RAT_FUNC "%9.2" "-" COEFFS 0 1 0 0 0 1 /end COMPU_METHOD
/begin COMPU_METHOD F_1_p0_4 "" RAT_FUNC "%9.2" "-" COEFFS 0 1 0 0 0 1 /end COMPU_METHOD
/begin COMPU_METHOD F_1_p0_21 "" RAT_FUNC "%9.2" "RPM" COEFFS 0 1 0 0 0 1 /end COMPU_METHOD
/begin COMPU_METHOD F_1_p0_35 "" RAT_FUNC "%9.2" "Hz" COEFFS 0 1 0 0 0 1 /end COMPU_METHOD
/begin COMPU_METHOD F_1_p0_36 "" RAT_FUNC "%9.2" "None." COEFFS 0 1 0 0 0 1 /end COMPU_METHOD
/begin COMPU_METHOD F_1_p0_38 "" RAT_FUNC "%9.2" "V" COEFFS 0 1 0 0 0 1 /end COMPU_METHOD
/begin COMPU_METHOD F_1_p0_39 "" RAT_FUNC "%9.2" "V." COEFFS 0 1 0 0 0 1 /end COMPU_METHOD
/begin COMPU_METHOD F_1_p0_43 "" RAT_FUNC "%9.2" "Nan." COEFFS 0 1 0 0 0 1 /end COMPU_METHOD
/begin COMPU_METHOD F_1_p0_45 "" RAT_FUNC "%9.2" "Nan" COEFFS 0 1 0 0 0 1 /end COMPU_METHOD
/begin COMPU_METHOD F_1_p0_46 "" RAT_FUNC "%9.2" "A" COEFFS 0 1 0 0 0 1 /end COMPU_METHOD
/begin COMPU_METHOD F_1_p0_47 "" RAT_FUNC "%9.2" "None" COEFFS 0 1 0 0 0 1 /end COMPU_METHOD
/begin COMPU_METHOD F_1_p0_49 "" RAT_FUNC "%9.2" "Nm" COEFFS 0 1 0 0 0 1 /end COMPU_METHOD
/begin COMPU_METHOD F_1_p0_50 "" RAT_FUNC "%9.2" "Rpm" COEFFS 0 1 0 0 0 1 /end COMPU_METHOD
/begin COMPU_METHOD F_1_p0_52 "" RAT_FUNC "%9.2" "rpm" COEFFS 0 1 0 0 0 1 /end COMPU_METHOD
/begin COMPU_METHOD F_1_p0_53 "" RAT_FUNC "%9.2" "s" COEFFS 0 1 0 0 0 1 /end COMPU_METHOD
/begin COMPU_METHOD F_1_p0_54 "" RAT_FUNC "%9.2" "NaN" COEFFS 0 1 0 0 0 1 /end COMPU_METHOD
/begin COMPU_METHOD F_1_p0_55 "" RAT_FUNC "%9.2" "none" COEFFS 0 1 0 0 0 1 /end COMPU_METHOD
/begin COMPU_METHOD F_1_p0_56 "" RAT_FUNC "%9.2" "N.m" COEFFS 0 1 0 0 0 1 /end COMPU_METHOD
/begin COMPU_METHOD F_1_p0_69 "" RAT_FUNC "%9.2" "W" COEFFS 0 1 0 0 0 1 /end COMPU_METHOD
/begin COMPU_METHOD F_1_p0_70 "" RAT_FUNC "%9.2" "A." COEFFS 0 1 0 0 0 1 /end COMPU_METHOD
/begin COMPU_METHOD F_1_p0_71 "" RAT_FUNC "%9.2" "J." COEFFS 0 1 0 0 0 1 /end COMPU_METHOD
/begin COMPU_METHOD F_1_p0_72 "" RAT_FUNC "%9.2" "Deg Celsius" COEFFS 0 1 0 0 0 1 /end COMPU_METHOD
/begin COMPU_METHOD F_1_p0_73 "" RAT_FUNC "%9.2" "Deg_Celsius" COEFFS 0 1 0 0 0 1 /end COMPU_METHOD
/begin COMPU_METHOD F_1_p0_74 "" RAT_FUNC "%9.2" "dec" COEFFS 0 1 0 0 0 1 /end COMPU_METHOD
/begin COMPU_METHOD F_1_p0_76 "" RAT_FUNC "%9.2" "rd/pi" COEFFS 0 1 0 0 0 1 /end COMPU_METHOD
/begin COMPU_METHOD Id_0x00 "" RAT_FUNC "%9.2" "." COEFFS 0 1 0 0 0 1 /end COMPU_METHOD
/begin COMPU_METHOD Bool_ON_OFF "" TAB_VERB "%8.4" "." COMPU_TAB_REF Bool_ON_OFF_table /end COMPU_METHOD
/begin COMPU_VTAB Bool_ON_OFF_table "" TAB_VERB 2 0 "OFF" 1 "ON" /end COMPU_VTAB
/begin FUNCTION SWC_FT ""
 /begin DEF_CHARACTERISTIC FTCMTCS_LutOutTorqueMinC FTCMTCS_LutOutVolMarginGenC FTCMTCS_LutOutVolMarginMotC FTCMTCS_MaxErrorFor100C FTCMTCS_ParkCurrentMaxC FTCMTCS_SlideSpdRpmC FTCMTCS_SwitchElecTorqueRangeC FTCMTCS_SwitchElecTrqRange0C FTCMTCS_VoltageLimiterOnOffC FTCMTCS_VoltageMarginC FTCMTCS_VoltMarginCtrlOnOffC FTCMTTC_AntiJerkMecaTorqueMaxC FTCMTTC_AntiJerkMecaTorqueMinC FTCMTTC_BpAccHighCutOffFrequencyC FTCMTTC_DampingEnableC FTCMTTC_DampingSpdHighC FTCMTTC_DampingSpdLowC FTCMTTC_DampTorqTgtHighThdC FTCMTTC_DampTorqueTargetThdC FTCMTTC_Lut3InMecaSpeedRpmC FTCMTTC_Lut3InTorqueTgtC FTCMTTC_Lut3InUbatC FTCMTTC_LutInMecaSpeedRpmC FTCMTTC_LutInSpdRpmAtjkDeltaC FTCMTTC_LutInSpdRpmBaseC FTCMTTC_LutInSpeedRpmBpTrqHacC FTCMTTC_LutInSpeedRpmDampingC FTCMTTC_LutInUbatC FTCMTTC_LutOutAntiJerkBaseGainC FTCMTTC_LutOutAntiJerkBaseGainHacC FTCMTTC_LutOutAtjkDeltaGainC FTCMTTC_LutOutCutOffFrequencyC FTCMTTC_LutOutMecaPowerC FTCMTTC_PowerLimtEnableC FTCMTTC_PreTorqTrasRangeC FTCMTTC_PreTorqTrasStep2C FTCMTTC_PreTorqTrasStepMaxC FTCMTTC_PreTorqTrasStepMinC FTCMTTC_PreTorqueC FTCMTTC_PreTorqueEnableC FTCMTTC_PreTorqueStartC FTCMTTC_PreTorqueTimeC FTCMTTC_Rpm2RdsC FTCMTTC_SpeedHysteresisRangeC FTCMTTC_SpeedThdC FTCMTTC_TolTqrLmtEnC FTCMTTC_ToqueHpFilterSpdThrdC FTCMTTC_TorMaxC FTCMTTC_TorqCorEnableC FTCMTTC_TorqueBySecondNegC FTCMTTC_TorqueBySecondPosC FTCMTTC_TorqueCutOffFrequencyC FTCMTTC_TorqueFildTrC FTCMTTC_TorqueHpFilterSpdHystRgC FTCMTTC_TrqHpCutOffFrequencyC FTCMTTC_TrqSatThrdC FTCMTTC_ZeroSpdC FTDDLMP_I0LimitMaxC FTDDLMP_I0LimitMinC FTDDLMP_IdLimitMaxC FTDDLMP_IdLimitMinC FTDDLMP_IqLimitMaxC FTDDLMP_IqLimitMinC FTDDLMP_PowerLimC FTDDLMP_SpeedLimitMaxC FTDDLMP_SpeedLimitMinC FTDDLMP_TorqLimitMaxC FTDDLMP_TorqLimitMinC FTEVEIT_CommutDataCoeffC FTEVEIT_EoffICurrentsC FTEVEIT_EoffIEnergiesC FTEVEIT_EonICurrentsC FTEVEIT_EonIEnergiesC FTEVEIT_ErecICurrentsC FTEVEIT_ErecIEnergiesC FTEVEIT_KoffUdcCoeffsC FTEVEIT_KoffUdcVoltagesC FTEVEIT_KonUdcCoeffsC FTEVEIT_KonUdcVoltagesC FTEVEIT_KrecUdcCoeffsC FTEVEIT_KrecUdcVoltagesC FTEVEIT_MaxMechaSpdHysteresisC FTEVEIT_MaxTempC FTEVEIT_MinMechaSpdHysteresisC FTEVEIT_OverTempThresC FTEVEIT_PdiodeTdiodeAlphaS1C FTEVEIT_PdiodeTdiodeAlphaS2C FTEVEIT_PdiodeTdiodeAlphaS3C FTEVEIT_PdiodeTdiodeAlphaS4C FTEVEIT_PdiodeTdiodeAlphaS5C FTEVEIT_PdiodeTdiodeNumS1C FTEVEIT_PdiodeTdiodeNumS2C FTEVEIT_PdiodeTdiodeNumS3C FTEVEIT_PdiodeTdiodeNumS4C FTEVEIT_PdiodeTdiodeNumS5C FTEVEIT_PdiodeTigbtAlphaC FTEVEIT_PdiodeTigbtNumC FTEVEIT_PigbtTdiodeAlphaC FTEVEIT_PigbtTdiodeNumC FTEVEIT_PigbtTigbtAlphaS1C FTEVEIT_PigbtTigbtAlphaS2C FTEVEIT_PigbtTigbtAlphaS3C FTEVEIT_PigbtTigbtAlphaS4C FTEVEIT_PigbtTigbtAlphaS5C FTEVEIT_PigbtTigbtNumS1C FTEVEIT_PigbtTigbtNumS2C FTEVEIT_PigbtTigbtNumS3C FTEVEIT_PigbtTigbtNumS4C FTEVEIT_PigbtTigbtNumS5C FTEVEIT_TcoolBenchC FTEVEIT_TcoolChoosePMWC FTEVEIT_TcoolScalingAlphaC FTEVEIT_TcoolScalingBetaC FTEVEIT_TempFirstFildTrC FTEVEIT_TempSecFildTrC FTEVEIT_TempVectFildTrC FTEVEIT_UdICurrentsC FTEVEIT_UdIVoltagesC FTEVEIT_UtICurrentsC FTEVEIT_UtIVoltagesC FTMTLCS_A2DGainIsuLC FTMTLCS_A2DGainIsvLC FTMTLCS_A2DGainIswLC FTMTLCS_A2DHighThresholdC FTMTLCS_A2DLowThresholdC FTMTLCS_A2DOutRngHThresholdHC FTMTLCS_A2DOutRngHThresholdLC FTMTLCS_A2DOutRngLThresholdHC FTMTLCS_A2DOutRngLThresholdLC FTMTLCS_CurrentCalEnableC FTMTLCS_CurrentOffsetInitC FTMTLCS_Init2DurationC FTMTLCS_InitIuvw3C FTMTLCS_IuGainC FTMTLCS_IvGainC FTMTLCS_IwGainC FTMTLCS_LostPhaseDelayCntC FTMTLCS_LostPhaseEnaEleSpdRdsC FTMTLCS_LostPhaseMaxRateC FTMTLCS_LostPhaseMinIRmsC FTMTLCS_LutInPhaseCurrUC FTMTLCS_LutInPhaseCurrVC FTMTLCS_LutInPhaseCurrWC FTMTLCS_LutOutPhaseCurrUC FTMTLCS_LutOutPhaseCurrVC FTMTLCS_LutOutPhaseCurrWC FTMTLCS_SpdCutOffFrequencyC FTMTLCS_SumErrorNegThrC FTMTLCS_SumErrorPosThrC FTMTSEP_ErrorThetaFactorC FTMTSEP_TimeAdvanceFactC FTSMACS_AclSpeedThdC FTSMACS_BenchModeC FTSMACS_PwmOffSpeedThdC FTSMACS_ReinitFaultC FTSMACS_TestFaultC FTSMACS_UbatHVMinC FTSMACS_VsiTimerFreqRatioRefC FTSMMAM_AclStateBypassOnOffC FTSMMAM_AclStateBypassValueC FTSMMAM_CMCCS_M0ConOnoffC FTSMMAM_FtModeReqBypassOnOffC FTSMMAM_FtModeReqBypassValueC FTSMMAM_MTMEP_StateC FTSMREF_AutoPhasingOutputNumC FTSMREF_CalEnableTimeC FTSMREF_CalFinishTimeC FTSMREF_CalStartTimeMaxC FTSMREF_CyclefinishNumC FTSMREF_IdrefGainC FTSMREF_Neg0TimerThdHighC FTSMREF_Neg0TimerThdLowC FTSMREF_Pos0TimerThdHighC FTSMREF_Pos0TimerThdLowC SDMTLCS_CounterInitC SDMTLCS_CurrentRmsCounterC SDMTLCS_CurrentRmsCounterZC SDMTLCS_CurrentRmsSumInitC SDMTLCS_CutOffFrequencyC SDMTMEP_A2DOutRngHighC SDMTMEP_A2DOutRngLowC SDMTMEP_A2DShortCircuitGndC SDMTMEP_A2DShortCircuitVccC SDMTMEP_AutoPhasingAngleC SDMTMEP_AutoPhasingAngOnOffC SDMTMEP_AutophasingThdHighC SDMTMEP_AutophasingThdLowC SDMTMEP_AvarageGainC SDMTMEP_BenchModeValueC SDMTMEP_Filter_NumZC SDMTMEP_GainCosSignAutoEnC SDMTMEP_GainCosSignC SDMTMEP_GainCosThdHighC SDMTMEP_GainCosThdLowC SDMTMEP_GainCosTrimC SDMTMEP_GainSinHighC SDMTMEP_GainSinSignC SDMTMEP_GainSinThdLowC SDMTMEP_GainSinTrimC SDMTMEP_ImpoedThetaStepC SDMTMEP_ImpoedThetaStepMaxC SDMTMEP_K1ParameterC SDMTMEP_K2ParameterC SDMTMEP_LutInMecaSpeedRpmC SDMTMEP_LutInUbatHvC SDMTMEP_LutOutAutoPhaseAngleC SDMTMEP_LutSinC SDMTMEP_LutThetaRdSurPiC SDMTMEP_MecaRpmToElecRdsC SDMTMEP_MecaSpeedRpmC SDMTMEP_OcGainCosTrimC SDMTMEP_OcGainSinTrimC SDMTMEP_OcOffsetCosTrimC SDMTMEP_OcOffsetSinTrimC SDMTMEP_OcRotoringNormalSumC SDMTMEP_OcSinCosAdcFilterNumZC SDMTMEP_OcSumRangeResThetaC SDMTMEP_OffsetCosThdHighC SDMTMEP_OffsetCosThdLowC SDMTMEP_OffsetCosTrimC SDMTMEP_OffsetSinThdHighC SDMTMEP_OffsetSinThdLowC SDMTMEP_OffsetSinTrimC SDMTMEP_OverSpeedThdC SDMTMEP_OverSpeedThdOcC SDMTMEP_PositionMarginC SDMTMEP_ResolverParamStoreEnC SDMTMEP_RotoringPerdCountC SDMTMEP_SpdCompEnableC SDMTMEP_SpeedMarginC SDMTMEP_UnderSpeedThdC SDMTMEP_UnderSpeedThdOcC /end DEF_CHARACTERISTIC
/end FUNCTION
/begin FUNCTION TLE9180 ""
 /begin DEF_CHARACTERISTIC TLE9180_bDrvOverCurrentTestOnC TLE9180_bDrvOverTempTestOnC TLE9180_bDrvOverVoltageTestOnC TLE9180_bDrvUnderVoltageTestOnC TLE9180_bManualReadRegC TLE9180_bPhasePerfTestOnC TLE9180_bPhaseShortHighTestOnC TLE9180_bPhaseShortLowTestOnC TLE9180_bPhsOverVoltTestOnC TLE9180_kf32PhsTempFaultC TLE9180_kf32PhsTempFltRecoverC TLE9180_ku16EnaResetTimeC TLE9180_ku16ErrPinChkTimC TLE9180_ku8EnaResetCntC TLE9180_ku8ErrRecvMaxNumC /end DEF_CHARACTERISTIC
 /begin OUT_MEASUREMENT TLE9180_af32ReadPhsTempPhys TLE9180_af32ReadPhsTempPhys[0] TLE9180_af32ReadPhsTempPhys[1] TLE9180_af32ReadPhsTempPhys[2] TLE9180_af32ReadPhsTempPhys[3] TLE9180_af32ReadPhsTempPhys[4] TLE9180_af32ReadPhsTempPhys[5] TLE9180_au32SpiReadFrame TLE9180_au32SpiReadFrame[0] TLE9180_au32SpiReadFrame[10] TLE9180_au32SpiReadFrame[11] TLE9180_au32SpiReadFrame[12] TLE9180_au32SpiReadFrame[13] TLE9180_au32SpiReadFrame[14] TLE9180_au32SpiReadFrame[15] TLE9180_au32SpiReadFrame[16] TLE9180_au32SpiReadFrame[17] TLE9180_au32SpiReadFrame[18] TLE9180_au32SpiReadFrame[19] TLE9180_au32SpiReadFrame[1] TLE9180_au32SpiReadFrame[20] TLE9180_au32SpiReadFrame[21] TLE9180_au32SpiReadFrame[22] TLE9180_au32SpiReadFrame[23] TLE9180_au32SpiReadFrame[24] TLE9180_au32SpiReadFrame[25] TLE9180_au32SpiReadFrame[26] TLE9180_au32SpiReadFrame[27] TLE9180_au32SpiReadFrame[28] TLE9180_au32SpiReadFrame[29] TLE9180_au32SpiReadFrame[2] TLE9180_au32SpiReadFrame[3] TLE9180_au32SpiReadFrame[4] TLE9180_au32SpiReadFrame[5] TLE9180_au32SpiReadFrame[6] TLE9180_au32SpiReadFrame[7] TLE9180_au32SpiReadFrame[8] TLE9180_au32SpiReadFrame[9] TLE9180_au32SpiWriteFrame TLE9180_au32SpiWriteFrame[0] TLE9180_au32SpiWriteFrame[10] TLE9180_au32SpiWriteFrame[11] TLE9180_au32SpiWriteFrame[12] TLE9180_au32SpiWriteFrame[13] TLE9180_au32SpiWriteFrame[14] TLE9180_au32SpiWriteFrame[15] TLE9180_au32SpiWriteFrame[16] TLE9180_au32SpiWriteFrame[17] TLE9180_au32SpiWriteFrame[18] TLE9180_au32SpiWriteFrame[19] TLE9180_au32SpiWriteFrame[1] TLE9180_au32SpiWriteFrame[20] TLE9180_au32SpiWriteFrame[21] TLE9180_au32SpiWriteFrame[22] TLE9180_au32SpiWriteFrame[23] TLE9180_au32SpiWriteFrame[24] TLE9180_au32SpiWriteFrame[25] TLE9180_au32SpiWriteFrame[26] TLE9180_au32SpiWriteFrame[27] TLE9180_au32SpiWriteFrame[28] TLE9180_au32SpiWriteFrame[29] TLE9180_au32SpiWriteFrame[2] TLE9180_au32SpiWriteFrame[3] TLE9180_au32SpiWriteFrame[4] TLE9180_au32SpiWriteFrame[5] TLE9180_au32SpiWriteFrame[6] TLE9180_au32SpiWriteFrame[7] TLE9180_au32SpiWriteFrame[8] TLE9180_au32SpiWriteFrame[9] TLE9180_au8CfgRegister TLE9180_au8CfgRegister[0] TLE9180_au8CfgRegister[10] TLE9180_au8CfgRegister[11] TLE9180_au8CfgRegister[12] TLE9180_au8CfgRegister[13] TLE9180_au8CfgRegister[14] TLE9180_au8CfgRegister[15] TLE9180_au8CfgRegister[16] TLE9180_au8CfgRegister[17] TLE9180_au8CfgRegister[18] TLE9180_au8CfgRegister[19] TLE9180_au8CfgRegister[1] TLE9180_au8CfgRegister[20] TLE9180_au8CfgRegister[21] TLE9180_au8CfgRegister[22] TLE9180_au8CfgRegister[23] TLE9180_au8CfgRegister[24] TLE9180_au8CfgRegister[25] TLE9180_au8CfgRegister[26] TLE9180_au8CfgRegister[27] TLE9180_au8CfgRegister[28] TLE9180_au8CfgRegister[29] TLE9180_au8CfgRegister[2] TLE9180_au8CfgRegister[3] TLE9180_au8CfgRegister[4] TLE9180_au8CfgRegister[5] TLE9180_au8CfgRegister[6] TLE9180_au8CfgRegister[7] TLE9180_au8CfgRegister[8] TLE9180_au8CfgRegister[9] TLE9180_au8CfgRegReadBk TLE9180_au8CfgRegReadBk[0] TLE9180_au8CfgRegReadBk[10] TLE9180_au8CfgRegReadBk[11] TLE9180_au8CfgRegReadBk[12] TLE9180_au8CfgRegReadBk[13] TLE9180_au8CfgRegReadBk[14] TLE9180_au8CfgRegReadBk[15] TLE9180_au8CfgRegReadBk[16] TLE9180_au8CfgRegReadBk[17] TLE9180_au8CfgRegReadBk[18] TLE9180_au8CfgRegReadBk[19] TLE9180_au8CfgRegReadBk[1] TLE9180_au8CfgRegReadBk[20] TLE9180_au8CfgRegReadBk[21] TLE9180_au8CfgRegReadBk[22] TLE9180_au8CfgRegReadBk[23] TLE9180_au8CfgRegReadBk[24] TLE9180_au8CfgRegReadBk[25] TLE9180_au8CfgRegReadBk[26] TLE9180_au8CfgRegReadBk[27] TLE9180_au8CfgRegReadBk[28] TLE9180_au8CfgRegReadBk[29] TLE9180_au8CfgRegReadBk[2] TLE9180_au8CfgRegReadBk[3] TLE9180_au8CfgRegReadBk[4] TLE9180_au8CfgRegReadBk[5] TLE9180_au8CfgRegReadBk[6] TLE9180_au8CfgRegReadBk[7] TLE9180_au8CfgRegReadBk[8] TLE9180_au8CfgRegReadBk[9] TLE9180_au8ReadPhsTemp TLE9180_au8ReadPhsTemp[0] TLE9180_au8ReadPhsTemp[1] TLE9180_au8ReadPhsTemp[2] TLE9180_au8ReadPhsTemp[3] TLE9180_au8ReadPhsTemp[4] TLE9180_au8ReadPhsTemp[5] TLE9180_au8ReadRegs TLE9180_au8ReadRegs[0] TLE9180_au8ReadRegs[10] TLE9180_au8ReadRegs[11] TLE9180_au8ReadRegs[12] TLE9180_au8ReadRegs[13] TLE9180_au8ReadRegs[14] TLE9180_au8ReadRegs[15] TLE9180_au8ReadRegs[16] TLE9180_au8ReadRegs[17] TLE9180_au8ReadRegs[18] TLE9180_au8ReadRegs[19] TLE9180_au8ReadRegs[1] TLE9180_au8ReadRegs[20] TLE9180_au8ReadRegs[21] TLE9180_au8ReadRegs[22] TLE9180_au8ReadRegs[23] TLE9180_au8ReadRegs[24] TLE9180_au8ReadRegs[25] TLE9180_au8ReadRegs[26] TLE9180_au8ReadRegs[27] TLE9180_au8ReadRegs[28] TLE9180_au8ReadRegs[29] TLE9180_au8ReadRegs[2] TLE9180_au8ReadRegs[3] TLE9180_au8ReadRegs[4] TLE9180_au8ReadRegs[5] TLE9180_au8ReadRegs[6] TLE9180_au8ReadRegs[7] TLE9180_au8ReadRegs[8] TLE9180_au8ReadRegs[9] TLE9180_bDataTransferDone TLE9180_bDrvOverCurrent TLE9180_bDrvOverTemp TLE9180_bDrvOverVoltage TLE9180_bDrvUnderVoltage TLE9180_bErrorFlag TLE9180_bErrorPinLevel TLE9180_bHALOverVolt TLE9180_bHALUnderVolt TLE9180_bInitFailFlg TLE9180_bPhasePerf TLE9180_bPhaseShortHigh TLE9180_bPhaseShortLow TLE9180_bPhsOverVolt TLE9180_bReadErrInfoFlg TLE9180_bTempWarning TLE9180_bTestReadErrRegs TLE9180_bTestReadReg TLE9180_bTestWriteReg TLE9180_f32MaxPhsTempPhys TLE9180_u16EnaResetTime TLE9180_u16ErrPinChkCnt TLE9180_u16HallSupVolt TLE9180_u8CurOperMode TLE9180_u8EnaResetCnt TLE9180_u8ErrorFrameCnt TLE9180_u8ErrRecoverCnt TLE9180_u8FeedBackAddr TLE9180_u8FeedBackData TLE9180_u8FeedBackStatus TLE9180_u8HallSupVolt TLE9180_u8IndexFrame TLE9180_u8Mode TLE9180_u8RdRegTimCnt TLE9180_u8ReadRegAddr TLE9180_u8SelfTestStep TLE9180_u8SelfTstModChk TLE9180_u8SpiTxFrameMaxNb TLE9180_u8TestMode TLE9180_u8WriteData TLE9180_u8WriteRegAddr /end OUT_MEASUREMENT
/end FUNCTION
/begin GROUP Acquisitions "Acquisitions_GROUP" ROOT /begin FUNCTION_LIST HARD MAIN /end FUNCTION_LIST /end GROUP
/begin GROUP Application "Application_GROUP" ROOT /begin FUNCTION_LIST ESM HARD MAIN /end FUNCTION_LIST /end GROUP
/begin GROUP BLDC "BLDC_GROUP" ROOT /begin FUNCTION_LIST BLDC /end FUNCTION_LIST /end GROUP
/begin GROUP BSW "BSW_GROUP" ROOT /begin FUNCTION_LIST BSW FAIL /end FUNCTION_LIST /end GROUP
/begin GROUP CALUSR "CALUSR_GROUP" ROOT /begin FUNCTION_LIST CALUSR /end FUNCTION_LIST /end GROUP
/begin GROUP CCU6 "CCU6_GROUP" ROOT /begin FUNCTION_LIST CCU6 /end FUNCTION_LIST /end GROUP
/begin GROUP COMMUSR "COMMUSR_GROUP" ROOT /end GROUP
/begin GROUP Calibration "Calibration_GROUP" /begin SUB_GROUP DEV /end SUB_GROUP /end GROUP
/begin GROUP Com "Com_GROUP" ROOT /begin FUNCTION_LIST MAIN /end FUNCTION_LIST /end GROUP
/begin GROUP Communication "Communication_GROUP" ROOT /begin FUNCTION_LIST BLDC CCU6 MAIN RTE /end FUNCTION_LIST /end GROUP
/begin GROUP DEV "DEV_GROUP" /begin FUNCTION_LIST MAIN /end FUNCTION_LIST /end GROUP
/begin GROUP DFLASH "DFLASH_GROUP" ROOT /begin FUNCTION_LIST DFLASH /end FUNCTION_LIST /end GROUP
/begin GROUP DSM "DSM_GROUP" /begin FUNCTION_LIST FAULT_FF /end FUNCTION_LIST /end GROUP
/begin GROUP Develop "Develop_GROUP" /begin FUNCTION_LIST MAIN /end FUNCTION_LIST /end GROUP
/begin GROUP Development_z "Development_z_GROUP" ROOT /begin FUNCTION_LIST DEVHAL SPY /end FUNCTION_LIST /end GROUP
/begin GROUP Developpement "Developpement_GROUP" ROOT /begin FUNCTION_LIST BSW HARD /end FUNCTION_LIST /end GROUP
/begin GROUP Diagnostic "Diagnostic_GROUP" ROOT /begin FUNCTION_LIST BSW DSM FAULT MAIN /end FUNCTION_LIST /end GROUP
/begin GROUP Divers "Divers_GROUP" ROOT /begin FUNCTION_LIST MAIN /end FUNCTION_LIST /end GROUP
/begin GROUP Driver "Driver_GROUP" ROOT /begin FUNCTION_LIST BLDC COMMUSR MAIN RES SBC STFSRV /end FUNCTION_LIST /end GROUP
/begin GROUP EAS "EAS_GROUP" ROOT /end GROUP
/begin GROUP FAIL "FAIL_GROUP" ROOT /begin FUNCTION_LIST FAIL /end FUNCTION_LIST /end GROUP
/begin GROUP FAULT_FF "FAULT_FF_GROUP" ROOT /begin SUB_GROUP DSM /end SUB_GROUP /end GROUP
/begin GROUP FRecord "FRecord_GROUP" ROOT /begin FUNCTION_LIST FRecord /end FUNCTION_LIST /end GROUP
/begin GROUP MAIN "MAIN_GROUP" ROOT /begin FUNCTION_LIST MAIN /end FUNCTION_LIST /end GROUP
/begin GROUP Main "Main_GROUP" ROOT /begin FUNCTION_LIST BSW MAIN SPY /end FUNCTION_LIST /end GROUP
/begin GROUP Miscellaneous "Miscellaneous_GROUP" ROOT /end GROUP
/begin GROUP Noyau "Noyau_GROUP" ROOT /end GROUP
/begin GROUP NvM "NvM_GROUP" ROOT /begin FUNCTION_LIST BSW /end FUNCTION_LIST /end GROUP
/begin GROUP OBD "OBD_GROUP" ROOT /end GROUP
/begin GROUP RSTSRV "RSTSRV_GROUP" ROOT /end GROUP
/begin GROUP RTE "RTE_GROUP" ROOT /begin FUNCTION_LIST RTE /end FUNCTION_LIST /end GROUP
/begin GROUP Raw "Raw_GROUP" ROOT /begin SUB_GROUP Calibration /end SUB_GROUP /end GROUP
/begin GROUP SWC_FS "SWC_FS_GROUP" ROOT /begin FUNCTION_LIST SWC_FS /end FUNCTION_LIST /end GROUP
/begin GROUP SWC_FT "SWC_FT_GROUP" ROOT /begin FUNCTION_LIST SWC_FT /end FUNCTION_LIST /end GROUP
/begin GROUP TJA1145 "TJA1145_GROUP" ROOT /end GROUP
/begin GROUP TLE9180 "TLE9180_GROUP" ROOT /begin FUNCTION_LIST TLE9180 /end FUNCTION_LIST /end GROUP
/begin GROUP TST "TST_GROUP" ROOT /begin FUNCTION_LIST HARD /end FUNCTION_LIST /end GROUP
/begin GROUP Tsk "Tsk_GROUP" ROOT /begin SUB_GROUP Develop /end SUB_GROUP /end GROUP
/begin GROUP UDS "UDS_GROUP" ROOT /end GROUP
/begin GROUP miscellaneous "miscellaneous_GROUP" ROOT /end GROUP
/begin GROUP miscellenious "miscellenious_GROUP" ROOT /end GROUP
/begin RECORD_LAYOUT Scalar_BOOLEAN FNC_VALUES 1 UBYTE COLUMN_DIR DIRECT /end RECORD_LAYOUT
/begin RECORD_LAYOUT Scalar_UBYTE FNC_VALUES 1 UBYTE COLUMN_DIR DIRECT /end RECORD_LAYOUT
/begin RECORD_LAYOUT Scalar_UWORD FNC_VALUES 1 UWORD COLUMN_DIR DIRECT /end RECORD_LAYOUT
/begin RECORD_LAYOUT Scalar_SWORD FNC_VALUES 1 SWORD COLUMN_DIR DIRECT /end RECORD_LAYOUT
/begin RECORD_LAYOUT Lookup1D_WORD FNC_VALUES 1 SWORD COLUMN_DIR DIRECT /end RECORD_LAYOUT
/begin RECORD_LAYOUT Lookup1D_X_WORD AXIS_PTS_X 1 SWORD INDEX_INCR DIRECT /end RECORD_LAYOUT
/begin COMPU_METHOD CM_CLCOte_e_ActualClutchState "Enumerated data type: CLCOte_e_ActualClutchState" TAB_VERB "%0.6" "" COMPU_TAB_REF VTAB_FOR_CM_CLCOte_e_ActualClutchState /end COMPU_METHOD
/begin COMPU_VTAB VTAB_FOR_CM_CLCOte_e_ActualClutchState "Enumerated data type: CLCOte_e_ActualClutchState" TAB_VERB 6 0 "CLCOce_e_ClutchNeutral" 1 "CLCOce_e_ClutchDisengage" 2 "CLCOce_e_ClutchInGear" 3 "CLCOce_e_ClutchPrepare" 4 "CLCOce_e_ClutchTrqMode" 5 "CLCOce_e_ClutchSpdMode" /end COMPU_VTAB
/begin COMPU_METHOD CM_T_n_rpm_1_1_s16 "Q = V" RAT_FUNC "%5.0" "rpm (revolutions / minute  (rpm))" COEFFS 0 1 0 0 0 1 /end COMPU_METHOD
/begin COMPU_METHOD CM_T_Cnt_Num_1_1_u16 "Q = V" RAT_FUNC "%5.0" "Num (counts)" COEFFS 0 1 0 0 0 1 /end COMPU_METHOD
/begin COMPU_METHOD CM_T_M_Nm_32_1_s16 "Q = V*32.000000" RAT_FUNC "%9.5" "Nm (newton-meters  (Nm))" COEFFS 0 32 0 0 0 1 /end COMPU_METHOD
/begin COMPU_METHOD CM_T_T_degC_16_1_s16 "Q = V*16.000000" RAT_FUNC "%8.4" "degC (degrees Celsius  (deg C))" COEFFS 0 16 0 0 0 1 /end COMPU_METHOD
/begin COMPU_METHOD CM_T_r_NA_1024_1_s16 "Q = V*1024.000000" RAT_FUNC "%12.10" "NA (none)" COEFFS 0 1024 0 0 0 1 /end COMPU_METHOD
/begin COMPU_METHOD CM_T_BOOLEAN "Q = V" RAT_FUNC "%1.0" "Bool" COEFFS 0 1 0 0 0 1 /end COMPU_METHOD
/* EOF SWIN.a2l */
/begin RECORD_LAYOUT Scalar_BOOLEAN FNC_VALUES 1 UBYTE COLUMN_DIR DIRECT /end RECORD_LAYOUT
/begin RECORD_LAYOUT Scalar_UBYTE FNC_VALUES 1 UBYTE COLUMN_DIR DIRECT /end RECORD_LAYOUT
/begin RECORD_LAYOUT Scalar_UWORD FNC_VALUES 1 UWORD COLUMN_DIR DIRECT /end RECORD_LAYOUT
/begin RECORD_LAYOUT Scalar_SWORD FNC_VALUES 1 SWORD COLUMN_DIR DIRECT /end RECORD_LAYOUT
/begin RECORD_LAYOUT Lookup1D_WORD FNC_VALUES 1 SWORD COLUMN_DIR DIRECT /end RECORD_LAYOUT
/begin RECORD_LAYOUT Lookup1D_X_WORD AXIS_PTS_X 1 SWORD INDEX_INCR DIRECT /end RECORD_LAYOUT
/begin COMPU_METHOD CM_T_T_degC_16_1_s16 "Q = V*16.000000" RAT_FUNC "%8.4" "degC (degrees Celsius  (deg C))" COEFFS 0 16 0 0 0 1 /end COMPU_METHOD
/begin COMPU_METHOD CM_T_BOOLEAN "Q = V" RAT_FUNC "%1.0" "Bool" COEFFS 0 1 0 0 0 1 /end COMPU_METHOD
/begin COMPU_METHOD CM_T_n_rpm_1_1_s16 "Q = V" RAT_FUNC "%5.0" "rpm (revolutions / minute  (rpm))" COEFFS 0 1 0 0 0 1 /end COMPU_METHOD
/begin COMPU_METHOD CM_T_y_BitField8 "Q = V" RAT_FUNC "%3.0" "BitField" COEFFS 0 1 0 0 0 1 /end COMPU_METHOD
/* EOF TAMD.a2l */
/begin RECORD_LAYOUT Scalar_BOOLEAN FNC_VALUES 1 UBYTE COLUMN_DIR DIRECT /end RECORD_LAYOUT
/begin RECORD_LAYOUT Scalar_UBYTE FNC_VALUES 1 UBYTE COLUMN_DIR DIRECT /end RECORD_LAYOUT
/begin RECORD_LAYOUT Scalar_UWORD FNC_VALUES 1 UWORD COLUMN_DIR DIRECT /end RECORD_LAYOUT
/begin RECORD_LAYOUT Scalar_SWORD FNC_VALUES 1 SWORD COLUMN_DIR DIRECT /end RECORD_LAYOUT
/begin RECORD_LAYOUT Lookup1D_WORD FNC_VALUES 1 SWORD COLUMN_DIR DIRECT /end RECORD_LAYOUT
/begin RECORD_LAYOUT Lookup1D_X_WORD AXIS_PTS_X 1 SWORD INDEX_INCR DIRECT /end RECORD_LAYOUT
/begin COMPU_METHOD CM_T_n_rpm_1_1_s16 "Q = V" RAT_FUNC "%5.0" "rpm (revolutions / minute  (rpm))" COEFFS 0 1 0 0 0 1 /end COMPU_METHOD
/begin COMPU_METHOD CM_T_T_degC_16_1_s16 "Q = V*16.000000" RAT_FUNC "%8.4" "degC (degrees Celsius  (deg C))" COEFFS 0 16 0 0 0 1 /end COMPU_METHOD
/begin COMPU_METHOD CM_T_Cnt_Num_1_1_u16 "Q = V" RAT_FUNC "%5.0" "Num (counts)" COEFFS 0 1 0 0 0 1 /end COMPU_METHOD
/begin COMPU_METHOD CM_T_BOOLEAN "Q = V" RAT_FUNC "%1.0" "Bool" COEFFS 0 1 0 0 0 1 /end COMPU_METHOD
/begin COMPU_METHOD CM_T_Cnt_Num_1_1_s16 "Q = V" RAT_FUNC "%5.0" "Num (counts)" COEFFS 0 1 0 0 0 1 /end COMPU_METHOD
/begin COMPU_METHOD CM_T_Cnt_Num_1_1_u8 "Q = V" RAT_FUNC "%3.0" "Num (counts)" COEFFS 0 1 0 0 0 1 /end COMPU_METHOD
/* EOF TCFC.a2l */
/begin RECORD_LAYOUT Scalar_BOOLEAN FNC_VALUES 1 UBYTE COLUMN_DIR DIRECT /end RECORD_LAYOUT
/begin RECORD_LAYOUT Scalar_UBYTE FNC_VALUES 1 UBYTE COLUMN_DIR DIRECT /end RECORD_LAYOUT
/begin RECORD_LAYOUT Scalar_UWORD FNC_VALUES 1 UWORD COLUMN_DIR DIRECT /end RECORD_LAYOUT
/begin RECORD_LAYOUT Scalar_SWORD FNC_VALUES 1 SWORD COLUMN_DIR DIRECT /end RECORD_LAYOUT
/begin RECORD_LAYOUT Lookup1D_WORD FNC_VALUES 1 SWORD COLUMN_DIR DIRECT /end RECORD_LAYOUT
/begin RECORD_LAYOUT Lookup1D_X_WORD AXIS_PTS_X 1 SWORD INDEX_INCR DIRECT /end RECORD_LAYOUT
/begin COMPU_METHOD CM_T_T_degC_16_1_s16 "Q = V*16.000000" RAT_FUNC "%8.4" "degC (degrees Celsius  (deg C))" COEFFS 0 16 0 0 0 1 /end COMPU_METHOD
/begin COMPU_METHOD CM_T_n_rpm_1_1_s16 "Q = V" RAT_FUNC "%5.0" "rpm (revolutions / minute  (rpm))" COEFFS 0 1 0 0 0 1 /end COMPU_METHOD
/begin COMPU_METHOD CM_T_Cnt_Num_1_1_u16 "Q = V" RAT_FUNC "%5.0" "Num (counts)" COEFFS 0 1 0 0 0 1 /end COMPU_METHOD
/begin COMPU_METHOD CM_T_r_NA_1024_1_s16 "Q = V*1024.000000" RAT_FUNC "%12.10" "NA (none)" COEFFS 0 1024 0 0 0 1 /end COMPU_METHOD
/begin COMPU_METHOD CM_T_r_NA_16384_1_s16 "Q = V*16384.000000" RAT_FUNC "%15.14" "NA (none)" COEFFS 0 16384 0 0 0 1 /end COMPU_METHOD
/begin COMPU_METHOD CM_T_BOOLEAN "Q = V" RAT_FUNC "%1.0" "Bool" COEFFS 0 1 0 0 0 1 /end COMPU_METHOD
/begin COMPU_METHOD CM_T_P_kW_128_1_s16 "Q = V*128.000000" RAT_FUNC "%10.7" "kW (kilowatts  (kW))" COEFFS 0 128 0 0 0 1 /end COMPU_METHOD
/begin COMPU_METHOD CM_T_Cnt_Num_1_1_u8 "Q = V" RAT_FUNC "%3.0" "Num (counts)" COEFFS 0 1 0 0 0 1 /end COMPU_METHOD
/* EOF TCFR.a2l */
/begin RECORD_LAYOUT Scalar_BOOLEAN FNC_VALUES 1 UBYTE COLUMN_DIR DIRECT /end RECORD_LAYOUT
/begin RECORD_LAYOUT Scalar_UBYTE FNC_VALUES 1 UBYTE COLUMN_DIR DIRECT /end RECORD_LAYOUT
/begin RECORD_LAYOUT Scalar_UWORD FNC_VALUES 1 UWORD COLUMN_DIR DIRECT /end RECORD_LAYOUT
/begin RECORD_LAYOUT Scalar_SWORD FNC_VALUES 1 SWORD COLUMN_DIR DIRECT /end RECORD_LAYOUT
/begin RECORD_LAYOUT Lookup1D_WORD FNC_VALUES 1 SWORD COLUMN_DIR DIRECT /end RECORD_LAYOUT
/begin RECORD_LAYOUT Lookup1D_X_WORD AXIS_PTS_X 1 SWORD INDEX_INCR DIRECT /end RECORD_LAYOUT
/begin COMPU_METHOD CM_T_n_rpm_1_1_s16 "Q = V" RAT_FUNC "%5.0" "rpm (revolutions / minute  (rpm))" COEFFS 0 1 0 0 0 1 /end COMPU_METHOD
/begin COMPU_METHOD CM_T_Cnt_Num_1_1_u16 "Q = V" RAT_FUNC "%5.0" "Num (counts)" COEFFS 0 1 0 0 0 1 /end COMPU_METHOD
/begin COMPU_METHOD CM_T_T_degC_16_1_s16 "Q = V*16.000000" RAT_FUNC "%8.4" "degC (degrees Celsius  (deg C))" COEFFS 0 16 0 0 0 1 /end COMPU_METHOD
/begin COMPU_METHOD CM_T_r_NA_256_1_u16 "Q = V*256.000000" RAT_FUNC "%11.8" "NA (none)" COEFFS 0 256 0 0 0 1 /end COMPU_METHOD
/begin COMPU_METHOD CM_T_BOOLEAN "Q = V" RAT_FUNC "%1.0" "Bool" COEFFS 0 1 0 0 0 1 /end COMPU_METHOD
/begin COMPU_METHOD CM_T_y_BitField8 "Q = V" RAT_FUNC "%3.0" "BitField" COEFFS 0 1 0 0 0 1 /end COMPU_METHOD
/* EOF TCMD.a2l */
/begin RECORD_LAYOUT Scalar_BOOLEAN FNC_VALUES 1 UBYTE COLUMN_DIR DIRECT /end RECORD_LAYOUT
/begin RECORD_LAYOUT Scalar_UBYTE FNC_VALUES 1 UBYTE COLUMN_DIR DIRECT /end RECORD_LAYOUT
/begin RECORD_LAYOUT Scalar_UWORD FNC_VALUES 1 UWORD COLUMN_DIR DIRECT /end RECORD_LAYOUT
/begin RECORD_LAYOUT Scalar_SWORD FNC_VALUES 1 SWORD COLUMN_DIR DIRECT /end RECORD_LAYOUT
/begin RECORD_LAYOUT Lookup1D_WORD FNC_VALUES 1 SWORD COLUMN_DIR DIRECT /end RECORD_LAYOUT
/begin RECORD_LAYOUT Lookup1D_X_WORD AXIS_PTS_X 1 SWORD INDEX_INCR DIRECT /end RECORD_LAYOUT
/begin COMPU_METHOD CM_T_p_kPa_1_1_s16 "Q = V" RAT_FUNC "%5.0" "kPa (kiloPascals  (kPa))" COEFFS 0 1 0 0 0 1 /end COMPU_METHOD
/begin COMPU_METHOD CM_T_Cnt_Num_1_1_u16 "Q = V" RAT_FUNC "%5.0" "Num (counts)" COEFFS 0 1 0 0 0 1 /end COMPU_METHOD
/begin COMPU_METHOD CM_T_r_NA_256_1_u16 "Q = V*256.000000" RAT_FUNC "%11.8" "NA (none)" COEFFS 0 256 0 0 0 1 /end COMPU_METHOD
/begin COMPU_METHOD CM_T_Cnt_Num_1_1_u8 "Q = V" RAT_FUNC "%3.0" "Num (counts)" COEFFS 0 1 0 0 0 1 /end COMPU_METHOD
/begin COMPU_METHOD CM_T_BOOLEAN "Q = V" RAT_FUNC "%1.0" "Bool" COEFFS 0 1 0 0 0 1 /end COMPU_METHOD
/begin COMPU_METHOD CM_T_y_BitField8 "Q = V" RAT_FUNC "%3.0" "BitField" COEFFS 0 1 0 0 0 1 /end COMPU_METHOD
/* EOF TCPD.a2l */
/begin RECORD_LAYOUT Scalar_BOOLEAN FNC_VALUES 1 UBYTE COLUMN_DIR DIRECT /end RECORD_LAYOUT
/begin RECORD_LAYOUT Scalar_UBYTE FNC_VALUES 1 UBYTE COLUMN_DIR DIRECT /end RECORD_LAYOUT
/begin RECORD_LAYOUT Scalar_UWORD FNC_VALUES 1 UWORD COLUMN_DIR DIRECT /end RECORD_LAYOUT
/begin RECORD_LAYOUT Scalar_SWORD FNC_VALUES 1 SWORD COLUMN_DIR DIRECT /end RECORD_LAYOUT
/begin RECORD_LAYOUT Lookup1D_WORD FNC_VALUES 1 SWORD COLUMN_DIR DIRECT /end RECORD_LAYOUT
/begin RECORD_LAYOUT Lookup1D_X_WORD AXIS_PTS_X 1 SWORD INDEX_INCR DIRECT /end RECORD_LAYOUT
/begin COMPU_METHOD CM_T_p_kPa_1_1_s16 "Q = V" RAT_FUNC "%5.0" "kPa (kiloPascals  (kPa))" COEFFS 0 1 0 0 0 1 /end COMPU_METHOD
/begin COMPU_METHOD CM_T_Cnt_Num_1_1_u16 "Q = V" RAT_FUNC "%5.0" "Num (counts)" COEFFS 0 1 0 0 0 1 /end COMPU_METHOD
/begin COMPU_METHOD CM_T_r_NA_256_1_u16 "Q = V*256.000000" RAT_FUNC "%11.8" "NA (none)" COEFFS 0 256 0 0 0 1 /end COMPU_METHOD
/begin COMPU_METHOD CM_T_K_NA_1024_1_u16 "Q = V*1024.000000" RAT_FUNC "%12.10" "NA (dependent upon the gain)" COEFFS 0 1024 0 0 0 1 /end COMPU_METHOD
/begin COMPU_METHOD CM_T_Cnt_Num_1_1_u8 "Q = V" RAT_FUNC "%3.0" "Num (counts)" COEFFS 0 1 0 0 0 1 /end COMPU_METHOD
/begin COMPU_METHOD CM_T_BOOLEAN "Q = V" RAT_FUNC "%1.0" "Bool" COEFFS 0 1 0 0 0 1 /end COMPU_METHOD
/* EOF TLMD.a2l */
/begin RECORD_LAYOUT Scalar_BOOLEAN FNC_VALUES 1 UBYTE COLUMN_DIR DIRECT /end RECORD_LAYOUT
/begin RECORD_LAYOUT Scalar_UBYTE FNC_VALUES 1 UBYTE COLUMN_DIR DIRECT /end RECORD_LAYOUT
/begin RECORD_LAYOUT Scalar_UWORD FNC_VALUES 1 UWORD COLUMN_DIR DIRECT /end RECORD_LAYOUT
/begin RECORD_LAYOUT Scalar_SWORD FNC_VALUES 1 SWORD COLUMN_DIR DIRECT /end RECORD_LAYOUT
/begin RECORD_LAYOUT Lookup1D_WORD FNC_VALUES 1 SWORD COLUMN_DIR DIRECT /end RECORD_LAYOUT
/begin RECORD_LAYOUT Lookup1D_X_WORD AXIS_PTS_X 1 SWORD INDEX_INCR DIRECT /end RECORD_LAYOUT
/begin COMPU_METHOD CM_T_T_degC_16_1_s16 "Q = V*16.000000" RAT_FUNC "%8.4" "degC (degrees Celsius  (deg C))" COEFFS 0 16 0 0 0 1 /end COMPU_METHOD
/begin COMPU_METHOD CM_T_n_rpm_1_1_s16 "Q = V" RAT_FUNC "%5.0" "rpm (revolutions / minute  (rpm))" COEFFS 0 1 0 0 0 1 /end COMPU_METHOD
/begin COMPU_METHOD CM_T_Cnt_Num_1_1_u16 "Q = V" RAT_FUNC "%5.0" "Num (counts)" COEFFS 0 1 0 0 0 1 /end COMPU_METHOD
/begin COMPU_METHOD CM_T_r_NA_256_1_u16 "Q = V*256.000000" RAT_FUNC "%11.8" "NA (none)" COEFFS 0 256 0 0 0 1 /end COMPU_METHOD
/begin COMPU_METHOD CM_T_Cnt_Num_1_1_u8 "Q = V" RAT_FUNC "%3.0" "Num (counts)" COEFFS 0 1 0 0 0 1 /end COMPU_METHOD
/begin COMPU_METHOD CM_T_y_BitField8 "Q = V" RAT_FUNC "%3.0" "BitField" COEFFS 0 1 0 0 0 1 /end COMPU_METHOD
/begin COMPU_METHOD CM_T_BOOLEAN "Q = V" RAT_FUNC "%1.0" "Bool" COEFFS 0 1 0 0 0 1 /end COMPU_METHOD
/* EOF TOTD.a2l */
/begin RECORD_LAYOUT Scalar_BOOLEAN FNC_VALUES 1 UBYTE COLUMN_DIR DIRECT /end RECORD_LAYOUT
/begin RECORD_LAYOUT Scalar_UBYTE FNC_VALUES 1 UBYTE COLUMN_DIR DIRECT /end RECORD_LAYOUT
/begin RECORD_LAYOUT Scalar_UWORD FNC_VALUES 1 UWORD COLUMN_DIR DIRECT /end RECORD_LAYOUT
/begin RECORD_LAYOUT Scalar_SWORD FNC_VALUES 1 SWORD COLUMN_DIR DIRECT /end RECORD_LAYOUT
/begin RECORD_LAYOUT Lookup1D_WORD FNC_VALUES 1 SWORD COLUMN_DIR DIRECT /end RECORD_LAYOUT
/begin RECORD_LAYOUT Lookup1D_X_WORD AXIS_PTS_X 1 SWORD INDEX_INCR DIRECT /end RECORD_LAYOUT
/begin COMPU_METHOD CM_T_BOOLEAN "Q = V" RAT_FUNC "%1.0" "Bool" COEFFS 0 1 0 0 0 1 /end COMPU_METHOD
/* EOF TSPC.a2l */
/begin RECORD_LAYOUT Scalar_BOOLEAN FNC_VALUES 1 UBYTE COLUMN_DIR DIRECT /end RECORD_LAYOUT
/begin RECORD_LAYOUT Scalar_UBYTE FNC_VALUES 1 UBYTE COLUMN_DIR DIRECT /end RECORD_LAYOUT
/begin RECORD_LAYOUT Scalar_UWORD FNC_VALUES 1 UWORD COLUMN_DIR DIRECT /end RECORD_LAYOUT
/begin RECORD_LAYOUT Scalar_SWORD FNC_VALUES 1 SWORD COLUMN_DIR DIRECT /end RECORD_LAYOUT
/begin RECORD_LAYOUT Lookup1D_WORD FNC_VALUES 1 SWORD COLUMN_DIR DIRECT /end RECORD_LAYOUT
/begin RECORD_LAYOUT Lookup1D_X_WORD AXIS_PTS_X 1 SWORD INDEX_INCR DIRECT /end RECORD_LAYOUT
/begin COMPU_METHOD CM_T_n_rpm_1_1_s16 "Q = V" RAT_FUNC "%5.0" "rpm (revolutions / minute  (rpm))" COEFFS 0 1 0 0 0 1 /end COMPU_METHOD
/begin COMPU_METHOD CM_T_Cnt_Num_1_1_u16 "Q = V" RAT_FUNC "%5.0" "Num (counts)" COEFFS 0 1 0 0 0 1 /end COMPU_METHOD
/begin COMPU_METHOD CM_T_M_Nm_32_1_s16 "Q = V*32.000000" RAT_FUNC "%9.5" "Nm (newton-meters  (Nm))" COEFFS 0 32 0 0 0 1 /end COMPU_METHOD
/begin COMPU_METHOD CM_T_r_NA_256_1_u16 "Q = V*256.000000" RAT_FUNC "%11.8" "NA (none)" COEFFS 0 256 0 0 0 1 /end COMPU_METHOD
/begin COMPU_METHOD CM_T_Cnt_Num_1_1_u8 "Q = V" RAT_FUNC "%3.0" "Num (counts)" COEFFS 0 1 0 0 0 1 /end COMPU_METHOD
/begin COMPU_METHOD CM_T_BOOLEAN "Q = V" RAT_FUNC "%1.0" "Bool" COEFFS 0 1 0 0 0 1 /end COMPU_METHOD
/* EOF TSSD.a2l */
/begin RECORD_LAYOUT Scalar_BOOLEAN FNC_VALUES 1 UBYTE COLUMN_DIR DIRECT /end RECORD_LAYOUT
/begin RECORD_LAYOUT Scalar_UBYTE FNC_VALUES 1 UBYTE COLUMN_DIR DIRECT /end RECORD_LAYOUT
/begin RECORD_LAYOUT Scalar_UWORD FNC_VALUES 1 UWORD COLUMN_DIR DIRECT /end RECORD_LAYOUT
/begin RECORD_LAYOUT Scalar_SWORD FNC_VALUES 1 SWORD COLUMN_DIR DIRECT /end RECORD_LAYOUT
/begin RECORD_LAYOUT Lookup1D_WORD FNC_VALUES 1 SWORD COLUMN_DIR DIRECT /end RECORD_LAYOUT
/begin RECORD_LAYOUT Lookup1D_X_WORD AXIS_PTS_X 1 SWORD INDEX_INCR DIRECT /end RECORD_LAYOUT
/begin COMPU_METHOD CM_T_BOOLEAN "Q = V" RAT_FUNC "%1.0" "Bool" COEFFS 0 1 0 0 0 1 /end COMPU_METHOD
/begin COMPU_METHOD CM_T_y_BitField8 "Q = V" RAT_FUNC "%3.0" "BitField" COEFFS 0 1 0 0 0 1 /end COMPU_METHOD
/* EOF V5RD.a2l */
/begin RECORD_LAYOUT Scalar_BOOLEAN FNC_VALUES 1 UBYTE COLUMN_DIR DIRECT /end RECORD_LAYOUT
/begin RECORD_LAYOUT Scalar_UBYTE FNC_VALUES 1 UBYTE COLUMN_DIR DIRECT /end RECORD_LAYOUT
/begin RECORD_LAYOUT Scalar_UWORD FNC_VALUES 1 UWORD COLUMN_DIR DIRECT /end RECORD_LAYOUT
/begin RECORD_LAYOUT Scalar_SWORD FNC_VALUES 1 SWORD COLUMN_DIR DIRECT /end RECORD_LAYOUT
/begin RECORD_LAYOUT Lookup1D_WORD FNC_VALUES 1 SWORD COLUMN_DIR DIRECT /end RECORD_LAYOUT
/begin RECORD_LAYOUT Lookup1D_X_WORD AXIS_PTS_X 1 SWORD INDEX_INCR DIRECT /end RECORD_LAYOUT
/begin COMPU_METHOD CM_T_BOOLEAN "Q = V" RAT_FUNC "%1.0" "Bool" COEFFS 0 1 0 0 0 1 /end COMPU_METHOD
/end MODULE
/end PROJECT
