ASAP2_VERSION 1 31
/begin PROJECT ProjectName "Project Comment Goes Here"
/begin HEADER "Header Comments go here" /end HEADER
/begin MODULE ModuleName "Module Comment Goes Here"
/begin MOD_COMMON "Mod Common Comment Here" BYTE_ORDER MSB_FIRST /end MOD_COMMON
/begin RECORD_LAYOUT Scalar_BOOLEAN FNC_VALUES 1 UBYTE COLUMN_DIR DIRECT /end RECORD_LAYOUT
/begin RECORD_LAYOUT Scalar_UBYTE FNC_VALUES 1 UBYTE COLUMN_DIR DIRECT /end RECORD_LAYOUT
/begin RECORD_LAYOUT Scalar_UWORD FNC_VALUES 1 UWORD COLUMN_DIR DIRECT /end RECORD_LAYOUT
/begin RECORD_LAYOUT Scalar_SWORD FNC_VALUES 1 SWORD COLUMN_DIR DIRECT /end RECORD_LAYOUT
/begin RECORD_LAYOUT Scalar_ULONG FNC_VALUES 1 ULONG COLUMN_DIR DIRECT /end RECORD_LAYOUT
/begin RECORD_LAYOUT Scalar_FLOAT32_IEEE FNC_VALUES 1 FLOAT32_IEEE COLUMN_DIR DIRECT /end RECORD_LAYOUT
/begin RECORD_LAYOUT Lookup1D_UBYTE FNC_VALUES 1 UBYTE COLUMN_DIR DIRECT /end RECORD_LAYOUT
/begin RECORD_LAYOUT Lookup1D_UWORD FNC_VALUES 1 UWORD COLUMN_DIR DIRECT /end RECORD_LAYOUT
/begin RECORD_LAYOUT Lookup1D_WORD FNC_VALUES 1 SWORD COLUMN_DIR DIRECT /end RECORD_LAYOUT
/begin RECORD_LAYOUT Lookup1D_X_WORD AXIS_PTS_X 1 SWORD INDEX_INCR DIRECT /end RECORD_LAYOUT
/begin COMPU_METHOD CM_T_Cnt_Num_1_1_u16 "Q = V" RAT_FUNC "%5.0" "Num (counts)" COEFFS 0 1 0 0 0 1 /end COMPU_METHOD
/begin COMPU_METHOD CM_T_y_BitField8 "Q = V" RAT_FUNC "%3.0" "BitField" COEFFS 0 1 0 0 0 1 /end COMPU_METHOD
/begin COMPU_METHOD CM_T_Cnt_Num_1_1_u8 "Q = V" RAT_FUNC "%3.0" "Num (counts)" COEFFS 0 1 0 0 0 1 /end COMPU_METHOD
/begin COMPU_METHOD CM_T_BOOLEAN "Q = V" RAT_FUNC "%1.0" "Bool" COEFFS 0 1 0 0 0 1 /end COMPU_METHOD
/begin COMPU_METHOD CM_T_y_BitFieldDiagStatus "Q = V" RAT_FUNC "%3.0" "BitField" COEFFS 0 1 0 0 0 1 /end COMPU_METHOD
/* (add any file trailer comments here) */ /* EOF CAND.a2l */
/begin RECORD_LAYOUT Scalar_BOOLEAN FNC_VALUES 1 UBYTE COLUMN_DIR DIRECT /end RECORD_LAYOUT
/begin RECORD_LAYOUT Scalar_UBYTE FNC_VALUES 1 UBYTE COLUMN_DIR DIRECT /end RECORD_LAYOUT
/begin RECORD_LAYOUT Scalar_UWORD FNC_VALUES 1 UWORD COLUMN_DIR DIRECT /end RECORD_LAYOUT
/begin RECORD_LAYOUT Scalar_SWORD FNC_VALUES 1 SWORD COLUMN_DIR DIRECT /end RECORD_LAYOUT
/begin RECORD_LAYOUT Scalar_ULONG FNC_VALUES 1 ULONG COLUMN_DIR DIRECT /end RECORD_LAYOUT
/begin RECORD_LAYOUT Scalar_FLOAT32_IEEE FNC_VALUES 1 FLOAT32_IEEE COLUMN_DIR DIRECT /end RECORD_LAYOUT
/begin RECORD_LAYOUT Lookup1D_UBYTE FNC_VALUES 1 UBYTE COLUMN_DIR DIRECT /end RECORD_LAYOUT
/begin RECORD_LAYOUT Lookup1D_UWORD FNC_VALUES 1 UWORD COLUMN_DIR DIRECT /end RECORD_LAYOUT
/begin RECORD_LAYOUT Lookup1D_WORD FNC_VALUES 1 SWORD COLUMN_DIR DIRECT /end RECORD_LAYOUT
/begin RECORD_LAYOUT Lookup1D_X_WORD AXIS_PTS_X 1 SWORD INDEX_INCR DIRECT /end RECORD_LAYOUT
/begin COMPU_METHOD CM_T_n_rpm_1_1_s16 "Q = V" RAT_FUNC "%5.0" "rpm (revolutions / minute  (rpm))" COEFFS 0 1 0 0 0 1 /end COMPU_METHOD
/begin COMPU_METHOD CM_T_Cnt_Num_1_1_u16 "Q = V" RAT_FUNC "%5.0" "Num (counts)" COEFFS 0 1 0 0 0 1 /end COMPU_METHOD
/begin COMPU_METHOD CM_T_M_Nm_32_1_s16 "Q = V*32.000000" RAT_FUNC "%9.5" "Nm (newton-meters  (Nm))" COEFFS 0 32 0 0 0 1 /end COMPU_METHOD
/begin COMPU_METHOD CM_T_r_NA_1024_1_s16 "Q = V*1024.000000" RAT_FUNC "%12.10" "NA (none)" COEFFS 0 1024 0 0 0 1 /end COMPU_METHOD
/begin COMPU_METHOD CM_T_T_degC_16_1_s16 "Q = V*16.000000" RAT_FUNC "%8.4" "degC (degrees Celsius  (deg C))" COEFFS 0 16 0 0 0 1 /end COMPU_METHOD
/begin COMPU_METHOD CM_T_BOOLEAN "Q = V" RAT_FUNC "%1.0" "Bool" COEFFS 0 1 0 0 0 1 /end COMPU_METHOD
/* EOF CCAP.a2l */
/begin RECORD_LAYOUT Scalar_BOOLEAN FNC_VALUES 1 UBYTE COLUMN_DIR DIRECT /end RECORD_LAYOUT
/begin RECORD_LAYOUT Scalar_UBYTE FNC_VALUES 1 UBYTE COLUMN_DIR DIRECT /end RECORD_LAYOUT
/begin RECORD_LAYOUT Scalar_UWORD FNC_VALUES 1 UWORD COLUMN_DIR DIRECT /end RECORD_LAYOUT
/begin RECORD_LAYOUT Scalar_SWORD FNC_VALUES 1 SWORD COLUMN_DIR DIRECT /end RECORD_LAYOUT
/begin RECORD_LAYOUT Scalar_ULONG FNC_VALUES 1 ULONG COLUMN_DIR DIRECT /end RECORD_LAYOUT
/begin RECORD_LAYOUT Scalar_FLOAT32_IEEE FNC_VALUES 1 FLOAT32_IEEE COLUMN_DIR DIRECT /end RECORD_LAYOUT
/begin RECORD_LAYOUT Lookup1D_UBYTE FNC_VALUES 1 UBYTE COLUMN_DIR DIRECT /end RECORD_LAYOUT
/begin RECORD_LAYOUT Lookup1D_UWORD FNC_VALUES 1 UWORD COLUMN_DIR DIRECT /end RECORD_LAYOUT
/begin RECORD_LAYOUT Lookup1D_WORD FNC_VALUES 1 SWORD COLUMN_DIR DIRECT /end RECORD_LAYOUT
/begin RECORD_LAYOUT Lookup1D_X_WORD AXIS_PTS_X 1 SWORD INDEX_INCR DIRECT /end RECORD_LAYOUT
/begin COMPU_METHOD CM_T_M_Nm_32_1_s16 "Q = V*32.000000" RAT_FUNC "%9.5" "Nm (newton-meters  (Nm))" COEFFS 0 32 0 0 0 1 /end COMPU_METHOD
/begin COMPU_METHOD CM_T_n_rpm_1_1_s16 "Q = V" RAT_FUNC "%5.0" "rpm (revolutions / minute  (rpm))" COEFFS 0 1 0 0 0 1 /end COMPU_METHOD
/begin COMPU_METHOD CM_CLCOte_e_ActualClutchState "Enumerated data type: CLCOte_e_ActualClutchState" TAB_VERB "%0.6" "" COMPU_TAB_REF VTAB_FOR_CM_CLCOte_e_ActualClutchState /end COMPU_METHOD
/begin COMPU_VTAB VTAB_FOR_CM_CLCOte_e_ActualClutchState "Enumerated data type: CLCOte_e_ActualClutchState" TAB_VERB 6 0 "CLCOce_e_ClutchNeutral" 1 "CLCOce_e_ClutchDisengage" 2 "CLCOce_e_ClutchInGear" 3 "CLCOce_e_ClutchPrepare" 4 "CLCOce_e_ClutchTrqMode" 5 "CLCOce_e_ClutchSpdMode" /end COMPU_VTAB
/begin COMPU_METHOD CM_T_Cnt_Num_1_1_s16 "Q = V" RAT_FUNC "%5.0" "Num (counts)" COEFFS 0 1 0 0 0 1 /end COMPU_METHOD
/begin COMPU_METHOD CM_T_Cnt_Num_1_1_u16 "Q = V" RAT_FUNC "%5.0" "Num (counts)" COEFFS 0 1 0 0 0 1 /end COMPU_METHOD
/begin COMPU_METHOD CM_T_t_s_100_1_s16 "Q = V*100.000000" RAT_FUNC "%0.6" "s (seconds  (s))" COEFFS 0 100 0 0 0 1 /end COMPU_METHOD
/begin COMPU_METHOD CM_T_BOOLEAN "Q = V" RAT_FUNC "%1.0" "Bool" COEFFS 0 1 0 0 0 1 /end COMPU_METHOD
/* EOF CLCO.a2l */
/begin RECORD_LAYOUT Scalar_BOOLEAN FNC_VALUES 1 UBYTE COLUMN_DIR DIRECT /end RECORD_LAYOUT
/begin RECORD_LAYOUT Scalar_UBYTE FNC_VALUES 1 UBYTE COLUMN_DIR DIRECT /end RECORD_LAYOUT
/begin RECORD_LAYOUT Scalar_UWORD FNC_VALUES 1 UWORD COLUMN_DIR DIRECT /end RECORD_LAYOUT
/begin RECORD_LAYOUT Scalar_SWORD FNC_VALUES 1 SWORD COLUMN_DIR DIRECT /end RECORD_LAYOUT
/begin RECORD_LAYOUT Scalar_ULONG FNC_VALUES 1 ULONG COLUMN_DIR DIRECT /end RECORD_LAYOUT
/begin RECORD_LAYOUT Scalar_FLOAT32_IEEE FNC_VALUES 1 FLOAT32_IEEE COLUMN_DIR DIRECT /end RECORD_LAYOUT
/begin RECORD_LAYOUT Lookup1D_UBYTE FNC_VALUES 1 UBYTE COLUMN_DIR DIRECT /end RECORD_LAYOUT
/begin RECORD_LAYOUT Lookup1D_UWORD FNC_VALUES 1 UWORD COLUMN_DIR DIRECT /end RECORD_LAYOUT
/begin RECORD_LAYOUT Lookup1D_WORD FNC_VALUES 1 SWORD COLUMN_DIR DIRECT /end RECORD_LAYOUT
/begin RECORD_LAYOUT Lookup1D_X_WORD AXIS_PTS_X 1 SWORD INDEX_INCR DIRECT /end RECORD_LAYOUT
/begin COMPU_METHOD CM_T_Pct_pct_256_1_s16 "Q = V*256.000000" RAT_FUNC "%11.8" "pct (percent  (%))" COEFFS 0 256 0 0 0 1 /end COMPU_METHOD
/begin COMPU_METHOD CM_T_n_rpm_1_1_s16 "Q = V" RAT_FUNC "%5.0" "rpm (revolutions / minute  (rpm))" COEFFS 0 1 0 0 0 1 /end COMPU_METHOD
/begin COMPU_METHOD CM_T_p_kPa_32_1_u16 "Q = V*32.000000" RAT_FUNC "%9.5" "kPa (kiloPascals  (kPa))" COEFFS 0 32 0 0 0 1 /end COMPU_METHOD
/begin COMPU_METHOD CM_T_T_degC_16_1_s16 "Q = V*16.000000" RAT_FUNC "%8.4" "degC (degrees Celsius  (deg C))" COEFFS 0 16 0 0 0 1 /end COMPU_METHOD
/begin COMPU_METHOD CM_T_I_A_32_1_s16 "Q = V*32.000000" RAT_FUNC "%9.5" "A (amperes  (A))" COEFFS 0 32 0 0 0 1 /end COMPU_METHOD
/begin COMPU_METHOD CM_T_r_NA_32768_1_u16 "Q = V*32768.000000" RAT_FUNC "%16.15" "NA (none)" COEFFS 0 32768 0 0 0 1 /end COMPU_METHOD
/begin COMPU_METHOD CM_T_Cnt_Num_1_1_u16 "Q = V" RAT_FUNC "%5.0" "Num (counts)" COEFFS 0 1 0 0 0 1 /end COMPU_METHOD
/begin COMPU_METHOD CM_T_M_Nm_32_1_s16 "Q = V*32.000000" RAT_FUNC "%9.5" "Nm (newton-meters  (Nm))" COEFFS 0 32 0 0 0 1 /end COMPU_METHOD
/begin COMPU_METHOD CM_T_I_A_Float32 "Q = V" RAT_FUNC "%8.6" "A (amperes  (A))" COEFFS 0 1 0 0 0 1 /end COMPU_METHOD
/begin COMPU_METHOD CM_T_K_NA_Float32 "Q = V" RAT_FUNC "%8.6" "NA (dependent upon the gain)" COEFFS 0 1 0 0 0 1 /end COMPU_METHOD
/begin COMPU_METHOD CM_T_U_V_512_1_s16 "Q = V*512.000000" RAT_FUNC "%12.9" "V (volts  (V))" COEFFS 0 512 0 0 0 1 /end COMPU_METHOD
/begin COMPU_METHOD CM_T_v_kph_64_1_s16 "Q = V*64.000000" RAT_FUNC "%10.6" "kph (kilometers / hour  (kph))" COEFFS 0 64 0 0 0 1 /end COMPU_METHOD
/begin COMPU_METHOD CM_T_Pct_pct_10_1_s16 "Q = V*10.000000" RAT_FUNC "%0.6" "pct (percent  (%))" COEFFS 0 10 0 0 0 1 /end COMPU_METHOD
/begin COMPU_METHOD CM_T_K_NA_32768_1_u16 "Q = V*32768.000000" RAT_FUNC "%16.15" "NA (dependent upon the gain)" COEFFS 0 32768 0 0 0 1 /end COMPU_METHOD
/begin COMPU_METHOD CM_T_r_NA_1024_1_s16 "Q = V*1024.000000" RAT_FUNC "%12.10" "NA (none)" COEFFS 0 1024 0 0 0 1 /end COMPU_METHOD
/begin COMPU_METHOD CM_T_l_m_1024_1_s16 "Q = V*1024.000000" RAT_FUNC "%12.10" "m (meters  (m))" COEFFS 0 1024 0 0 0 1 /end COMPU_METHOD
/begin COMPU_METHOD CM_T_V_ml_128_1_s16 "Q = V*128.000000" RAT_FUNC "%10.7" "ml (milliliters  (ml))" COEFFS 0 128 0 0 0 1 /end COMPU_METHOD
/begin COMPU_METHOD CM_T_Cnt_Num_1_1_u8 "Q = V" RAT_FUNC "%3.0" "Num (counts)" COEFFS 0 1 0 0 0 1 /end COMPU_METHOD
/begin COMPU_METHOD CM_T_BOOLEAN "Q = V" RAT_FUNC "%1.0" "Bool" COEFFS 0 1 0 0 0 1 /end COMPU_METHOD
/begin COMPU_METHOD CM_T_r_NA_Float32 "Q = V" RAT_FUNC "%8.6" "NA (none)" COEFFS 0 1 0 0 0 1 /end COMPU_METHOD
/begin COMPU_METHOD CM_T_P_W_Float32 "Q = V" RAT_FUNC "%8.6" "W (watts  (W))" COEFFS 0 1 0 0 0 1 /end COMPU_METHOD
/begin COMPU_METHOD CM_T_Cnt_Num_1_1_s16 "Q = V" RAT_FUNC "%5.0" "Num (counts)" COEFFS 0 1 0 0 0 1 /end COMPU_METHOD
/* EOF CLPC.a2l */
/begin RECORD_LAYOUT Scalar_BOOLEAN FNC_VALUES 1 UBYTE COLUMN_DIR DIRECT /end RECORD_LAYOUT
/begin RECORD_LAYOUT Scalar_UBYTE FNC_VALUES 1 UBYTE COLUMN_DIR DIRECT /end RECORD_LAYOUT
/begin RECORD_LAYOUT Scalar_UWORD FNC_VALUES 1 UWORD COLUMN_DIR DIRECT /end RECORD_LAYOUT
/begin RECORD_LAYOUT Scalar_SWORD FNC_VALUES 1 SWORD COLUMN_DIR DIRECT /end RECORD_LAYOUT
/begin RECORD_LAYOUT Scalar_ULONG FNC_VALUES 1 ULONG COLUMN_DIR DIRECT /end RECORD_LAYOUT
/begin RECORD_LAYOUT Scalar_FLOAT32_IEEE FNC_VALUES 1 FLOAT32_IEEE COLUMN_DIR DIRECT /end RECORD_LAYOUT
/begin RECORD_LAYOUT Lookup1D_UBYTE FNC_VALUES 1 UBYTE COLUMN_DIR DIRECT /end RECORD_LAYOUT
/begin RECORD_LAYOUT Lookup1D_UWORD FNC_VALUES 1 UWORD COLUMN_DIR DIRECT /end RECORD_LAYOUT
/begin RECORD_LAYOUT Lookup1D_WORD FNC_VALUES 1 SWORD COLUMN_DIR DIRECT /end RECORD_LAYOUT
/begin RECORD_LAYOUT Lookup1D_X_WORD AXIS_PTS_X 1 SWORD INDEX_INCR DIRECT /end RECORD_LAYOUT
/begin CHARACTERISTIC FDMAie_b_CtrlMon_10ms_BlockReport "This override blocks the report of the execution to the monitoring system.
      Should be used during testing to verify correct behaviour of the monitoring system.
      " VALUE 0x0000 /* @ECU_Address@FDMAie_b_CtrlMon_10ms_BlockReport@ */ Scalar_BOOLEAN 0 CM_T_BOOLEAN 0.0 1.0 /end CHARACTERISTIC
/begin CHARACTERISTIC FDMAie_b_DisableLooping "This instrumentation slew disables looping for development testing purposes." VALUE 0x0000 /* @ECU_Address@FDMAie_b_DisableLooping@ */ Scalar_BOOLEAN 0 CM_T_BOOLEAN 0.0 1.0 /end CHARACTERISTIC
/begin CHARACTERISTIC FDMAie_b_ETC_ControlMode_ob "Override boolean" VALUE 0x0000 /* @ECU_Address@FDMAie_b_ETC_ControlMode_ob@ */ Scalar_BOOLEAN 0 CM_T_BOOLEAN 0 1 /end CHARACTERISTIC
/begin CHARACTERISTIC FDMAie_b_ForceAC_CompressorCpbyPrioHigh_ob "Override boolean." VALUE 0x0000 /* @ECU_Address@FDMAie_b_ForceAC_CompressorCpbyPrioHigh_ob@ */ Scalar_BOOLEAN 0 CM_T_BOOLEAN 0.0 1.0 /end CHARACTERISTIC
/begin CHARACTERISTIC FDMAie_b_ForceAC_CompressorCpbyPrioHigh_ov "Override value." VALUE 0x0000 /* @ECU_Address@FDMAie_b_ForceAC_CompressorCpbyPrioHigh_ov@ */ Scalar_BOOLEAN 0 CM_T_BOOLEAN 0.0 1.0 /end CHARACTERISTIC
/begin CHARACTERISTIC FDMAie_b_ForceAC_CompressorToOff_ob "Override boolean." VALUE 0x0000 /* @ECU_Address@FDMAie_b_ForceAC_CompressorToOff_ob@ */ Scalar_BOOLEAN 0 CM_T_BOOLEAN 0.0 1.0 /end CHARACTERISTIC
/begin CHARACTERISTIC FDMAie_b_ForceAC_CompressorToOff_ov "Override value." VALUE 0x0000 /* @ECU_Address@FDMAie_b_ForceAC_CompressorToOff_ov@ */ Scalar_BOOLEAN 0 CM_T_BOOLEAN 0.0 1.0 /end CHARACTERISTIC
/begin CHARACTERISTIC FDMAie_b_ForceAC_LoadCompensationToOff_ob "Override boolean." VALUE 0x0000 /* @ECU_Address@FDMAie_b_ForceAC_LoadCompensationToOff_ob@ */ Scalar_BOOLEAN 0 CM_T_BOOLEAN 0.0 1.0 /end CHARACTERISTIC
/begin CHARACTERISTIC FDMAie_b_ForceAC_LoadCompensationToOff_ov "Override value." VALUE 0x0000 /* @ECU_Address@FDMAie_b_ForceAC_LoadCompensationToOff_ov@ */ Scalar_BOOLEAN 0 CM_T_BOOLEAN 0.0 1.0 /end CHARACTERISTIC
/begin CHARACTERISTIC FDMAie_b_ForceActiveDischarge_ob "Override boolean." VALUE 0x0000 /* @ECU_Address@FDMAie_b_ForceActiveDischarge_ob@ */ Scalar_BOOLEAN 0 CM_T_BOOLEAN 0.0 1.0 /end CHARACTERISTIC
/begin CHARACTERISTIC FDMAie_b_ForceActiveDischarge_ov "Override value." VALUE 0x0000 /* @ECU_Address@FDMAie_b_ForceActiveDischarge_ov@ */ Scalar_BOOLEAN 0 CM_T_BOOLEAN 0.0 1.0 /end CHARACTERISTIC
/begin CHARACTERISTIC FDMAie_b_ForceAirEstimationByMAP_SensorToOff_ob "Override boolean." VALUE 0x0000 /* @ECU_Address@FDMAie_b_ForceAirEstimationByMAP_SensorToOff_ob@ */ Scalar_BOOLEAN 0 CM_T_BOOLEAN 0.0 1.0 /end CHARACTERISTIC
/begin CHARACTERISTIC FDMAie_b_ForceAirEstimationByMAP_SensorToOff_ov "Override value." VALUE 0x0000 /* @ECU_Address@FDMAie_b_ForceAirEstimationByMAP_SensorToOff_ov@ */ Scalar_BOOLEAN 0 CM_T_BOOLEAN 0.0 1.0 /end CHARACTERISTIC
/begin CHARACTERISTIC FDMAie_b_ForceAntiJerkControlOff_ob "Override boolean." VALUE 0x0000 /* @ECU_Address@FDMAie_b_ForceAntiJerkControlOff_ob@ */ Scalar_BOOLEAN 0 CM_T_BOOLEAN 0.0 1.0 /end CHARACTERISTIC
/begin CHARACTERISTIC FDMAie_b_ForceAntiJerkControlOff_ov "Override value." VALUE 0x0000 /* @ECU_Address@FDMAie_b_ForceAntiJerkControlOff_ov@ */ Scalar_BOOLEAN 0 CM_T_BOOLEAN 0.0 1.0 /end CHARACTERISTIC
/begin CHARACTERISTIC FDMAie_b_ForceBackupPowerModeToActive_ob "Override boolean." VALUE 0x0000 /* @ECU_Address@FDMAie_b_ForceBackupPowerModeToActive_ob@ */ Scalar_BOOLEAN 0 CM_T_BOOLEAN 0.0 1.0 /end CHARACTERISTIC
/begin CHARACTERISTIC FDMAie_b_ForceBackupPowerModeToActive_ov "Override value." VALUE 0x0000 /* @ECU_Address@FDMAie_b_ForceBackupPowerModeToActive_ov@ */ Scalar_BOOLEAN 0 CM_T_BOOLEAN 0.0 1.0 /end CHARACTERISTIC
/begin CHARACTERISTIC FDMAie_b_ForceBoostPressureControlToLowPressure_ob "Override boolean." VALUE 0x0000 /* @ECU_Address@FDMAie_b_ForceBoostPressureControlToLowPressure_ob@ */ Scalar_BOOLEAN 0 CM_T_BOOLEAN 0.0 1.0 /end CHARACTERISTIC
/begin CHARACTERISTIC FDMAie_b_ForceBoostPressureControlToLowPressure_ov "Override value." VALUE 0x0000 /* @ECU_Address@FDMAie_b_ForceBoostPressureControlToLowPressure_ov@ */ Scalar_BOOLEAN 0 CM_T_BOOLEAN 0.0 1.0 /end CHARACTERISTIC
/begin CHARACTERISTIC FDMAie_b_ForceBoostTorqueOff_ob "Override boolean." VALUE 0x0000 /* @ECU_Address@FDMAie_b_ForceBoostTorqueOff_ob@ */ Scalar_BOOLEAN 0 CM_T_BOOLEAN 0.0 1.0 /end CHARACTERISTIC
/begin CHARACTERISTIC FDMAie_b_ForceBoostTorqueOff_ov "Override value." VALUE 0x0000 /* @ECU_Address@FDMAie_b_ForceBoostTorqueOff_ov@ */ Scalar_BOOLEAN 0 CM_T_BOOLEAN 0.0 1.0 /end CHARACTERISTIC
/begin CHARACTERISTIC FDMAie_b_ForceBrakeRegenerationTorqueOff_ob "Override boolean." VALUE 0x0000 /* @ECU_Address@FDMAie_b_ForceBrakeRegenerationTorqueOff_ob@ */ Scalar_BOOLEAN 0 CM_T_BOOLEAN 0.0 1.0 /end CHARACTERISTIC
/begin CHARACTERISTIC FDMAie_b_ForceBrakeRegenerationTorqueOff_ov "Override value." VALUE 0x0000 /* @ECU_Address@FDMAie_b_ForceBrakeRegenerationTorqueOff_ov@ */ Scalar_BOOLEAN 0 CM_T_BOOLEAN 0.0 1.0 /end CHARACTERISTIC
/begin CHARACTERISTIC FDMAie_b_ForceCCPCancleSpdLimit_ob "Override boolean." VALUE 0x0000 /* @ECU_Address@FDMAie_b_ForceCCPCancleSpdLimit_ob@ */ Scalar_BOOLEAN 0 CM_T_BOOLEAN 0.0 1.0 /end CHARACTERISTIC
/begin CHARACTERISTIC FDMAie_b_ForceCCPCancleSpdLimit_ov "Override value." VALUE 0x0000 /* @ECU_Address@FDMAie_b_ForceCCPCancleSpdLimit_ov@ */ Scalar_BOOLEAN 0 CM_T_BOOLEAN 0.0 1.0 /end CHARACTERISTIC
/begin CHARACTERISTIC FDMAie_b_ForceCamPositionToParked_ob "Override boolean." VALUE 0x0000 /* @ECU_Address@FDMAie_b_ForceCamPositionToParked_ob@ */ Scalar_BOOLEAN 0 CM_T_BOOLEAN 0.0 1.0 /end CHARACTERISTIC
/begin CHARACTERISTIC FDMAie_b_ForceCamPositionToParked_ov "Override value." VALUE 0x0000 /* @ECU_Address@FDMAie_b_ForceCamPositionToParked_ov@ */ Scalar_BOOLEAN 0 CM_T_BOOLEAN 0.0 1.0 /end CHARACTERISTIC
/begin CHARACTERISTIC FDMAie_b_ForceClutchOddOpen_ob "Override boolean." VALUE 0x0000 /* @ECU_Address@FDMAie_b_ForceClutchOddOpen_ob@ */ Scalar_BOOLEAN 0 CM_T_BOOLEAN 0.0 1.0 /end CHARACTERISTIC
/begin CHARACTERISTIC FDMAie_b_ForceClutchOddOpen_ov "Override value." VALUE 0x0000 /* @ECU_Address@FDMAie_b_ForceClutchOddOpen_ov@ */ Scalar_BOOLEAN 0 CM_T_BOOLEAN 0.0 1.0 /end CHARACTERISTIC
/begin CHARACTERISTIC FDMAie_b_ForceCoastRegenerationTorqueOff_ob "Override boolean." VALUE 0x0000 /* @ECU_Address@FDMAie_b_ForceCoastRegenerationTorqueOff_ob@ */ Scalar_BOOLEAN 0 CM_T_BOOLEAN 0.0 1.0 /end CHARACTERISTIC
/begin CHARACTERISTIC FDMAie_b_ForceCoastRegenerationTorqueOff_ov "Override value." VALUE 0x0000 /* @ECU_Address@FDMAie_b_ForceCoastRegenerationTorqueOff_ov@ */ Scalar_BOOLEAN 0 CM_T_BOOLEAN 0.0 1.0 /end CHARACTERISTIC
/begin CHARACTERISTIC FDMAie_b_ForceContactorsOpen_ob "Override boolean." VALUE 0x0000 /* @ECU_Address@FDMAie_b_ForceContactorsOpen_ob@ */ Scalar_BOOLEAN 0 CM_T_BOOLEAN 0.0 1.0 /end CHARACTERISTIC
/begin CHARACTERISTIC FDMAie_b_ForceContactorsOpen_ov "Override value." VALUE 0x0000 /* @ECU_Address@FDMAie_b_ForceContactorsOpen_ov@ */ Scalar_BOOLEAN 0 CM_T_BOOLEAN 0.0 1.0 /end CHARACTERISTIC
/begin CHARACTERISTIC FDMAie_b_ForceCreepControlToOff_ob "Override boolean." VALUE 0x0000 /* @ECU_Address@FDMAie_b_ForceCreepControlToOff_ob@ */ Scalar_BOOLEAN 0 CM_T_BOOLEAN 0.0 1.0 /end CHARACTERISTIC
/begin CHARACTERISTIC FDMAie_b_ForceCreepControlToOff_ov "Override value." VALUE 0x0000 /* @ECU_Address@FDMAie_b_ForceCreepControlToOff_ov@ */ Scalar_BOOLEAN 0 CM_T_BOOLEAN 0.0 1.0 /end CHARACTERISTIC
/begin CHARACTERISTIC FDMAie_b_ForceCruiseControlToOff_ob "Override boolean." VALUE 0x0000 /* @ECU_Address@FDMAie_b_ForceCruiseControlToOff_ob@ */ Scalar_BOOLEAN 0 CM_T_BOOLEAN 0.0 1.0 /end CHARACTERISTIC
/begin CHARACTERISTIC FDMAie_b_ForceCruiseControlToOff_ov "Override value." VALUE 0x0000 /* @ECU_Address@FDMAie_b_ForceCruiseControlToOff_ov@ */ Scalar_BOOLEAN 0 CM_T_BOOLEAN 0.0 1.0 /end CHARACTERISTIC
/begin CHARACTERISTIC FDMAie_b_ForceDCDC_BuckConversionOff_ob "Override boolean." VALUE 0x0000 /* @ECU_Address@FDMAie_b_ForceDCDC_BuckConversionOff_ob@ */ Scalar_BOOLEAN 0 CM_T_BOOLEAN 0.0 1.0 /end CHARACTERISTIC
/begin CHARACTERISTIC FDMAie_b_ForceDCDC_BuckConversionOff_ov "Override value." VALUE 0x0000 /* @ECU_Address@FDMAie_b_ForceDCDC_BuckConversionOff_ov@ */ Scalar_BOOLEAN 0 CM_T_BOOLEAN 0.0 1.0 /end CHARACTERISTIC
/begin CHARACTERISTIC FDMAie_b_ForceDCDC_ControlToDefault_ob "Override boolean." VALUE 0x0000 /* @ECU_Address@FDMAie_b_ForceDCDC_ControlToDefault_ob@ */ Scalar_BOOLEAN 0 CM_T_BOOLEAN 0.0 1.0 /end CHARACTERISTIC
/begin CHARACTERISTIC FDMAie_b_ForceDCDC_ControlToDefault_ov "Override value." VALUE 0x0000 /* @ECU_Address@FDMAie_b_ForceDCDC_ControlToDefault_ov@ */ Scalar_BOOLEAN 0 CM_T_BOOLEAN 0.0 1.0 /end CHARACTERISTIC
/begin CHARACTERISTIC FDMAie_b_ForceEGR_ControlToOff_ob "Override boolean." VALUE 0x0000 /* @ECU_Address@FDMAie_b_ForceEGR_ControlToOff_ob@ */ Scalar_BOOLEAN 0 CM_T_BOOLEAN 0.0 1.0 /end CHARACTERISTIC
/begin CHARACTERISTIC FDMAie_b_ForceEGR_ControlToOff_ov "Override value." VALUE 0x0000 /* @ECU_Address@FDMAie_b_ForceEGR_ControlToOff_ov@ */ Scalar_BOOLEAN 0 CM_T_BOOLEAN 0.0 1.0 /end CHARACTERISTIC
/begin CHARACTERISTIC FDMAie_b_ForceElectricLoadCompensationToOff_ob "Override boolean." VALUE 0x0000 /* @ECU_Address@FDMAie_b_ForceElectricLoadCompensationToOff_ob@ */ Scalar_BOOLEAN 0 CM_T_BOOLEAN 0.0 1.0 /end CHARACTERISTIC
/begin CHARACTERISTIC FDMAie_b_ForceElectricLoadCompensationToOff_ov "Override value." VALUE 0x0000 /* @ECU_Address@FDMAie_b_ForceElectricLoadCompensationToOff_ov@ */ Scalar_BOOLEAN 0 CM_T_BOOLEAN 0.0 1.0 /end CHARACTERISTIC
/begin CHARACTERISTIC FDMAie_b_ForceElectricThermostatControlToLowTemp_ob "Override boolean." VALUE 0x0000 /* @ECU_Address@FDMAie_b_ForceElectricThermostatControlToLowTemp_ob@ */ Scalar_BOOLEAN 0 CM_T_BOOLEAN 0.0 1.0 /end CHARACTERISTIC
/begin CHARACTERISTIC FDMAie_b_ForceElectricThermostatControlToLowTemp_ov "Override value." VALUE 0x0000 /* @ECU_Address@FDMAie_b_ForceElectricThermostatControlToLowTemp_ov@ */ Scalar_BOOLEAN 0 CM_T_BOOLEAN 0.0 1.0 /end CHARACTERISTIC
/begin CHARACTERISTIC FDMAie_b_ForceElectricThermostatToOff_ob "Override boolean." VALUE 0x0000 /* @ECU_Address@FDMAie_b_ForceElectricThermostatToOff_ob@ */ Scalar_BOOLEAN 0 CM_T_BOOLEAN 0.0 1.0 /end CHARACTERISTIC
/begin CHARACTERISTIC FDMAie_b_ForceElectricThermostatToOff_ov "Override value." VALUE 0x0000 /* @ECU_Address@FDMAie_b_ForceElectricThermostatToOff_ov@ */ Scalar_BOOLEAN 0 CM_T_BOOLEAN 0.0 1.0 /end CHARACTERISTIC
/begin CHARACTERISTIC FDMAie_b_ForceElectricVacuumPumpOff_ob "Override boolean." VALUE 0x0000 /* @ECU_Address@FDMAie_b_ForceElectricVacuumPumpOff_ob@ */ Scalar_BOOLEAN 0 CM_T_BOOLEAN 0.0 1.0 /end CHARACTERISTIC
/begin CHARACTERISTIC FDMAie_b_ForceElectricVacuumPumpOff_ov "Override value." VALUE 0x0000 /* @ECU_Address@FDMAie_b_ForceElectricVacuumPumpOff_ov@ */ Scalar_BOOLEAN 0 CM_T_BOOLEAN 0.0 1.0 /end CHARACTERISTIC
/begin CHARACTERISTIC FDMAie_b_ForceElectricVacuumPumpPulseMode_ob "Override boolean." VALUE 0x0000 /* @ECU_Address@FDMAie_b_ForceElectricVacuumPumpPulseMode_ob@ */ Scalar_BOOLEAN 0 CM_T_BOOLEAN 0.0 1.0 /end CHARACTERISTIC
/begin CHARACTERISTIC FDMAie_b_ForceElectricVacuumPumpPulseMode_ov "Override value." VALUE 0x0000 /* @ECU_Address@FDMAie_b_ForceElectricVacuumPumpPulseMode_ov@ */ Scalar_BOOLEAN 0 CM_T_BOOLEAN 0.0 1.0 /end CHARACTERISTIC
/begin CHARACTERISTIC FDMAie_b_ForceEngCoolantTempToEstimationModel_ob "Override boolean." VALUE 0x0000 /* @ECU_Address@FDMAie_b_ForceEngCoolantTempToEstimationModel_ob@ */ Scalar_BOOLEAN 0 CM_T_BOOLEAN 0.0 1.0 /end CHARACTERISTIC
/begin CHARACTERISTIC FDMAie_b_ForceEngCoolantTempToEstimationModel_ov "Override value." VALUE 0x0000 /* @ECU_Address@FDMAie_b_ForceEngCoolantTempToEstimationModel_ov@ */ Scalar_BOOLEAN 0 CM_T_BOOLEAN 0.0 1.0 /end CHARACTERISTIC
/begin CHARACTERISTIC FDMAie_b_ForceEngTransientLimOff_ob "Override boolean." VALUE 0x0000 /* @ECU_Address@FDMAie_b_ForceEngTransientLimOff_ob@ */ Scalar_BOOLEAN 0 CM_T_BOOLEAN 0.0 1.0 /end CHARACTERISTIC
/begin CHARACTERISTIC FDMAie_b_ForceEngTransientLimOff_ov "Override value." VALUE 0x0000 /* @ECU_Address@FDMAie_b_ForceEngTransientLimOff_ov@ */ Scalar_BOOLEAN 0 CM_T_BOOLEAN 0.0 1.0 /end CHARACTERISTIC
/begin CHARACTERISTIC FDMAie_b_ForceEngineRunning_ob "Override boolean." VALUE 0x0000 /* @ECU_Address@FDMAie_b_ForceEngineRunning_ob@ */ Scalar_BOOLEAN 0 CM_T_BOOLEAN 0.0 1.0 /end CHARACTERISTIC
/begin CHARACTERISTIC FDMAie_b_ForceEngineRunning_ov "Override value." VALUE 0x0000 /* @ECU_Address@FDMAie_b_ForceEngineRunning_ov@ */ Scalar_BOOLEAN 0 CM_T_BOOLEAN 0.0 1.0 /end CHARACTERISTIC
/begin CHARACTERISTIC FDMAie_b_ForceEngineTorqueFillOff_ob "Override boolean." VALUE 0x0000 /* @ECU_Address@FDMAie_b_ForceEngineTorqueFillOff_ob@ */ Scalar_BOOLEAN 0 CM_T_BOOLEAN 0.0 1.0 /end CHARACTERISTIC
/begin CHARACTERISTIC FDMAie_b_ForceEngineTorqueFillOff_ov "Override value." VALUE 0x0000 /* @ECU_Address@FDMAie_b_ForceEngineTorqueFillOff_ov@ */ Scalar_BOOLEAN 0 CM_T_BOOLEAN 0.0 1.0 /end CHARACTERISTIC
/begin CHARACTERISTIC FDMAie_b_ForceEngineTorqueReductionToMedium_ob "Override boolean." VALUE 0x0000 /* @ECU_Address@FDMAie_b_ForceEngineTorqueReductionToMedium_ob@ */ Scalar_BOOLEAN 0 CM_T_BOOLEAN 0.0 1.0 /end CHARACTERISTIC
/begin CHARACTERISTIC FDMAie_b_ForceEngineTorqueReductionToMedium_ov "Override value." VALUE 0x0000 /* @ECU_Address@FDMAie_b_ForceEngineTorqueReductionToMedium_ov@ */ Scalar_BOOLEAN 0 CM_T_BOOLEAN 0.0 1.0 /end CHARACTERISTIC
/begin CHARACTERISTIC FDMAie_b_ForceFrntO2SnsrBnk1ToPrtctnMd_ob "Override boolean." VALUE 0x0000 /* @ECU_Address@FDMAie_b_ForceFrntO2SnsrBnk1ToPrtctnMd_ob@ */ Scalar_BOOLEAN 0 CM_T_BOOLEAN 0.0 1.0 /end CHARACTERISTIC
/begin CHARACTERISTIC FDMAie_b_ForceFrntO2SnsrBnk1ToPrtctnMd_ov "Override value." VALUE 0x0000 /* @ECU_Address@FDMAie_b_ForceFrntO2SnsrBnk1ToPrtctnMd_ov@ */ Scalar_BOOLEAN 0 CM_T_BOOLEAN 0.0 1.0 /end CHARACTERISTIC
/begin CHARACTERISTIC FDMAie_b_ForceFuelControlToOpenLoop_ob "Override boolean." VALUE 0x0000 /* @ECU_Address@FDMAie_b_ForceFuelControlToOpenLoop_ob@ */ Scalar_BOOLEAN 0 CM_T_BOOLEAN 0.0 1.0 /end CHARACTERISTIC
/begin CHARACTERISTIC FDMAie_b_ForceFuelControlToOpenLoop_ov "Override value." VALUE 0x0000 /* @ECU_Address@FDMAie_b_ForceFuelControlToOpenLoop_ov@ */ Scalar_BOOLEAN 0 CM_T_BOOLEAN 0.0 1.0 /end CHARACTERISTIC
/begin CHARACTERISTIC FDMAie_b_ForceFuelPressureActivationToOff_ob "Override boolean." VALUE 0x0000 /* @ECU_Address@FDMAie_b_ForceFuelPressureActivationToOff_ob@ */ Scalar_BOOLEAN 0 CM_T_BOOLEAN 0.0 1.0 /end CHARACTERISTIC
/begin CHARACTERISTIC FDMAie_b_ForceFuelPressureActivationToOff_ov "Override value." VALUE 0x0000 /* @ECU_Address@FDMAie_b_ForceFuelPressureActivationToOff_ov@ */ Scalar_BOOLEAN 0 CM_T_BOOLEAN 0.0 1.0 /end CHARACTERISTIC
/begin CHARACTERISTIC FDMAie_b_ForceFuelRailPressureFeedbackExclusion_ob "Override boolean." VALUE 0x0000 /* @ECU_Address@FDMAie_b_ForceFuelRailPressureFeedbackExclusion_ob@ */ Scalar_BOOLEAN 0 CM_T_BOOLEAN 0.0 1.0 /end CHARACTERISTIC
/begin CHARACTERISTIC FDMAie_b_ForceFuelRailPressureFeedbackExclusion_ov "Override value." VALUE 0x0000 /* @ECU_Address@FDMAie_b_ForceFuelRailPressureFeedbackExclusion_ov@ */ Scalar_BOOLEAN 0 CM_T_BOOLEAN 0.0 1.0 /end CHARACTERISTIC
/begin CHARACTERISTIC FDMAie_b_ForceGCUTorqueToExclusionFromTransPresTarget_ob "Override boolean" VALUE 0x0000 /* @ECU_Address@FDMAie_b_ForceGCUTorqueToExclusionFromTransPresTarget_ob@ */ Scalar_BOOLEAN 0 CM_T_BOOLEAN 0.0 1.0 /end CHARACTERISTIC
/begin CHARACTERISTIC FDMAie_b_ForceGCUTorqueToExclusionFromTransPresTarget_ov "Override value" VALUE 0x0000 /* @ECU_Address@FDMAie_b_ForceGCUTorqueToExclusionFromTransPresTarget_ov@ */ Scalar_BOOLEAN 0 CM_T_BOOLEAN 0.0 1.0 /end CHARACTERISTIC
/begin CHARACTERISTIC FDMAie_b_ForceGearRecommendationToOff_ob "Override boolean." VALUE 0x0000 /* @ECU_Address@FDMAie_b_ForceGearRecommendationToOff_ob@ */ Scalar_BOOLEAN 0 CM_T_BOOLEAN 0.0 1.0 /end CHARACTERISTIC
/begin CHARACTERISTIC FDMAie_b_ForceGearRecommendationToOff_ov "Override value." VALUE 0x0000 /* @ECU_Address@FDMAie_b_ForceGearRecommendationToOff_ov@ */ Scalar_BOOLEAN 0 CM_T_BOOLEAN 0.0 1.0 /end CHARACTERISTIC
/begin CHARACTERISTIC FDMAie_b_ForceHVAC_ElectricHeaterOff_ob "Override boolean." VALUE 0x0000 /* @ECU_Address@FDMAie_b_ForceHVAC_ElectricHeaterOff_ob@ */ Scalar_BOOLEAN 0 CM_T_BOOLEAN 0.0 1.0 /end CHARACTERISTIC
/begin CHARACTERISTIC FDMAie_b_ForceHVAC_ElectricHeaterOff_ov "Override value." VALUE 0x0000 /* @ECU_Address@FDMAie_b_ForceHVAC_ElectricHeaterOff_ov@ */ Scalar_BOOLEAN 0 CM_T_BOOLEAN 0.0 1.0 /end CHARACTERISTIC
/begin CHARACTERISTIC FDMAie_b_ForceHVBattSOC_ControlOff_ob "Override boolean." VALUE 0x0000 /* @ECU_Address@FDMAie_b_ForceHVBattSOC_ControlOff_ob@ */ Scalar_BOOLEAN 0 CM_T_BOOLEAN 0.0 1.0 /end CHARACTERISTIC
/begin CHARACTERISTIC FDMAie_b_ForceHVBattSOC_ControlOff_ov "Override value." VALUE 0x0000 /* @ECU_Address@FDMAie_b_ForceHVBattSOC_ControlOff_ov@ */ Scalar_BOOLEAN 0 CM_T_BOOLEAN 0.0 1.0 /end CHARACTERISTIC
/begin CHARACTERISTIC FDMAie_b_ForceHiPressFuelPumpEnblToDisable_ob "Override boolean." VALUE 0x0000 /* @ECU_Address@FDMAie_b_ForceHiPressFuelPumpEnblToDisable_ob@ */ Scalar_BOOLEAN 0 CM_T_BOOLEAN 0.0 1.0 /end CHARACTERISTIC
/begin CHARACTERISTIC FDMAie_b_ForceHiPressFuelPumpEnblToDisable_ov "Override value." VALUE 0x0000 /* @ECU_Address@FDMAie_b_ForceHiPressFuelPumpEnblToDisable_ov@ */ Scalar_BOOLEAN 0 CM_T_BOOLEAN 0.0 1.0 /end CHARACTERISTIC
/begin CHARACTERISTIC FDMAie_b_ForceIdleControlToElevatedMode_ob "Override boolean." VALUE 0x0000 /* @ECU_Address@FDMAie_b_ForceIdleControlToElevatedMode_ob@ */ Scalar_BOOLEAN 0 CM_T_BOOLEAN 0.0 1.0 /end CHARACTERISTIC
/begin CHARACTERISTIC FDMAie_b_ForceIdleControlToElevatedMode_ov "Override value." VALUE 0x0000 /* @ECU_Address@FDMAie_b_ForceIdleControlToElevatedMode_ov@ */ Scalar_BOOLEAN 0 CM_T_BOOLEAN 0.0 1.0 /end CHARACTERISTIC
/begin CHARACTERISTIC FDMAie_b_ForceIgnitionToLowOctane_ob "Override boolean." VALUE 0x0000 /* @ECU_Address@FDMAie_b_ForceIgnitionToLowOctane_ob@ */ Scalar_BOOLEAN 0 CM_T_BOOLEAN 0.0 1.0 /end CHARACTERISTIC
/begin CHARACTERISTIC FDMAie_b_ForceIgnitionToLowOctane_ov "Override value." VALUE 0x0000 /* @ECU_Address@FDMAie_b_ForceIgnitionToLowOctane_ov@ */ Scalar_BOOLEAN 0 CM_T_BOOLEAN 0.0 1.0 /end CHARACTERISTIC
/begin CHARACTERISTIC FDMAie_b_ForceIgnitionToOff_ob "Override boolean." VALUE 0x0000 /* @ECU_Address@FDMAie_b_ForceIgnitionToOff_ob@ */ Scalar_BOOLEAN 0 CM_T_BOOLEAN 0.0 1.0 /end CHARACTERISTIC
/begin CHARACTERISTIC FDMAie_b_ForceIgnitionToOff_ov "Override value." VALUE 0x0000 /* @ECU_Address@FDMAie_b_ForceIgnitionToOff_ov@ */ Scalar_BOOLEAN 0 CM_T_BOOLEAN 0.0 1.0 /end CHARACTERISTIC
/begin CHARACTERISTIC FDMAie_b_ForceIntelligentGeneratorControlToDefault_ob "Override boolean." VALUE 0x0000 /* @ECU_Address@FDMAie_b_ForceIntelligentGeneratorControlToDefault_ob@ */ Scalar_BOOLEAN 0 CM_T_BOOLEAN 0.0 1.0 /end CHARACTERISTIC
/begin CHARACTERISTIC FDMAie_b_ForceIntelligentGeneratorControlToDefault_ov "Override value." VALUE 0x0000 /* @ECU_Address@FDMAie_b_ForceIntelligentGeneratorControlToDefault_ov@ */ Scalar_BOOLEAN 0 CM_T_BOOLEAN 0.0 1.0 /end CHARACTERISTIC
/begin CHARACTERISTIC FDMAie_b_ForceLftDrvnWhlSpdInfoExclusion_ob "Override boolean." VALUE 0x0000 /* @ECU_Address@FDMAie_b_ForceLftDrvnWhlSpdInfoExclusion_ob@ */ Scalar_BOOLEAN 0 CM_T_BOOLEAN 0.0 1.0 /end CHARACTERISTIC
/begin CHARACTERISTIC FDMAie_b_ForceLftDrvnWhlSpdInfoExclusion_ov "Override value." VALUE 0x0000 /* @ECU_Address@FDMAie_b_ForceLftDrvnWhlSpdInfoExclusion_ov@ */ Scalar_BOOLEAN 0 CM_T_BOOLEAN 0.0 1.0 /end CHARACTERISTIC
/begin CHARACTERISTIC FDMAie_b_ForceLftNnDrvnWhlSpdInfoExclusion_ob "Override boolean." VALUE 0x0000 /* @ECU_Address@FDMAie_b_ForceLftNnDrvnWhlSpdInfoExclusion_ob@ */ Scalar_BOOLEAN 0 CM_T_BOOLEAN 0.0 1.0 /end CHARACTERISTIC
/begin CHARACTERISTIC FDMAie_b_ForceLftNnDrvnWhlSpdInfoExclusion_ov "Override value." VALUE 0x0000 /* @ECU_Address@FDMAie_b_ForceLftNnDrvnWhlSpdInfoExclusion_ov@ */ Scalar_BOOLEAN 0 CM_T_BOOLEAN 0.0 1.0 /end CHARACTERISTIC
/begin CHARACTERISTIC FDMAie_b_ForceLongTermAdaptionToOff_ob "Override boolean." VALUE 0x0000 /* @ECU_Address@FDMAie_b_ForceLongTermAdaptionToOff_ob@ */ Scalar_BOOLEAN 0 CM_T_BOOLEAN 0.0 1.0 /end CHARACTERISTIC
/begin CHARACTERISTIC FDMAie_b_ForceLongTermAdaptionToOff_ov "Override value." VALUE 0x0000 /* @ECU_Address@FDMAie_b_ForceLongTermAdaptionToOff_ov@ */ Scalar_BOOLEAN 0 CM_T_BOOLEAN 0.0 1.0 /end CHARACTERISTIC
/begin CHARACTERISTIC FDMAie_b_ForceP1ElectricMotorToNeutral_ob "Override boolean." VALUE 0x0000 /* @ECU_Address@FDMAie_b_ForceP1ElectricMotorToNeutral_ob@ */ Scalar_BOOLEAN 0 CM_T_BOOLEAN 0.0 1.0 /end CHARACTERISTIC
/begin CHARACTERISTIC FDMAie_b_ForceP1ElectricMotorToNeutral_ov "Override value." VALUE 0x0000 /* @ECU_Address@FDMAie_b_ForceP1ElectricMotorToNeutral_ov@ */ Scalar_BOOLEAN 0 CM_T_BOOLEAN 0.0 1.0 /end CHARACTERISTIC
/begin CHARACTERISTIC FDMAie_b_ForceP1ElectricTorqueReserveOff_ob "Override boolean." VALUE 0x0000 /* @ECU_Address@FDMAie_b_ForceP1ElectricTorqueReserveOff_ob@ */ Scalar_BOOLEAN 0 CM_T_BOOLEAN 0.0 1.0 /end CHARACTERISTIC
/begin CHARACTERISTIC FDMAie_b_ForceP1ElectricTorqueReserveOff_ov "Override value." VALUE 0x0000 /* @ECU_Address@FDMAie_b_ForceP1ElectricTorqueReserveOff_ov@ */ Scalar_BOOLEAN 0 CM_T_BOOLEAN 0.0 1.0 /end CHARACTERISTIC
/begin CHARACTERISTIC FDMAie_b_ForceP3MtrSpdInfoExclusion_ob "Override boolean." VALUE 0x0000 /* @ECU_Address@FDMAie_b_ForceP3MtrSpdInfoExclusion_ob@ */ Scalar_BOOLEAN 0 CM_T_BOOLEAN 0.0 1.0 /end CHARACTERISTIC
/begin CHARACTERISTIC FDMAie_b_ForceP3MtrSpdInfoExclusion_ov "Override value." VALUE 0x0000 /* @ECU_Address@FDMAie_b_ForceP3MtrSpdInfoExclusion_ov@ */ Scalar_BOOLEAN 0 CM_T_BOOLEAN 0.0 1.0 /end CHARACTERISTIC
/begin CHARACTERISTIC FDMAie_b_ForcePF_ActiveRegenOff_ob "Override boolean." VALUE 0x0000 /* @ECU_Address@FDMAie_b_ForcePF_ActiveRegenOff_ob@ */ Scalar_BOOLEAN 0 CM_T_BOOLEAN 0.0 1.0 /end CHARACTERISTIC
/begin CHARACTERISTIC FDMAie_b_ForcePF_ActiveRegenOff_ov "Override value." VALUE 0x0000 /* @ECU_Address@FDMAie_b_ForcePF_ActiveRegenOff_ov@ */ Scalar_BOOLEAN 0 CM_T_BOOLEAN 0.0 1.0 /end CHARACTERISTIC
/begin CHARACTERISTIC FDMAie_b_ForcePF_PrssrSnsrAdptnOff_ob "Override boolean." VALUE 0x0000 /* @ECU_Address@FDMAie_b_ForcePF_PrssrSnsrAdptnOff_ob@ */ Scalar_BOOLEAN 0 CM_T_BOOLEAN 0.0 1.0 /end CHARACTERISTIC
/begin CHARACTERISTIC FDMAie_b_ForcePF_PrssrSnsrAdptnOff_ov "Override value." VALUE 0x0000 /* @ECU_Address@FDMAie_b_ForcePF_PrssrSnsrAdptnOff_ov@ */ Scalar_BOOLEAN 0 CM_T_BOOLEAN 0.0 1.0 /end CHARACTERISTIC
/begin CHARACTERISTIC FDMAie_b_ForcePF_PrssrSnsrBasedSootEstOff_ob "Override boolean." VALUE 0x0000 /* @ECU_Address@FDMAie_b_ForcePF_PrssrSnsrBasedSootEstOff_ob@ */ Scalar_BOOLEAN 0 CM_T_BOOLEAN 0.0 1.0 /end CHARACTERISTIC
/begin CHARACTERISTIC FDMAie_b_ForcePF_PrssrSnsrBasedSootEstOff_ov "Override value." VALUE 0x0000 /* @ECU_Address@FDMAie_b_ForcePF_PrssrSnsrBasedSootEstOff_ov@ */ Scalar_BOOLEAN 0 CM_T_BOOLEAN 0.0 1.0 /end CHARACTERISTIC
/begin CHARACTERISTIC FDMAie_b_ForcePowerModeLock_ob "Override boolean." VALUE 0x0000 /* @ECU_Address@FDMAie_b_ForcePowerModeLock_ob@ */ Scalar_BOOLEAN 0 CM_T_BOOLEAN 0.0 1.0 /end CHARACTERISTIC
/begin CHARACTERISTIC FDMAie_b_ForcePowerModeLock_ov "Override value." VALUE 0x0000 /* @ECU_Address@FDMAie_b_ForcePowerModeLock_ov@ */ Scalar_BOOLEAN 0 CM_T_BOOLEAN 0.0 1.0 /end CHARACTERISTIC
/begin CHARACTERISTIC FDMAie_b_ForcePowerSteeringCompensationToOff_ob "Override boolean." VALUE 0x0000 /* @ECU_Address@FDMAie_b_ForcePowerSteeringCompensationToOff_ob@ */ Scalar_BOOLEAN 0 CM_T_BOOLEAN 0.0 1.0 /end CHARACTERISTIC
/begin CHARACTERISTIC FDMAie_b_ForcePowerSteeringCompensationToOff_ov "Override value." VALUE 0x0000 /* @ECU_Address@FDMAie_b_ForcePowerSteeringCompensationToOff_ov@ */ Scalar_BOOLEAN 0 CM_T_BOOLEAN 0.0 1.0 /end CHARACTERISTIC
/begin CHARACTERISTIC FDMAie_b_ForcePropModeCalcToExcludeVehSpd_ob "Override boolean." VALUE 0x0000 /* @ECU_Address@FDMAie_b_ForcePropModeCalcToExcludeVehSpd_ob@ */ Scalar_BOOLEAN 0 CM_T_BOOLEAN 0.0 1.0 /end CHARACTERISTIC
/begin CHARACTERISTIC FDMAie_b_ForcePropModeCalcToExcludeVehSpd_ov "Override value." VALUE 0x0000 /* @ECU_Address@FDMAie_b_ForcePropModeCalcToExcludeVehSpd_ov@ */ Scalar_BOOLEAN 0 CM_T_BOOLEAN 0.0 1.0 /end CHARACTERISTIC
/begin CHARACTERISTIC FDMAie_b_ForcePropulsionAllowedToNotAllowed_ob "Override boolean." VALUE 0x0000 /* @ECU_Address@FDMAie_b_ForcePropulsionAllowedToNotAllowed_ob@ */ Scalar_BOOLEAN 0 CM_T_BOOLEAN 0.0 1.0 /end CHARACTERISTIC
/begin CHARACTERISTIC FDMAie_b_ForcePropulsionAllowedToNotAllowed_ov "Override value." VALUE 0x0000 /* @ECU_Address@FDMAie_b_ForcePropulsionAllowedToNotAllowed_ov@ */ Scalar_BOOLEAN 0 CM_T_BOOLEAN 0.0 1.0 /end CHARACTERISTIC
/begin CHARACTERISTIC FDMAie_b_ForcePurgeControlToOff_ob "Override boolean." VALUE 0x0000 /* @ECU_Address@FDMAie_b_ForcePurgeControlToOff_ob@ */ Scalar_BOOLEAN 0 CM_T_BOOLEAN 0.0 1.0 /end CHARACTERISTIC
/begin CHARACTERISTIC FDMAie_b_ForcePurgeControlToOff_ov "Override value." VALUE 0x0000 /* @ECU_Address@FDMAie_b_ForcePurgeControlToOff_ov@ */ Scalar_BOOLEAN 0 CM_T_BOOLEAN 0.0 1.0 /end CHARACTERISTIC
/begin CHARACTERISTIC FDMAie_b_ForceRearO2SensorFuelControlToOff_ob "Override boolean." VALUE 0x0000 /* @ECU_Address@FDMAie_b_ForceRearO2SensorFuelControlToOff_ob@ */ Scalar_BOOLEAN 0 CM_T_BOOLEAN 0.0 1.0 /end CHARACTERISTIC
/begin CHARACTERISTIC FDMAie_b_ForceRearO2SensorFuelControlToOff_ov "Override value." VALUE 0x0000 /* @ECU_Address@FDMAie_b_ForceRearO2SensorFuelControlToOff_ov@ */ Scalar_BOOLEAN 0 CM_T_BOOLEAN 0.0 1.0 /end CHARACTERISTIC
/begin CHARACTERISTIC FDMAie_b_ForceRghtDrvnWhlSpdInfoExclusion_ob "Override boolean." VALUE 0x0000 /* @ECU_Address@FDMAie_b_ForceRghtDrvnWhlSpdInfoExclusion_ob@ */ Scalar_BOOLEAN 0 CM_T_BOOLEAN 0.0 1.0 /end CHARACTERISTIC
/begin CHARACTERISTIC FDMAie_b_ForceRghtDrvnWhlSpdInfoExclusion_ov "Override value." VALUE 0x0000 /* @ECU_Address@FDMAie_b_ForceRghtDrvnWhlSpdInfoExclusion_ov@ */ Scalar_BOOLEAN 0 CM_T_BOOLEAN 0.0 1.0 /end CHARACTERISTIC
/begin CHARACTERISTIC FDMAie_b_ForceRghtNnDrvnWhlSpdInfoExclusion_ob "Override boolean." VALUE 0x0000 /* @ECU_Address@FDMAie_b_ForceRghtNnDrvnWhlSpdInfoExclusion_ob@ */ Scalar_BOOLEAN 0 CM_T_BOOLEAN 0.0 1.0 /end CHARACTERISTIC
/begin CHARACTERISTIC FDMAie_b_ForceRghtNnDrvnWhlSpdInfoExclusion_ov "Override value." VALUE 0x0000 /* @ECU_Address@FDMAie_b_ForceRghtNnDrvnWhlSpdInfoExclusion_ov@ */ Scalar_BOOLEAN 0 CM_T_BOOLEAN 0.0 1.0 /end CHARACTERISTIC
/begin CHARACTERISTIC FDMAie_b_ForceTCU_CreepTorqueControlToOff_ob "Override boolean." VALUE 0x0000 /* @ECU_Address@FDMAie_b_ForceTCU_CreepTorqueControlToOff_ob@ */ Scalar_BOOLEAN 0 CM_T_BOOLEAN 0.0 1.0 /end CHARACTERISTIC
/begin CHARACTERISTIC FDMAie_b_ForceTCU_CreepTorqueControlToOff_ov "Override value." VALUE 0x0000 /* @ECU_Address@FDMAie_b_ForceTCU_CreepTorqueControlToOff_ov@ */ Scalar_BOOLEAN 0 CM_T_BOOLEAN 0.0 1.0 /end CHARACTERISTIC
/begin CHARACTERISTIC FDMAie_b_ForceThrottleMassAirFlowToDefaultAir_ob "Override boolean." VALUE 0x0000 /* @ECU_Address@FDMAie_b_ForceThrottleMassAirFlowToDefaultAir_ob@ */ Scalar_BOOLEAN 0 CM_T_BOOLEAN 0.0 1.0 /end CHARACTERISTIC
/begin CHARACTERISTIC FDMAie_b_ForceThrottleMassAirFlowToDefaultAir_ov "Override value." VALUE 0x0000 /* @ECU_Address@FDMAie_b_ForceThrottleMassAirFlowToDefaultAir_ov@ */ Scalar_BOOLEAN 0 CM_T_BOOLEAN 0.0 1.0 /end CHARACTERISTIC
/begin CHARACTERISTIC FDMAie_b_ForceTransIOCControlToOff_ob "Override boolean" VALUE 0x0000 /* @ECU_Address@FDMAie_b_ForceTransIOCControlToOff_ob@ */ Scalar_BOOLEAN 0 CM_T_BOOLEAN 0.0 1.0 /end CHARACTERISTIC
/begin CHARACTERISTIC FDMAie_b_ForceTransIOCControlToOff_ov "Override value" VALUE 0x0000 /* @ECU_Address@FDMAie_b_ForceTransIOCControlToOff_ov@ */ Scalar_BOOLEAN 0 CM_T_BOOLEAN 0.0 1.0 /end CHARACTERISTIC
/begin CHARACTERISTIC FDMAie_b_ForceTransOilCoolingToSafeCoolingMode_ob "Override boolean" VALUE 0x0000 /* @ECU_Address@FDMAie_b_ForceTransOilCoolingToSafeCoolingMode_ob@ */ Scalar_BOOLEAN 0 CM_T_BOOLEAN 0.0 1.0 /end CHARACTERISTIC
/begin CHARACTERISTIC FDMAie_b_ForceTransOilCoolingToSafeCoolingMode_ov "Override value" VALUE 0x0000 /* @ECU_Address@FDMAie_b_ForceTransOilCoolingToSafeCoolingMode_ov@ */ Scalar_BOOLEAN 0 CM_T_BOOLEAN 0.0 1.0 /end CHARACTERISTIC
/begin CHARACTERISTIC FDMAie_b_ForceTransOilLubricationtoSafeLubricationMode_ob "Override boolean" VALUE 0x0000 /* @ECU_Address@FDMAie_b_ForceTransOilLubricationtoSafeLubricationMode_ob@ */ Scalar_BOOLEAN 0 CM_T_BOOLEAN 0.0 1.0 /end CHARACTERISTIC
/begin CHARACTERISTIC FDMAie_b_ForceTransOilLubricationtoSafeLubricationMode_ov "Override value." VALUE 0x0000 /* @ECU_Address@FDMAie_b_ForceTransOilLubricationtoSafeLubricationMode_ov@ */ Scalar_BOOLEAN 0 CM_T_BOOLEAN 0.0 1.0 /end CHARACTERISTIC
/begin CHARACTERISTIC FDMAie_b_ForceUnderHoodCoolingToHigh_ob "Override boolean." VALUE 0x0000 /* @ECU_Address@FDMAie_b_ForceUnderHoodCoolingToHigh_ob@ */ Scalar_BOOLEAN 0 CM_T_BOOLEAN 0.0 1.0 /end CHARACTERISTIC
/begin CHARACTERISTIC FDMAie_b_ForceUnderHoodCoolingToHigh_ov "Override value." VALUE 0x0000 /* @ECU_Address@FDMAie_b_ForceUnderHoodCoolingToHigh_ov@ */ Scalar_BOOLEAN 0 CM_T_BOOLEAN 0.0 1.0 /end CHARACTERISTIC
/begin CHARACTERISTIC FDMAie_b_ForceVehicleSpeedInfoExclusion_ob "Override boolean." VALUE 0x0000 /* @ECU_Address@FDMAie_b_ForceVehicleSpeedInfoExclusion_ob@ */ Scalar_BOOLEAN 0 CM_T_BOOLEAN 0.0 1.0 /end CHARACTERISTIC
/begin CHARACTERISTIC FDMAie_b_ForceVehicleSpeedInfoExclusion_ov "Override value." VALUE 0x0000 /* @ECU_Address@FDMAie_b_ForceVehicleSpeedInfoExclusion_ov@ */ Scalar_BOOLEAN 0 CM_T_BOOLEAN 0.0 1.0 /end CHARACTERISTIC
/begin CHARACTERISTIC FDMAie_b_LimitHV_BattSOC_CntrlAuthorityToLow_ob "Override boolean." VALUE 0x0000 /* @ECU_Address@FDMAie_b_LimitHV_BattSOC_CntrlAuthorityToLow_ob@ */ Scalar_BOOLEAN 0 CM_T_BOOLEAN 0.0 1.0 /end CHARACTERISTIC
/begin CHARACTERISTIC FDMAie_b_LimitHV_BattSOC_CntrlAuthorityToLow_ov "Override value." VALUE 0x0000 /* @ECU_Address@FDMAie_b_LimitHV_BattSOC_CntrlAuthorityToLow_ov@ */ Scalar_BOOLEAN 0 CM_T_BOOLEAN 0.0 1.0 /end CHARACTERISTIC
/begin CHARACTERISTIC FDMAie_b_LockoutEngineStateChange_ob "Override boolean." VALUE 0x0000 /* @ECU_Address@FDMAie_b_LockoutEngineStateChange_ob@ */ Scalar_BOOLEAN 0 CM_T_BOOLEAN 0.0 1.0 /end CHARACTERISTIC
/begin CHARACTERISTIC FDMAie_b_LockoutEngineStateChange_ov "Override value." VALUE 0x0000 /* @ECU_Address@FDMAie_b_LockoutEngineStateChange_ov@ */ Scalar_BOOLEAN 0 CM_T_BOOLEAN 0.0 1.0 /end CHARACTERISTIC
/begin CHARACTERISTIC FDMAie_b_LockoutPropulsionSystemStart_ob "Override boolean." VALUE 0x0000 /* @ECU_Address@FDMAie_b_LockoutPropulsionSystemStart_ob@ */ Scalar_BOOLEAN 0 CM_T_BOOLEAN 0.0 1.0 /end CHARACTERISTIC
/begin CHARACTERISTIC FDMAie_b_LockoutPropulsionSystemStart_ov "Override value." VALUE 0x0000 /* @ECU_Address@FDMAie_b_LockoutPropulsionSystemStart_ov@ */ Scalar_BOOLEAN 0 CM_T_BOOLEAN 0.0 1.0 /end CHARACTERISTIC
/begin CHARACTERISTIC FDMAie_b_LockoutSpdDepCntctrAfterrun_ob "Override boolean." VALUE 0x0000 /* @ECU_Address@FDMAie_b_LockoutSpdDepCntctrAfterrun_ob@ */ Scalar_BOOLEAN 0 CM_T_BOOLEAN 0.0 1.0 /end CHARACTERISTIC
/begin CHARACTERISTIC FDMAie_b_LockoutSpdDepCntctrAfterrun_ov "Override value." VALUE 0x0000 /* @ECU_Address@FDMAie_b_LockoutSpdDepCntctrAfterrun_ov@ */ Scalar_BOOLEAN 0 CM_T_BOOLEAN 0.0 1.0 /end CHARACTERISTIC
/begin CHARACTERISTIC FDMAie_b_LockoutStopStartEngineStateChange_ob "Override boolean." VALUE 0x0000 /* @ECU_Address@FDMAie_b_LockoutStopStartEngineStateChange_ob@ */ Scalar_BOOLEAN 0 CM_T_BOOLEAN 0.0 1.0 /end CHARACTERISTIC
/begin CHARACTERISTIC FDMAie_b_LockoutStopStartEngineStateChange_ov "Override value." VALUE 0x0000 /* @ECU_Address@FDMAie_b_LockoutStopStartEngineStateChange_ov@ */ Scalar_BOOLEAN 0 CM_T_BOOLEAN 0.0 1.0 /end CHARACTERISTIC
/begin CHARACTERISTIC FDMAie_b_SetAccPedPosToZero_ob "Override boolean." VALUE 0x0000 /* @ECU_Address@FDMAie_b_SetAccPedPosToZero_ob@ */ Scalar_BOOLEAN 0 CM_T_BOOLEAN 0.0 1.0 /end CHARACTERISTIC
/begin CHARACTERISTIC FDMAie_b_SetAccPedPosToZero_ov "Override value." VALUE 0x0000 /* @ECU_Address@FDMAie_b_SetAccPedPosToZero_ov@ */ Scalar_BOOLEAN 0 CM_T_BOOLEAN 0.0 1.0 /end CHARACTERISTIC
/begin CHARACTERISTIC FDMAie_b_SetAutoTransIdleSpdRqstToNoRqst_ob "Override boolean." VALUE 0x0000 /* @ECU_Address@FDMAie_b_SetAutoTransIdleSpdRqstToNoRqst_ob@ */ Scalar_BOOLEAN 0 CM_T_BOOLEAN 0.0 1.0 /end CHARACTERISTIC
/begin CHARACTERISTIC FDMAie_b_SetAutoTransIdleSpdRqstToNoRqst_ov "Override value." VALUE 0x0000 /* @ECU_Address@FDMAie_b_SetAutoTransIdleSpdRqstToNoRqst_ov@ */ Scalar_BOOLEAN 0 CM_T_BOOLEAN 0.0 1.0 /end CHARACTERISTIC
/begin CHARACTERISTIC FDMAie_b_SetAutoTransTorqueRequestToNoRequest_ob "Override boolean." VALUE 0x0000 /* @ECU_Address@FDMAie_b_SetAutoTransTorqueRequestToNoRequest_ob@ */ Scalar_BOOLEAN 0 CM_T_BOOLEAN 0.0 1.0 /end CHARACTERISTIC
/begin CHARACTERISTIC FDMAie_b_SetAutoTransTorqueRequestToNoRequest_ov "Override value." VALUE 0x0000 /* @ECU_Address@FDMAie_b_SetAutoTransTorqueRequestToNoRequest_ov@ */ Scalar_BOOLEAN 0 CM_T_BOOLEAN 0.0 1.0 /end CHARACTERISTIC
/begin CHARACTERISTIC FDMAie_b_SetDCDC_ActualLoadDefaultVal_ob "Override boolean." VALUE 0x0000 /* @ECU_Address@FDMAie_b_SetDCDC_ActualLoadDefaultVal_ob@ */ Scalar_BOOLEAN 0 CM_T_BOOLEAN 0.0 1.0 /end CHARACTERISTIC
/begin CHARACTERISTIC FDMAie_b_SetDCDC_ActualLoadDefaultVal_ov "Override value." VALUE 0x0000 /* @ECU_Address@FDMAie_b_SetDCDC_ActualLoadDefaultVal_ov@ */ Scalar_BOOLEAN 0 CM_T_BOOLEAN 0.0 1.0 /end CHARACTERISTIC
/begin CHARACTERISTIC FDMAie_b_SetDriversRequestToZero_ob "Override boolean." VALUE 0x0000 /* @ECU_Address@FDMAie_b_SetDriversRequestToZero_ob@ */ Scalar_BOOLEAN 0 CM_T_BOOLEAN 0.0 1.0 /end CHARACTERISTIC
/begin CHARACTERISTIC FDMAie_b_SetDriversRequestToZero_ov "Override value." VALUE 0x0000 /* @ECU_Address@FDMAie_b_SetDriversRequestToZero_ov@ */ Scalar_BOOLEAN 0 CM_T_BOOLEAN 0.0 1.0 /end CHARACTERISTIC
/begin CHARACTERISTIC FDMAie_b_SetESP_TCS_TorqueRequestToNoRequest_ob "Override boolean." VALUE 0x0000 /* @ECU_Address@FDMAie_b_SetESP_TCS_TorqueRequestToNoRequest_ob@ */ Scalar_BOOLEAN 0 CM_T_BOOLEAN 0.0 1.0 /end CHARACTERISTIC
/begin CHARACTERISTIC FDMAie_b_SetESP_TCS_TorqueRequestToNoRequest_ov "Override value." VALUE 0x0000 /* @ECU_Address@FDMAie_b_SetESP_TCS_TorqueRequestToNoRequest_ov@ */ Scalar_BOOLEAN 0 CM_T_BOOLEAN 0.0 1.0 /end CHARACTERISTIC
/begin CHARACTERISTIC FDMAie_b_SetFuelMassToZeroCylinder1_ob "Override boolean." VALUE 0x0000 /* @ECU_Address@FDMAie_b_SetFuelMassToZeroCylinder1_ob@ */ Scalar_BOOLEAN 0 CM_T_BOOLEAN 0.0 1.0 /end CHARACTERISTIC
/begin CHARACTERISTIC FDMAie_b_SetFuelMassToZeroCylinder1_ov "Override value." VALUE 0x0000 /* @ECU_Address@FDMAie_b_SetFuelMassToZeroCylinder1_ov@ */ Scalar_BOOLEAN 0 CM_T_BOOLEAN 0.0 1.0 /end CHARACTERISTIC
/begin CHARACTERISTIC FDMAie_b_SetFuelMassToZeroCylinder2_ob "Override boolean." VALUE 0x0000 /* @ECU_Address@FDMAie_b_SetFuelMassToZeroCylinder2_ob@ */ Scalar_BOOLEAN 0 CM_T_BOOLEAN 0.0 1.0 /end CHARACTERISTIC
/begin CHARACTERISTIC FDMAie_b_SetFuelMassToZeroCylinder2_ov "Override value." VALUE 0x0000 /* @ECU_Address@FDMAie_b_SetFuelMassToZeroCylinder2_ov@ */ Scalar_BOOLEAN 0 CM_T_BOOLEAN 0.0 1.0 /end CHARACTERISTIC
/begin CHARACTERISTIC FDMAie_b_SetFuelMassToZeroCylinder3_ob "Override boolean." VALUE 0x0000 /* @ECU_Address@FDMAie_b_SetFuelMassToZeroCylinder3_ob@ */ Scalar_BOOLEAN 0 CM_T_BOOLEAN 0.0 1.0 /end CHARACTERISTIC
/begin CHARACTERISTIC FDMAie_b_SetFuelMassToZeroCylinder3_ov "Override value." VALUE 0x0000 /* @ECU_Address@FDMAie_b_SetFuelMassToZeroCylinder3_ov@ */ Scalar_BOOLEAN 0 CM_T_BOOLEAN 0.0 1.0 /end CHARACTERISTIC
/begin CHARACTERISTIC FDMAie_b_SetFuelMassToZeroCylinder4_ob "Override boolean." VALUE 0x0000 /* @ECU_Address@FDMAie_b_SetFuelMassToZeroCylinder4_ob@ */ Scalar_BOOLEAN 0 CM_T_BOOLEAN 0.0 1.0 /end CHARACTERISTIC
/begin CHARACTERISTIC FDMAie_b_SetFuelMassToZeroCylinder4_ov "Override value." VALUE 0x0000 /* @ECU_Address@FDMAie_b_SetFuelMassToZeroCylinder4_ov@ */ Scalar_BOOLEAN 0 CM_T_BOOLEAN 0.0 1.0 /end CHARACTERISTIC
/begin CHARACTERISTIC FDMAie_b_SetHVBattElectricPowerLimToHalf_ob "Override boolean." VALUE 0x0000 /* @ECU_Address@FDMAie_b_SetHVBattElectricPowerLimToHalf_ob@ */ Scalar_BOOLEAN 0 CM_T_BOOLEAN 0.0 1.0 /end CHARACTERISTIC
/begin CHARACTERISTIC FDMAie_b_SetHVBattElectricPowerLimToHalf_ov "Override value." VALUE 0x0000 /* @ECU_Address@FDMAie_b_SetHVBattElectricPowerLimToHalf_ov@ */ Scalar_BOOLEAN 0 CM_T_BOOLEAN 0.0 1.0 /end CHARACTERISTIC
/begin CHARACTERISTIC FDMAie_b_SetICETrqCapToSafeVal_ob "Override boolean." VALUE 0x0000 /* @ECU_Address@FDMAie_b_SetICETrqCapToSafeVal_ob@ */ Scalar_BOOLEAN 0 CM_T_BOOLEAN 0.0 1.0 /end CHARACTERISTIC
/begin CHARACTERISTIC FDMAie_b_SetICETrqCapToSafeVal_ov "Override value." VALUE 0x0000 /* @ECU_Address@FDMAie_b_SetICETrqCapToSafeVal_ov@ */ Scalar_BOOLEAN 0 CM_T_BOOLEAN 0.0 1.0 /end CHARACTERISTIC
/begin CHARACTERISTIC FDMAie_b_SetLoTempCoolantCircuitPumpFlowHigh_ob "Override boolean." VALUE 0x0000 /* @ECU_Address@FDMAie_b_SetLoTempCoolantCircuitPumpFlowHigh_ob@ */ Scalar_BOOLEAN 0 CM_T_BOOLEAN 0.0 1.0 /end CHARACTERISTIC
/begin CHARACTERISTIC FDMAie_b_SetLoTempCoolantCircuitPumpFlowHigh_ov "Override value." VALUE 0x0000 /* @ECU_Address@FDMAie_b_SetLoTempCoolantCircuitPumpFlowHigh_ov@ */ Scalar_BOOLEAN 0 CM_T_BOOLEAN 0.0 1.0 /end CHARACTERISTIC
/begin CHARACTERISTIC FDMAie_b_SetMAT_ToTempBeforeThrottle_ob "Override boolean." VALUE 0x0000 /* @ECU_Address@FDMAie_b_SetMAT_ToTempBeforeThrottle_ob@ */ Scalar_BOOLEAN 0 CM_T_BOOLEAN 0.0 1.0 /end CHARACTERISTIC
/begin CHARACTERISTIC FDMAie_b_SetMAT_ToTempBeforeThrottle_ov "Override value." VALUE 0x0000 /* @ECU_Address@FDMAie_b_SetMAT_ToTempBeforeThrottle_ov@ */ Scalar_BOOLEAN 0 CM_T_BOOLEAN 0.0 1.0 /end CHARACTERISTIC
/begin CHARACTERISTIC FDMAie_b_SetP1ElectricMotorCapabilityToZero_ob "Override boolean." VALUE 0x0000 /* @ECU_Address@FDMAie_b_SetP1ElectricMotorCapabilityToZero_ob@ */ Scalar_BOOLEAN 0 CM_T_BOOLEAN 0.0 1.0 /end CHARACTERISTIC
/begin CHARACTERISTIC FDMAie_b_SetP1ElectricMotorCapabilityToZero_ov "Override value." VALUE 0x0000 /* @ECU_Address@FDMAie_b_SetP1ElectricMotorCapabilityToZero_ov@ */ Scalar_BOOLEAN 0 CM_T_BOOLEAN 0.0 1.0 /end CHARACTERISTIC
/begin CHARACTERISTIC FDMAie_b_SetP3ElectricMotorCapabilityToZero_ob "Override boolean." VALUE 0x0000 /* @ECU_Address@FDMAie_b_SetP3ElectricMotorCapabilityToZero_ob@ */ Scalar_BOOLEAN 0 CM_T_BOOLEAN 0.0 1.0 /end CHARACTERISTIC
/begin CHARACTERISTIC FDMAie_b_SetP3ElectricMotorCapabilityToZero_ov "Override value." VALUE 0x0000 /* @ECU_Address@FDMAie_b_SetP3ElectricMotorCapabilityToZero_ov@ */ Scalar_BOOLEAN 0 CM_T_BOOLEAN 0.0 1.0 /end CHARACTERISTIC
/begin CHARACTERISTIC FDMAie_b_SetShftLvrPstnToLstKnwnVal_ob "Override boolean." VALUE 0x0000 /* @ECU_Address@FDMAie_b_SetShftLvrPstnToLstKnwnVal_ob@ */ Scalar_BOOLEAN 0 CM_T_BOOLEAN 0.0 1.0 /end CHARACTERISTIC
/begin CHARACTERISTIC FDMAie_b_SetShftLvrPstnToLstKnwnVal_ov "Override value." VALUE 0x0000 /* @ECU_Address@FDMAie_b_SetShftLvrPstnToLstKnwnVal_ov@ */ Scalar_BOOLEAN 0 CM_T_BOOLEAN 0.0 1.0 /end CHARACTERISTIC
/begin CHARACTERISTIC FDMAie_b_SetShftLvrPstnToN_ob "Override boolean." VALUE 0x0000 /* @ECU_Address@FDMAie_b_SetShftLvrPstnToN_ob@ */ Scalar_BOOLEAN 0 CM_T_BOOLEAN 0.0 1.0 /end CHARACTERISTIC
/begin CHARACTERISTIC FDMAie_b_SetShftLvrPstnToN_ov "Override value." VALUE 0x0000 /* @ECU_Address@FDMAie_b_SetShftLvrPstnToN_ov@ */ Scalar_BOOLEAN 0 CM_T_BOOLEAN 0.0 1.0 /end CHARACTERISTIC
/begin CHARACTERISTIC FDMAie_b_SetShftLvrPstnToP_ob "Override boolean." VALUE 0x0000 /* @ECU_Address@FDMAie_b_SetShftLvrPstnToP_ob@ */ Scalar_BOOLEAN 0 CM_T_BOOLEAN 0.0 1.0 /end CHARACTERISTIC
/begin CHARACTERISTIC FDMAie_b_SetShftLvrPstnToP_ov "Override value." VALUE 0x0000 /* @ECU_Address@FDMAie_b_SetShftLvrPstnToP_ov@ */ Scalar_BOOLEAN 0 CM_T_BOOLEAN 0.0 1.0 /end CHARACTERISTIC
/begin MEASUREMENT FDMAve_e_CurrentFunctionActions "Rolling variable indicating currently active function actions." UBYTE CM_FDMAte_e_FunctionAction 0 0 0 141 ECU_ADDRESS 0x0000 /* @ECU_Address@FDMAve_e_CurrentFunctionActions@ */ /end MEASUREMENT
/begin MEASUREMENT FDMAve_Cnt_NoOfInputsDrivingFA_TKO "Indicates how many failure indicators (FDMA inputs) have triggered Function Actions during this key cycle (TKO)." SWORD CM_T_Cnt_Num_1_1_s16 0 0 -32768 32767 ECU_ADDRESS 0x0000 /* @ECU_Address@FDMAve_Cnt_NoOfInputsDrivingFA_TKO@ */ /end MEASUREMENT
/begin MEASUREMENT FDMAve_b_TAMDve_e_ClutchActPwrStgTempVldFA_TKO "Indicates if this input triggered FA (Function Action) during TKO (This Key On)" UBYTE CM_T_BOOLEAN 0 0 0.0 1.0 ECU_ADDRESS 0x0000 /* @ECU_Address@FDMAve_b_TAMDve_e_ClutchActPwrStgTempVldFA_TKO@ */ /end MEASUREMENT
/begin MEASUREMENT FDMAve_b_SWINve_e_MCU_COM_ValidityFA_TKO "Indicates if this input triggered FA (Function Action) during TKO (This Key On)" UBYTE CM_T_BOOLEAN 0 0 0 1 ECU_ADDRESS 0x0000 /* @ECU_Address@FDMAve_b_SWINve_e_MCU_COM_ValidityFA_TKO@ */ /end MEASUREMENT
/begin MEASUREMENT FDMAve_b_TCMDve_e_CoolingActSpdDevVldFA_TKO "Indicates if this input triggered FA (Function Action) during TKO (This Key On)" UBYTE CM_T_BOOLEAN 0 0 0 1 ECU_ADDRESS 0x0000 /* @ECU_Address@FDMAve_b_TCMDve_e_CoolingActSpdDevVldFA_TKO@ */ /end MEASUREMENT
/begin MEASUREMENT FDMAve_b_TLMDve_e_TransCtrlSysPerfVldFA_TKO "Indicates if this input triggered FA (Function Action) during TKO (This Key On)" UBYTE CM_T_BOOLEAN 0 0 0 1 ECU_ADDRESS 0x0000 /* @ECU_Address@FDMAve_b_TLMDve_e_TransCtrlSysPerfVldFA_TKO@ */ /end MEASUREMENT
/begin MEASUREMENT FDMAve_b_TOTDve_e_TransmissionOilTempCritVldFA_TKO "Indicates if this input triggered FA (Function Action) during TKO (This Key On)" UBYTE CM_T_BOOLEAN 0 0 0 1 ECU_ADDRESS 0x0000 /* @ECU_Address@FDMAve_b_TOTDve_e_TransmissionOilTempCritVldFA_TKO@ */ /end MEASUREMENT
/begin MEASUREMENT FDMAve_b_TCMDve_e_CoolingActuatorVldFA_TKO "Indicates if this input triggered FA (Function Action) during TKO (This Key On)" UBYTE CM_T_BOOLEAN 0 0 0 1 ECU_ADDRESS 0x0000 /* @ECU_Address@FDMAve_b_TCMDve_e_CoolingActuatorVldFA_TKO@ */ /end MEASUREMENT
/begin MEASUREMENT FDMAve_b_TAMDve_e_MosfetVldFA_TKO "Indicates if this input triggered FA (Function Action) during TKO (This Key On)" UBYTE CM_T_BOOLEAN 0 0 0 1 ECU_ADDRESS 0x0000 /* @ECU_Address@FDMAve_b_TAMDve_e_MosfetVldFA_TKO@ */ /end MEASUREMENT
/begin MEASUREMENT FDMAve_b_CANComErrExtFA_TKO "Indicates if this input triggered FA (Function Action) during TKO (This Key On)" UBYTE CM_T_BOOLEAN 0 0 0 1 ECU_ADDRESS 0x0000 /* @ECU_Address@FDMAve_b_CANComErrExtFA_TKO@ */ /end MEASUREMENT
/begin MEASUREMENT FDMAve_b_TCMDve_e_StuckVldFA_TKO "Indicates if this input triggered FA (Function Action) during TKO (This Key On)" UBYTE CM_T_BOOLEAN 0 0 0 1 ECU_ADDRESS 0x0000 /* @ECU_Address@FDMAve_b_TCMDve_e_StuckVldFA_TKO@ */ /end MEASUREMENT
/begin MEASUREMENT FDMAve_b_TAMDve_e_StuckVldFA_TKO "Indicates if this input triggered FA (Function Action) during TKO (This Key On)" UBYTE CM_T_BOOLEAN 0 0 0 1 ECU_ADDRESS 0x0000 /* @ECU_Address@FDMAve_b_TAMDve_e_StuckVldFA_TKO@ */ /end MEASUREMENT
/begin MEASUREMENT FDMAve_b_TCMDve_e_MosfetVldFA_TKO "Indicates if this input triggered FA (Function Action) during TKO (This Key On)" UBYTE CM_T_BOOLEAN 0 0 0 1 ECU_ADDRESS 0x0000 /* @ECU_Address@FDMAve_b_TCMDve_e_MosfetVldFA_TKO@ */ /end MEASUREMENT
/begin MEASUREMENT FDMAve_b_SWINve_e_VCU_COM_ValidityFA_TKO "Indicates if this input triggered FA (Function Action) during TKO (This Key On)" UBYTE CM_T_BOOLEAN 0 0 0.0 1.0 ECU_ADDRESS 0x0000 /* @ECU_Address@FDMAve_b_SWINve_e_VCU_COM_ValidityFA_TKO@ */ /end MEASUREMENT
/begin MEASUREMENT FDMAve_b_CANDve_e_VCU_InvalidDataVldFA_TKO "Indicates if this input triggered FA (Function Action) during TKO (This Key On)" UBYTE CM_T_BOOLEAN 0 0 0 1 ECU_ADDRESS 0x0000 /* @ECU_Address@FDMAve_b_CANDve_e_VCU_InvalidDataVldFA_TKO@ */ /end MEASUREMENT
/begin MEASUREMENT FDMAve_b_TSSDve_e_ClutchCapacityInsuffVldFA_TKO "Indicates if this input triggered FA (Function Action) during TKO (This Key On)" UBYTE CM_T_BOOLEAN 0 0 0 1 ECU_ADDRESS 0x0000 /* @ECU_Address@FDMAve_b_TSSDve_e_ClutchCapacityInsuffVldFA_TKO@ */ /end MEASUREMENT
/begin MEASUREMENT FDMAve_b_TSSDve_e_ClutchDragTrqTooHighVldFA_TKO "Indicates if this input triggered FA (Function Action) during TKO (This Key On)" UBYTE CM_T_BOOLEAN 0 0 0 1 ECU_ADDRESS 0x0000 /* @ECU_Address@FDMAve_b_TSSDve_e_ClutchDragTrqTooHighVldFA_TKO@ */ /end MEASUREMENT
/begin MEASUREMENT FDMAve_b_V5RDve_e_EC_StatusRef1VldFA_TKO "Indicates if this input triggered FA (Function Action) during TKO (This Key On)" UBYTE CM_T_BOOLEAN 0 0 0.0 1.0 ECU_ADDRESS 0x0000 /* @ECU_Address@FDMAve_b_V5RDve_e_EC_StatusRef1VldFA_TKO@ */ /end MEASUREMENT
/begin MEASUREMENT FDMAve_b_V5RDve_e_EC_StatusRef2VldFA_TKO "Indicates if this input triggered FA (Function Action) during TKO (This Key On)" UBYTE CM_T_BOOLEAN 0 0 0.0 1.0 ECU_ADDRESS 0x0000 /* @ECU_Address@FDMAve_b_V5RDve_e_EC_StatusRef2VldFA_TKO@ */ /end MEASUREMENT
/begin MEASUREMENT FDMAve_b_TCPDve_e_ClutchPressureSensPerfVldFA_TKO "Indicates if this input triggered FA (Function Action) during TKO (This Key On)" UBYTE CM_T_BOOLEAN 0 0 0 1 ECU_ADDRESS 0x0000 /* @ECU_Address@FDMAve_b_TCPDve_e_ClutchPressureSensPerfVldFA_TKO@ */ /end MEASUREMENT
/begin MEASUREMENT FDMAve_b_V5RDve_e_EC_StatusRef3VldFA_TKO "Indicates if this input triggered FA (Function Action) during TKO (This Key On)" UBYTE CM_T_BOOLEAN 0 0 0.0 1.0 ECU_ADDRESS 0x0000 /* @ECU_Address@FDMAve_b_V5RDve_e_EC_StatusRef3VldFA_TKO@ */ /end MEASUREMENT
/begin MEASUREMENT FDMAve_b_TAMDve_e_ClutchActuatorVldFA_TKO "Indicates if this input triggered FA (Function Action) during TKO (This Key On)" UBYTE CM_T_BOOLEAN 0 0 0 1 ECU_ADDRESS 0x0000 /* @ECU_Address@FDMAve_b_TAMDve_e_ClutchActuatorVldFA_TKO@ */ /end MEASUREMENT
/begin MEASUREMENT FDMAve_b_TOTDve_e_TransmissionTempSensorVldFA_TKO "Indicates if this input triggered FA (Function Action) during TKO (This Key On)" UBYTE CM_T_BOOLEAN 0 0 0 1 ECU_ADDRESS 0x0000 /* @ECU_Address@FDMAve_b_TOTDve_e_TransmissionTempSensorVldFA_TKO@ */ /end MEASUREMENT
/begin MEASUREMENT FDMAve_b_LV_VltgCntrlErrExtFA_TKO "Indicates if this input triggered FA (Function Action) during TKO (This Key On)" UBYTE CM_T_BOOLEAN 0 0 0.0 1.0 ECU_ADDRESS 0x0000 /* @ECU_Address@FDMAve_b_LV_VltgCntrlErrExtFA_TKO@ */ /end MEASUREMENT
/begin MEASUREMENT FDMAve_b_LV_VltgHiErrExtFA_TKO "Indicates if this input triggered FA (Function Action) during TKO (This Key On)" UBYTE CM_T_BOOLEAN 0 0 0.0 1.0 ECU_ADDRESS 0x0000 /* @ECU_Address@FDMAve_b_LV_VltgHiErrExtFA_TKO@ */ /end MEASUREMENT
/begin MEASUREMENT FDMAve_b_LV_VltgLoCriticalErrExtFA_TKO "Indicates if this input triggered FA (Function Action) during TKO (This Key On)" UBYTE CM_T_BOOLEAN 0 0 0.0 1.0 ECU_ADDRESS 0x0000 /* @ECU_Address@FDMAve_b_LV_VltgLoCriticalErrExtFA_TKO@ */ /end MEASUREMENT
/begin MEASUREMENT FDMAve_b_SWINve_e_GCU_COM_ValidityFA_TKO "Indicates if this input triggered FA (Function Action) during TKO (This Key On)" UBYTE CM_T_BOOLEAN 0 0 0 1 ECU_ADDRESS 0x0000 /* @ECU_Address@FDMAve_b_SWINve_e_GCU_COM_ValidityFA_TKO@ */ /end MEASUREMENT
/begin MEASUREMENT FDMAve_b_TCPDve_e_ClutchPressureHighVldFA_TKO "Indicates if this input triggered FA (Function Action) during TKO (This Key On)" UBYTE CM_T_BOOLEAN 0 0 0.0 1.0 ECU_ADDRESS 0x0000 /* @ECU_Address@FDMAve_b_TCPDve_e_ClutchPressureHighVldFA_TKO@ */ /end MEASUREMENT
/begin MEASUREMENT FDMAve_b_TCPDve_e_ClutchPressureLowVldFA_TKO "Indicates if this input triggered FA (Function Action) during TKO (This Key On)" UBYTE CM_T_BOOLEAN 0 0 0.0 1.0 ECU_ADDRESS 0x0000 /* @ECU_Address@FDMAve_b_TCPDve_e_ClutchPressureLowVldFA_TKO@ */ /end MEASUREMENT
/begin MEASUREMENT FDMAve_b_TCPDve_e_ClutchPressureSensorVldFA_TKO "Indicates if this input triggered FA (Function Action) during TKO (This Key On)" UBYTE CM_T_BOOLEAN 0 0 0.0 1.0 ECU_ADDRESS 0x0000 /* @ECU_Address@FDMAve_b_TCPDve_e_ClutchPressureSensorVldFA_TKO@ */ /end MEASUREMENT
/begin MEASUREMENT FDMAve_b_CANComErrExt "Indicates if this input triggered FA (Function Action) during TKO (This Key On)" UBYTE CM_T_BOOLEAN 0 0 0 1 ECU_ADDRESS 0x0000 /* @ECU_Address@FDMAve_b_CANComErrExt@ */ /end MEASUREMENT
/begin MEASUREMENT FDMAve_b_LatchFunctionActions "Indicates that init delay timer has expired and Function Actions will be latched." UBYTE CM_T_BOOLEAN 0 0 0.0 1.0 ECU_ADDRESS 0x0000 /* @ECU_Address@FDMAve_b_LatchFunctionActions@ */ /end MEASUREMENT
/begin MEASUREMENT FDMAve_b_EvaluateValidities "Indicates that init timer has expired and validities will be evaluated." UBYTE CM_T_BOOLEAN 0 0 0.0 1.0 ECU_ADDRESS 0x0000 /* @ECU_Address@FDMAve_b_EvaluateValidities@ */ /end MEASUREMENT
/begin MEASUREMENT FDMAva_e_ActiveFA_BufferNonPIM "Array constituting a buffer for Inca display purpose" UBYTE CM_FDMAte_e_FunctionAction 0 0 0 141 ARRAY_SIZE 10 ECU_ADDRESS 0x0000 /* @ECU_Address@FDMAva_e_ActiveFA_BufferNonPIM@ */ /end MEASUREMENT
/begin COMPU_METHOD CM_SPARte_e_Validity "Enumerated data type: SPARte_e_Validity" TAB_VERB "%0.6" "" COMPU_TAB_REF VTAB_FOR_CM_SPARte_e_Validity /end COMPU_METHOD
/begin COMPU_VTAB VTAB_FOR_CM_SPARte_e_Validity "Enumerated data type: SPARte_e_Validity" TAB_VERB 4 0 "SPARce_e_Valid" 1 "SPARce_e_Invalid" 2 "SPARce_e_EstimatedReplaceValue" 3 "SPARce_e_NotEvaluatedYet" /end COMPU_VTAB
/begin COMPU_METHOD CM_FDMAte_e_FunctionAction "Enumerated data type: FDMAte_e_FunctionAction" TAB_VERB "%0.6" "" COMPU_TAB_REF VTAB_FOR_CM_FDMAte_e_FunctionAction /end COMPU_METHOD
/begin COMPU_VTAB VTAB_FOR_CM_FDMAte_e_FunctionAction "Enumerated data type: FDMAte_e_FunctionAction" TAB_VERB 142 0 "FDMAce_e_NoAction" 1 "FDMAce_e_ForceAirEstimationByMAP_SensorToOff" 2 "FDMAce_e_ForceAC_CompressorToOff" 3 "FDMAce_e_ForceAC_LoadCompensationToOff" 4 "FDMAce_e_ForceCamPositionToParked" 5 "FDMAce_e_ForceCruiseControlToOff" 6 "FDMAce_e_ForceEngineTorqueReductionToMedium" 7 "FDMAce_e_ForceFuelControlToOpenLoop" 8 "FDMAce_e_ForceFuelPressureActivationToOff" 9 "FDMAce_e_ForceIdleControlToElevatedMode" 10 "FDMAce_e_ForceIgnitionToLowOctane" 11 "FDMAce_e_ForceIgnitionToOffCylinder1" 12 "FDMAce_e_ForceIgnitionToOffCylinder2" 13 "FDMAce_e_ForceIgnitionToOffCylinder3" 14 "FDMAce_e_ForceIgnitionToOffCylinder4" 15 "FDMAce_e_ForceLongTermAdaptionToOff" 16 "FDMAce_e_ForcePowerSteeringCompensationToOff" 17 "FDMAce_e_ForcePurgeControlToOff" 18 "FDMAce_e_ForceRearO2SensorFuelControlToOff" 19 "FDMAce_e_ForceThrottleMassAirFlowToDefaultAir" 20 "FDMAce_e_ForceUnderHoodCoolingToHigh" 21 "FDMAce_e_SetAutoTransTorqueRequestToNoRequest" 22 "FDMAce_e_SetDriversRequestToZero" 23 "FDMAce_e_SetFuelMassToZeroCylinder1" 24 "FDMAce_e_SetFuelMassToZeroCylinder2" 25 "FDMAce_e_SetFuelMassToZeroCylinder3" 26 "FDMAce_e_SetFuelMassToZeroCylinder4" 27 "FDMAce_e_SetICETrqCapToSafeVal" 28 "FDMAce_e_SetESP_TCS_TorqueRequestToNoRequest" 29 "FDMAce_e_ForceElectricThermostatToOff" 30 "FDMAce_e_LockoutEngineStateChange" 31 "FDMAce_e_ForceEngineRunning" 32 "FDMAce_e_ForceGearRecommendationToOff" 33 "FDMAce_e_ForceIgnitionToOff" 34 "FDMAce_e_ForceBoostTorqueOff" 35 "FDMAce_e_ForceBrakeRegenerationTorqueOff" 36 "FDMAce_e_ForceCoastRegenerationTorqueOff" 37 "FDMAce_e_ForceContactorsOpen" 38 "FDMAce_e_ForceDCDC_ON" 39 "FDMAce_e_ForceEngTransientLimOff" 40 "FDMAce_e_ForceHVBattSOC_ControlOff" 41 "FDMAce_e_ForceHybridOptimizationTrqOff" 42 "FDMAce_e_ForceLftDrvnWhlSpdInfoExclusion" 43 "FDMAce_e_ForceLftNnDrvnWhlSpdInfoExclusion" 44 "FDMAce_e_ForceP1ElectricTorqueReserveOff" 45 "FDMAce_e_ForceP3MtrSpdInfoExclusion" 46 "FDMAce_e_ForcePropulsionAllowedToNotAllowed" 47 "FDMAce_e_ForceRghtDrvnWhlSpdInfoExclusion" 48 "FDMAce_e_ForceRghtNnDrvnWhlSpdInfoExclusion" 49 "FDMAce_e_ForceVehicleSpeedInfoExclusion" 50 "FDMAce_e_LimitHV_BattSOC_CntrlAuthorityToLow" 51 "FDMAce_e_LockoutPropulsionSystemStart" 52 "FDMAce_e_LockoutSpdDepCntctrAfterrun" 53 "FDMAce_e_SetDCDC_ActualLoadDefaultVal" 54 "FDMAce_e_SetDCDCChargeVoltageHigh" 55 "FDMAce_e_SetElectricTorqueRequestZero" 56 "FDMAce_e_SetHVBattElectricPowerLimToHalf" 57 "FDMAce_e_ForcePropModeCalcToExcludeVehSpd" 58 "FDMAce_e_SetLoTempCoolantCircuitPumpFlowHigh" 59 "FDMAce_e_SetAccPedPosToZero" 60 "FDMAce_e_ForceElectricLoadCompensationToOff" 61 "FDMAce_e_ForceEngTrqRdctnToMediumUnlatched" 62 "FDMAce_e_ForceBackupPowerModeToActive" 63 "FDMAce_e_ForceBoostPressureControlToLowPressure" 64 "FDMAce_e_ForceElectricThermostatControlToLowTemp" 65 "FDMAce_e_ForceEngCoolantTempToEstimationModel" 66 "FDMAce_e_ForceFuelRailPressureFeedbackExclusion" 67 "FDMAce_e_ForceIntelligentGeneratorControlToDefault" 68 "FDMAce_e_ForceTCU_CreepTorqueControlToOff" 69 "FDMAce_e_SetAutoTransIdleSpdRqstToNoRqst" 70 "FDMAce_e_LockoutStopStartEngineStateChange" 71 "FDMAce_e_SetMAT_ToTempBeforeThrottle" 72 "FDMAce_e_ForceEngineStop" 73 "FDMAce_e_ForceFrntO2SnsrBnk1ToPrtctnMd" 74 "FDMAce_e_ForceHiPressFuelPumpEnblToDisable" 75 "FDMAce_e_ForcePowerModeLock" 76 "FDMAce_e_ForceDCDC_ControlToDefault" 77 "FDMAce_e_SetP1ElectricMotorCapabilityToZero" 78 "FDMAce_e_ForceP1ElectricMotorToNeutral" 79 "FDMAce_e_ForceEGR_ControlToOff" 80 "FDMAce_e_ForceElectricVacuumPumpOff" 81 "FDMAce_e_ForcePF_ActiveRegenOff" 82 "FDMAce_e_ForcePF_PrssrSnsrAdptnOff" 83 "FDMAce_e_ForcePF_PrssrSnsrBasedSootEstOff" 84 "FDMAce_e_ForceElectricVacuumPumpPulseMode" 85 "FDMAce_e_ForceNeutralGear" 86 "FDMAce_e_ForceEngineTorqueFillOff" 87 "FDMAce_e_ForceAntiJerkControlOff" 88 "FDMAce_e_ForceAC_CompressorCpbyPrioHigh" 89 "FDMAce_e_SetP3ElectricMotorCapabilityToZero" 90 "FDMAce_e_ForceCreepControlToOff" 91 "FDMAce_e_ForceDCDC_BuckConversionOff" 92 "FDMAce_e_ForceHVAC_ElectricHeaterOff" 93 "FDMAce_e_ForceActiveDischarge" 94 "FDMAce_e_SetShftLvrPstnToLstKnwnVal" 95 "FDMAce_e_SetShftLvrPstnToN" 96 "FDMAce_e_SetShftLvrPstnToP" 97 "FDMAce_e_ForceClutchOddOpen" 98 "FDMAce_e_ForceCntctrsOpnngCmd" 99 "FDMAce_e_ForceCntctrsOpnngCmdWthActvDschrg" 100 "FDMAce_e_ForceCntctrsOpnngRqst" 101 "FDMAce_e_ForceAutonomousModeOff" 102 "FDMAce_e_ForceElectricSteeringPowerToOff" 103 "FDMAce_e_ForceAutParkAsstToOff" 104 "FDMAce_e_ForceHrdwrdBrkVcmInfoExclusion" 105 "FDMAce_e_LimitVhclSpdToLmpHmSpd" 106 "FDMAce_e_LimitHV_BattCurrToSfCntctrOpnng" 107 "FDMAce_e_ForceTransIOCControlToOff" 108 "FDMAce_e_ForceGCUTorqueToExclusionFromTransPresTarget" 109 "FDMAce_e_ForceTransOilCoolingToSafeCoolingMode" 110 "FDMAce_e_ForceTransOilLubricationtoSafeLubricationMode" 111 "FDMAce_e_ForceHiTmpRdtrClntFlwHi" 112 "FDMAce_e_ForceStoichiometricCombustion" 113 "FDMAce_e_ForceRrO2SnsrBnk1ToPrtctnMd" 114 "FDMAce_e_ForceAVH_RltdDrvrRqTrqRtLmtrOff" 115 "FDMAce_e_FDMAve_b_ForceSteeringAssistToOff" 116 "FDMAce_e_LimitSteeringAssistToLow" 117 "FDMAce_e_ForceHiTmpRdtrFanOff" 118 "FDMAce_e_SetAPA_TorqueRequestToNoRequest" 119 "FDMAce_e_ForceEngineTorqueReductionToModerate" 120 "FDMAce_e_SetHV_BattCurrRxToZero" 121 "FDMAce_e_SetAC_EvapTempToDefaultTemp" 122 "FDMAce_e_LimitP1ShaftSpeedToLow" 123 "FDMAce_e_LimitVhclSpdToMedium" 124 "FDMAce_e_LimitVhclSpdToModerate" 125 "FDMAce_e_ForceFuelCutAllowed" 126 "FDMAce_e_ForceHonorImmediate" 127 "FDMAce_e_ForceIntelligentECU_ModeOff" 128 "FDMAce_e_SetHVBattElectricPowerToLim" 129 "FDMAce_e_SetP4ElectricMotorCapabilityToZero" 130 "FDMAce_e_ForceFrontDiffLockOpen" 131 "FDMAce_e_ForceRearDiffLockOpen" 132 "FDMAce_e_ForceDCDC2_BuckConversionOff" 133 "FDMAce_e_ForceDCDC2_ControlToDefault" 134 "FDMAce_e_SetFrontAxleToN" 135 "FDMAce_e_SetRearAxleToN" 136 "FDMAce_e_ForceCCPCancleSpdLimit" 137 "FDMAce_e_LimitHV_BattCurrToSfCntctrOpnngUnltchd" 138 "FDMAce_e_SetElectricMotorCapabilityToZero" 139 "FDMAce_e_ForceMosfetOff" 140 "FDMAce_e_ForceSafeclockOff" 141 "FDMAce_e_SetSoftwareASC" /end COMPU_VTAB
/begin COMPU_METHOD CM_T_Cnt_Num_1_1_s16 "Q = V" RAT_FUNC "%5.0" "Num (counts)" COEFFS 0 1 0 0 0 1 /end COMPU_METHOD
/begin COMPU_METHOD CM_T_Cnt_Num_1_1_u8 "Q = V" RAT_FUNC "%3.0" "Num (counts)" COEFFS 0 1 0 0 0 1 /end COMPU_METHOD
/begin COMPU_METHOD CM_T_BOOLEAN "Q = V" RAT_FUNC "%1.0" "Bool" COEFFS 0 1 0 0 0 1 /end COMPU_METHOD
/* EOF FDMA.a2l */
/begin RECORD_LAYOUT Scalar_BOOLEAN FNC_VALUES 1 UBYTE COLUMN_DIR DIRECT /end RECORD_LAYOUT
/begin RECORD_LAYOUT Scalar_UBYTE FNC_VALUES 1 UBYTE COLUMN_DIR DIRECT /end RECORD_LAYOUT
/begin RECORD_LAYOUT Scalar_UWORD FNC_VALUES 1 UWORD COLUMN_DIR DIRECT /end RECORD_LAYOUT
/begin RECORD_LAYOUT Scalar_SWORD FNC_VALUES 1 SWORD COLUMN_DIR DIRECT /end RECORD_LAYOUT
/begin RECORD_LAYOUT Scalar_ULONG FNC_VALUES 1 ULONG COLUMN_DIR DIRECT /end RECORD_LAYOUT
/begin RECORD_LAYOUT Scalar_FLOAT32_IEEE FNC_VALUES 1 FLOAT32_IEEE COLUMN_DIR DIRECT /end RECORD_LAYOUT
/begin RECORD_LAYOUT Lookup1D_UBYTE FNC_VALUES 1 UBYTE COLUMN_DIR DIRECT /end RECORD_LAYOUT
/begin RECORD_LAYOUT Lookup1D_UWORD FNC_VALUES 1 UWORD COLUMN_DIR DIRECT /end RECORD_LAYOUT
/begin RECORD_LAYOUT Lookup1D_WORD FNC_VALUES 1 SWORD COLUMN_DIR DIRECT /end RECORD_LAYOUT
/begin RECORD_LAYOUT Lookup1D_X_WORD AXIS_PTS_X 1 SWORD INDEX_INCR DIRECT /end RECORD_LAYOUT
/begin CHARACTERISTIC PORSkt_K_P1Weighting "P1 speed and Engine speed weighting.
      in various RPM intervals (PORSkn_n_Intervals) P1 speed sensor influence on P1 rotational speed output can be weighted.
      
      Example:
      1 ->  100% P1 speed value will be used
      0.5 -> 50% P1/ICE speed. i.e mean value.
      0.1 -> 10% P1 value and 90% ICE sensor value will be used.
      
      
      
      
      
      
      
      
      
      " CURVE 0x0000 /* @ECU_Address@PORSkt_K_P1Weighting@ */ Lookup1D_UBYTE 0 CM_T_K_NA_128_1_u8 0.0 1.0 EXTENDED_LIMITS 0.0 1.9921875
 /begin AXIS_DESCR COM_AXIS PORSve_n_EngSpd CM_T_n_rpm_1_1_s16 11 0.0 10000.0 AXIS_PTS_REF PORSkn_n_Intervals /end AXIS_DESCR
/end CHARACTERISTIC
/begin AXIS_PTS PORSkn_n_Intervals "This vecor is used for both sensor weighting and LP filter coefficient settings for different rpm values" 0x0000 /* @ECU_Address@PORSkn_n_Intervals@ */ PORSve_n_EngSpd Lookup1D_X_WORD 0 CM_T_n_rpm_1_1_s16 11 0.0 10000.0 EXTENDED_LIMITS -32768.0 32767.0 /end AXIS_PTS
/begin CHARACTERISTIC PORSke_e_P1RotationalSpeedVld_OV "###Description
      P1rotational speed validity output overide Value
      ###Calibration
      PORSke_e_P1RotationalSpeedVld_OV will be passed to the output if its corresponding OB value is enabled True(1)
      SPARce_e_Valid(0)
      SPARce_e_Invalid(1)
      SPARce_e_EstimatedReplaceValue(2)
      SPARce_e_NotEvaluatedYet(3)
      ###Usage
      For hardware test purpose only
      
      
      
      " VALUE 0x0000 /* @ECU_Address@PORSke_e_P1RotationalSpeedVld_OV@ */ Scalar_UBYTE 0 CM_SPARte_e_Validity 0 3 EXTENDED_LIMITS 0 0 /end CHARACTERISTIC
/begin CHARACTERISTIC PORSke_r_DiffDrvtvFiltrConst "###Description
      Derivative Filter constant  0p1 means that 10pct of the new value and 90pct of the old is used, 1 means that the new value is passed through unfiltered.
      
      
      
      " VALUE 0x0000 /* @ECU_Address@PORSke_r_DiffDrvtvFiltrConst@ */ Scalar_ULONG 0 CM_T_A_m2_1024_1_u32 0.0 1.0 EXTENDED_LIMITS 0.0 4.1943039990234375E+6 /end CHARACTERISTIC
/begin CHARACTERISTIC PORSke_n_BypassFilter "Motor/Engine speed rpm below this value will bypass the filter." VALUE 0x0000 /* @ECU_Address@PORSke_n_BypassFilter@ */ Scalar_SWORD 0 CM_T_n_rpm_1_1_s16 0.0 15000.0 EXTENDED_LIMITS -32768.0 32767.0 /end CHARACTERISTIC
/begin CHARACTERISTIC PORSke_n_MaxLimit "PORS output maximum value" VALUE 0x0000 /* @ECU_Address@PORSke_n_MaxLimit@ */ Scalar_SWORD 0 CM_T_n_rpm_1_1_s16 -32000.0 32000.0 EXTENDED_LIMITS -32768.0 32767.0 /end CHARACTERISTIC
/begin CHARACTERISTIC PORSke_n_MinLimit "PORS output minimum value" VALUE 0x0000 /* @ECU_Address@PORSke_n_MinLimit@ */ Scalar_SWORD 0 CM_T_n_rpm_1_1_s16 -32000.0 32000.0 EXTENDED_LIMITS -32768.0 32767.0 /end CHARACTERISTIC
/begin CHARACTERISTIC PORSke_n_P1RotationalSpeedUnsigned_OV "###Description
      P1rotational speed output overide value
      ###Calibration
      If PORSke_b_P1RotationalSpeedUnsigned_OB is set True(1) PORSke_n_P1RotationalSpeedUnsigned_OV will be passed to the output
      ###Usage
      For hardware test purpose only
      " VALUE 0x0000 /* @ECU_Address@PORSke_n_P1RotationalSpeedUnsigned_OV@ */ Scalar_SWORD 0 CM_T_n_rpm_1_1_s16 0.0 12000.0 EXTENDED_LIMITS -32768.0 32767.0 /end CHARACTERISTIC
/begin CHARACTERISTIC PORSke_n_P1RotationalSpeed_OV "###Description
      P1rotational speed output overide value
      ###Calibration
      If PORSke_b_P1RotationalSpeed_OB is set True(1) PORSke_n_P1RotationalSpeed_OV will be passed to the output
      ###Usage
      For hardware test purpose only
      
      
      " VALUE 0x0000 /* @ECU_Address@PORSke_n_P1RotationalSpeed_OV@ */ Scalar_SWORD 0 CM_T_n_rpm_1_1_s16 -12000.0 12000.0 EXTENDED_LIMITS -32768.0 32767.0 /end CHARACTERISTIC
/begin CHARACTERISTIC PORSke_n_SetToZero "This parameter is used to zero smooth the output. i.e the output will not include sign.
      
      If set to -8000, the function will be disabled, and minus sign rpm's will be accepted.
      " VALUE 0x0000 /* @ECU_Address@PORSke_n_SetToZero@ */ Scalar_SWORD 0 CM_T_n_rpm_1_1_s16 -8000.0 8000.0 EXTENDED_LIMITS -32768.0 32767.0 /end CHARACTERISTIC
/begin CHARACTERISTIC PORSke_dn_P1Derivative_OV "###Description
      This value may overide the output if its corresponding _OB is set to true
      ###Calibration
      
      ###Usage
      For hardware test
      
      " VALUE 0x0000 /* @ECU_Address@PORSke_dn_P1Derivative_OV@ */ Scalar_SWORD 0 CM_T_dn_rpmps_2_1_s16 -16384.0 16383.5 /end CHARACTERISTIC
/begin CHARACTERISTIC PORSke_d2n_2nd_P1Derivative_OV "###Description
      This value may overide the output if its corresponding _OB is set to true
      ###Calibration
      
      ###Usage
      For hardware test
      
      
      
      " VALUE 0x0000 /* @ECU_Address@PORSke_d2n_2nd_P1Derivative_OV@ */ Scalar_SWORD 0 CM_T_d2n_rpmps2_4_1_s16 -8192.0 8191.75 /end CHARACTERISTIC
/begin CHARACTERISTIC PORSke_t_dT "PORS execution time" VALUE 0x0000 /* @ECU_Address@PORSke_t_dT@ */ Scalar_SWORD 0 CM_T_t_s_100_1_s16 0.01 1.0 EXTENDED_LIMITS -327.68 327.67 /end CHARACTERISTIC
/begin CHARACTERISTIC PORSke_cnt_UseMotorSpdToCalcDerivative "###Description
      It is possible to choose which input to be used to calculate 1st and 2nd derivative of P1 rotational speed
      ###Calibration
      1 -> ISG Motor Speed used
      2 -> EPOSve_n_EngSpd used (default)
      3 -> LP filtered PORSve_n_P1MtrSpd
      4--> LP filtered PORSve_n_EngSpd used
      5->  Internaly filtered calculated rotational speed used. (PORSve_n_P1RotationalSpeed)
      
      
      " VALUE 0x0000 /* @ECU_Address@PORSke_cnt_UseMotorSpdToCalcDerivative@ */ Scalar_UBYTE 0 CM_T_Cnt_Num_1_1_u8 1.0 5.0 EXTENDED_LIMITS 0.0 255.0 /end CHARACTERISTIC
/begin CHARACTERISTIC PORSke_b_2nd_P1Derivative_OB "###Description
      PORSve_d2n_P1SecondDerivative overide boolean,
      ###Calibration
      If this signal is True then PORSke_d2n_2nd_P1Derivative_OV will be bypassed to PORSve_d2n_P1SecondDerivative
      ###Usage
      For hardware test purpose
      
      
      " VALUE 0x0000 /* @ECU_Address@PORSke_b_2nd_P1Derivative_OB@ */ Scalar_BOOLEAN 0 CM_T_BOOLEAN 0.0 1.0 /end CHARACTERISTIC
/begin CHARACTERISTIC PORSke_b_ByPassEposDerivatives "###Description
      This value will bypass derivative calculations from EPOS. Epos calculation is synced to engine speed.
      ###Calibration
      True(1) -> EPOS derivatives will be used
      False(0) -> PORS internal derivatives will be used
      ###Usage
      Default cal will be internal calculation / False(0)
      " VALUE 0x0000 /* @ECU_Address@PORSke_b_ByPassEposDerivatives@ */ Scalar_BOOLEAN 0 CM_T_BOOLEAN 0.0 1.0 /end CHARACTERISTIC
/begin CHARACTERISTIC PORSke_b_BypassEngSpd "If this parameter is set to true, output and validity will be bypassed.
      
      PORSve_n_P1RotationalSpeed will always equal SWINve_n_EngSpd
      and PORSve_e_P1RotationalSpeedVld will equal SWINve_e_EngSpdValidity
      " VALUE 0x0000 /* @ECU_Address@PORSke_b_BypassEngSpd@ */ Scalar_BOOLEAN 0 CM_T_BOOLEAN 0.0 1.0 /end CHARACTERISTIC
/begin CHARACTERISTIC PORSke_b_DerivativeWithAvgFilt "###Descritpion
      Two ways how to calculate derivative is implemented.
      ###Calibration
      To use average fillter to calculate first derivative set this boolean to 1 (40ms delay) probably the best when source is engine sync
      " VALUE 0x0000 /* @ECU_Address@PORSke_b_DerivativeWithAvgFilt@ */ Scalar_BOOLEAN 0 CM_T_BOOLEAN 0.0 1.0 /end CHARACTERISTIC
/begin CHARACTERISTIC PORSke_b_EngSpdOk_ob "Overide PORSle_b_EngSpdOk
      
      IF This value == True
      PORSle_b_EngSpdOk = PORSke_b_EngSpdOk_ov
      " VALUE 0x0000 /* @ECU_Address@PORSke_b_EngSpdOk_ob@ */ Scalar_BOOLEAN 0 CM_T_BOOLEAN 0.0 1.0 /end CHARACTERISTIC
/begin CHARACTERISTIC PORSke_b_EngSpdOk_ov "PORSke_b_EngSpdOk_ob ==  True
      PORSle_b_EngSpdOk =  This value
      
      Make correct settings to PORSke_b_P1MtrOk_ob = True and PORSke_b_P1MtrOk_ov = False to make
      PORSve_n_P1RotationalSpeed = SWINve_n_EngSpd
      " VALUE 0x0000 /* @ECU_Address@PORSke_b_EngSpdOk_ov@ */ Scalar_BOOLEAN 0 CM_T_BOOLEAN 0.0 1.0 /end CHARACTERISTIC
/begin CHARACTERISTIC PORSke_b_P1Derivative_OB "###Description
      PORSve_dn_P1Derivative overide boolean,
      ###Calibration
      If this signal is True then PORSke_dn_P1Derivative_OV will be bypassed to PORSve_dn_P1Derivative
      ###Usage
      For hardware test purpose
      
      " VALUE 0x0000 /* @ECU_Address@PORSke_b_P1Derivative_OB@ */ Scalar_BOOLEAN 0 CM_T_BOOLEAN 0.0 1.0 /end CHARACTERISTIC
/begin CHARACTERISTIC PORSke_b_P1MtrOk_ob "Overide PORSle_b_P1MtrOk
      
      IF This value == True
      PORSle_b_P1MtrOk = PORSke_b_P1MtrOk_ov
      " VALUE 0x0000 /* @ECU_Address@PORSke_b_P1MtrOk_ob@ */ Scalar_BOOLEAN 0 CM_T_BOOLEAN 0.0 1.0 /end CHARACTERISTIC
/begin CHARACTERISTIC PORSke_b_P1MtrOk_ov "If PORSke_b_P1MtrOk_ob ==  True
      PORSle_b_P1MtrOk =  This value
      " VALUE 0x0000 /* @ECU_Address@PORSke_b_P1MtrOk_ov@ */ Scalar_BOOLEAN 0 CM_T_BOOLEAN 0.0 1.0 /end CHARACTERISTIC
/begin CHARACTERISTIC PORSke_b_P1RotationalSpeedUnsigned_OB "###Description
      P1rotational speed output overide enable
      ###Calibration
      IF this boolean is set to True(1) the corresponding PORSke_n_P1RotationalSpeedUnsigned_OV will be passed to the output
      ###Usage
      For hardware test purpose only
      
      
      " VALUE 0x0000 /* @ECU_Address@PORSke_b_P1RotationalSpeedUnsigned_OB@ */ Scalar_BOOLEAN 0 CM_T_BOOLEAN 0.0 1.0 /end CHARACTERISTIC
/begin CHARACTERISTIC PORSke_b_P1RotationalSpeedVld_OB "###Description
      P1rotational speed validity output overide enable
      ###Calibration
      IF this boolean is set to True(1) the corresponding PORSke_e_P1RotationalSpeedVld_OV will be passed to the output
      ###Usage
      For hardware test purpose only
      
      " VALUE 0x0000 /* @ECU_Address@PORSke_b_P1RotationalSpeedVld_OB@ */ Scalar_BOOLEAN 0 CM_T_BOOLEAN 0.0 1.0 /end CHARACTERISTIC
/begin CHARACTERISTIC PORSke_b_P1RotationalSpeed_OB "###Description
      P1rotational speed output overide enable
      ###Calibration
      IF this boolean is set to True(1) the corresponding PORSke_n_P1RotationalSpeed_OV will be passed to the output
      ###Usage
      For hardware test purpose only
      
      " VALUE 0x0000 /* @ECU_Address@PORSke_b_P1RotationalSpeed_OB@ */ Scalar_BOOLEAN 0 CM_T_BOOLEAN 0.0 1.0 /end CHARACTERISTIC
/begin CHARACTERISTIC PORSke_k_EngSpdFilterCoeff "Engine speed LP filter coefficient
      
      If this cal is set to 1, filter is disabled.
      Lower value equals more filter effect and more lag
      
      " VALUE 0x0000 /* @ECU_Address@PORSke_k_EngSpdFilterCoeff@ */ Scalar_UBYTE 0 CM_T_K_NA_128_1_u8 0.0 1.0 EXTENDED_LIMITS 0.0 1.9921875 /end CHARACTERISTIC
/begin CHARACTERISTIC PORSke_k_P1MtrSpdFilterCoeff "P1 motorspeed filter coefficient
      
      1  =filter disabled
      <1 =filter active
      
      
      
      " VALUE 0x0000 /* @ECU_Address@PORSke_k_P1MtrSpdFilterCoeff@ */ Scalar_UBYTE 0 CM_T_K_NA_128_1_u8 0.0 1.0 EXTENDED_LIMITS 0.0 1.9921875 /end CHARACTERISTIC
/begin MEASUREMENT PORSve_dn_CalcP1Derivative "P1 rotational speed derivative" SWORD CM_T_dn_rpmps_2_1_s16 0 0 -16384.0 16383.5 ECU_ADDRESS 0x0000 /* @ECU_Address@PORSve_dn_CalcP1Derivative@ */ /end MEASUREMENT
/begin MEASUREMENT PORSve_d2n_CalcP1SecondDerivative "###Description
      P1 second derivative
      
      
      
      " SWORD CM_T_d2n_rpmps2_4_1_s16 0 0 -8192.0 8191.75 ECU_ADDRESS 0x0000 /* @ECU_Address@PORSve_d2n_CalcP1SecondDerivative@ */ /end MEASUREMENT
/begin MEASUREMENT PORSve_dn_CalcP1DerivativeRaw "###Description
      Engien speed derivative unfiltered signal
      
      " SWORD CM_T_K_NA_8_1_s16 0 0 -4096.0 4095.875 ECU_ADDRESS 0x0000 /* @ECU_Address@PORSve_dn_CalcP1DerivativeRaw@ */ /end MEASUREMENT
/begin MEASUREMENT PORSve_n_EngSpd "Filtered engine speed" SWORD CM_T_n_rpm_1_1_s16 0 0 -32000.0 32000.0 ECU_ADDRESS 0x0000 /* @ECU_Address@PORSve_n_EngSpd@ */ /end MEASUREMENT
/begin MEASUREMENT PORSve_n_P1MtrSpd "Filtered P1 motor speed" SWORD CM_T_n_rpm_1_1_s16 0 0 -32000.0 32000.0 ECU_ADDRESS 0x0000 /* @ECU_Address@PORSve_n_P1MtrSpd@ */ /end MEASUREMENT
/begin COMPU_METHOD CM_T_K_NA_128_1_u8 "Q = V*128.000000" RAT_FUNC "%8.7" "NA (dependent upon the gain)" COEFFS 0 128 0 0 0 1 /end COMPU_METHOD
/begin COMPU_METHOD CM_T_n_rpm_1_1_s16 "Q = V" RAT_FUNC "%5.0" "rpm (revolutions / minute  (rpm))" COEFFS 0 1 0 0 0 1 /end COMPU_METHOD
/begin COMPU_METHOD CM_SPARte_e_Validity "Enumerated data type: SPARte_e_Validity" TAB_VERB "%0.6" "" COMPU_TAB_REF VTAB_FOR_CM_SPARte_e_Validity /end COMPU_METHOD
/begin COMPU_VTAB VTAB_FOR_CM_SPARte_e_Validity "Enumerated data type: SPARte_e_Validity" TAB_VERB 4 0 "SPARce_e_Valid" 1 "SPARce_e_Invalid" 2 "SPARce_e_EstimatedReplaceValue" 3 "SPARce_e_NotEvaluatedYet" /end COMPU_VTAB
/begin COMPU_METHOD CM_T_A_m2_1024_1_u32 "Q = V*1024.000000" RAT_FUNC "%17.10" "m2 (square meters  (m2))" COEFFS 0 1024 0 0 0 1 /end COMPU_METHOD
/begin COMPU_METHOD CM_T_dn_rpmps_2_1_s16 "Q = V*2.000000" RAT_FUNC "%6.1" "rpmps (revolutions / minute / second  (rpm/s))" COEFFS 0 2 0 0 0 1 /end COMPU_METHOD
/begin COMPU_METHOD CM_T_d2n_rpmps2_4_1_s16 "Q = V*4.000000" RAT_FUNC "%7.2" "rpmps2 (revolutions / minute / second2  (rpm/s2))" COEFFS 0 4 0 0 0 1 /end COMPU_METHOD
/begin COMPU_METHOD CM_T_t_s_100_1_s16 "Q = V*100.000000" RAT_FUNC "%0.6" "s (seconds  (s))" COEFFS 0 100 0 0 0 1 /end COMPU_METHOD
/begin COMPU_METHOD CM_T_Cnt_Num_1_1_u8 "Q = V" RAT_FUNC "%3.0" "Num (counts)" COEFFS 0 1 0 0 0 1 /end COMPU_METHOD
/begin COMPU_METHOD CM_T_BOOLEAN "Q = V" RAT_FUNC "%1.0" "Bool" COEFFS 0 1 0 0 0 1 /end COMPU_METHOD
/begin COMPU_METHOD CM_T_K_NA_8_1_s16 "Q = V*8.000000" RAT_FUNC "%7.3" "NA (dependent upon the gain)" COEFFS 0 8 0 0 0 1 /end COMPU_METHOD
/* EOF PORS.a2l */
/begin RECORD_LAYOUT DATA_RECORD_UBYTE FNC_VALUES 1 UBYTE ROW_DIR DIRECT /end RECORD_LAYOUT
/begin CHARACTERISTIC CLPCke_b_CAPM_CommandDBC_Enable "..." VALUE 0x80058BC5 DATA_RECORD_UBYTE 1 Bool_ON_OFF 0 1 BIT_MASK 0x01 /end CHARACTERISTIC
/begin CHARACTERISTIC FDMAie_b_ForceEngineStop_ob "..." VALUE 0x800590A1 DATA_RECORD_UBYTE 1 Bool_ON_OFF 0 1 BIT_MASK 0x01 /end CHARACTERISTIC
/begin CHARACTERISTIC FDMAie_b_ForceEngineStop_ov "..." VALUE 0x800590A0 DATA_RECORD_UBYTE 1 Bool_ON_OFF 0 1 BIT_MASK 0x01 /end CHARACTERISTIC
/begin CHARACTERISTIC FDMAie_b_ForceNeutralGear_ob "..." VALUE 0x8005907B DATA_RECORD_UBYTE 1 Bool_ON_OFF 0 1 BIT_MASK 0x01 /end CHARACTERISTIC
/begin CHARACTERISTIC FDMAie_b_ForceNeutralGear_ov "..." VALUE 0x8005907A DATA_RECORD_UBYTE 1 Bool_ON_OFF 0 1 BIT_MASK 0x01 /end CHARACTERISTIC
/begin MEASUREMENT CANDve_Cnt_DiagCounts "..." UWORD F_1_p0_4 1 2 0 65535 ECU_ADDRESS 0x700212C0 /end MEASUREMENT
/begin MEASUREMENT CANDve_Cnt_DiagFails "..." UWORD F_1_p0_4 1 2 0 65535 ECU_ADDRESS 0x700212BE /end MEASUREMENT
/begin MEASUREMENT CANDve_y_ID_Status "..." UBYTE I_1 1 2 0 255 ECU_ADDRESS 0x700212BD /end MEASUREMENT
/begin MEASUREMENT CANDve_y_Progress "..." UBYTE I_1 1 2 0 255 ECU_ADDRESS 0x700212BC /end MEASUREMENT
/begin MEASUREMENT CANDve_y_VCUFAULT_DiagCounts "..." UWORD F_1_p0_4 1 2 0 65535 ECU_ADDRESS 0x700212BA /end MEASUREMENT
/begin MEASUREMENT CANDve_y_VCUFAULT_DiagFails "..." UWORD F_1_p0_4 1 2 0 65535 ECU_ADDRESS 0x700212B8 /end MEASUREMENT
/begin MEASUREMENT CANDve_y_VCUFAULT_Progress "..." UBYTE I_1 1 2 0 255 ECU_ADDRESS 0x700212B7 /end MEASUREMENT
/begin MEASUREMENT CANDve_y_VCUFAULT_Status "..." UBYTE I_1 1 2 0 255 ECU_ADDRESS 0x700212B6 /end MEASUREMENT
/begin MEASUREMENT CLPCve_Pct_CAPMPS_DC_Actual "..." SWORD F_0v1_p0_2 1 2 -3276.8 3276.7 ECU_ADDRESS 0x70001E90 /end MEASUREMENT
/begin MEASUREMENT CLPCve_Pct_C_Pct_CAP_Data "..." SWORD F_0v1_p0_2 1 2 -3276.8 3276.7 ECU_ADDRESS 0x700212B4 /end MEASUREMENT
/begin MEASUREMENT CLPCve_b_KneePoint_FirstDone "..." UBYTE Bool_ON_OFF 1 2 0 1 BIT_MASK 0x01 ECU_ADDRESS 0x700212B2 /end MEASUREMENT
/begin MEASUREMENT CLPCve_b_NewKissPointAdaptionPointFound "..." UBYTE Bool_ON_OFF 1 2 0 1 BIT_MASK 0x01 ECU_ADDRESS 0x700212B1 /end MEASUREMENT
/begin MEASUREMENT CLPCve_e_CAP_DID_Enabled "..." UBYTE I_1 1 2 0 255 ECU_ADDRESS 0x700212B0 /end MEASUREMENT
/begin MEASUREMENT CLPCve_n_C_n_CAP_Data "..." SWORD F_1_p0_4 1 2 -32768 32767 ECU_ADDRESS 0x700212AE /end MEASUREMENT
/begin MEASUREMENT CLPCve_p_C_p_CAP_Data "..." UWORD F_1_p0_4 1 2 0 65535 ECU_ADDRESS 0x700212AC /end MEASUREMENT
/begin MEASUREMENT CLPCve_p_KneePoint_Stored "..." SWORD F_0v15625_p0_18 1 2 -5120 5119.84375 ECU_ADDRESS 0x700212AA /end MEASUREMENT
/begin MEASUREMENT CLPCve_r_CAP_Y "..." UWORD F_0v0000305176_p0_19 1 2 0 1.999969482 ECU_ADDRESS 0x70001E20 /end MEASUREMENT
/begin COMPU_METHOD I_1 "" RAT_FUNC "%9.2" "-" COEFFS 0 1 0 0 0 1 /end COMPU_METHOD
/begin COMPU_METHOD F_0v1_p0_2 "" RAT_FUNC "%9.2" "-" COEFFS 0 1 0 0 0 0.1 /end COMPU_METHOD
/begin COMPU_METHOD F_1_p0_4 "" RAT_FUNC "%9.2" "-" COEFFS 0 1 0 0 0 1 /end COMPU_METHOD
/begin COMPU_METHOD F_0v15625_p0_18 "" RAT_FUNC "%9.2" "-" COEFFS 0 1 0 0 0 0.15625 /end COMPU_METHOD
/begin COMPU_METHOD F_0v0000305176_p0_19 "" RAT_FUNC "%9.5" "-" COEFFS 0 1 0 0 0 3.05176e-005 /end COMPU_METHOD
/begin COMPU_METHOD Bool_ON_OFF "" TAB_VERB "%8.4" "." COMPU_TAB_REF Bool_ON_OFF_table /end COMPU_METHOD
/begin COMPU_VTAB Bool_ON_OFF_table "" TAB_VERB 2 0 "OFF" 1 "ON" /end COMPU_VTAB
/begin RECORD_LAYOUT Scalar_BOOLEAN FNC_VALUES 1 UBYTE COLUMN_DIR DIRECT /end RECORD_LAYOUT
/begin RECORD_LAYOUT Scalar_UBYTE FNC_VALUES 1 UBYTE COLUMN_DIR DIRECT /end RECORD_LAYOUT
/begin RECORD_LAYOUT Scalar_UWORD FNC_VALUES 1 UWORD COLUMN_DIR DIRECT /end RECORD_LAYOUT
/begin RECORD_LAYOUT Scalar_SWORD FNC_VALUES 1 SWORD COLUMN_DIR DIRECT /end RECORD_LAYOUT
/begin RECORD_LAYOUT Scalar_ULONG FNC_VALUES 1 ULONG COLUMN_DIR DIRECT /end RECORD_LAYOUT
/begin RECORD_LAYOUT Scalar_FLOAT32_IEEE FNC_VALUES 1 FLOAT32_IEEE COLUMN_DIR DIRECT /end RECORD_LAYOUT
/begin RECORD_LAYOUT Lookup1D_UBYTE FNC_VALUES 1 UBYTE COLUMN_DIR DIRECT /end RECORD_LAYOUT
/begin RECORD_LAYOUT Lookup1D_UWORD FNC_VALUES 1 UWORD COLUMN_DIR DIRECT /end RECORD_LAYOUT
/begin RECORD_LAYOUT Lookup1D_WORD FNC_VALUES 1 SWORD COLUMN_DIR DIRECT /end RECORD_LAYOUT
/begin RECORD_LAYOUT Lookup1D_X_WORD AXIS_PTS_X 1 SWORD INDEX_INCR DIRECT /end RECORD_LAYOUT
/begin RECORD_LAYOUT Lookup2D_UBYTE FNC_VALUES 1 UBYTE COLUMN_DIR DIRECT /end RECORD_LAYOUT
/begin RECORD_LAYOUT Lookup2D_X_UBYTE AXIS_PTS_X 1 UBYTE INDEX_INCR DIRECT /end RECORD_LAYOUT
/begin RECORD_LAYOUT Lookup2D_BYTE FNC_VALUES 1 SBYTE COLUMN_DIR DIRECT /end RECORD_LAYOUT
/begin RECORD_LAYOUT Lookup2D_X_BYTE AXIS_PTS_X 1 SBYTE INDEX_INCR DIRECT /end RECORD_LAYOUT
/begin RECORD_LAYOUT Lookup2D_ULONG FNC_VALUES 1 ULONG COLUMN_DIR DIRECT /end RECORD_LAYOUT
/begin RECORD_LAYOUT Lookup2D_X_ULONG AXIS_PTS_X 1 ULONG INDEX_INCR DIRECT /end RECORD_LAYOUT
/begin RECORD_LAYOUT Lookup2D_LONG FNC_VALUES 1 SLONG COLUMN_DIR DIRECT /end RECORD_LAYOUT
/begin RECORD_LAYOUT Lookup2D_X_LONG AXIS_PTS_X 1 SLONG INDEX_INCR DIRECT /end RECORD_LAYOUT
/begin RECORD_LAYOUT Lookup2D_FLOAT32_IEEE FNC_VALUES 1 FLOAT32_IEEE COLUMN_DIR DIRECT /end RECORD_LAYOUT
/begin RECORD_LAYOUT Lookup2D_X_FLOAT32_IEEE AXIS_PTS_X 1 FLOAT32_IEEE INDEX_INCR DIRECT /end RECORD_LAYOUT
/begin RECORD_LAYOUT Lookup2D_FLOAT64_IEEE FNC_VALUES 1 FLOAT64_IEEE COLUMN_DIR DIRECT /end RECORD_LAYOUT
/begin RECORD_LAYOUT Lookup2D_X_FLOAT64_IEEE AXIS_PTS_X 1 FLOAT64_IEEE INDEX_INCR DIRECT /end RECORD_LAYOUT
/begin CHARACTERISTIC SWINke_e_ClutchState0 "Calibratable value for GSEQve_e_OddClutchStateReq for value recieved from VCU_ClutchCommand raw value 0" VALUE 0x0000 /* @ECU_Address@SWINke_e_ClutchState0@ */ Scalar_UBYTE 0 CM_CLCOte_e_ActualClutchState 0 5 EXTENDED_LIMITS 0 0 /end CHARACTERISTIC
/begin CHARACTERISTIC SWINke_e_ClutchState1 "Calibratable value for GSEQve_e_OddClutchStateReq for value recieved from VCU_ClutchCommand raw value 1" VALUE 0x0000 /* @ECU_Address@SWINke_e_ClutchState1@ */ Scalar_UBYTE 0 CM_CLCOte_e_ActualClutchState 0 5 EXTENDED_LIMITS 0 0 /end CHARACTERISTIC
/begin CHARACTERISTIC SWINke_e_ClutchState2 "Calibratable value for GSEQve_e_OddClutchStateReq for value recieved from VCU_ClutchCommand raw value 2" VALUE 0x0000 /* @ECU_Address@SWINke_e_ClutchState2@ */ Scalar_UBYTE 0 CM_CLCOte_e_ActualClutchState 0 5 EXTENDED_LIMITS 0 0 /end CHARACTERISTIC
/begin CHARACTERISTIC SWINke_e_ClutchState3 "Calibratable value for GSEQve_e_OddClutchStateReq for value recieved from VCU_ClutchCommand raw value 3" VALUE 0x0000 /* @ECU_Address@SWINke_e_ClutchState3@ */ Scalar_UBYTE 0 CM_CLCOte_e_ActualClutchState 0 5 EXTENDED_LIMITS 0 0 /end CHARACTERISTIC
/begin CHARACTERISTIC SWINke_e_ClutchState4 "Calibratable value for GSEQve_e_OddClutchStateReq for value recieved from VCU_ClutchCommand raw value 4" VALUE 0x0000 /* @ECU_Address@SWINke_e_ClutchState4@ */ Scalar_UBYTE 0 CM_CLCOte_e_ActualClutchState 0 5 EXTENDED_LIMITS 0 0 /end CHARACTERISTIC
/begin CHARACTERISTIC SWINke_e_ClutchState5 "Calibratable value for GSEQve_e_OddClutchStateReq for value recieved from VCU_ClutchCommand raw value 5" VALUE 0x0000 /* @ECU_Address@SWINke_e_ClutchState5@ */ Scalar_UBYTE 0 CM_CLCOte_e_ActualClutchState 0 5 EXTENDED_LIMITS 0 0 /end CHARACTERISTIC
/begin CHARACTERISTIC SWINke_e_ClutchState6 "Calibratable value for GSEQve_e_OddClutchStateReq for value recieved from VCU_ClutchCommand raw value 6" VALUE 0x0000 /* @ECU_Address@SWINke_e_ClutchState6@ */ Scalar_UBYTE 0 CM_CLCOte_e_ActualClutchState 0 5 EXTENDED_LIMITS 0 0 /end CHARACTERISTIC
/begin CHARACTERISTIC SWINke_e_ClutchState7 "Calibratable value for GSEQve_e_OddClutchStateReq for value recieved from VCU_ClutchCommand raw value 7" VALUE 0x0000 /* @ECU_Address@SWINke_e_ClutchState7@ */ Scalar_UBYTE 0 CM_CLCOte_e_ActualClutchState 0 5 EXTENDED_LIMITS 0 0 /end CHARACTERISTIC
/begin CHARACTERISTIC SWINke_e_DRSPve_e_RangeSelPos "Stubbed parameter output to signal DRSPve_e_RangeSelPos." VALUE 0x0000 /* @ECU_Address@SWINke_e_DRSPve_e_RangeSelPos@ */ Scalar_UBYTE 0 CM_DRSPte_e_RangeSelPos 0 23 EXTENDED_LIMITS 0 0 /end CHARACTERISTIC
/begin CHARACTERISTIC SWINke_n_MinClutchSpdForGearEngagementAvailable "Minimum clutch (secondary side) speed for still indicating GearAvailable" VALUE 0x0000 /* @ECU_Address@SWINke_n_MinClutchSpdForGearEngagementAvailable@ */ Scalar_SWORD 0 CM_T_n_rpm_1_1_s16 -32768 32767 /end CHARACTERISTIC
/begin CHARACTERISTIC SWINke_Cnt_GearEngagementAvailableTurnBackOnDelay "Delay for indicating GearAvailable again after being disabled,in counts of 10ms sample time" VALUE 0x0000 /* @ECU_Address@SWINke_Cnt_GearEngagementAvailableTurnBackOnDelay@ */ Scalar_UWORD 0 CM_T_Cnt_Num_1_1_u16 0 65535 /end CHARACTERISTIC
/begin CHARACTERISTIC SWINke_Cnt_GearNotAvailableAfterUse "Delay for allowing GearEngagement again after opening of clutch,in counts of 10ms sample time" VALUE 0x0000 /* @ECU_Address@SWINke_Cnt_GearNotAvailableAfterUse@ */ Scalar_UWORD 0 CM_T_Cnt_Num_1_1_u16 0 65535 /end CHARACTERISTIC
/begin CHARACTERISTIC SWINke_Cnt_MaxVehicleSpeedAfterRun "This specifies the maximum afterrun due to vehicle speed above limit, in counts of sample time (10ms), if set to maximum value 65535 then theres no time limit" VALUE 0x0000 /* @ECU_Address@SWINke_Cnt_MaxVehicleSpeedAfterRun@ */ Scalar_UWORD 0 CM_T_Cnt_Num_1_1_u16 0 65535 /end CHARACTERISTIC
/begin CHARACTERISTIC SWINke_Cnt_VehicleSpeedAfterRunAfterBelowLim "This specifies the afterrun time after vehicle speed has gone below limit, in counts of sample time (10ms), if set to maximum value 65535 then theres no time limit" VALUE 0x0000 /* @ECU_Address@SWINke_Cnt_VehicleSpeedAfterRunAfterBelowLim@ */ Scalar_UWORD 0 CM_T_Cnt_Num_1_1_u16 0 65535 /end CHARACTERISTIC
/begin CHARACTERISTIC SWINke_Cnt_VehicleSpeedAfterRunDeadSignal "This specifies the time for considering the vehicle speed signal as dead, i.e. have had the exact same value for this long, in counts of sample time (10ms), if set to maximum value 65535 then theres no time limit. CANE, framevalidity interface doesn'tprovide any information when node has stopped sending after key-off" VALUE 0x0000 /* @ECU_Address@SWINke_Cnt_VehicleSpeedAfterRunDeadSignal@ */ Scalar_UWORD 0 CM_T_Cnt_Num_1_1_u16 0 65535 /end CHARACTERISTIC
/begin CHARACTERISTIC SWINke_dV_LubeFlow "Stubbed parameter output to signal LMSCve_dV_LubeFlow." VALUE 0x0000 /* @ECU_Address@SWINke_dV_LubeFlow@ */ Scalar_SWORD 0 CM_T_dV_lpm_128_1_s16 -256.0 255.9921875 /end CHARACTERISTIC
/begin CHARACTERISTIC SWINke_p_CrankingAuthorizationMax "Maximum pressure for allowing Cranking, actual pressure needs to be below this value as well as below kisspoint" VALUE 0x0000 /* @ECU_Address@SWINke_p_CrankingAuthorizationMax@ */ Scalar_UWORD 0 CM_T_p_kPa_32_1_u16 0 2047.96875 /end CHARACTERISTIC
/begin CHARACTERISTIC SWINke_M_ClutchAvailableMaximumMax "Maximum possible clutch max torque" VALUE 0x0000 /* @ECU_Address@SWINke_M_ClutchAvailableMaximumMax@ */ Scalar_SWORD 0 CM_T_M_Nm_32_1_s16 0.0 1023.96875 EXTENDED_LIMITS -1024.0 1023.96875 /end CHARACTERISTIC
/begin CHARACTERISTIC SWINke_M_ClutchAvailableMinimumMax "Minimum possible clutch max torque (positive value)" VALUE 0x0000 /* @ECU_Address@SWINke_M_ClutchAvailableMinimumMax@ */ Scalar_SWORD 0 CM_T_M_Nm_32_1_s16 0.0 1023.96875 EXTENDED_LIMITS -1024.0 1023.96875 /end CHARACTERISTIC
/begin CHARACTERISTIC SWINke_M_MinTorqCapacityForGearEngagementAvailable "Minimum available clutch transfer torque for indication of gear available" VALUE 0x0000 /* @ECU_Address@SWINke_M_MinTorqCapacityForGearEngagementAvailable@ */ Scalar_SWORD 0 CM_T_M_Nm_32_1_s16 -1024.0 1023.96875 /end CHARACTERISTIC
/begin CHARACTERISTIC SWINke_M_TTSSke_M_P1MinTrqImmd "Stubbed parameter output to signal TTSSve_M_P1MinTrqImmd." VALUE 0x0000 /* @ECU_Address@SWINke_M_TTSSke_M_P1MinTrqImmd@ */ Scalar_SWORD 0 CM_T_M_Nm_32_1_s16 -1024.0 1023.96875 /end CHARACTERISTIC
/begin CHARACTERISTIC SWINke_M_TTSSve_M_P1MaxTrqImmd "Stubbed parameter output to signal TTSSve_M_P1MaxTrqImmd." VALUE 0x0000 /* @ECU_Address@SWINke_M_TTSSve_M_P1MaxTrqImmd@ */ Scalar_SWORD 0 CM_T_M_Nm_32_1_s16 -1024.0 1023.96875 /end CHARACTERISTIC
/begin CHARACTERISTIC SWINke_T_MaxCAP_PS_ForGearEngagementAvailable "Maximum CAP PowerStage temp for still indicating GearAvailable" VALUE 0x0000 /* @ECU_Address@SWINke_T_MaxCAP_PS_ForGearEngagementAvailable@ */ Scalar_SWORD 0 CM_T_T_degC_16_1_s16 -2048.0 2047.9375 /end CHARACTERISTIC
/begin CHARACTERISTIC SWINke_T_MinOilForGearEngagementAvailable "Minimum oil temp for still indicating GearAvailable" VALUE 0x0000 /* @ECU_Address@SWINke_T_MinOilForGearEngagementAvailable@ */ Scalar_SWORD 0 CM_T_T_degC_16_1_s16 -2048.0 2047.9375 /end CHARACTERISTIC
/begin CHARACTERISTIC SWINke_U_MinSystemForGearEngagementAvailable "Minimum System Voltage for still indicating GearAvailable" VALUE 0x0000 /* @ECU_Address@SWINke_U_MinSystemForGearEngagementAvailable@ */ Scalar_SWORD 0 CM_T_U_V_512_1_s16 -64.0 63.998046875 /end CHARACTERISTIC
/begin CHARACTERISTIC SWINke_v_VehicleSpeedAfterRunLim "Limit for vehicle speed after run, if absolute vehicle speed is above this limit then after run due to vehicle speed is held" VALUE 0x0000 /* @ECU_Address@SWINke_v_VehicleSpeedAfterRunLim@ */ Scalar_SWORD 0 CM_T_v_kph_64_1_s16 0.0 511.984375 EXTENDED_LIMITS -512.0 511.984375 /end CHARACTERISTIC
/begin CHARACTERISTIC SWINke_l_WheelRadius "Stubbed parameter output to signal SPARve_l_WheelRadius." VALUE 0x0000 /* @ECU_Address@SWINke_l_WheelRadius@ */ Scalar_SWORD 0 CM_T_l_m_1024_1_s16 -32.0 31.9990234375 /end CHARACTERISTIC
/begin CHARACTERISTIC SWINke_r_P1TransInput "Stubbed parameter output to signal SWINve_r_P1TransInput." VALUE 0x0000 /* @ECU_Address@SWINke_r_P1TransInput@ */ Scalar_SWORD 0 CM_T_r_NA_1024_1_s16 -32.0 31.9990234375 /end CHARACTERISTIC
/begin CHARACTERISTIC SWINke_r_SPARke_r_P1Trans1stGearRatio "Stubbed parameter output to signal SPARve_r_P1Trans1stGearRatio." VALUE 0x0000 /* @ECU_Address@SWINke_r_SPARke_r_P1Trans1stGearRatio@ */ Scalar_SWORD 0 CM_T_r_NA_1024_1_s16 -32.0 31.9990234375 /end CHARACTERISTIC
/begin CHARACTERISTIC SWINke_r_SPARke_r_P1Trans2ndGearRatio "Stubbed parameter output to signal SPARve_r_P1Trans2ndGearRatio." VALUE 0x0000 /* @ECU_Address@SWINke_r_SPARke_r_P1Trans2ndGearRatio@ */ Scalar_SWORD 0 CM_T_r_NA_1024_1_s16 -32.0 31.9990234375 /end CHARACTERISTIC
/begin CHARACTERISTIC SWINke_r_SPARke_r_P3TransDM_Ratio "Stubbed parameter output to signal SPARve_r_P3TransDM_Ratio." VALUE 0x0000 /* @ECU_Address@SWINke_r_SPARke_r_P3TransDM_Ratio@ */ Scalar_SWORD 0 CM_T_r_NA_1024_1_s16 -32.0 31.9990234375 /end CHARACTERISTIC
/begin CHARACTERISTIC SWINke_r_SPARke_r_TransFnlDrvRatio "Stubbed parameter output to signal SPARve_r_TransFnlDrvRatio." VALUE 0x0000 /* @ECU_Address@SWINke_r_SPARke_r_TransFnlDrvRatio@ */ Scalar_SWORD 0 CM_T_r_NA_1024_1_s16 -32.0 31.9990234375 /end CHARACTERISTIC
/begin CHARACTERISTIC SWINke_r_SPARve_r_P1MtrRatio "Stubbed parameter output to signal SPARve_r_P1MtrRatio." VALUE 0x0000 /* @ECU_Address@SWINke_r_SPARve_r_P1MtrRatio@ */ Scalar_SWORD 0 CM_T_r_NA_1024_1_s16 -32.0 31.9990234375 /end CHARACTERISTIC
/begin CHARACTERISTIC SWINie_b_GearAvailable_OB "Override enable for indicating GearAvailable" VALUE 0x0000 /* @ECU_Address@SWINie_b_GearAvailable_OB@ */ Scalar_BOOLEAN 0 CM_T_BOOLEAN 0.0 1.0 /end CHARACTERISTIC
/begin CHARACTERISTIC SWINie_b_GearAvailable_OV "Override value for indicating GearAvailable" VALUE 0x0000 /* @ECU_Address@SWINie_b_GearAvailable_OV@ */ Scalar_BOOLEAN 0 CM_T_BOOLEAN 0.0 1.0 /end CHARACTERISTIC
/begin CHARACTERISTIC SWINke_b_ClutchAvailableMinimumPositiveValue "This sets if the ClutchAvailableMinimumTorque shall be indicated in positive value, otherwise negative value is used." VALUE 0x0000 /* @ECU_Address@SWINke_b_ClutchAvailableMinimumPositiveValue@ */ Scalar_BOOLEAN 0 CM_T_BOOLEAN 0.0 1.0 /end CHARACTERISTIC
/begin CHARACTERISTIC SWINke_b_GearNotAvailableAfterUse "This enables not allowing gear engagement for a calibratable time (SWINke_Cnt_GearEngagementAvailableTurnBackOnDelay) after opening of clutch" VALUE 0x0000 /* @ECU_Address@SWINke_b_GearNotAvailableAfterUse@ */ Scalar_BOOLEAN 0 CM_T_BOOLEAN 0.0 1.0 /end CHARACTERISTIC
/begin CHARACTERISTIC SWINke_b_TTSSve_b_P1TrqLimReq "Stubbed parameter output to signal TTSSve_b_P1TrqLimReq." VALUE 0x0000 /* @ECU_Address@SWINke_b_TTSSve_b_P1TrqLimReq@ */ Scalar_BOOLEAN 0 CM_T_BOOLEAN 0.0 1.0 /end CHARACTERISTIC
/begin COMPU_METHOD CM_CLCOte_e_ActualClutchState "Enumerated data type: CLCOte_e_ActualClutchState" TAB_VERB "%0.6" "" COMPU_TAB_REF VTAB_FOR_CM_CLCOte_e_ActualClutchState /end COMPU_METHOD
/begin COMPU_VTAB VTAB_FOR_CM_CLCOte_e_ActualClutchState "Enumerated data type: CLCOte_e_ActualClutchState" TAB_VERB 6 0 "CLCOce_e_ClutchNeutral" 1 "CLCOce_e_ClutchDisengage" 2 "CLCOce_e_ClutchInGear" 3 "CLCOce_e_ClutchPrepare" 4 "CLCOce_e_ClutchTrqMode" 5 "CLCOce_e_ClutchSpdMode" /end COMPU_VTAB
/begin COMPU_METHOD CM_DRSPte_e_RangeSelPos "Enumerated data type: DRSPte_e_RangeSelPos" TAB_VERB "%0.6" "" COMPU_TAB_REF VTAB_FOR_CM_DRSPte_e_RangeSelPos /end COMPU_METHOD
/begin COMPU_VTAB VTAB_FOR_CM_DRSPte_e_RangeSelPos "Enumerated data type: DRSPte_e_RangeSelPos" TAB_VERB 9 0 "DRSPce_e_Undefined" 3 "DRSPce_e_Park" 5 "DRSPce_e_Reverse" 6 "DRSPce_e_Neutral" 9 "DRSPce_e_Drive" 10 "DRSPce_e_Manual" 12 "DRSPce_e_Drive1" 20 "DRSPce_e_ManualTapUp" 23 "DRSPce_e_ManualTapDown" /end COMPU_VTAB
/begin COMPU_METHOD CM_T_n_rpm_1_1_s16 "Q = V" RAT_FUNC "%5.0" "rpm (revolutions / minute  (rpm))" COEFFS 0 1 0 0 0 1 /end COMPU_METHOD
/begin COMPU_METHOD CM_T_Cnt_Num_1_1_u16 "Q = V" RAT_FUNC "%5.0" "Num (counts)" COEFFS 0 1 0 0 0 1 /end COMPU_METHOD
/begin COMPU_METHOD CM_T_dV_lpm_128_1_s16 "Q = V*128.000000" RAT_FUNC "%10.7" "lpm (liters / minute  (l/m))" COEFFS 0 128 0 0 0 1 /end COMPU_METHOD
/begin COMPU_METHOD CM_T_p_kPa_32_1_u16 "Q = V*32.000000" RAT_FUNC "%9.5" "kPa (kiloPascals  (kPa))" COEFFS 0 32 0 0 0 1 /end COMPU_METHOD
/begin COMPU_METHOD CM_T_M_Nm_32_1_s16 "Q = V*32.000000" RAT_FUNC "%9.5" "Nm (newton-meters  (Nm))" COEFFS 0 32 0 0 0 1 /end COMPU_METHOD
/begin COMPU_METHOD CM_T_T_degC_16_1_s16 "Q = V*16.000000" RAT_FUNC "%8.4" "degC (degrees Celsius  (deg C))" COEFFS 0 16 0 0 0 1 /end COMPU_METHOD
/begin COMPU_METHOD CM_T_U_V_512_1_s16 "Q = V*512.000000" RAT_FUNC "%12.9" "V (volts  (V))" COEFFS 0 512 0 0 0 1 /end COMPU_METHOD
/begin COMPU_METHOD CM_T_v_kph_64_1_s16 "Q = V*64.000000" RAT_FUNC "%10.6" "kph (kilometers / hour  (kph))" COEFFS 0 64 0 0 0 1 /end COMPU_METHOD
/begin COMPU_METHOD CM_T_l_m_1024_1_s16 "Q = V*1024.000000" RAT_FUNC "%12.10" "m (meters  (m))" COEFFS 0 1024 0 0 0 1 /end COMPU_METHOD
/begin COMPU_METHOD CM_T_r_NA_1024_1_s16 "Q = V*1024.000000" RAT_FUNC "%12.10" "NA (none)" COEFFS 0 1024 0 0 0 1 /end COMPU_METHOD
/begin COMPU_METHOD CM_T_BOOLEAN "Q = V" RAT_FUNC "%1.0" "Bool" COEFFS 0 1 0 0 0 1 /end COMPU_METHOD
/* EOF SWIN.a2l */
/begin RECORD_LAYOUT Scalar_BOOLEAN FNC_VALUES 1 UBYTE COLUMN_DIR DIRECT /end RECORD_LAYOUT
/begin RECORD_LAYOUT Scalar_UBYTE FNC_VALUES 1 UBYTE COLUMN_DIR DIRECT /end RECORD_LAYOUT
/begin RECORD_LAYOUT Scalar_BYTE FNC_VALUES 1 SBYTE COLUMN_DIR DIRECT /end RECORD_LAYOUT
/begin RECORD_LAYOUT Scalar_UWORD FNC_VALUES 1 UWORD COLUMN_DIR DIRECT /end RECORD_LAYOUT
/begin RECORD_LAYOUT Scalar_SWORD FNC_VALUES 1 SWORD COLUMN_DIR DIRECT /end RECORD_LAYOUT
/begin RECORD_LAYOUT Scalar_ULONG FNC_VALUES 1 ULONG COLUMN_DIR DIRECT /end RECORD_LAYOUT
/begin RECORD_LAYOUT Scalar_LONG FNC_VALUES 1 SLONG COLUMN_DIR DIRECT /end RECORD_LAYOUT
/begin RECORD_LAYOUT Scalar_FLOAT32_IEEE FNC_VALUES 1 FLOAT32_IEEE COLUMN_DIR DIRECT /end RECORD_LAYOUT
/begin RECORD_LAYOUT Scalar_FLOAT64_IEEE FNC_VALUES 1 FLOAT64_IEEE COLUMN_DIR DIRECT /end RECORD_LAYOUT
/begin RECORD_LAYOUT Lookup1D_BYTE FNC_VALUES 1 SBYTE COLUMN_DIR DIRECT /end RECORD_LAYOUT
/begin RECORD_LAYOUT Lookup1D_X_BYTE AXIS_PTS_X 1 SBYTE INDEX_INCR DIRECT /end RECORD_LAYOUT
/begin RECORD_LAYOUT Lookup1D_UBYTE FNC_VALUES 1 UBYTE COLUMN_DIR DIRECT /end RECORD_LAYOUT
/begin RECORD_LAYOUT Lookup1D_X_UBYTE AXIS_PTS_X 1 UBYTE INDEX_INCR DIRECT /end RECORD_LAYOUT
/begin RECORD_LAYOUT Lookup1D_UWORD FNC_VALUES 1 UWORD COLUMN_DIR DIRECT /end RECORD_LAYOUT
/begin RECORD_LAYOUT Lookup1D_WORD FNC_VALUES 1 SWORD COLUMN_DIR DIRECT /end RECORD_LAYOUT
/begin RECORD_LAYOUT Lookup1D_X_WORD AXIS_PTS_X 1 SWORD INDEX_INCR DIRECT /end RECORD_LAYOUT
/begin RECORD_LAYOUT Lookup1D_ULONG FNC_VALUES 1 ULONG COLUMN_DIR DIRECT /end RECORD_LAYOUT
/begin RECORD_LAYOUT Lookup1D_X_ULONG AXIS_PTS_X 1 ULONG INDEX_INCR DIRECT /end RECORD_LAYOUT
/begin RECORD_LAYOUT Lookup1D_SLONG FNC_VALUES 1 SLONG COLUMN_DIR DIRECT /end RECORD_LAYOUT
/begin RECORD_LAYOUT Lookup1D_X_LONG AXIS_PTS_X 1 SLONG INDEX_INCR DIRECT /end RECORD_LAYOUT
/begin RECORD_LAYOUT Lookup1D_FLOAT32_IEEE FNC_VALUES 1 FLOAT32_IEEE COLUMN_DIR DIRECT /end RECORD_LAYOUT
/begin RECORD_LAYOUT Lookup1D_X_FLOAT32_IEEE AXIS_PTS_X 1 FLOAT32_IEEE INDEX_INCR DIRECT /end RECORD_LAYOUT
/begin RECORD_LAYOUT Lookup1D_FLOAT64_IEEE FNC_VALUES 1 FLOAT64_IEEE COLUMN_DIR DIRECT /end RECORD_LAYOUT
/begin RECORD_LAYOUT Lookup1D_X_FLOAT64_IEEE AXIS_PTS_X 1 FLOAT64_IEEE INDEX_INCR DIRECT /end RECORD_LAYOUT
/begin RECORD_LAYOUT Lookup2D_UBYTE FNC_VALUES 1 UBYTE COLUMN_DIR DIRECT /end RECORD_LAYOUT
/begin RECORD_LAYOUT Lookup2D_X_UBYTE AXIS_PTS_X 1 UBYTE INDEX_INCR DIRECT /end RECORD_LAYOUT
/begin RECORD_LAYOUT Lookup2D_BYTE FNC_VALUES 1 SBYTE COLUMN_DIR DIRECT /end RECORD_LAYOUT
/begin RECORD_LAYOUT Lookup2D_X_BYTE AXIS_PTS_X 1 SBYTE INDEX_INCR DIRECT /end RECORD_LAYOUT
/begin RECORD_LAYOUT Lookup2D_ULONG FNC_VALUES 1 ULONG COLUMN_DIR DIRECT /end RECORD_LAYOUT
/begin RECORD_LAYOUT Lookup2D_X_ULONG AXIS_PTS_X 1 ULONG INDEX_INCR DIRECT /end RECORD_LAYOUT
/begin RECORD_LAYOUT Lookup2D_LONG FNC_VALUES 1 SLONG COLUMN_DIR DIRECT /end RECORD_LAYOUT
/begin RECORD_LAYOUT Lookup2D_X_LONG AXIS_PTS_X 1 SLONG INDEX_INCR DIRECT /end RECORD_LAYOUT
/begin RECORD_LAYOUT Lookup2D_FLOAT32_IEEE FNC_VALUES 1 FLOAT32_IEEE COLUMN_DIR DIRECT /end RECORD_LAYOUT
/begin RECORD_LAYOUT Lookup2D_X_FLOAT32_IEEE AXIS_PTS_X 1 FLOAT32_IEEE INDEX_INCR DIRECT /end RECORD_LAYOUT
/begin RECORD_LAYOUT Lookup2D_FLOAT64_IEEE FNC_VALUES 1 FLOAT64_IEEE COLUMN_DIR DIRECT /end RECORD_LAYOUT
/begin RECORD_LAYOUT Lookup2D_X_FLOAT64_IEEE AXIS_PTS_X 1 FLOAT64_IEEE INDEX_INCR DIRECT /end RECORD_LAYOUT
/begin CHARACTERISTIC TAMDie_T_ClutchActPwrStgTemp_OV "Override value for the motor power stage temperature signal, TAMDve_T_ClutchActPwrStg." VALUE 0x0000 /* @ECU_Address@TAMDie_T_ClutchActPwrStgTemp_OV@ */ Scalar_SWORD 0 CM_T_a_kphps_16_1_s16 -2048.0 2047.9375 /end CHARACTERISTIC
/begin CHARACTERISTIC TAMDke_T_Offset "Sensor offset" VALUE 0x0000 /* @ECU_Address@TAMDke_T_Offset@ */ Scalar_SWORD 0 CM_T_T_degC_16_1_s16 -2048.0 2047.0 EXTENDED_LIMITS -2048.0 2047.9375 /end CHARACTERISTIC
/begin CHARACTERISTIC TAMDie_b_ClutchActPwrStgTemp_OB "Override boolean for the motor power stage temperature signal, TAMDve_T_ClutchActPwrStg." VALUE 0x0000 /* @ECU_Address@TAMDie_b_ClutchActPwrStgTemp_OB@ */ Scalar_BOOLEAN 0 CM_T_BOOLEAN 0 1 /end CHARACTERISTIC
/begin CHARACTERISTIC TAMDie_b_ElecFault_OB "Override boolean for the BSW electrical diagnosis." VALUE 0x0000 /* @ECU_Address@TAMDie_b_ElecFault_OB@ */ Scalar_BOOLEAN 0 CM_T_BOOLEAN 0.0 1.0 /end CHARACTERISTIC
/begin CHARACTERISTIC TAMDie_b_ElecFault_OV "Override value for BSW electrical diagnosis." VALUE 0x0000 /* @ECU_Address@TAMDie_b_ElecFault_OV@ */ Scalar_BOOLEAN 0 CM_T_BOOLEAN 0.0 1.0 /end CHARACTERISTIC
/begin CHARACTERISTIC TAMDie_b_MosElecFault_OB "Override boolean for the BSW mosfet electrical check." VALUE 0x0000 /* @ECU_Address@TAMDie_b_MosElecFault_OB@ */ Scalar_BOOLEAN 0 CM_T_BOOLEAN 0.0 1.0 /end CHARACTERISTIC
/begin CHARACTERISTIC TAMDie_b_MosElecFault_OV "Override value for BSW mosfet electrical diagnosis." VALUE 0x0000 /* @ECU_Address@TAMDie_b_MosElecFault_OV@ */ Scalar_BOOLEAN 0 CM_T_BOOLEAN 0.0 1.0 /end CHARACTERISTIC
/begin CHARACTERISTIC TAMDie_b_Stuck_OB "Override boolean for the BSW BLDC Stuck check." VALUE 0x0000 /* @ECU_Address@TAMDie_b_Stuck_OB@ */ Scalar_BOOLEAN 0 CM_T_BOOLEAN 0.0 1.0 /end CHARACTERISTIC
/begin CHARACTERISTIC TAMDie_b_Stuck_OV "Override value for BSW BLDC Stuck diagnosis." VALUE 0x0000 /* @ECU_Address@TAMDie_b_Stuck_OV@ */ Scalar_BOOLEAN 0 CM_T_BOOLEAN 0.0 1.0 /end CHARACTERISTIC
/begin CHARACTERISTIC TAMDke_b_EC_DiagEnbl "When this is set to TRUE, the electrical checks are executed." VALUE 0x0000 /* @ECU_Address@TAMDke_b_EC_DiagEnbl@ */ Scalar_BOOLEAN 0 CM_T_BOOLEAN 0 1 /end CHARACTERISTIC
/begin CHARACTERISTIC TAMDke_b_EC_MosDiagEnbl "When this is set to TRUE, the mosfet electrical checks are executed." VALUE 0x0000 /* @ECU_Address@TAMDke_b_EC_MosDiagEnbl@ */ Scalar_BOOLEAN 0 CM_T_BOOLEAN 0 1 /end CHARACTERISTIC
/begin CHARACTERISTIC TAMDke_b_EC_StuckDiagEnbl "Stuck Diag Enable" VALUE 0x0000 /* @ECU_Address@TAMDke_b_EC_StuckDiagEnbl@ */ Scalar_BOOLEAN 0 CM_T_BOOLEAN 0 1 /end CHARACTERISTIC
/begin MEASUREMENT TAMDve_n_HWIO_MotorRotSpd "Clutch pump PWM from HWIO to DID3101." SWORD CM_T_n_rpm_1_1_s16 0 0 -32768 32767 ECU_ADDRESS 0x0000 /* @ECU_Address@TAMDve_n_HWIO_MotorRotSpd@ */ /end MEASUREMENT
/begin MEASUREMENT TAMDve_T_ClutchActPwrStg_ "Motor power stage temperature for transmission actuator motor." SWORD CM_T_T_degC_16_1_s16 0 0 -2048.0 2047.9375 ECU_ADDRESS 0x0000 /* @ECU_Address@TAMDve_T_ClutchActPwrStg_@ */ /end MEASUREMENT
/begin MEASUREMENT TAMDve_I_HWIO_MotorCurrent "Clutch pump current from HWIO to DID3101." SWORD CM_T_I_A_32_1_s16 0 0 -1024.0 1023.96875 ECU_ADDRESS 0x0000 /* @ECU_Address@TAMDve_I_HWIO_MotorCurrent@ */ /end MEASUREMENT
/begin MEASUREMENT TAMDve_Pct_HWIO_MotorActPWM "Clutch pump PWM from HWIO." SWORD CM_T_Pct_pct_10_1_s16 0 0 -3276.8 3276.7000000000003 ECU_ADDRESS 0x0000 /* @ECU_Address@TAMDve_Pct_HWIO_MotorActPWM@ */ /end MEASUREMENT
/begin MEASUREMENT TAMDve_y_Status_ "Bundled status for the transmission clutch actuator diagnosis." UBYTE CM_T_y_BitFieldDiagStatus 0 0 0 255 ECU_ADDRESS 0x0000 /* @ECU_Address@TAMDve_y_Status_@ */ /end MEASUREMENT
/begin MEASUREMENT TAMDve_y_BSWDiagStuck "BLDC Stuck" UBYTE CM_T_y_BitField8 0 0 0 255 ECU_ADDRESS 0x0000 /* @ECU_Address@TAMDve_y_BSWDiagStuck@ */ /end MEASUREMENT
/begin MEASUREMENT TAMDve_y_BSWDiagMosHWOverCurrent "GCU hardware over current." UBYTE CM_T_y_BitField8 0 0 0 255 ECU_ADDRESS 0x0000 /* @ECU_Address@TAMDve_y_BSWDiagMosHWOverCurrent@ */ /end MEASUREMENT
/begin MEASUREMENT TAMDve_y_BSWDiagMosOverVolt "BUS voltage of GCU over voltage." UBYTE CM_T_y_BitField8 0 0 0 255 ECU_ADDRESS 0x0000 /* @ECU_Address@TAMDve_y_BSWDiagMosOverVolt@ */ /end MEASUREMENT
/begin MEASUREMENT TAMDve_y_BSWDiagMosShort "GCU mosfet short circuit." UBYTE CM_T_y_BitField8 0 0 0 255 ECU_ADDRESS 0x0000 /* @ECU_Address@TAMDve_y_BSWDiagMosShort@ */ /end MEASUREMENT
/begin MEASUREMENT TAMDve_y_BSWDiagMosShutDown "GCU Driver chip shutdown because temperature is too high." UBYTE CM_T_y_BitField8 0 0 0 255 ECU_ADDRESS 0x0000 /* @ECU_Address@TAMDve_y_BSWDiagMosShutDown@ */ /end MEASUREMENT
/begin MEASUREMENT TAMDve_y_BSWDiagMosSWOverCurrent "GCU software over current." UBYTE CM_T_y_BitField8 0 0 0 255 ECU_ADDRESS 0x0000 /* @ECU_Address@TAMDve_y_BSWDiagMosSWOverCurrent@ */ /end MEASUREMENT
/begin MEASUREMENT TAMDve_y_BSWDiagMosUnderVolt "BUS voltage of GCU under voltage." UBYTE CM_T_y_BitField8 0 0 0 255 ECU_ADDRESS 0x0000 /* @ECU_Address@TAMDve_y_BSWDiagMosUnderVolt@ */ /end MEASUREMENT
/begin MEASUREMENT TAMDve_y_BSWDiagDrvOvrCur "Clutch pump motor driver current too high." UBYTE CM_T_y_BitField8 0 0 0 255 ECU_ADDRESS 0x0000 /* @ECU_Address@TAMDve_y_BSWDiagDrvOvrCur@ */ /end MEASUREMENT
/begin MEASUREMENT TAMDve_y_BSWDiagDrvOvrTemp "Clutch pump power stage temperature high" UBYTE CM_T_y_BitField8 0 0 0 255 ECU_ADDRESS 0x0000 /* @ECU_Address@TAMDve_y_BSWDiagDrvOvrTemp@ */ /end MEASUREMENT
/begin MEASUREMENT TAMDve_y_BSWDiagDrvSupOvrVolt "Clutch pump motor driver supply voltage too high" UBYTE CM_T_y_BitField8 0 0 0 255 ECU_ADDRESS 0x0000 /* @ECU_Address@TAMDve_y_BSWDiagDrvSupOvrVolt@ */ /end MEASUREMENT
/begin MEASUREMENT TAMDve_y_BSWDiagHALUndefFault "Clutch pump HAL sensor fault" UBYTE CM_T_y_BitField8 0 0 0 255 ECU_ADDRESS 0x0000 /* @ECU_Address@TAMDve_y_BSWDiagHALUndefFault@ */ /end MEASUREMENT
/begin MEASUREMENT TAMDve_y_BSWDiagHALSupOvrVolt "Clutch pump HAL sensor supply over voltage" UBYTE CM_T_y_BitField8 0 0 0 255 ECU_ADDRESS 0x0000 /* @ECU_Address@TAMDve_y_BSWDiagHALSupOvrVolt@ */ /end MEASUREMENT
/begin MEASUREMENT TAMDve_y_BSWDiagHALSupUndrVolt "Clutch pump HAL sensor supply under voltage" UBYTE CM_T_y_BitField8 0 0 0 255 ECU_ADDRESS 0x0000 /* @ECU_Address@TAMDve_y_BSWDiagHALSupUndrVolt@ */ /end MEASUREMENT
/begin MEASUREMENT TAMDve_y_BSWDiagPhasePerf "Clutch pump motor phase U-V-W performance" UBYTE CM_T_y_BitField8 0 0 0 255 ECU_ADDRESS 0x0000 /* @ECU_Address@TAMDve_y_BSWDiagPhasePerf@ */ /end MEASUREMENT
/begin MEASUREMENT TAMDve_y_BSWDiagPhaseHigh "Clutch pump motor phase U-V-W short to power" UBYTE CM_T_y_BitField8 0 0 0 255 ECU_ADDRESS 0x0000 /* @ECU_Address@TAMDve_y_BSWDiagPhaseHigh@ */ /end MEASUREMENT
/begin MEASUREMENT TAMDve_y_BSWDiagPhaseLow "Clutch pump motor phase U-V-W short to ground" UBYTE CM_T_y_BitField8 0 0 0 255 ECU_ADDRESS 0x0000 /* @ECU_Address@TAMDve_y_BSWDiagPhaseLow@ */ /end MEASUREMENT
/begin MEASUREMENT TAMDve_y_BSWDiagHALInvalFault "Clutch pump HAL sensor invalid fault from BSW." UBYTE CM_T_y_BitField8 0 0 0 255 ECU_ADDRESS 0x0000 /* @ECU_Address@TAMDve_y_BSWDiagHALInvalFault@ */ /end MEASUREMENT
/begin MEASUREMENT TAMDve_y_BSWDiagHALSigOvrVolt "Clutch pump HAL sensor signal over voltage from BSW." UBYTE CM_T_y_BitField8 0 0 0 255 ECU_ADDRESS 0x0000 /* @ECU_Address@TAMDve_y_BSWDiagHALSigOvrVolt@ */ /end MEASUREMENT
/begin MEASUREMENT TAMDve_y_BSWDiagHALSigUndrVolt "Clutch pump HAL sensor signal under voltage from BSW." UBYTE CM_T_y_BitField8 0 0 0 255 ECU_ADDRESS 0x0000 /* @ECU_Address@TAMDve_y_BSWDiagHALSigUndrVolt@ */ /end MEASUREMENT
/begin MEASUREMENT TAMDve_b_Sutck "whether Stuck " UBYTE CM_T_BOOLEAN 0 0 0 1 ECU_ADDRESS 0x0000 /* @ECU_Address@TAMDve_b_Sutck@ */ /end MEASUREMENT
/begin MEASUREMENT TAMDve_b_EC_StuckDiagEnbl "Stuck Diag Enable" UBYTE CM_T_BOOLEAN 0 0 0 1 ECU_ADDRESS 0x0000 /* @ECU_Address@TAMDve_b_EC_StuckDiagEnbl@ */ /end MEASUREMENT
/begin MEASUREMENT TAMDve_b_MosElecFault "mosfet Electrical diagnostic status from BSW" UBYTE CM_T_BOOLEAN 0 0 0 1 ECU_ADDRESS 0x0000 /* @ECU_Address@TAMDve_b_MosElecFault@ */ /end MEASUREMENT
/begin MEASUREMENT TAMDve_b_EC_MosDiagEnbl "This measurement signal indicates if the enable conditions are fulfilled for the mosfet electrical diagnosis." UBYTE CM_T_BOOLEAN 0 0 0 1 ECU_ADDRESS 0x0000 /* @ECU_Address@TAMDve_b_EC_MosDiagEnbl@ */ /end MEASUREMENT
/begin MEASUREMENT TAMDve_b_ElecFault "Status of the electrical diagnosis from BSW" UBYTE CM_T_BOOLEAN 0 0 0 1 ECU_ADDRESS 0x0000 /* @ECU_Address@TAMDve_b_ElecFault@ */ /end MEASUREMENT
/begin MEASUREMENT TAMDve_b_EC_DiagEnbl "This measurement signal indicates if the enable conditions are fulfilled for the electrical diagnosis." UBYTE CM_T_BOOLEAN 0 0 0 1 ECU_ADDRESS 0x0000 /* @ECU_Address@TAMDve_b_EC_DiagEnbl@ */ /end MEASUREMENT
/begin MEASUREMENT TAMDve_y_EC_StuckStatus "The bundled status of of the electrical checks.
      
      Status bit field:
      Data type: T_y_BitFieldDiagStatus
      Dec:	Status:
      0	STATUS_ALL_OK
      1	STATUS_SAMPLE_FAIL
      2	STATUS_TEST_FAIL
      4	STATUS_TEST_FAIL_THIS_CYCLE
      8	STATUS_TEST_NOT_RUN_THIS_CYCLE
      " UBYTE CM_T_y_BitFieldDiagStatus 0 0 0 255 ECU_ADDRESS 0x0000 /* @ECU_Address@TAMDve_y_EC_StuckStatus@ */ /end MEASUREMENT
/begin MEASUREMENT TAMDve_y_EC_MosStatus "The bundled status of of the electrical checks.
      
      Status bit field:
      Data type: T_y_BitFieldDiagStatus
      Dec:	Status:
      0	STATUS_ALL_OK
      1	STATUS_SAMPLE_FAIL
      2	STATUS_TEST_FAIL
      4	STATUS_TEST_FAIL_THIS_CYCLE
      8	STATUS_TEST_NOT_RUN_THIS_CYCLE
      " UBYTE CM_T_y_BitFieldDiagStatus 0 0 0 255 ECU_ADDRESS 0x0000 /* @ECU_Address@TAMDve_y_EC_MosStatus@ */ /end MEASUREMENT
/begin MEASUREMENT TAMDve_y_EC_Status "The bundled status of of the electrical checks.
      
      Status bit field:
      Data type: T_y_BitFieldDiagStatus
      Dec:	Status:
      0	STATUS_ALL_OK
      1	STATUS_SAMPLE_FAIL
      2	STATUS_TEST_FAIL
      4	STATUS_TEST_FAIL_THIS_CYCLE
      8	STATUS_TEST_NOT_RUN_THIS_CYCLE
      
      " UBYTE CM_T_y_BitFieldDiagStatus 0 0 0 255 ECU_ADDRESS 0x0000 /* @ECU_Address@TAMDve_y_EC_Status@ */ /end MEASUREMENT
/begin COMPU_METHOD CM_T_a_kphps_16_1_s16 "Q = V*16.000000" RAT_FUNC "%8.4" "kphps (kilometers / hour / second  (kph/s))" COEFFS 0 16 0 0 0 1 /end COMPU_METHOD
/begin COMPU_METHOD CM_T_T_degC_16_1_s16 "Q = V*16.000000" RAT_FUNC "%8.4" "degC (degrees Celsius  (deg C))" COEFFS 0 16 0 0 0 1 /end COMPU_METHOD
/begin COMPU_METHOD CM_T_BOOLEAN "Q = V" RAT_FUNC "%1.0" "Bool" COEFFS 0 1 0 0 0 1 /end COMPU_METHOD
/begin COMPU_METHOD CM_T_n_rpm_1_1_s16 "Q = V" RAT_FUNC "%5.0" "rpm (revolutions / minute  (rpm))" COEFFS 0 1 0 0 0 1 /end COMPU_METHOD
/begin COMPU_METHOD CM_T_I_A_32_1_s16 "Q = V*32.000000" RAT_FUNC "%9.5" "A (amperes  (A))" COEFFS 0 32 0 0 0 1 /end COMPU_METHOD
/begin COMPU_METHOD CM_T_Pct_pct_10_1_s16 "Q = V*10.000000" RAT_FUNC "%0.6" "pct (percent  (%))" COEFFS 0 10 0 0 0 1 /end COMPU_METHOD
/begin COMPU_METHOD CM_T_y_BitFieldDiagStatus "Q = V" RAT_FUNC "%3.0" "BitField" COEFFS 0 1 0 0 0 1 /end COMPU_METHOD
/begin COMPU_METHOD CM_T_y_BitField8 "Q = V" RAT_FUNC "%3.0" "BitField" COEFFS 0 1 0 0 0 1 /end COMPU_METHOD
/* EOF TAMD.a2l */
/begin RECORD_LAYOUT Scalar_BOOLEAN FNC_VALUES 1 UBYTE COLUMN_DIR DIRECT /end RECORD_LAYOUT
/begin RECORD_LAYOUT Scalar_UBYTE FNC_VALUES 1 UBYTE COLUMN_DIR DIRECT /end RECORD_LAYOUT
/begin RECORD_LAYOUT Scalar_BYTE FNC_VALUES 1 SBYTE COLUMN_DIR DIRECT /end RECORD_LAYOUT
/begin RECORD_LAYOUT Scalar_UWORD FNC_VALUES 1 UWORD COLUMN_DIR DIRECT /end RECORD_LAYOUT
/begin RECORD_LAYOUT Scalar_SWORD FNC_VALUES 1 SWORD COLUMN_DIR DIRECT /end RECORD_LAYOUT
/begin RECORD_LAYOUT Scalar_ULONG FNC_VALUES 1 ULONG COLUMN_DIR DIRECT /end RECORD_LAYOUT
/begin RECORD_LAYOUT Scalar_LONG FNC_VALUES 1 SLONG COLUMN_DIR DIRECT /end RECORD_LAYOUT
/begin RECORD_LAYOUT Scalar_FLOAT32_IEEE FNC_VALUES 1 FLOAT32_IEEE COLUMN_DIR DIRECT /end RECORD_LAYOUT
/begin RECORD_LAYOUT Scalar_FLOAT64_IEEE FNC_VALUES 1 FLOAT64_IEEE COLUMN_DIR DIRECT /end RECORD_LAYOUT
/begin RECORD_LAYOUT Lookup1D_BYTE FNC_VALUES 1 SBYTE COLUMN_DIR DIRECT /end RECORD_LAYOUT
/begin RECORD_LAYOUT Lookup1D_X_BYTE AXIS_PTS_X 1 SBYTE INDEX_INCR DIRECT /end RECORD_LAYOUT
/begin RECORD_LAYOUT Lookup1D_UBYTE FNC_VALUES 1 UBYTE COLUMN_DIR DIRECT /end RECORD_LAYOUT
/begin RECORD_LAYOUT Lookup1D_X_UBYTE AXIS_PTS_X 1 UBYTE INDEX_INCR DIRECT /end RECORD_LAYOUT
/begin RECORD_LAYOUT Lookup1D_UWORD FNC_VALUES 1 UWORD COLUMN_DIR DIRECT /end RECORD_LAYOUT
/begin RECORD_LAYOUT Lookup1D_WORD FNC_VALUES 1 SWORD COLUMN_DIR DIRECT /end RECORD_LAYOUT
/begin RECORD_LAYOUT Lookup1D_X_WORD AXIS_PTS_X 1 SWORD INDEX_INCR DIRECT /end RECORD_LAYOUT
/begin RECORD_LAYOUT Lookup1D_ULONG FNC_VALUES 1 ULONG COLUMN_DIR DIRECT /end RECORD_LAYOUT
/begin RECORD_LAYOUT Lookup1D_X_ULONG AXIS_PTS_X 1 ULONG INDEX_INCR DIRECT /end RECORD_LAYOUT
/begin RECORD_LAYOUT Lookup1D_SLONG FNC_VALUES 1 SLONG COLUMN_DIR DIRECT /end RECORD_LAYOUT
/begin RECORD_LAYOUT Lookup1D_X_LONG AXIS_PTS_X 1 SLONG INDEX_INCR DIRECT /end RECORD_LAYOUT
/begin RECORD_LAYOUT Lookup1D_FLOAT32_IEEE FNC_VALUES 1 FLOAT32_IEEE COLUMN_DIR DIRECT /end RECORD_LAYOUT
/begin RECORD_LAYOUT Lookup1D_X_FLOAT32_IEEE AXIS_PTS_X 1 FLOAT32_IEEE INDEX_INCR DIRECT /end RECORD_LAYOUT
/begin RECORD_LAYOUT Lookup1D_FLOAT64_IEEE FNC_VALUES 1 FLOAT64_IEEE COLUMN_DIR DIRECT /end RECORD_LAYOUT
/begin RECORD_LAYOUT Lookup1D_X_FLOAT64_IEEE AXIS_PTS_X 1 FLOAT64_IEEE INDEX_INCR DIRECT /end RECORD_LAYOUT
/begin RECORD_LAYOUT Lookup2D_UBYTE FNC_VALUES 1 UBYTE COLUMN_DIR DIRECT /end RECORD_LAYOUT
/begin RECORD_LAYOUT Lookup2D_X_UBYTE AXIS_PTS_X 1 UBYTE INDEX_INCR DIRECT /end RECORD_LAYOUT
/begin RECORD_LAYOUT Lookup2D_BYTE FNC_VALUES 1 SBYTE COLUMN_DIR DIRECT /end RECORD_LAYOUT
/begin RECORD_LAYOUT Lookup2D_X_BYTE AXIS_PTS_X 1 SBYTE INDEX_INCR DIRECT /end RECORD_LAYOUT
/begin RECORD_LAYOUT Lookup2D_ULONG FNC_VALUES 1 ULONG COLUMN_DIR DIRECT /end RECORD_LAYOUT
/begin RECORD_LAYOUT Lookup2D_X_ULONG AXIS_PTS_X 1 ULONG INDEX_INCR DIRECT /end RECORD_LAYOUT
/begin RECORD_LAYOUT Lookup2D_LONG FNC_VALUES 1 SLONG COLUMN_DIR DIRECT /end RECORD_LAYOUT
/begin RECORD_LAYOUT Lookup2D_X_LONG AXIS_PTS_X 1 SLONG INDEX_INCR DIRECT /end RECORD_LAYOUT
/begin RECORD_LAYOUT Lookup2D_FLOAT32_IEEE FNC_VALUES 1 FLOAT32_IEEE COLUMN_DIR DIRECT /end RECORD_LAYOUT
/begin RECORD_LAYOUT Lookup2D_X_FLOAT32_IEEE AXIS_PTS_X 1 FLOAT32_IEEE INDEX_INCR DIRECT /end RECORD_LAYOUT
/begin RECORD_LAYOUT Lookup2D_FLOAT64_IEEE FNC_VALUES 1 FLOAT64_IEEE COLUMN_DIR DIRECT /end RECORD_LAYOUT
/begin RECORD_LAYOUT Lookup2D_X_FLOAT64_IEEE AXIS_PTS_X 1 FLOAT64_IEEE INDEX_INCR DIRECT /end RECORD_LAYOUT
/begin CHARACTERISTIC TCFCkt_n_CoolingMaxDueToTemp "### Description
      This is cooling flow actuator (CCPM) max speed limitation due to oil temperature
      ### Usage
      Set to desired maximum speed as function of temperature
      ### Calibration Note
      
      " CURVE 0x0000 /* @ECU_Address@TCFCkt_n_CoolingMaxDueToTemp@ */ Lookup1D_WORD 0 CM_T_n_rpm_1_1_s16 0.0 32767.0 EXTENDED_LIMITS -32768.0 32767.0
 /begin AXIS_DESCR COM_AXIS TCFCve_T_OilTemp CM_T_T_degC_16_1_s16 16 -40.0 155.0 AXIS_PTS_REF TCFCkn_T_OilTemp /end AXIS_DESCR
/end CHARACTERISTIC
/begin AXIS_PTS TCFCkn_T_OilTemp "### Description
      This is the oil temperature support point axis for cooling flow actuator (CCPM) max speed limitation due to oil temperature
      ### Usage
      Set to desired oil temperature support points
      ### Calibration Note
      
      " 0x0000 /* @ECU_Address@TCFCkn_T_OilTemp@ */ TCFCve_T_OilTemp Lookup1D_X_WORD 0 CM_T_T_degC_16_1_s16 16 -40.0 155.0 EXTENDED_LIMITS -2048.0 2047.9375 /end AXIS_PTS
/begin CHARACTERISTIC TCFCkt_Pct_CCPM_DutyCompensation "### Description
      This is the DC compensation for CCPM needed to maintain a certain speed
      ### Usage
      Set to measured DC needed to maintain each speed in the support point axis
      ### Calibration Note
      Support point axis are calibrated with TCFCkn_n_CCPM_Target
      It may not be possible to achieve all speeds
      This feed-forward is highly dependent on supply voltage to BLDC power stage, currently not compensated for change in voltage
      
      " CURVE 0x0000 /* @ECU_Address@TCFCkt_Pct_CCPM_DutyCompensation@ */ Lookup1D_WORD 0 CM_T_Pct_pct_256_1_s16 -128.0 127.9960937 EXTENDED_LIMITS -128.0 127.99609375
 /begin AXIS_DESCR COM_AXIS NO_INPUT_QUANTITY CM_T_n_rpm_1_1_s16 16 0.0 32767.0 AXIS_PTS_REF TCFCkn_n_CCPM_Target /end AXIS_DESCR
/end CHARACTERISTIC
/begin AXIS_PTS TCFCkn_n_CCPM_Target "### Description
      This is the support point axis for DC compensation for CCPM needed to maintain a certain speed
      ### Usage
      Set to desired support points
      ### Calibration Note
      
      " 0x0000 /* @ECU_Address@TCFCkn_n_CCPM_Target@ */ NO_INPUT_QUANTITY Lookup1D_X_WORD 0 CM_T_n_rpm_1_1_s16 16 0.0 32767.0 EXTENDED_LIMITS -32768.0 32767.0 /end AXIS_PTS
/begin CHARACTERISTIC TCFCke_I_CCP_BSW_CurrentLimit "### Description
      This is the BSW current limit for CCP BLDC Phase Current
      ### Usage
      Set to the same value as used in BSW
      ### Calibration Note
      " VALUE 0x0000 /* @ECU_Address@TCFCke_I_CCP_BSW_CurrentLimit@ */ Scalar_FLOAT32_IEEE 0 CM_T_I_A_Float32 0.1 3.4E+38 EXTENDED_LIMITS -3.4E+38 3.4E+38 /end CHARACTERISTIC
/begin CHARACTERISTIC TCFCke_K_CCP_BSW_CurrentLimit "Low pass filter koefficient =  deltaT/T
      Where deltaT is periodicity for the filter, here 1 sec.
      And T is timeconstant for filter.
      " VALUE 0x0000 /* @ECU_Address@TCFCke_K_CCP_BSW_CurrentLimit@ */ Scalar_FLOAT32_IEEE 0 CM_T_K_NA_Float32 0.0 1.0 EXTENDED_LIMITS -3.4E+38 3.4E+38 /end CHARACTERISTIC
/begin CHARACTERISTIC TCFCke_e_CCPM_Source "### Description
      This sets the source of CCPM actuator control
      ### Usage
      Set to TCFCce_e_CCPM_Source_FlowRequest to set target speed based on cooling flow request
      Set to TCFCce_e_CCPM_Source_SpeedTarget to set target speed to calibration input TCFCkn_n_CCPM_Target
      Set to TCFCce_e_CCPM_Source_DC_Target to set output duty-cycle to calibration input TCFCke_Pct_CCPM_DC
      ### Calibration Note
      " VALUE 0x0000 /* @ECU_Address@TCFCke_e_CCPM_Source@ */ Scalar_UBYTE 0 CM_TCFCte_e_CCPM_Source 0 5 EXTENDED_LIMITS 0 0 /end CHARACTERISTIC
/begin CHARACTERISTIC TCFCke_e_CCPM_Status "### Description
      This sets the CCPM BLDC Command Status, this needs to be set/enabled manually
      ### Usage
      Set to desired CCPM BLDC Command Status
      ### Calibration Note
      This needs to be enabled to be able to run CCPM BLDC motor" VALUE 0x0000 /* @ECU_Address@TCFCke_e_CCPM_Status@ */ Scalar_UBYTE 0 CM_TCFCte_e_St_ElM 15 255 EXTENDED_LIMITS 0 0 /end CHARACTERISTIC
/begin CHARACTERISTIC TCFCke_n_CCPM_LimitationHighY_Decrease "Decrease rate-limitation of CCPM speed limitation based current usage to be used when TCFCve_r_CCP_Y is high, in rpm per sample (@ 1000ms)" VALUE 0x0000 /* @ECU_Address@TCFCke_n_CCPM_LimitationHighY_Decrease@ */ Scalar_SWORD 0 CM_T_n_rpm_1_1_s16 -32768 0.0 EXTENDED_LIMITS -32768.0 32767.0 /end CHARACTERISTIC
/begin CHARACTERISTIC TCFCke_n_CCPM_LimitationHighY_Increase "Increase rate-limitation of CCPM speed limitation based current usage to be used when TCFCve_r_CCP_Y is high, in rpm per sample (@ 1000ms)" VALUE 0x0000 /* @ECU_Address@TCFCke_n_CCPM_LimitationHighY_Increase@ */ Scalar_SWORD 0 CM_T_n_rpm_1_1_s16 0.0 32767 EXTENDED_LIMITS -32768.0 32767.0 /end CHARACTERISTIC
/begin CHARACTERISTIC TCFCke_n_CCPM_LimitationLowY_Decrease "Decrease rate-limitation of CCPM speed limitation based current usage to be used when TCFCve_r_CCP_Y is low, in rpm per sample (@ 1000ms)" VALUE 0x0000 /* @ECU_Address@TCFCke_n_CCPM_LimitationLowY_Decrease@ */ Scalar_SWORD 0 CM_T_n_rpm_1_1_s16 -32768 0.0 EXTENDED_LIMITS -32768.0 32767.0 /end CHARACTERISTIC
/begin CHARACTERISTIC TCFCke_n_CCPM_LimitationLowY_Increase "Increase rate-limitation of CCPM speed limitation based current usage to be used when TCFCve_r_CCP_Y is low, in rpm per sample (@ 1000ms)" VALUE 0x0000 /* @ECU_Address@TCFCke_n_CCPM_LimitationLowY_Increase@ */ Scalar_SWORD 0 CM_T_n_rpm_1_1_s16 -32768 32767 /end CHARACTERISTIC
/begin CHARACTERISTIC TCFCke_n_CCPM_MinSpeedToEnableController "### Description
      This is the minimum speed to enable CCPM BLDC speed controller
      ### Usage
      Set to desired minimum controllable CCPM speed
      ### Calibration Note
      " VALUE 0x0000 /* @ECU_Address@TCFCke_n_CCPM_MinSpeedToEnableController@ */ Scalar_SWORD 0 CM_T_n_rpm_1_1_s16 0.0 32767 EXTENDED_LIMITS -32768.0 32767.0 /end CHARACTERISTIC
/begin CHARACTERISTIC TCFCke_n_CCPM_SpeedControllerTarget "### Description
      This is the target speed for CCPM speed controller
      ### Usage
      Set to target speed for CCPM speed controller
      ### Calibration Note
      This value will only be acknowledged when CCPM speed control is enabled" VALUE 0x0000 /* @ECU_Address@TCFCke_n_CCPM_SpeedControllerTarget@ */ Scalar_SWORD 0 CM_T_n_rpm_1_1_s16 0.0 14000.0 EXTENDED_LIMITS -32768.0 32767.0 /end CHARACTERISTIC
/begin CHARACTERISTIC TCFCke_n_MaxTransInputSpeedForLubricationIOCs "### Description
      This sets the maximum transmission input speed for allowing IOC ShortTermAdjustment of cooling and lubrication pump
      ### Usage
      Set to maximum transmission input speed to allow CCP IOC
      ### Calibration Note" VALUE 0x0000 /* @ECU_Address@TCFCke_n_MaxTransInputSpeedForLubricationIOCs@ */ Scalar_SWORD 0 CM_T_n_rpm_1_1_s16 0.0 32767.0 EXTENDED_LIMITS -32768.0 32767.0 /end CHARACTERISTIC
/begin CHARACTERISTIC TCFCke_n_MinCoolingSpeed "### Description
      This is the minimum speed of CCPM BLDC
      ### Usage
      Set to desired minimum CCPM speed
      ### Calibration Note
      " VALUE 0x0000 /* @ECU_Address@TCFCke_n_MinCoolingSpeed@ */ Scalar_SWORD 0 CM_T_n_rpm_1_1_s16 -32768 32767 /end CHARACTERISTIC
/begin CHARACTERISTIC TCFCke_Cnt_DelayToDisableSpeedController "### Description
      This is the delay until the  CCPM BLDC speed controller is disabled when below activation limit
      ### Usage
      Set to desired delay (in counts of 2.5ms periodic task)
      ### Calibration Note
      " VALUE 0x0000 /* @ECU_Address@TCFCke_Cnt_DelayToDisableSpeedController@ */ Scalar_UWORD 0 CM_T_Cnt_Num_1_1_u16 0 65535 /end CHARACTERISTIC
/begin CHARACTERISTIC TCFCke_V_CCP_Displacement "### Description
      This is the displacement of the Cooling Pump
      ### Usage
      Set to ideal volymetric displacment in ml per revolution
      ### Calibration Note" VALUE 0x0000 /* @ECU_Address@TCFCke_V_CCP_Displacement@ */ Scalar_SWORD 0 CM_T_V_ml_128_1_s16 0.0 255.991875 EXTENDED_LIMITS -256.0 255.9921875 /end CHARACTERISTIC
/begin CHARACTERISTIC TCFCke_U_CCPM_NominalVoltage "### Description
      This is the nominal voltage for CCPM BLDC
      ### Usage
      Set to estimated voltage for CCPM BLDC
      ### Calibration Note
      Untestet!" VALUE 0x0000 /* @ECU_Address@TCFCke_U_CCPM_NominalVoltage@ */ Scalar_SWORD 0 CM_T_U_V_512_1_s16 0.0 60.0 EXTENDED_LIMITS -64.0 63.998046875 /end CHARACTERISTIC
/begin CHARACTERISTIC TCFCke_U_MinMotorSupplyVoltage "### Description
      This sets the minimum reasonable BLDC supply voltage, to avoid voltage compensation overcompensating for unreasonable values
      ### Usage
      Set to minimum reasonable BLDC supply voltage
      ### Calibration Note" VALUE 0x0000 /* @ECU_Address@TCFCke_U_MinMotorSupplyVoltage@ */ Scalar_SWORD 0 CM_T_U_V_512_1_s16 5.0 63.998046875 EXTENDED_LIMITS -64.0 63.998046875 /end CHARACTERISTIC
/begin CHARACTERISTIC TCFCke_v_MaxVehicleSpeedForLubricationIOCs "### Description
      This sets the maximum absolute vehicle speed for allowing IOC ShortTermAdjustment of cooling and lubrication pump
      ### Usage
      Set to maximum absolute vehicle speed to allow CCP IOC
      ### Calibration Note" VALUE 0x0000 /* @ECU_Address@TCFCke_v_MaxVehicleSpeedForLubricationIOCs@ */ Scalar_SWORD 0 CM_T_v_kph_64_1_s16 0.0 511.984375 EXTENDED_LIMITS -512.0 511.984375 /end CHARACTERISTIC
/begin CHARACTERISTIC TCFCke_Pct_CCPM_DC "### Description
      This is the set value for output DC for CCPM BLDC
      ### Usage
      Set to desired DC command for CCPM BLDC
      ### Calibration Note
      This needs CCPM speed controller to be turned off to be used" VALUE 0x0000 /* @ECU_Address@TCFCke_Pct_CCPM_DC@ */ Scalar_SWORD 0 CM_T_Pct_pct_10_1_s16 -100.0 100.0 EXTENDED_LIMITS -3276.8 3276.7000000000003 /end CHARACTERISTIC
/begin CHARACTERISTIC TCFCke_Pct_CCPM_RateLimitDecrease "### Description
      This is the Decrease rate-limit for output duty-cycle for CCPM BLDC
      ### Usage
      Set to desired DC rate-limitation in Pct duty-cycle Decrease per sample (running at 2.5ms)
      ### Calibration Note
      Set as fast as possible, since speed controller doesn't expect/considers this rate limitation
      Negative Value!
      " VALUE 0x0000 /* @ECU_Address@TCFCke_Pct_CCPM_RateLimitDecrease@ */ Scalar_SWORD 0 CM_T_Pct_pct_10_1_s16 -3276.8 -0.1 EXTENDED_LIMITS -3276.8 3276.7000000000003 /end CHARACTERISTIC
/begin CHARACTERISTIC TCFCke_Pct_CCPM_RateLimitIncrease "### Description
      This is the Increase rate-limit for output duty-cycle for CCPM BLDC
      ### Usage
      Set to desired DC rate-limitation in Pct duty-cycle Increase per sample (running at 2.5ms)
      ### Calibration Note
      Set as fast as possible, since speed controller doesn't expect/considers this rate limitation
      " VALUE 0x0000 /* @ECU_Address@TCFCke_Pct_CCPM_RateLimitIncrease@ */ Scalar_SWORD 0 CM_T_Pct_pct_10_1_s16 0.1 3276.7 EXTENDED_LIMITS -3276.8 3276.7000000000003 /end CHARACTERISTIC
/begin CHARACTERISTIC TCFCke_Pct_CCPM_SpeedControl_DC_Max "### Description
      This is calibration for possibility to limit maximum output DC for CCPM BLDC Speed controller
      ### Usage
      Set to desired max duty cycle for CCPM BLDC
      ### Calibration Note
      Seems as maximum duty-cycle supprted by BLDC is 97.4
      " VALUE 0x0000 /* @ECU_Address@TCFCke_Pct_CCPM_SpeedControl_DC_Max@ */ Scalar_SWORD 0 CM_T_Pct_pct_10_1_s16 0.0 100.0 EXTENDED_LIMITS -3276.8 3276.7000000000003 /end CHARACTERISTIC
/begin CHARACTERISTIC TCFCke_Pct_CCPM_SpeedControl_DC_Min "### Description
      This is calibration for possibility to limit minimum output DC for CCPM BLDC Speed controller
      ### Usage
      Set to desired min duty cycle for CCPM BLDC
      ### Calibration Note
      Seems as maximum duty-cycle supprted by BLDC is 97.4
      Negative value
      " VALUE 0x0000 /* @ECU_Address@TCFCke_Pct_CCPM_SpeedControl_DC_Min@ */ Scalar_SWORD 0 CM_T_Pct_pct_10_1_s16 -100.0 0.0 EXTENDED_LIMITS -3276.8 3276.7000000000003 /end CHARACTERISTIC
/begin CHARACTERISTIC TCFCke_r_CCPM_SpeedControlD_Part "### Description
      This is the CCPM speed control D-part
      ### Usage
      Set to desired CCPM speed control D-part
      ### Calibration Note" VALUE 0x0000 /* @ECU_Address@TCFCke_r_CCPM_SpeedControlD_Part@ */ Scalar_UWORD 0 CM_T_K_NA_32768_1_u16 0.0 1.99 EXTENDED_LIMITS 0.0 1.999969482421875 /end CHARACTERISTIC
/begin CHARACTERISTIC TCFCke_r_CCPM_SpeedControlI_Part "### Description
      This is the CCPM speed control I-part
      ### Usage
      Set to desired CCPM speed control I-part
      ### Calibration Note" VALUE 0x0000 /* @ECU_Address@TCFCke_r_CCPM_SpeedControlI_Part@ */ Scalar_UWORD 0 CM_T_K_NA_32768_1_u16 0.0 1.99 EXTENDED_LIMITS 0.0 1.999969482421875 /end CHARACTERISTIC
/begin CHARACTERISTIC TCFCke_r_CCPM_SpeedControlP_Part "### Description
      This is the CCPM speed control P-part
      ### Usage
      Set to desired CCPM speed control P-part
      ### Calibration Note" VALUE 0x0000 /* @ECU_Address@TCFCke_r_CCPM_SpeedControlP_Part@ */ Scalar_UWORD 0 CM_T_K_NA_32768_1_u16 0.0 1.99 EXTENDED_LIMITS 0.0 1.999969482421875 /end CHARACTERISTIC
/begin CHARACTERISTIC TCFCke_r_CCPM_SpeedLimitationRateLimY "This sets which rate limiter parameters shall be used based on TCFCve_r_CCP_Y, for rate-limitation of CCPM speed limitation based current usage.
      
      If TCFCve_r_CCP_Y is equal to or greater than this value, then TCFCke_n_CCPM_LimitationHighY_Increase and TCFCke_n_CCPM_LimitationHighY_Decrease will be used.
      Otherwise TCFCke_n_CCPM_LimitationLowY_Increase and TCFCke_n_CCPM_LimitationLowY_Decrease will be used
      
      " VALUE 0x0000 /* @ECU_Address@TCFCke_r_CCPM_SpeedLimitationRateLimY@ */ Scalar_UWORD 0 CM_T_r_NA_32768_1_u16 0.0 1.999969482421875 /end CHARACTERISTIC
/begin CHARACTERISTIC TCFCke_r_CCP_Y_OverCurrentMargin "### Description
      This is the margin for CCP overcurrent filter load value Y, used to prevent CCP Phase Overcurrent.
      The speed limit will be reduced when the margin (relative to 1) is smaller than this value
      ### Usage
      Set to desired minimum margin for filtered load current before target speed is reduced
      ### Calibration Note" VALUE 0x0000 /* @ECU_Address@TCFCke_r_CCP_Y_OverCurrentMargin@ */ Scalar_UWORD 0 CM_T_r_NA_32768_1_u16 0.0 1.0 EXTENDED_LIMITS 0.0 1.999969482421875 /end CHARACTERISTIC
/begin CHARACTERISTIC TCFCke_b_CCPM_ChangeBLDC_Direction "### Description
      This enables changes the direction of CCPM BLDC
      ### Usage
      Set to true if CCPM BLDC direction shall be changed
      ### Calibration Note
      " VALUE 0x0000 /* @ECU_Address@TCFCke_b_CCPM_ChangeBLDC_Direction@ */ Scalar_BOOLEAN 0 CM_T_BOOLEAN 0.0 1.0 /end CHARACTERISTIC
/begin CHARACTERISTIC TCFCke_b_CCPM_CommandDBC_Enable "CCPM_DBC_control_enable" VALUE 0x0000 /* @ECU_Address@TCFCke_b_CCPM_CommandDBC_Enable@ */ Scalar_BOOLEAN 0 CM_T_BOOLEAN 0.0 1.0 /end CHARACTERISTIC
/begin CHARACTERISTIC TCFCke_b_CCPM_OverCurrent_UseBSW_Limit "### Description
      This enables indicating using the BSW CCPM BLDC filtered overcurrent limit for CurrentBasedMaxSpeed
      ### Usage
      Set to true to use information from BSW as well as (max of) the calculated value in TCFC
      Set to false to only use the calculated value in TCFC
      ### Calibration Note
      The BSW value can be measured with TCFCve_r_CCP_BSW_Y and the TCFC value with TCFCve_r_CCP_Y" VALUE 0x0000 /* @ECU_Address@TCFCke_b_CCPM_OverCurrent_UseBSW_Limit@ */ Scalar_BOOLEAN 0 CM_T_BOOLEAN 0.0 1.0 /end CHARACTERISTIC
/begin CHARACTERISTIC TCFCke_b_CCPM_SpeedControlDutyCompVoltageCompEnable "### Description
      This enables voltage compensation of MotorSupply voltage of CCPM for speed control duty-cycle compensation
      ### Usage
      Set to true if voltage compensation for feed-forward shall be enabled
      ### Calibration Note
      " VALUE 0x0000 /* @ECU_Address@TCFCke_b_CCPM_SpeedControlDutyCompVoltageCompEnable@ */ Scalar_BOOLEAN 0 CM_T_BOOLEAN 0.0 1.0 /end CHARACTERISTIC
/begin CHARACTERISTIC TCFCke_b_DebouncedRoundingOfOilTempForSpeedLimit "### Description
      This enables rounding of oil temp value that is used for temperature based speed limit of cooling circuit
      When enabled the used oil temp is rounded to complete degrees C, with some hysterisis when switching.
      ### Usage
      Set to true to enable rounding of oil temp for cooling circuit speed limit
      ### Calibration Note" VALUE 0x0000 /* @ECU_Address@TCFCke_b_DebouncedRoundingOfOilTempForSpeedLimit@ */ Scalar_BOOLEAN 0 CM_T_BOOLEAN 0.0 1.0 /end CHARACTERISTIC
/begin CHARACTERISTIC TCFCke_b_UseCurrentBasedMaxSpeed "This enables using a min of the temperature dependent max speed and a max speed based on used current relative to max-limit for max CCPM speed.
      
      If set to false, onlu temperature dependent max speed is used.
      " VALUE 0x0000 /* @ECU_Address@TCFCke_b_UseCurrentBasedMaxSpeed@ */ Scalar_BOOLEAN 0 CM_T_BOOLEAN 0.0 1.0 /end CHARACTERISTIC
/begin CHARACTERISTIC TCFCke_b_UseForceCCPCancleSpdLimit "use or not use FMDA UseForceCCPCancleSpdLimit" VALUE 0x0000 /* @ECU_Address@TCFCke_b_UseForceCCPCancleSpdLimit@ */ Scalar_BOOLEAN 0 CM_T_BOOLEAN 0.0 1.0 /end CHARACTERISTIC
/begin MEASUREMENT TCFCve_r_CCP_X "Normalized CCP Phase Current, when this is above 1 the CCP Phase Current is above the current limit" FLOAT32_IEEE CM_T_r_NA_Float32 0 0 -3.4E+38 3.4E+38 ECU_ADDRESS 0x0000 /* @ECU_Address@TCFCve_r_CCP_X@ */ /end MEASUREMENT
/begin MEASUREMENT TCFCve_I_CCPM_Avg "###Description
      Feedback from BLDC for CCPM, TCU_I_MotAvrgCrnt
      
      
      " FLOAT32_IEEE CM_T_I_A_Float32 0 0 -327.68 327.67 ECU_ADDRESS 0x0000 /* @ECU_Address@TCFCve_I_CCPM_Avg@ */ /end MEASUREMENT
/begin MEASUREMENT TCFCve_P_CCPM_Estimated "Estimated power of CCPM" FLOAT32_IEEE CM_T_P_W_Float32 0 0 -3.4E+38 3.4E+38 ECU_ADDRESS 0x0000 /* @ECU_Address@TCFCve_P_CCPM_Estimated@ */ /end MEASUREMENT
/begin MEASUREMENT TCFCve_I_CCPM_Max "###Description
      Feedback from BLDC for CCPM, TCU_I_MotMaxCrnt
      
      
      " FLOAT32_IEEE CM_T_I_A_Float32 0 0 -327.68 327.67 ECU_ADDRESS 0x0000 /* @ECU_Address@TCFCve_I_CCPM_Max@ */ /end MEASUREMENT
/begin MEASUREMENT TCFCve_n_CCPM "###Description
      Feedback from BLDC for CCPM, TCU_n_MotRotSpd (actual speed)" SWORD CM_T_n_rpm_1_1_s16 0 0 -32768.0 32767.0 ECU_ADDRESS 0x0000 /* @ECU_Address@TCFCve_n_CCPM@ */ /end MEASUREMENT
/begin MEASUREMENT TCFCve_Cnt_CCPMPS_ActPosInc "###Description
      Feedback from BLDC for CCPM, TCU_Ct_PwrStgActPosInc" SWORD CM_T_Cnt_Num_1_1_s16 0 0 -32768.0 32767.0 ECU_ADDRESS 0x0000 /* @ECU_Address@TCFCve_Cnt_CCPMPS_ActPosInc@ */ /end MEASUREMENT
/begin MEASUREMENT TCFCve_Pct_CCP_PhaseCurLoad "Phase current load from BSW" SWORD CM_T_Pct_pct_1_1_s16 0 0 0.0 32767 ECU_ADDRESS 0x0000 /* @ECU_Address@TCFCve_Pct_CCP_PhaseCurLoad@ */ /end MEASUREMENT
/begin MEASUREMENT TCFCve_n_CoolingFlowCommand "###Description
      CCPM target speed based on Cooling Flow Demand
      " SWORD CM_T_n_rpm_1_1_s16 0 0 0.0 32767.0 ECU_ADDRESS 0x0000 /* @ECU_Address@TCFCve_n_CoolingFlowCommand@ */ /end MEASUREMENT
/begin MEASUREMENT TCFCve_n_CoolingFlowCMD "" SWORD CM_T_n_rpm_1_1_s16 0 0 0.0 32767.0 ECU_ADDRESS 0x0000 /* @ECU_Address@TCFCve_n_CoolingFlowCMD@ */ /end MEASUREMENT
/begin MEASUREMENT TCFCve_T_CCPMPS "###Description
      Feedback from BLDC for CCPM, TCU_Temp_PwrStgTemp" SWORD CM_T_T_degC_16_1_s16 0 0 -2048.0 2047.9375 ECU_ADDRESS 0x0000 /* @ECU_Address@TCFCve_T_CCPMPS@ */ /end MEASUREMENT
/begin MEASUREMENT TCFCve_T_OilTemp "This is the signal used for support point for the temperature based speed limit of cooling circuit pump" SWORD CM_T_T_degC_16_1_s16 0 0 -2048.0 2047.9375 ECU_ADDRESS 0x0000 /* @ECU_Address@TCFCve_T_OilTemp@ */ /end MEASUREMENT
/begin MEASUREMENT TCFCve_Pct_CCPM_SpeedControl_DC "###Description
      Actual CCPM speed controller duty-cycle" SWORD CM_T_Pct_pct_10_1_s16 0 0 0.0 100.0 ECU_ADDRESS 0x0000 /* @ECU_Address@TCFCve_Pct_CCPM_SpeedControl_DC@ */ /end MEASUREMENT
/begin MEASUREMENT TCFCve_Pct_CCPM_DC "###Description
      Actual CCPM duty-cycle command" SWORD CM_T_Pct_pct_10_1_s16 0 0 -3276.8 3276.7 ECU_ADDRESS 0x0000 /* @ECU_Address@TCFCve_Pct_CCPM_DC@ */ /end MEASUREMENT
/begin MEASUREMENT TCFCve_Pct_CCPMPS_DC_Actual "###Description
      Feedback from BLDC for CCPM, TCU_cyc_PwrStgActPWM" SWORD CM_T_Pct_pct_10_1_s16 0 0 -3276.8 3276.7 ECU_ADDRESS 0x0000 /* @ECU_Address@TCFCve_Pct_CCPMPS_DC_Actual@ */ /end MEASUREMENT
/begin MEASUREMENT TCFCve_Pct_CCPM_SpeedControlP_Part "###Description
      CCPM Speedcontroller P-part contribution" SWORD CM_T_Pct_pct_256_1_s16 0 0 -128.0 127.99609375 ECU_ADDRESS 0x0000 /* @ECU_Address@TCFCve_Pct_CCPM_SpeedControlP_Part@ */ /end MEASUREMENT
/begin MEASUREMENT TCFCve_Pct_CCPM_SpeedControlI_Part "###Description
      CCPM Speedcontroller I-part contribution" SWORD CM_T_Pct_pct_256_1_s16 0 0 -128.0 127.99609375 ECU_ADDRESS 0x0000 /* @ECU_Address@TCFCve_Pct_CCPM_SpeedControlI_Part@ */ /end MEASUREMENT
/begin MEASUREMENT TCFCve_Pct_CCPM_SpeedControlD_Part "###Description
      CCPM Speedcontroller D-part contribution" SWORD CM_T_Pct_pct_256_1_s16 0 0 -128.0 127.99609375 ECU_ADDRESS 0x0000 /* @ECU_Address@TCFCve_Pct_CCPM_SpeedControlD_Part@ */ /end MEASUREMENT
/begin MEASUREMENT TCFCve_Pct_CCPM_SpeedControlDutyCompensation "###Description
      CCPM Speedcontroller feed-forward, target speed to DC contribution" SWORD CM_T_Pct_pct_256_1_s16 0 0 -128.0 127.99609375 ECU_ADDRESS 0x0000 /* @ECU_Address@TCFCve_Pct_CCPM_SpeedControlDutyCompensation@ */ /end MEASUREMENT
/begin MEASUREMENT TCFCve_r_CCP_BSW_Y "Phase current load from BSW" UWORD CM_T_r_NA_32768_1_u16 0 0 0 1.999969482421875 ECU_ADDRESS 0x0000 /* @ECU_Address@TCFCve_r_CCP_BSW_Y@ */ /end MEASUREMENT
/begin MEASUREMENT TCFCve_r_CCP_ASW_Y "Phase current load estimated in ASW" UWORD CM_T_r_NA_32768_1_u16 0 0 0 1.999969482421875 ECU_ADDRESS 0x0000 /* @ECU_Address@TCFCve_r_CCP_ASW_Y@ */ /end MEASUREMENT
/begin MEASUREMENT TCFCve_r_CCP_Y "Normalized filtered CCP Phase Current, when this is above 1 the filtered CCP Phase Current is above the current limit" UWORD CM_T_r_NA_32768_1_u16 0 0 0 1.999969482421875 ECU_ADDRESS 0x0000 /* @ECU_Address@TCFCve_r_CCP_Y@ */ /end MEASUREMENT
/begin MEASUREMENT TCFCve_Cnt_CCPM_Speed_Status "170: valid
      255: not_valid
      " UBYTE CM_T_Cnt_Num_1_1_u8 0 0 0.0 255.0 ECU_ADDRESS 0x0000 /* @ECU_Address@TCFCve_Cnt_CCPM_Speed_Status@ */ /end MEASUREMENT
/begin MEASUREMENT TCFCve_Cnt_CCPMPS_Pos_Status "170: valid
      255: not_valid
      " UBYTE CM_T_Cnt_Num_1_1_u8 0 0 0.0 255.0 ECU_ADDRESS 0x0000 /* @ECU_Address@TCFCve_Cnt_CCPMPS_Pos_Status@ */ /end MEASUREMENT
/begin MEASUREMENT TCFCve_Cnt_CCPM_ActualStatus "15: not_supported
      170: valid
      195: not_precise
      240: Init
      255: not_valid
      " UBYTE CM_T_Cnt_Num_1_1_u8 0 0 0.0 255.0 ECU_ADDRESS 0x0000 /* @ECU_Address@TCFCve_Cnt_CCPM_ActualStatus@ */ /end MEASUREMENT
/begin MEASUREMENT TCFCve_Cnt_CCPMPS_Mode "15: power_stage_Hi_Z
      170: power_stage_ON
      240: power_stage_brake
      255: power_stage_OFF
      " UBYTE CM_T_Cnt_Num_1_1_u8 0 0 0.0 255.0 ECU_ADDRESS 0x0000 /* @ECU_Address@TCFCve_Cnt_CCPMPS_Mode@ */ /end MEASUREMENT
/begin MEASUREMENT TCFCve_Cnt_CCPMPS_Status "15: disconnected
      170 :no_failure
      240: short_circuit
      255: failure
      " UBYTE CM_T_Cnt_Num_1_1_u8 0 0 0.0 255.0 ECU_ADDRESS 0x0000 /* @ECU_Address@TCFCve_Cnt_CCPMPS_Status@ */ /end MEASUREMENT
/begin MEASUREMENT TCFCve_Cnt_CCPMPS_TemperatureStatus "170: valid
      255: not_valid
      " UBYTE CM_T_Cnt_Num_1_1_u8 0 0 0.0 255.0 ECU_ADDRESS 0x0000 /* @ECU_Address@TCFCve_Cnt_CCPMPS_TemperatureStatus@ */ /end MEASUREMENT
/begin MEASUREMENT TCFCve_Cnt_CCPMPS_TemperatureWarnLevel "170: normal_level
      204: warning_level
      240: off_request
      255: switch_off_forced
      " UBYTE CM_T_Cnt_Num_1_1_u8 0 0 0.0 255.0 ECU_ADDRESS 0x0000 /* @ECU_Address@TCFCve_Cnt_CCPMPS_TemperatureWarnLevel@ */ /end MEASUREMENT
/begin MEASUREMENT TCFCve_Cnt_CCPM_CommandDBC_in "" UBYTE CM_T_Cnt_Num_1_1_u8 0 0 0.0 3.0 ECU_ADDRESS 0x0000 /* @ECU_Address@TCFCve_Cnt_CCPM_CommandDBC_in@ */ /end MEASUREMENT
/begin MEASUREMENT TCFCve_b_CCPM_DC_DBC "" UBYTE CM_T_BOOLEAN 0 0 0.0 1.0 ECU_ADDRESS 0x0000 /* @ECU_Address@TCFCve_b_CCPM_DC_DBC@ */ /end MEASUREMENT
/begin MEASUREMENT TCFCve_b_CCPM_Flow_DBC "" UBYTE CM_T_BOOLEAN 0 0 0.0 1.0 ECU_ADDRESS 0x0000 /* @ECU_Address@TCFCve_b_CCPM_Flow_DBC@ */ /end MEASUREMENT
/begin MEASUREMENT TCFCve_b_ForceCCPCancleSpdLimit "use or not use ForceCCPCancleSpdLimit" UBYTE CM_T_BOOLEAN 0 0 0.0 1.0 ECU_ADDRESS 0x0000 /* @ECU_Address@TCFCve_b_ForceCCPCancleSpdLimit@ */ /end MEASUREMENT
/begin MEASUREMENT TCFCve_b_CCPM_Speed_DBC "" UBYTE CM_T_BOOLEAN 0 0 0.0 1.0 ECU_ADDRESS 0x0000 /* @ECU_Address@TCFCve_b_CCPM_Speed_DBC@ */ /end MEASUREMENT
/begin MEASUREMENT TCFCve_e_CCP_DID_Enabled "### Description
      This is the current IOC state for ShortTermAdjustment of cooling and lubrication pump" UBYTE CM_TCFCte_e_DID_State 0 0 0 6 ECU_ADDRESS 0x0000 /* @ECU_Address@TCFCve_e_CCP_DID_Enabled@ */ /end MEASUREMENT
/begin MEASUREMENT TCFCve_n_C_n_CCP_Data "### Description
      This is the setpoint of IOC for speed control of cooling and lubrication pump" SWORD CM_T_n_rpm_1_1_s16 0 0 -32768.0 32767.0 ECU_ADDRESS 0x0000 /* @ECU_Address@TCFCve_n_C_n_CCP_Data@ */ /end MEASUREMENT
/begin MEASUREMENT TCFCve_dV_C_dV_CCP_Data "### Description
      This is the setpoint of IOC for flow control of cooling and lubrication pump" SWORD CM_T_dV_lpm_128_1_s16 0 0 0.0 255.9921875 ECU_ADDRESS 0x0000 /* @ECU_Address@TCFCve_dV_C_dV_CCP_Data@ */ /end MEASUREMENT
/begin MEASUREMENT TCFCve_Pct_C_Pct_CCP_Data "### Description
      This is the setpoint of IOC for PWM dutycycle control of cooling and lubrication pump" SWORD CM_T_Pct_pct_10_1_s16 0 0 -100.0 100.0 ECU_ADDRESS 0x0000 /* @ECU_Address@TCFCve_Pct_C_Pct_CCP_Data@ */ /end MEASUREMENT
/begin COMPU_METHOD CM_T_n_rpm_1_1_s16 "Q = V" RAT_FUNC "%5.0" "rpm (revolutions / minute  (rpm))" COEFFS 0 1 0 0 0 1 /end COMPU_METHOD
/begin COMPU_METHOD CM_T_T_degC_16_1_s16 "Q = V*16.000000" RAT_FUNC "%8.4" "degC (degrees Celsius  (deg C))" COEFFS 0 16 0 0 0 1 /end COMPU_METHOD
/begin COMPU_METHOD CM_T_Pct_pct_256_1_s16 "Q = V*256.000000" RAT_FUNC "%11.8" "pct (percent  (%))" COEFFS 0 256 0 0 0 1 /end COMPU_METHOD
/begin COMPU_METHOD CM_T_I_A_Float32 "Q = V" RAT_FUNC "%8.6" "A (amperes  (A))" COEFFS 0 1 0 0 0 1 /end COMPU_METHOD
/begin COMPU_METHOD CM_T_K_NA_Float32 "Q = V" RAT_FUNC "%8.6" "NA (dependent upon the gain)" COEFFS 0 1 0 0 0 1 /end COMPU_METHOD
/begin COMPU_METHOD CM_TCFCte_e_CCPM_Source "Enumerated data type: TCFCte_e_CCPM_Source" TAB_VERB "%0.6" "" COMPU_TAB_REF VTAB_FOR_CM_TCFCte_e_CCPM_Source /end COMPU_METHOD
/begin COMPU_VTAB VTAB_FOR_CM_TCFCte_e_CCPM_Source "Enumerated data type: TCFCte_e_CCPM_Source" TAB_VERB 3 0 "TCFCce_e_CCPM_Source_FlowRequest" 3 "TCFCce_e_CCPM_Source_SpeedTarget" 5 "TCFCce_e_CCPM_Source_DC_Target" /end COMPU_VTAB
/begin COMPU_METHOD CM_TCFCte_e_St_ElM "Enumerated data type: TCFCte_e_St_ElM" TAB_VERB "%0.6" "" COMPU_TAB_REF VTAB_FOR_CM_TCFCte_e_St_ElM /end COMPU_METHOD
/begin COMPU_VTAB VTAB_FOR_CM_TCFCte_e_St_ElM "Enumerated data type: TCFCte_e_St_ElM" TAB_VERB 4 15 "TCFCce_e_St_ElM_power_stage_Hi_Z" 170 "TCFCce_e_St_ElM_power_stage_ON" 240 "TCFCce_e_St_ElM_power_stage_brake" 255 "TCFCce_e_St_ElM_power_stage_OFF" /end COMPU_VTAB
/begin COMPU_METHOD CM_T_Cnt_Num_1_1_u16 "Q = V" RAT_FUNC "%5.0" "Num (counts)" COEFFS 0 1 0 0 0 1 /end COMPU_METHOD
/begin COMPU_METHOD CM_T_V_ml_128_1_s16 "Q = V*128.000000" RAT_FUNC "%10.7" "ml (milliliters  (ml))" COEFFS 0 128 0 0 0 1 /end COMPU_METHOD
/begin COMPU_METHOD CM_T_U_V_512_1_s16 "Q = V*512.000000" RAT_FUNC "%12.9" "V (volts  (V))" COEFFS 0 512 0 0 0 1 /end COMPU_METHOD
/begin COMPU_METHOD CM_T_v_kph_64_1_s16 "Q = V*64.000000" RAT_FUNC "%10.6" "kph (kilometers / hour  (kph))" COEFFS 0 64 0 0 0 1 /end COMPU_METHOD
/begin COMPU_METHOD CM_T_Pct_pct_10_1_s16 "Q = V*10.000000" RAT_FUNC "%0.6" "pct (percent  (%))" COEFFS 0 10 0 0 0 1 /end COMPU_METHOD
/begin COMPU_METHOD CM_T_K_NA_32768_1_u16 "Q = V*32768.000000" RAT_FUNC "%16.15" "NA (dependent upon the gain)" COEFFS 0 32768 0 0 0 1 /end COMPU_METHOD
/begin COMPU_METHOD CM_T_r_NA_32768_1_u16 "Q = V*32768.000000" RAT_FUNC "%16.15" "NA (none)" COEFFS 0 32768 0 0 0 1 /end COMPU_METHOD
/begin COMPU_METHOD CM_T_BOOLEAN "Q = V" RAT_FUNC "%1.0" "Bool" COEFFS 0 1 0 0 0 1 /end COMPU_METHOD
/begin COMPU_METHOD CM_T_r_NA_Float32 "Q = V" RAT_FUNC "%8.6" "NA (none)" COEFFS 0 1 0 0 0 1 /end COMPU_METHOD
/begin COMPU_METHOD CM_T_P_W_Float32 "Q = V" RAT_FUNC "%8.6" "W (watts  (W))" COEFFS 0 1 0 0 0 1 /end COMPU_METHOD
/begin COMPU_METHOD CM_T_Cnt_Num_1_1_s16 "Q = V" RAT_FUNC "%5.0" "Num (counts)" COEFFS 0 1 0 0 0 1 /end COMPU_METHOD
/begin COMPU_METHOD CM_T_Pct_pct_1_1_s16 "Q = V" RAT_FUNC "%5.0" "pct (percent  (%))" COEFFS 0 1 0 0 0 1 /end COMPU_METHOD
/begin COMPU_METHOD CM_T_Cnt_Num_1_1_u8 "Q = V" RAT_FUNC "%3.0" "Num (counts)" COEFFS 0 1 0 0 0 1 /end COMPU_METHOD
/begin COMPU_METHOD CM_TCFCte_e_DID_State "Enumerated data type: TCFCte_e_DID_State" TAB_VERB "%0.6" "" COMPU_TAB_REF VTAB_FOR_CM_TCFCte_e_DID_State /end COMPU_METHOD
/begin COMPU_VTAB VTAB_FOR_CM_TCFCte_e_DID_State "Enumerated data type: TCFCte_e_DID_State" TAB_VERB 4 0 "TCFCce_e_DID_NoActive" 3 "TCFCce_e_DID_DutyCycle" 5 "TCFCce_e_DID_Speed" 6 "TCFCce_e_DID_Flow" /end COMPU_VTAB
/begin COMPU_METHOD CM_T_dV_lpm_128_1_s16 "Q = V*128.000000" RAT_FUNC "%10.7" "lpm (liters / minute  (l/m))" COEFFS 0 128 0 0 0 1 /end COMPU_METHOD
/* EOF TCFC.a2l */
/begin RECORD_LAYOUT Scalar_BOOLEAN FNC_VALUES 1 UBYTE COLUMN_DIR DIRECT /end RECORD_LAYOUT
/begin RECORD_LAYOUT Scalar_UBYTE FNC_VALUES 1 UBYTE COLUMN_DIR DIRECT /end RECORD_LAYOUT
/begin RECORD_LAYOUT Scalar_BYTE FNC_VALUES 1 SBYTE COLUMN_DIR DIRECT /end RECORD_LAYOUT
/begin RECORD_LAYOUT Scalar_UWORD FNC_VALUES 1 UWORD COLUMN_DIR DIRECT /end RECORD_LAYOUT
/begin RECORD_LAYOUT Scalar_SWORD FNC_VALUES 1 SWORD COLUMN_DIR DIRECT /end RECORD_LAYOUT
/begin RECORD_LAYOUT Scalar_ULONG FNC_VALUES 1 ULONG COLUMN_DIR DIRECT /end RECORD_LAYOUT
/begin RECORD_LAYOUT Scalar_LONG FNC_VALUES 1 SLONG COLUMN_DIR DIRECT /end RECORD_LAYOUT
/begin RECORD_LAYOUT Scalar_FLOAT32_IEEE FNC_VALUES 1 FLOAT32_IEEE COLUMN_DIR DIRECT /end RECORD_LAYOUT
/begin RECORD_LAYOUT Scalar_FLOAT64_IEEE FNC_VALUES 1 FLOAT64_IEEE COLUMN_DIR DIRECT /end RECORD_LAYOUT
/begin RECORD_LAYOUT Lookup1D_BYTE FNC_VALUES 1 SBYTE COLUMN_DIR DIRECT /end RECORD_LAYOUT
/begin RECORD_LAYOUT Lookup1D_X_BYTE AXIS_PTS_X 1 SBYTE INDEX_INCR DIRECT /end RECORD_LAYOUT
/begin RECORD_LAYOUT Lookup1D_UBYTE FNC_VALUES 1 UBYTE COLUMN_DIR DIRECT /end RECORD_LAYOUT
/begin RECORD_LAYOUT Lookup1D_X_UBYTE AXIS_PTS_X 1 UBYTE INDEX_INCR DIRECT /end RECORD_LAYOUT
/begin RECORD_LAYOUT Lookup1D_UWORD FNC_VALUES 1 UWORD COLUMN_DIR DIRECT /end RECORD_LAYOUT
/begin RECORD_LAYOUT Lookup1D_WORD FNC_VALUES 1 SWORD COLUMN_DIR DIRECT /end RECORD_LAYOUT
/begin RECORD_LAYOUT Lookup1D_X_WORD AXIS_PTS_X 1 SWORD INDEX_INCR DIRECT /end RECORD_LAYOUT
/begin RECORD_LAYOUT Lookup1D_ULONG FNC_VALUES 1 ULONG COLUMN_DIR DIRECT /end RECORD_LAYOUT
/begin RECORD_LAYOUT Lookup1D_X_ULONG AXIS_PTS_X 1 ULONG INDEX_INCR DIRECT /end RECORD_LAYOUT
/begin RECORD_LAYOUT Lookup1D_SLONG FNC_VALUES 1 SLONG COLUMN_DIR DIRECT /end RECORD_LAYOUT
/begin RECORD_LAYOUT Lookup1D_X_LONG AXIS_PTS_X 1 SLONG INDEX_INCR DIRECT /end RECORD_LAYOUT
/begin RECORD_LAYOUT Lookup1D_FLOAT32_IEEE FNC_VALUES 1 FLOAT32_IEEE COLUMN_DIR DIRECT /end RECORD_LAYOUT
/begin RECORD_LAYOUT Lookup1D_X_FLOAT32_IEEE AXIS_PTS_X 1 FLOAT32_IEEE INDEX_INCR DIRECT /end RECORD_LAYOUT
/begin RECORD_LAYOUT Lookup1D_FLOAT64_IEEE FNC_VALUES 1 FLOAT64_IEEE COLUMN_DIR DIRECT /end RECORD_LAYOUT
/begin RECORD_LAYOUT Lookup1D_X_FLOAT64_IEEE AXIS_PTS_X 1 FLOAT64_IEEE INDEX_INCR DIRECT /end RECORD_LAYOUT
/begin RECORD_LAYOUT Lookup2D_UBYTE FNC_VALUES 1 UBYTE COLUMN_DIR DIRECT /end RECORD_LAYOUT
/begin RECORD_LAYOUT Lookup2D_X_UBYTE AXIS_PTS_X 1 UBYTE INDEX_INCR DIRECT /end RECORD_LAYOUT
/begin RECORD_LAYOUT Lookup2D_BYTE FNC_VALUES 1 SBYTE COLUMN_DIR DIRECT /end RECORD_LAYOUT
/begin RECORD_LAYOUT Lookup2D_X_BYTE AXIS_PTS_X 1 SBYTE INDEX_INCR DIRECT /end RECORD_LAYOUT
/begin RECORD_LAYOUT Lookup2D_ULONG FNC_VALUES 1 ULONG COLUMN_DIR DIRECT /end RECORD_LAYOUT
/begin RECORD_LAYOUT Lookup2D_X_ULONG AXIS_PTS_X 1 ULONG INDEX_INCR DIRECT /end RECORD_LAYOUT
/begin RECORD_LAYOUT Lookup2D_LONG FNC_VALUES 1 SLONG COLUMN_DIR DIRECT /end RECORD_LAYOUT
/begin RECORD_LAYOUT Lookup2D_X_LONG AXIS_PTS_X 1 SLONG INDEX_INCR DIRECT /end RECORD_LAYOUT
/begin RECORD_LAYOUT Lookup2D_FLOAT32_IEEE FNC_VALUES 1 FLOAT32_IEEE COLUMN_DIR DIRECT /end RECORD_LAYOUT
/begin RECORD_LAYOUT Lookup2D_X_FLOAT32_IEEE AXIS_PTS_X 1 FLOAT32_IEEE INDEX_INCR DIRECT /end RECORD_LAYOUT
/begin RECORD_LAYOUT Lookup2D_FLOAT64_IEEE FNC_VALUES 1 FLOAT64_IEEE COLUMN_DIR DIRECT /end RECORD_LAYOUT
/begin RECORD_LAYOUT Lookup2D_X_FLOAT64_IEEE AXIS_PTS_X 1 FLOAT64_IEEE INDEX_INCR DIRECT /end RECORD_LAYOUT
/begin CHARACTERISTIC TCFRkt_dV_P3FlowWhenStop "P3 flow then P1 and P3 is both stopped" CURVE 0x0000 /* @ECU_Address@TCFRkt_dV_P3FlowWhenStop@ */ Lookup1D_WORD 0 CM_T_dV_lpm_128_1_s16 0.0 255.9921875 EXTENDED_LIMITS -256.0 255.9921875
 /begin AXIS_DESCR COM_AXIS NO_INPUT_QUANTITY CM_T_T_degC_16_1_s16 8 -40.0 155.0 AXIS_PTS_REF TCFRkn_T_CoolingFlowOilTemp /end AXIS_DESCR
/end CHARACTERISTIC
/begin AXIS_PTS TCFRkn_T_CoolingFlowOilTemp "Support point axis for fan request to determine cooling flow" 0x0000 /* @ECU_Address@TCFRkn_T_CoolingFlowOilTemp@ */ NO_INPUT_QUANTITY Lookup1D_X_WORD 0 CM_T_T_degC_16_1_s16 8 -40.0 155.0 EXTENDED_LIMITS -2048.0 2047.9375 /end AXIS_PTS
/begin CHARACTERISTIC TCFRkt_dV_P1FlowWhenStop "P1 cooling flow when all motor is stopped" CURVE 0x0000 /* @ECU_Address@TCFRkt_dV_P1FlowWhenStop@ */ Lookup1D_WORD 0 CM_T_dV_lpm_128_1_s16 0.0 255.9921875 EXTENDED_LIMITS -256.0 255.9921875
 /begin AXIS_DESCR COM_AXIS TCFRve_T_OilSumpTemp CM_T_T_degC_16_1_s16 8 -40.0 155.0 AXIS_PTS_REF TCFRkn_T_CoolingFlowOilTemp /end AXIS_DESCR
/end CHARACTERISTIC
/begin CHARACTERISTIC TCFRkt_dV_CoolingFlowOilTempWhenStop "Oil cooling flow when P1 and P3 is stopped." CURVE 0x0000 /* @ECU_Address@TCFRkt_dV_CoolingFlowOilTempWhenStop@ */ Lookup1D_WORD 0 CM_T_dV_lpm_128_1_s16 0.0 255.9921875 EXTENDED_LIMITS -256.0 255.9921875
 /begin AXIS_DESCR COM_AXIS NO_INPUT_QUANTITY CM_T_T_degC_16_1_s16 8 -40.0 155.0 AXIS_PTS_REF TCFRkn_T_CoolingFlowOilTemp /end AXIS_DESCR
/end CHARACTERISTIC
/begin CHARACTERISTIC TCFRkt_dV_P1CoolingVsOilTemp "Cooling flow needed based on P1 motor temp above oil temp" CURVE 0x0000 /* @ECU_Address@TCFRkt_dV_P1CoolingVsOilTemp@ */ Lookup1D_WORD 0 CM_T_dV_lpm_128_1_s16 0.0 255.9921875 EXTENDED_LIMITS -256.0 255.9921875
 /begin AXIS_DESCR COM_AXIS TCFRve_T_P1VsOilTemp CM_T_T_degC_16_1_s16 5 0.0 2047.9375 AXIS_PTS_REF TCFRkn_T_P1CoolingVsOilTemp /end AXIS_DESCR
/end CHARACTERISTIC
/begin AXIS_PTS TCFRkn_T_P1CoolingVsOilTemp "Support point axis for cooling flow need based on P1 motor temp above oil temp" 0x0000 /* @ECU_Address@TCFRkn_T_P1CoolingVsOilTemp@ */ TCFRve_T_P1VsOilTemp Lookup1D_X_WORD 0 CM_T_T_degC_16_1_s16 5 0.0 2047.9375 EXTENDED_LIMITS -2048.0 2047.9375 /end AXIS_PTS
/begin CHARACTERISTIC TCFRkt_r_P1CoolingVsOilTemp "How much of the flow request due to difference in P1 motor and oil temp to use
      To be able to not have cooling flow request when the motor is cold
      " CURVE 0x0000 /* @ECU_Address@TCFRkt_r_P1CoolingVsOilTemp@ */ Lookup1D_UWORD 0 CM_T_r_NA_32768_1_u16 0.0 1.0 EXTENDED_LIMITS 0.0 1.999969482421875
 /begin AXIS_DESCR COM_AXIS TCFRve_T_P1Motor CM_T_T_degC_16_1_s16 4 -2048.0 2047.9375 AXIS_PTS_REF TCFRkn_T_P1CoolingVsOilTempP1Temp /end AXIS_DESCR
/end CHARACTERISTIC
/begin AXIS_PTS TCFRkn_T_P1CoolingVsOilTempP1Temp "P1 motor temp support point axis for scaling of flow request due to difference in P1 motor and oil temp" 0x0000 /* @ECU_Address@TCFRkn_T_P1CoolingVsOilTempP1Temp@ */ TCFRve_T_P1Motor Lookup1D_X_WORD 0 CM_T_T_degC_16_1_s16 4 -2048.0 2047.9375 /end AXIS_PTS
/begin CHARACTERISTIC TCFRkt_dV_P1Cooling "P1 Motor Cooling flow need due to high P1 temp" CURVE 0x0000 /* @ECU_Address@TCFRkt_dV_P1Cooling@ */ Lookup1D_WORD 0 CM_T_dV_lpm_128_1_s16 0.0 255.9921875 EXTENDED_LIMITS -256.0 255.9921875
 /begin AXIS_DESCR COM_AXIS TCFRve_T_P1Motor CM_T_T_degC_16_1_s16 7 -2048.0 2047.9375 AXIS_PTS_REF TCFRkn_T_P1CoolingP1Temp /end AXIS_DESCR
/end CHARACTERISTIC
/begin AXIS_PTS TCFRkn_T_P1CoolingP1Temp "Support point axis for oil temp to determine P1 cooling flow need due to high P1 temp" 0x0000 /* @ECU_Address@TCFRkn_T_P1CoolingP1Temp@ */ TCFRve_T_P1Motor Lookup1D_X_WORD 0 CM_T_T_degC_16_1_s16 7 -2048.0 2047.9375 /end AXIS_PTS
/begin CHARACTERISTIC TCFRkt_dV_P3CoolingVsOilTemp "Cooling flow needed based on P3 motor temp above oil temp" CURVE 0x0000 /* @ECU_Address@TCFRkt_dV_P3CoolingVsOilTemp@ */ Lookup1D_WORD 0 CM_T_dV_lpm_128_1_s16 0.0 255.9921875 EXTENDED_LIMITS -256.0 255.9921875
 /begin AXIS_DESCR COM_AXIS TCFRve_T_P3VsOilTemp CM_T_T_degC_16_1_s16 5 0.0 2047.9375 AXIS_PTS_REF TCFRkn_T_P3CoolingVsOilTemp /end AXIS_DESCR
/end CHARACTERISTIC
/begin AXIS_PTS TCFRkn_T_P3CoolingVsOilTemp "Support point axis for cooling flow need based on P3 motor temp above oil temp" 0x0000 /* @ECU_Address@TCFRkn_T_P3CoolingVsOilTemp@ */ TCFRve_T_P3VsOilTemp Lookup1D_X_WORD 0 CM_T_T_degC_16_1_s16 5 0.0 2047.9375 EXTENDED_LIMITS -2048.0 2047.9375 /end AXIS_PTS
/begin CHARACTERISTIC TCFRkt_r_P3CoolingVsOilTemp "How much of the flow request due to difference in P3 motor and oil temp to use
      To be able to not have cooling flow request when the motor is cold
      
      " CURVE 0x0000 /* @ECU_Address@TCFRkt_r_P3CoolingVsOilTemp@ */ Lookup1D_UWORD 0 CM_T_r_NA_32768_1_u16 0.0 1.0 EXTENDED_LIMITS 0.0 1.999969482421875
 /begin AXIS_DESCR COM_AXIS TCFRve_T_P3Motor CM_T_T_degC_16_1_s16 4 -2048.0 2047.9375 AXIS_PTS_REF TCFRkn_T_P3CoolingVsOilTempP3Temp /end AXIS_DESCR
/end CHARACTERISTIC
/begin AXIS_PTS TCFRkn_T_P3CoolingVsOilTempP3Temp "P3 motor temp support point axis for scaling of flow request due to difference in P3 motor and oil temp" 0x0000 /* @ECU_Address@TCFRkn_T_P3CoolingVsOilTempP3Temp@ */ TCFRve_T_P3Motor Lookup1D_X_WORD 0 CM_T_T_degC_16_1_s16 4 -2048.0 2047.9375 /end AXIS_PTS
/begin CHARACTERISTIC TCFRkt_dV_P3Cooling "P3 Motor Cooling flow need due to high P3 temp" CURVE 0x0000 /* @ECU_Address@TCFRkt_dV_P3Cooling@ */ Lookup1D_WORD 0 CM_T_dV_lpm_128_1_s16 0.0 255.9921875 EXTENDED_LIMITS -256.0 255.9921875
 /begin AXIS_DESCR COM_AXIS TCFRve_T_P3Motor CM_T_T_degC_16_1_s16 7 -2048.0 2047.9375 AXIS_PTS_REF TCFRkn_T_P3CoolingP3Temp /end AXIS_DESCR
/end CHARACTERISTIC
/begin AXIS_PTS TCFRkn_T_P3CoolingP3Temp "Support point axis for oil temp to determine P3 cooling flow need due to high P3 temp" 0x0000 /* @ECU_Address@TCFRkn_T_P3CoolingP3Temp@ */ TCFRve_T_P3Motor Lookup1D_X_WORD 0 CM_T_T_degC_16_1_s16 7 -2048.0 2047.9375 /end AXIS_PTS
/begin CHARACTERISTIC TCFRkt_dV_CoolingFlowOilTemp "Cooling flow when fan is requested due to high oil temp" CURVE 0x0000 /* @ECU_Address@TCFRkt_dV_CoolingFlowOilTemp@ */ Lookup1D_WORD 0 CM_T_dV_lpm_128_1_s16 0.0 255.9921875 EXTENDED_LIMITS -256.0 255.9921875
 /begin AXIS_DESCR COM_AXIS TCFRve_T_OilSumpTemp CM_T_T_degC_16_1_s16 8 -40.0 155.0 AXIS_PTS_REF TCFRkn_T_CoolingFlowOilTemp /end AXIS_DESCR
/end CHARACTERISTIC
/begin CHARACTERISTIC TCFRkt_dV_P1Lubrication "Lubrication need to to P1 system is rotating" CURVE 0x0000 /* @ECU_Address@TCFRkt_dV_P1Lubrication@ */ Lookup1D_WORD 0 CM_T_dV_lpm_128_1_s16 0.0 255.9921875 EXTENDED_LIMITS -256.0 255.9921875
 /begin AXIS_DESCR COM_AXIS TCFRve_n_AbsP1MtrSpd CM_T_n_rpm_1_1_s16 9 0.0 32767.0 AXIS_PTS_REF TCFRkn_n_P1Lubrication /end AXIS_DESCR
/end CHARACTERISTIC
/begin AXIS_PTS TCFRkn_n_P1Lubrication "Support point axis for absolute P1 speed used by lubrication flow need due to P1 system is rotating" 0x0000 /* @ECU_Address@TCFRkn_n_P1Lubrication@ */ TCFRve_n_AbsP1MtrSpd Lookup1D_X_WORD 0 CM_T_n_rpm_1_1_s16 9 0.0 32767.0 EXTENDED_LIMITS -32768.0 32767.0 /end AXIS_PTS
/begin CHARACTERISTIC TCFRkt_dV_P3Lubrication "Lubrication need to to P3 system is rotating" CURVE 0x0000 /* @ECU_Address@TCFRkt_dV_P3Lubrication@ */ Lookup1D_WORD 0 CM_T_dV_lpm_128_1_s16 0.0 255.9921875 EXTENDED_LIMITS -256.0 255.9921875
 /begin AXIS_DESCR COM_AXIS TCFRve_n_AbsP3MtrSpd CM_T_n_rpm_1_1_s16 9 0.0 32767.0 AXIS_PTS_REF TCFRkn_n_P3Lubrication /end AXIS_DESCR
/end CHARACTERISTIC
/begin AXIS_PTS TCFRkn_n_P3Lubrication "Support point axis for absolute P3 speed used by lubrication flow need due to P3 system is rotating" 0x0000 /* @ECU_Address@TCFRkn_n_P3Lubrication@ */ TCFRve_n_AbsP3MtrSpd Lookup1D_X_WORD 0 CM_T_n_rpm_1_1_s16 9 0.0 32767.0 EXTENDED_LIMITS -32768.0 32767.0 /end AXIS_PTS
/begin CHARACTERISTIC TCFRkt_dV_MinLubrication "The minimum lubrication, if P1 or P3 motor is determined to be moving, dependent on oil-temperature" CURVE 0x0000 /* @ECU_Address@TCFRkt_dV_MinLubrication@ */ Lookup1D_WORD 0 CM_T_dV_lpm_128_1_s16 0.0 255.9921875 EXTENDED_LIMITS -256.0 255.9921875
 /begin AXIS_DESCR COM_AXIS TCFRve_T_OilTemp CM_T_T_degC_16_1_s16 8 -2048.0 2047.9375 AXIS_PTS_REF TCFRkn_T_MinLubrication /end AXIS_DESCR
/end CHARACTERISTIC
/begin AXIS_PTS TCFRkn_T_MinLubrication "Support point axis for oil temperature, used for minimum lubrication if P1 or P3 motor is determined to be moving" 0x0000 /* @ECU_Address@TCFRkn_T_MinLubrication@ */ TCFRve_T_OilTemp Lookup1D_X_WORD 0 CM_T_T_degC_16_1_s16 8 -2048.0 2047.9375 /end AXIS_PTS
/begin CHARACTERISTIC TCFRke_I_Busbar_BSW_CurrentLimit "### Description
      This is the BSW current limit for Busbar Current
      ### Usage
      Set to the same value as used in BSW
      ### Calibration Note
      " VALUE 0x0000 /* @ECU_Address@TCFRke_I_Busbar_BSW_CurrentLimit@ */ Scalar_FLOAT32_IEEE 0 CM_T_I_A_Float32 0.1 3.4E+38 EXTENDED_LIMITS -3.4E+38 3.4E+38 /end CHARACTERISTIC
/begin CHARACTERISTIC TCFRke_I_MinLubricationCurrentRampDown "This is the maximum ramp-down of \"stored\" busbar current needed for MinLubrication flow, it is used when at MinLubrication flow and when above MinLubrication and the current is below the \"stored\" MinLubrication current." VALUE 0x0000 /* @ECU_Address@TCFRke_I_MinLubricationCurrentRampDown@ */ Scalar_FLOAT32_IEEE 0 CM_T_I_A_Float32 -1024.0 0.0 EXTENDED_LIMITS -3.4E+38 3.4E+38 /end CHARACTERISTIC
/begin CHARACTERISTIC TCFRke_I_MinLubricationCurrentRampUp "This is the maximum ramp-up of \"stored\" busbar current needed for MinLubrication flow, it is used when at MinLubrication flow" VALUE 0x0000 /* @ECU_Address@TCFRke_I_MinLubricationCurrentRampUp@ */ Scalar_FLOAT32_IEEE 0 CM_T_I_A_Float32 0.03125 3.4E+38 EXTENDED_LIMITS -3.4E+38 3.4E+38 /end CHARACTERISTIC
/begin CHARACTERISTIC TCFRke_I_SumCur_BSW_CurrentLimit "### Description
      This is the BSW current limit for SumCur Current
      ### Usage
      Set to the same value as used in BSW
      ### Calibration Note
      " VALUE 0x0000 /* @ECU_Address@TCFRke_I_SumCur_BSW_CurrentLimit@ */ Scalar_FLOAT32_IEEE 0 CM_T_I_A_Float32 0.1 3.4E+38 EXTENDED_LIMITS -3.4E+38 3.4E+38 /end CHARACTERISTIC
/begin CHARACTERISTIC TCFRke_K_Busbar_BSW_CurrentLimit "Low pass filter koefficient =  deltaT/T
      Where deltaT is periodicity for the filter, here 1 sec.
      And T is timeconstant for filter.
      " VALUE 0x0000 /* @ECU_Address@TCFRke_K_Busbar_BSW_CurrentLimit@ */ Scalar_FLOAT32_IEEE 0 CM_T_K_NA_Float32 0.0 1.0 EXTENDED_LIMITS -3.4E+38 3.4E+38 /end CHARACTERISTIC
/begin CHARACTERISTIC TCFRke_K_SumCur_BSW_CurrentLimit "Low pass filter koefficient =  deltaT/T
      Where deltaT is periodicity for the filter, here 1 sec.
      And T is timeconstant for filter.
      " VALUE 0x0000 /* @ECU_Address@TCFRke_K_SumCur_BSW_CurrentLimit@ */ Scalar_FLOAT32_IEEE 0 CM_T_K_NA_Float32 0.0 1.0 EXTENDED_LIMITS -3.4E+38 3.4E+38 /end CHARACTERISTIC
/begin CHARACTERISTIC TCFRke_r_SumCurMargin_CAP_CurrentLimit "### Description
      This is the marging target of SumCur Y value by limiting CAP phase current. The flow needs to be reduced down to MinLubrication for CAP limitation to be enalbed though.
      ### Usage
      Set to desired margin of SumCur load by limiting CAP Phase current
      ### Calibration Note
      No lubrication request and no cooling request, will result in being at MinLubrication.
      
      " VALUE 0x0000 /* @ECU_Address@TCFRke_r_SumCurMargin_CAP_CurrentLimit@ */ Scalar_FLOAT32_IEEE 0 CM_T_r_NA_Float32 0.0 2.0 EXTENDED_LIMITS -3.4E+38 3.4E+38 /end CHARACTERISTIC
/begin CHARACTERISTIC TCFRke_e_CoolingSafeModeFanRequest "This is the minimum fan-request for \"Safe-mode\" when function action \"ForceTransOilCoolingToSafeCoolingMode\" is set" VALUE 0x0000 /* @ECU_Address@TCFRke_e_CoolingSafeModeFanRequest@ */ Scalar_UBYTE 0 CM_TCFRte_e_FanRequest 0 2 EXTENDED_LIMITS 0 0 /end CHARACTERISTIC
/begin CHARACTERISTIC TCFRke_e_FanCoolingAfterRun "Fan setpoint to be used when in cooling afterrun" VALUE 0x0000 /* @ECU_Address@TCFRke_e_FanCoolingAfterRun@ */ Scalar_UBYTE 0 CM_TCFRte_e_FanRequest 0 2 EXTENDED_LIMITS 0 0 /end CHARACTERISTIC
/begin CHARACTERISTIC TCFRke_n_DisableCoolingInStandstill "The max motor speed to disable cooling when the vehicle is standstill" VALUE 0x0000 /* @ECU_Address@TCFRke_n_DisableCoolingInStandstill@ */ Scalar_SWORD 0 CM_T_n_rpm_1_1_s16 0.0 32767.0 EXTENDED_LIMITS -32768.0 32767.0 /end CHARACTERISTIC
/begin CHARACTERISTIC TCFRke_n_P1_MinSpeedForLubrication "This is the absolute P1 speed limit for requiring MinLubrication, if absolute P1 speed is greater than this value then MinLubrication is needed" VALUE 0x0000 /* @ECU_Address@TCFRke_n_P1_MinSpeedForLubrication@ */ Scalar_SWORD 0 CM_T_n_rpm_1_1_s16 -1.0 32767 EXTENDED_LIMITS -32768.0 32767.0 /end CHARACTERISTIC
/begin CHARACTERISTIC TCFRke_n_P1_MinSpeedForLubricationOff "This is the absolute P1 speed limit for not requiring MinLubrication, if absolute P1 speed is less than this value then MinLubrication is switched off" VALUE 0x0000 /* @ECU_Address@TCFRke_n_P1_MinSpeedForLubricationOff@ */ Scalar_SWORD 0 CM_T_n_rpm_1_1_s16 -1.0 32767 EXTENDED_LIMITS -32768.0 32767.0 /end CHARACTERISTIC
/begin CHARACTERISTIC TCFRke_n_P3_MinSpeedForLubrication "This is the absolute P3 speed limit for requiring MinLubrication, if absolute P3 speed is greater than this value then MinLubrication is needed" VALUE 0x0000 /* @ECU_Address@TCFRke_n_P3_MinSpeedForLubrication@ */ Scalar_SWORD 0 CM_T_n_rpm_1_1_s16 -1.0 32767 EXTENDED_LIMITS -32768.0 32767.0 /end CHARACTERISTIC
/begin CHARACTERISTIC TCFRke_n_P3_MinSpeedForLubricationOff "This is the absolute P3 speed limit for not requiring MinLubrication, if absolute P3 speed is less than this value then MinLubrication is switched off" VALUE 0x0000 /* @ECU_Address@TCFRke_n_P3_MinSpeedForLubricationOff@ */ Scalar_SWORD 0 CM_T_n_rpm_1_1_s16 -1.0 32767 EXTENDED_LIMITS -32768.0 32767.0 /end CHARACTERISTIC
/begin CHARACTERISTIC TCFRke_Cnt_ClutchAvailableStabilization "This is a stabilization time for clutch available to be indicated, the temperature conditions needs to be fulfilled for this many samples before clutch available is indicated" VALUE 0x0000 /* @ECU_Address@TCFRke_Cnt_ClutchAvailableStabilization@ */ Scalar_UWORD 0 CM_T_Cnt_Num_1_1_u16 0.0 65535.0 /end CHARACTERISTIC
/begin CHARACTERISTIC TCFRke_Cnt_CoolingNeedPreventsCoolingIOC_Stabilization "This is a stabilization time for cooling IOC (ShortTermAdjustment) to be allowed, the temperature conditions needs to be fulfilled for this many samples before IOC is allowed" VALUE 0x0000 /* @ECU_Address@TCFRke_Cnt_CoolingNeedPreventsCoolingIOC_Stabilization@ */ Scalar_UWORD 0 CM_T_Cnt_Num_1_1_u16 0.0 65535.0 /end CHARACTERISTIC
/begin CHARACTERISTIC TCFRke_Cnt_DisableCoolingDelay "Delay to disable cooling when P1 or P3 motor is stopped" VALUE 0x0000 /* @ECU_Address@TCFRke_Cnt_DisableCoolingDelay@ */ Scalar_UWORD 0 CM_T_Cnt_Num_1_1_u16 0 65535 /end CHARACTERISTIC
/begin CHARACTERISTIC TCFRke_Cnt_FanRequestHighMinReqTime "Min hold time for fan request high, in counts of periodic sample time at 10 ms.
      Note, not delay for releasing but minimum total request time.
      " VALUE 0x0000 /* @ECU_Address@TCFRke_Cnt_FanRequestHighMinReqTime@ */ Scalar_UWORD 0 CM_T_Cnt_Num_1_1_u16 0.0 65535.0 /end CHARACTERISTIC
/begin CHARACTERISTIC TCFRke_Cnt_FanRequestLowMinReqTime "Min hold time for fan request low, in counts of periodic sample time at 10 ms.
      Note, not delay for releasing but minimum total request time.
      
      If high speed has been requested, then fan low will be held for this duration after high request.
      " VALUE 0x0000 /* @ECU_Address@TCFRke_Cnt_FanRequestLowMinReqTime@ */ Scalar_UWORD 0 CM_T_Cnt_Num_1_1_u16 0.0 65535.0 /end CHARACTERISTIC
/begin CHARACTERISTIC TCFRke_Cnt_LongCooling "Time for long afterrun cooling, in counts of periodic sample time (10ms)" VALUE 0x0000 /* @ECU_Address@TCFRke_Cnt_LongCooling@ */ Scalar_UWORD 0 CM_T_Cnt_Num_1_1_u16 0.0 65535 /end CHARACTERISTIC
/begin CHARACTERISTIC TCFRke_Cnt_LubricationAtIgnitionOn "This time enables running the CCP at MinLubrication speed for the specified number of samples (running at 10ms), to ensure some lubrication of gears before anything starts moving" VALUE 0x0000 /* @ECU_Address@TCFRke_Cnt_LubricationAtIgnitionOn@ */ Scalar_UWORD 0 CM_T_Cnt_Num_1_1_u16 0.0 65535.0 /end CHARACTERISTIC
/begin CHARACTERISTIC TCFRke_Cnt_MinLubricationMinActivation "This is the minimum activation time of MinLubrication (in counts of 10ms task cycles).
      If speed condition to trigger MinLubrication is set, then the MinLubrication is held active for at least this amount of samples since first requested.
      
      " VALUE 0x0000 /* @ECU_Address@TCFRke_Cnt_MinLubricationMinActivation@ */ Scalar_UWORD 0 CM_T_Cnt_Num_1_1_u16 0.0 65535.0 /end CHARACTERISTIC
/begin CHARACTERISTIC TCFRke_Cnt_PrepareShutdown "Time for preparing shutdown, to be able to lower fan-request and cooling flow before releasing afterrun-request, in counts of periodic sample time (10ms)" VALUE 0x0000 /* @ECU_Address@TCFRke_Cnt_PrepareShutdown@ */ Scalar_UWORD 0 CM_T_Cnt_Num_1_1_u16 0.0 65535 /end CHARACTERISTIC
/begin CHARACTERISTIC TCFRke_Cnt_ShortCooling "Time for short afterrun cooling, in counts of periodic sample time (10ms)" VALUE 0x0000 /* @ECU_Address@TCFRke_Cnt_ShortCooling@ */ Scalar_UWORD 0 CM_T_Cnt_Num_1_1_u16 0.0 65535 /end CHARACTERISTIC
/begin CHARACTERISTIC TCFRke_dV_DelayBeforeCurrentSetpointUpdate "This specifies the delay, in 10ms samples, before setting AtMinLubrication which is needed for updating the current needed MinLubrication" VALUE 0x0000 /* @ECU_Address@TCFRke_dV_DelayBeforeCurrentSetpointUpdate@ */ Scalar_UWORD 0 CM_T_Cnt_Num_1_1_u16 0 65535 /end CHARACTERISTIC
/begin CHARACTERISTIC TCFRke_T_CAP_PS_HighFanOff "Switching point for not requesting high fan due to CAP PowerStage temp less than this value" VALUE 0x0000 /* @ECU_Address@TCFRke_T_CAP_PS_HighFanOff@ */ Scalar_SWORD 0 CM_T_T_degC_16_1_s16 -2048.0 2047.9375 /end CHARACTERISTIC
/begin CHARACTERISTIC TCFRke_T_CAP_PS_HighFanOn "Switching point for requesting high fan due to CAP PowerStage temp greater than this value" VALUE 0x0000 /* @ECU_Address@TCFRke_T_CAP_PS_HighFanOn@ */ Scalar_SWORD 0 CM_T_T_degC_16_1_s16 -2048.0 2047.9375 /end CHARACTERISTIC
/begin COMPU_METHOD CM_T_dV_lpm_128_1_s16 "Q = V*128.000000" RAT_FUNC "%10.7" "lpm (liters / minute  (l/m))" COEFFS 0 128 0 0 0 1 /end COMPU_METHOD
/begin COMPU_METHOD CM_T_T_degC_16_1_s16 "Q = V*16.000000" RAT_FUNC "%8.4" "degC (degrees Celsius  (deg C))" COEFFS 0 16 0 0 0 1 /end COMPU_METHOD
/begin COMPU_METHOD CM_T_r_NA_32768_1_u16 "Q = V*32768.000000" RAT_FUNC "%16.15" "NA (none)" COEFFS 0 32768 0 0 0 1 /end COMPU_METHOD
/begin COMPU_METHOD CM_T_n_rpm_1_1_s16 "Q = V" RAT_FUNC "%5.0" "rpm (revolutions / minute  (rpm))" COEFFS 0 1 0 0 0 1 /end COMPU_METHOD
/begin COMPU_METHOD CM_T_I_A_Float32 "Q = V" RAT_FUNC "%8.6" "A (amperes  (A))" COEFFS 0 1 0 0 0 1 /end COMPU_METHOD
/begin COMPU_METHOD CM_T_K_NA_Float32 "Q = V" RAT_FUNC "%8.6" "NA (dependent upon the gain)" COEFFS 0 1 0 0 0 1 /end COMPU_METHOD
/begin COMPU_METHOD CM_T_r_NA_Float32 "Q = V" RAT_FUNC "%8.6" "NA (none)" COEFFS 0 1 0 0 0 1 /end COMPU_METHOD
/begin COMPU_METHOD CM_TCFRte_e_FanRequest "Enumerated data type: TCFRte_e_FanRequest" TAB_VERB "%0.6" "" COMPU_TAB_REF VTAB_FOR_CM_TCFRte_e_FanRequest /end COMPU_METHOD
/begin COMPU_VTAB VTAB_FOR_CM_TCFRte_e_FanRequest "Enumerated data type: TCFRte_e_FanRequest" TAB_VERB 3 0 "TCFRce_e_FanRequestOff" 1 "TCFRce_e_FanRequestLow" 2 "TCFRce_e_FanRequestHigh" /end COMPU_VTAB
/begin COMPU_METHOD CM_T_Cnt_Num_1_1_u16 "Q = V" RAT_FUNC "%5.0" "Num (counts)" COEFFS 0 1 0 0 0 1 /end COMPU_METHOD
/begin COMPU_METHOD CM_T_I_A_32_1_s16 "Q = V*32.000000" RAT_FUNC "%9.5" "A (amperes  (A))" COEFFS 0 32 0 0 0 1 /end COMPU_METHOD
/begin COMPU_METHOD CM_T_K_NA_32768_1_u16 "Q = V*32768.000000" RAT_FUNC "%16.15" "NA (dependent upon the gain)" COEFFS 0 32768 0 0 0 1 /end COMPU_METHOD
/begin COMPU_METHOD CM_T_r_NA_1024_1_s16 "Q = V*1024.000000" RAT_FUNC "%12.10" "NA (none)" COEFFS 0 1024 0 0 0 1 /end COMPU_METHOD
/begin COMPU_METHOD CM_T_Pct_pct_256_1_s16 "Q = V*256.000000" RAT_FUNC "%11.8" "pct (percent  (%))" COEFFS 0 256 0 0 0 1 /end COMPU_METHOD
/begin COMPU_METHOD CM_T_BOOLEAN "Q = V" RAT_FUNC "%1.0" "Bool" COEFFS 0 1 0 0 0 1 /end COMPU_METHOD
/begin COMPU_METHOD CM_T_Cnt_Num_1_1_u8 "Q = V" RAT_FUNC "%3.0" "Num (counts)" COEFFS 0 1 0 0 0 1 /end COMPU_METHOD
/* EOF TCFR.a2l */
/begin RECORD_LAYOUT Scalar_BOOLEAN FNC_VALUES 1 UBYTE COLUMN_DIR DIRECT /end RECORD_LAYOUT
/begin RECORD_LAYOUT Scalar_UBYTE FNC_VALUES 1 UBYTE COLUMN_DIR DIRECT /end RECORD_LAYOUT
/begin RECORD_LAYOUT Scalar_BYTE FNC_VALUES 1 SBYTE COLUMN_DIR DIRECT /end RECORD_LAYOUT
/begin RECORD_LAYOUT Scalar_UWORD FNC_VALUES 1 UWORD COLUMN_DIR DIRECT /end RECORD_LAYOUT
/begin RECORD_LAYOUT Scalar_SWORD FNC_VALUES 1 SWORD COLUMN_DIR DIRECT /end RECORD_LAYOUT
/begin RECORD_LAYOUT Scalar_ULONG FNC_VALUES 1 ULONG COLUMN_DIR DIRECT /end RECORD_LAYOUT
/begin RECORD_LAYOUT Scalar_LONG FNC_VALUES 1 SLONG COLUMN_DIR DIRECT /end RECORD_LAYOUT
/begin RECORD_LAYOUT Scalar_FLOAT32_IEEE FNC_VALUES 1 FLOAT32_IEEE COLUMN_DIR DIRECT /end RECORD_LAYOUT
/begin RECORD_LAYOUT Scalar_FLOAT64_IEEE FNC_VALUES 1 FLOAT64_IEEE COLUMN_DIR DIRECT /end RECORD_LAYOUT
/begin RECORD_LAYOUT Lookup1D_BYTE FNC_VALUES 1 SBYTE COLUMN_DIR DIRECT /end RECORD_LAYOUT
/begin RECORD_LAYOUT Lookup1D_X_BYTE AXIS_PTS_X 1 SBYTE INDEX_INCR DIRECT /end RECORD_LAYOUT
/begin RECORD_LAYOUT Lookup1D_UBYTE FNC_VALUES 1 UBYTE COLUMN_DIR DIRECT /end RECORD_LAYOUT
/begin RECORD_LAYOUT Lookup1D_X_UBYTE AXIS_PTS_X 1 UBYTE INDEX_INCR DIRECT /end RECORD_LAYOUT
/begin RECORD_LAYOUT Lookup1D_UWORD FNC_VALUES 1 UWORD COLUMN_DIR DIRECT /end RECORD_LAYOUT
/begin RECORD_LAYOUT Lookup1D_WORD FNC_VALUES 1 SWORD COLUMN_DIR DIRECT /end RECORD_LAYOUT
/begin RECORD_LAYOUT Lookup1D_X_WORD AXIS_PTS_X 1 SWORD INDEX_INCR DIRECT /end RECORD_LAYOUT
/begin RECORD_LAYOUT Lookup1D_ULONG FNC_VALUES 1 ULONG COLUMN_DIR DIRECT /end RECORD_LAYOUT
/begin RECORD_LAYOUT Lookup1D_X_ULONG AXIS_PTS_X 1 ULONG INDEX_INCR DIRECT /end RECORD_LAYOUT
/begin RECORD_LAYOUT Lookup1D_SLONG FNC_VALUES 1 SLONG COLUMN_DIR DIRECT /end RECORD_LAYOUT
/begin RECORD_LAYOUT Lookup1D_X_LONG AXIS_PTS_X 1 SLONG INDEX_INCR DIRECT /end RECORD_LAYOUT
/begin RECORD_LAYOUT Lookup1D_FLOAT32_IEEE FNC_VALUES 1 FLOAT32_IEEE COLUMN_DIR DIRECT /end RECORD_LAYOUT
/begin RECORD_LAYOUT Lookup1D_X_FLOAT32_IEEE AXIS_PTS_X 1 FLOAT32_IEEE INDEX_INCR DIRECT /end RECORD_LAYOUT
/begin RECORD_LAYOUT Lookup1D_FLOAT64_IEEE FNC_VALUES 1 FLOAT64_IEEE COLUMN_DIR DIRECT /end RECORD_LAYOUT
/begin RECORD_LAYOUT Lookup1D_X_FLOAT64_IEEE AXIS_PTS_X 1 FLOAT64_IEEE INDEX_INCR DIRECT /end RECORD_LAYOUT
/begin RECORD_LAYOUT Lookup2D_UBYTE FNC_VALUES 1 UBYTE COLUMN_DIR DIRECT /end RECORD_LAYOUT
/begin RECORD_LAYOUT Lookup2D_X_UBYTE AXIS_PTS_X 1 UBYTE INDEX_INCR DIRECT /end RECORD_LAYOUT
/begin RECORD_LAYOUT Lookup2D_BYTE FNC_VALUES 1 SBYTE COLUMN_DIR DIRECT /end RECORD_LAYOUT
/begin RECORD_LAYOUT Lookup2D_X_BYTE AXIS_PTS_X 1 SBYTE INDEX_INCR DIRECT /end RECORD_LAYOUT
/begin RECORD_LAYOUT Lookup2D_ULONG FNC_VALUES 1 ULONG COLUMN_DIR DIRECT /end RECORD_LAYOUT
/begin RECORD_LAYOUT Lookup2D_X_ULONG AXIS_PTS_X 1 ULONG INDEX_INCR DIRECT /end RECORD_LAYOUT
/begin RECORD_LAYOUT Lookup2D_LONG FNC_VALUES 1 SLONG COLUMN_DIR DIRECT /end RECORD_LAYOUT
/begin RECORD_LAYOUT Lookup2D_X_LONG AXIS_PTS_X 1 SLONG INDEX_INCR DIRECT /end RECORD_LAYOUT
/begin RECORD_LAYOUT Lookup2D_FLOAT32_IEEE FNC_VALUES 1 FLOAT32_IEEE COLUMN_DIR DIRECT /end RECORD_LAYOUT
/begin RECORD_LAYOUT Lookup2D_X_FLOAT32_IEEE AXIS_PTS_X 1 FLOAT32_IEEE INDEX_INCR DIRECT /end RECORD_LAYOUT
/begin RECORD_LAYOUT Lookup2D_FLOAT64_IEEE FNC_VALUES 1 FLOAT64_IEEE COLUMN_DIR DIRECT /end RECORD_LAYOUT
/begin RECORD_LAYOUT Lookup2D_X_FLOAT64_IEEE AXIS_PTS_X 1 FLOAT64_IEEE INDEX_INCR DIRECT /end RECORD_LAYOUT
/begin COMPU_METHOD CM_T_n_rpm_1_1_s16 "Q = V" RAT_FUNC "%5.0" "rpm (revolutions / minute  (rpm))" COEFFS 0 1 0 0 0 1 /end COMPU_METHOD
/begin COMPU_METHOD CM_T_Cnt_Num_1_1_u16 "Q = V" RAT_FUNC "%5.0" "Num (counts)" COEFFS 0 1 0 0 0 1 /end COMPU_METHOD
/begin COMPU_METHOD CM_T_T_degC_16_1_s16 "Q = V*16.000000" RAT_FUNC "%8.4" "degC (degrees Celsius  (deg C))" COEFFS 0 16 0 0 0 1 /end COMPU_METHOD
/begin COMPU_METHOD CM_T_BOOLEAN "Q = V" RAT_FUNC "%1.0" "Bool" COEFFS 0 1 0 0 0 1 /end COMPU_METHOD
/begin COMPU_METHOD CM_T_I_A_32_1_s16 "Q = V*32.000000" RAT_FUNC "%9.5" "A (amperes  (A))" COEFFS 0 32 0 0 0 1 /end COMPU_METHOD
/begin COMPU_METHOD CM_T_Pct_pct_10_1_s16 "Q = V*10.000000" RAT_FUNC "%0.6" "pct (percent  (%))" COEFFS 0 10 0 0 0 1 /end COMPU_METHOD
/begin COMPU_METHOD CM_T_y_BitFieldDiagStatus "Q = V" RAT_FUNC "%3.0" "BitField" COEFFS 0 1 0 0 0 1 /end COMPU_METHOD
/begin COMPU_METHOD CM_T_y_BitField8 "Q = V" RAT_FUNC "%3.0" "BitField" COEFFS 0 1 0 0 0 1 /end COMPU_METHOD
/* EOF TCMD.a2l */
/begin RECORD_LAYOUT Scalar_BOOLEAN FNC_VALUES 1 UBYTE COLUMN_DIR DIRECT /end RECORD_LAYOUT
/begin RECORD_LAYOUT Scalar_UBYTE FNC_VALUES 1 UBYTE COLUMN_DIR DIRECT /end RECORD_LAYOUT
/begin RECORD_LAYOUT Scalar_BYTE FNC_VALUES 1 SBYTE COLUMN_DIR DIRECT /end RECORD_LAYOUT
/begin RECORD_LAYOUT Scalar_UWORD FNC_VALUES 1 UWORD COLUMN_DIR DIRECT /end RECORD_LAYOUT
/begin RECORD_LAYOUT Scalar_SWORD FNC_VALUES 1 SWORD COLUMN_DIR DIRECT /end RECORD_LAYOUT
/begin RECORD_LAYOUT Scalar_ULONG FNC_VALUES 1 ULONG COLUMN_DIR DIRECT /end RECORD_LAYOUT
/begin RECORD_LAYOUT Scalar_LONG FNC_VALUES 1 SLONG COLUMN_DIR DIRECT /end RECORD_LAYOUT
/begin RECORD_LAYOUT Scalar_FLOAT32_IEEE FNC_VALUES 1 FLOAT32_IEEE COLUMN_DIR DIRECT /end RECORD_LAYOUT
/begin RECORD_LAYOUT Scalar_FLOAT64_IEEE FNC_VALUES 1 FLOAT64_IEEE COLUMN_DIR DIRECT /end RECORD_LAYOUT
/begin RECORD_LAYOUT Lookup1D_BYTE FNC_VALUES 1 SBYTE COLUMN_DIR DIRECT /end RECORD_LAYOUT
/begin RECORD_LAYOUT Lookup1D_X_BYTE AXIS_PTS_X 1 SBYTE INDEX_INCR DIRECT /end RECORD_LAYOUT
/begin RECORD_LAYOUT Lookup1D_UBYTE FNC_VALUES 1 UBYTE COLUMN_DIR DIRECT /end RECORD_LAYOUT
/begin RECORD_LAYOUT Lookup1D_X_UBYTE AXIS_PTS_X 1 UBYTE INDEX_INCR DIRECT /end RECORD_LAYOUT
/begin RECORD_LAYOUT Lookup1D_UWORD FNC_VALUES 1 UWORD COLUMN_DIR DIRECT /end RECORD_LAYOUT
/begin RECORD_LAYOUT Lookup1D_WORD FNC_VALUES 1 SWORD COLUMN_DIR DIRECT /end RECORD_LAYOUT
/begin RECORD_LAYOUT Lookup1D_X_WORD AXIS_PTS_X 1 SWORD INDEX_INCR DIRECT /end RECORD_LAYOUT
/begin RECORD_LAYOUT Lookup1D_ULONG FNC_VALUES 1 ULONG COLUMN_DIR DIRECT /end RECORD_LAYOUT
/begin RECORD_LAYOUT Lookup1D_X_ULONG AXIS_PTS_X 1 ULONG INDEX_INCR DIRECT /end RECORD_LAYOUT
/begin RECORD_LAYOUT Lookup1D_SLONG FNC_VALUES 1 SLONG COLUMN_DIR DIRECT /end RECORD_LAYOUT
/begin RECORD_LAYOUT Lookup1D_X_LONG AXIS_PTS_X 1 SLONG INDEX_INCR DIRECT /end RECORD_LAYOUT
/begin RECORD_LAYOUT Lookup1D_FLOAT32_IEEE FNC_VALUES 1 FLOAT32_IEEE COLUMN_DIR DIRECT /end RECORD_LAYOUT
/begin RECORD_LAYOUT Lookup1D_X_FLOAT32_IEEE AXIS_PTS_X 1 FLOAT32_IEEE INDEX_INCR DIRECT /end RECORD_LAYOUT
/begin RECORD_LAYOUT Lookup1D_FLOAT64_IEEE FNC_VALUES 1 FLOAT64_IEEE COLUMN_DIR DIRECT /end RECORD_LAYOUT
/begin RECORD_LAYOUT Lookup1D_X_FLOAT64_IEEE AXIS_PTS_X 1 FLOAT64_IEEE INDEX_INCR DIRECT /end RECORD_LAYOUT
/begin RECORD_LAYOUT Lookup2D_UBYTE FNC_VALUES 1 UBYTE COLUMN_DIR DIRECT /end RECORD_LAYOUT
/begin RECORD_LAYOUT Lookup2D_X_UBYTE AXIS_PTS_X 1 UBYTE INDEX_INCR DIRECT /end RECORD_LAYOUT
/begin RECORD_LAYOUT Lookup2D_BYTE FNC_VALUES 1 SBYTE COLUMN_DIR DIRECT /end RECORD_LAYOUT
/begin RECORD_LAYOUT Lookup2D_X_BYTE AXIS_PTS_X 1 SBYTE INDEX_INCR DIRECT /end RECORD_LAYOUT
/begin RECORD_LAYOUT Lookup2D_ULONG FNC_VALUES 1 ULONG COLUMN_DIR DIRECT /end RECORD_LAYOUT
/begin RECORD_LAYOUT Lookup2D_X_ULONG AXIS_PTS_X 1 ULONG INDEX_INCR DIRECT /end RECORD_LAYOUT
/begin RECORD_LAYOUT Lookup2D_LONG FNC_VALUES 1 SLONG COLUMN_DIR DIRECT /end RECORD_LAYOUT
/begin RECORD_LAYOUT Lookup2D_X_LONG AXIS_PTS_X 1 SLONG INDEX_INCR DIRECT /end RECORD_LAYOUT
/begin RECORD_LAYOUT Lookup2D_FLOAT32_IEEE FNC_VALUES 1 FLOAT32_IEEE COLUMN_DIR DIRECT /end RECORD_LAYOUT
/begin RECORD_LAYOUT Lookup2D_X_FLOAT32_IEEE AXIS_PTS_X 1 FLOAT32_IEEE INDEX_INCR DIRECT /end RECORD_LAYOUT
/begin RECORD_LAYOUT Lookup2D_FLOAT64_IEEE FNC_VALUES 1 FLOAT64_IEEE COLUMN_DIR DIRECT /end RECORD_LAYOUT
/begin RECORD_LAYOUT Lookup2D_X_FLOAT64_IEEE AXIS_PTS_X 1 FLOAT64_IEEE INDEX_INCR DIRECT /end RECORD_LAYOUT
/begin COMPU_METHOD CM_T_Cnt_Num_1_1_u16 "Q = V" RAT_FUNC "%5.0" "Num (counts)" COEFFS 0 1 0 0 0 1 /end COMPU_METHOD
/begin COMPU_METHOD CM_T_p_kPa_32_1_u16 "Q = V*32.000000" RAT_FUNC "%9.5" "kPa (kiloPascals  (kPa))" COEFFS 0 32 0 0 0 1 /end COMPU_METHOD
/begin COMPU_METHOD CM_T_K_NA_32768_1_u16 "Q = V*32768.000000" RAT_FUNC "%16.15" "NA (dependent upon the gain)" COEFFS 0 32768 0 0 0 1 /end COMPU_METHOD
/begin COMPU_METHOD CM_T_Cnt_Num_1_1_u8 "Q = V" RAT_FUNC "%3.0" "Num (counts)" COEFFS 0 1 0 0 0 1 /end COMPU_METHOD
/begin COMPU_METHOD CM_T_BOOLEAN "Q = V" RAT_FUNC "%1.0" "Bool" COEFFS 0 1 0 0 0 1 /end COMPU_METHOD
/begin COMPU_METHOD CM_T_y_BitFieldDiagStatus "Q = V" RAT_FUNC "%3.0" "BitField" COEFFS 0 1 0 0 0 1 /end COMPU_METHOD
/begin COMPU_METHOD CM_T_y_BitField8 "Q = V" RAT_FUNC "%3.0" "BitField" COEFFS 0 1 0 0 0 1 /end COMPU_METHOD
/* EOF TCPD.a2l */
/begin RECORD_LAYOUT Scalar_BOOLEAN FNC_VALUES 1 UBYTE COLUMN_DIR DIRECT /end RECORD_LAYOUT
/begin RECORD_LAYOUT Scalar_UBYTE FNC_VALUES 1 UBYTE COLUMN_DIR DIRECT /end RECORD_LAYOUT
/begin RECORD_LAYOUT Scalar_BYTE FNC_VALUES 1 SBYTE COLUMN_DIR DIRECT /end RECORD_LAYOUT
/begin RECORD_LAYOUT Scalar_UWORD FNC_VALUES 1 UWORD COLUMN_DIR DIRECT /end RECORD_LAYOUT
/begin RECORD_LAYOUT Scalar_SWORD FNC_VALUES 1 SWORD COLUMN_DIR DIRECT /end RECORD_LAYOUT
/begin RECORD_LAYOUT Scalar_ULONG FNC_VALUES 1 ULONG COLUMN_DIR DIRECT /end RECORD_LAYOUT
/begin RECORD_LAYOUT Scalar_LONG FNC_VALUES 1 SLONG COLUMN_DIR DIRECT /end RECORD_LAYOUT
/begin RECORD_LAYOUT Scalar_FLOAT32_IEEE FNC_VALUES 1 FLOAT32_IEEE COLUMN_DIR DIRECT /end RECORD_LAYOUT
/begin RECORD_LAYOUT Scalar_FLOAT64_IEEE FNC_VALUES 1 FLOAT64_IEEE COLUMN_DIR DIRECT /end RECORD_LAYOUT
/begin RECORD_LAYOUT Lookup1D_UBYTE FNC_VALUES 1 UBYTE COLUMN_DIR DIRECT /end RECORD_LAYOUT
/begin RECORD_LAYOUT Lookup1D_UWORD FNC_VALUES 1 UWORD COLUMN_DIR DIRECT /end RECORD_LAYOUT
/begin RECORD_LAYOUT Lookup1D_WORD FNC_VALUES 1 SWORD COLUMN_DIR DIRECT /end RECORD_LAYOUT
/begin RECORD_LAYOUT Lookup1D_X_WORD AXIS_PTS_X 1 SWORD INDEX_INCR DIRECT /end RECORD_LAYOUT
/begin COMPU_METHOD CM_T_Cnt_Num_1_1_u16 "Q = V" RAT_FUNC "%5.0" "Num (counts)" COEFFS 0 1 0 0 0 1 /end COMPU_METHOD
/begin COMPU_METHOD CM_T_Cnt_Num_1_1_u8 "Q = V" RAT_FUNC "%3.0" "Num (counts)" COEFFS 0 1 0 0 0 1 /end COMPU_METHOD
/begin COMPU_METHOD CM_T_BOOLEAN "Q = V" RAT_FUNC "%1.0" "Bool" COEFFS 0 1 0 0 0 1 /end COMPU_METHOD
/begin COMPU_METHOD CM_SPARte_e_Validity "Enumerated data type: SPARte_e_Validity" TAB_VERB "%0.6" "" COMPU_TAB_REF VTAB_FOR_CM_SPARte_e_Validity /end COMPU_METHOD
/begin COMPU_VTAB VTAB_FOR_CM_SPARte_e_Validity "Enumerated data type: SPARte_e_Validity" TAB_VERB 4 0 "SPARce_e_Valid" 1 "SPARce_e_Invalid" 2 "SPARce_e_EstimatedReplaceValue" 3 "SPARce_e_NotEvaluatedYet" /end COMPU_VTAB
/begin COMPU_METHOD CM_T_y_BitFieldDiagStatus "Q = V" RAT_FUNC "%3.0" "BitField" COEFFS 0 1 0 0 0 1 /end COMPU_METHOD
/* EOF TLMD.a2l */
/begin RECORD_LAYOUT Scalar_BOOLEAN FNC_VALUES 1 UBYTE COLUMN_DIR DIRECT /end RECORD_LAYOUT
/begin RECORD_LAYOUT Scalar_UBYTE FNC_VALUES 1 UBYTE COLUMN_DIR DIRECT /end RECORD_LAYOUT
/begin RECORD_LAYOUT Scalar_UWORD FNC_VALUES 1 UWORD COLUMN_DIR DIRECT /end RECORD_LAYOUT
/begin RECORD_LAYOUT Scalar_SWORD FNC_VALUES 1 SWORD COLUMN_DIR DIRECT /end RECORD_LAYOUT
/begin RECORD_LAYOUT Scalar_ULONG FNC_VALUES 1 ULONG COLUMN_DIR DIRECT /end RECORD_LAYOUT
/begin RECORD_LAYOUT Scalar_FLOAT32_IEEE FNC_VALUES 1 FLOAT32_IEEE COLUMN_DIR DIRECT /end RECORD_LAYOUT
/begin RECORD_LAYOUT Lookup1D_UBYTE FNC_VALUES 1 UBYTE COLUMN_DIR DIRECT /end RECORD_LAYOUT
/begin RECORD_LAYOUT Lookup1D_UWORD FNC_VALUES 1 UWORD COLUMN_DIR DIRECT /end RECORD_LAYOUT
/begin RECORD_LAYOUT Lookup1D_WORD FNC_VALUES 1 SWORD COLUMN_DIR DIRECT /end RECORD_LAYOUT
/begin RECORD_LAYOUT Lookup1D_X_WORD AXIS_PTS_X 1 SWORD INDEX_INCR DIRECT /end RECORD_LAYOUT
/begin COMPU_METHOD CM_T_T_degC_16_1_s16 "Q = V*16.000000" RAT_FUNC "%8.4" "degC (degrees Celsius  (deg C))" COEFFS 0 16 0 0 0 1 /end COMPU_METHOD
/begin COMPU_METHOD CM_T_n_rpm_1_1_s16 "Q = V" RAT_FUNC "%5.0" "rpm (revolutions / minute  (rpm))" COEFFS 0 1 0 0 0 1 /end COMPU_METHOD
/begin COMPU_METHOD CM_T_Cnt_Num_1_1_u16 "Q = V" RAT_FUNC "%5.0" "Num (counts)" COEFFS 0 1 0 0 0 1 /end COMPU_METHOD
/begin COMPU_METHOD CM_T_K_NA_32768_1_u16 "Q = V*32768.000000" RAT_FUNC "%16.15" "NA (dependent upon the gain)" COEFFS 0 32768 0 0 0 1 /end COMPU_METHOD
/begin COMPU_METHOD CM_T_Cnt_Num_1_1_u8 "Q = V" RAT_FUNC "%3.0" "Num (counts)" COEFFS 0 1 0 0 0 1 /end COMPU_METHOD
/begin COMPU_METHOD CM_T_y_BitField8 "Q = V" RAT_FUNC "%3.0" "BitField" COEFFS 0 1 0 0 0 1 /end COMPU_METHOD
/begin COMPU_METHOD CM_T_BOOLEAN "Q = V" RAT_FUNC "%1.0" "Bool" COEFFS 0 1 0 0 0 1 /end COMPU_METHOD
/begin COMPU_METHOD CM_T_y_BitFieldDiagStatus "Q = V" RAT_FUNC "%3.0" "BitField" COEFFS 0 1 0 0 0 1 /end COMPU_METHOD
/* EOF TOTD.a2l */
/begin RECORD_LAYOUT Scalar_BOOLEAN FNC_VALUES 1 UBYTE COLUMN_DIR DIRECT /end RECORD_LAYOUT
/begin RECORD_LAYOUT Scalar_UBYTE FNC_VALUES 1 UBYTE COLUMN_DIR DIRECT /end RECORD_LAYOUT
/begin RECORD_LAYOUT Scalar_UWORD FNC_VALUES 1 UWORD COLUMN_DIR DIRECT /end RECORD_LAYOUT
/begin RECORD_LAYOUT Scalar_SWORD FNC_VALUES 1 SWORD COLUMN_DIR DIRECT /end RECORD_LAYOUT
/begin RECORD_LAYOUT Scalar_ULONG FNC_VALUES 1 ULONG COLUMN_DIR DIRECT /end RECORD_LAYOUT
/begin RECORD_LAYOUT Scalar_FLOAT32_IEEE FNC_VALUES 1 FLOAT32_IEEE COLUMN_DIR DIRECT /end RECORD_LAYOUT
/begin RECORD_LAYOUT Lookup1D_UBYTE FNC_VALUES 1 UBYTE COLUMN_DIR DIRECT /end RECORD_LAYOUT
/begin RECORD_LAYOUT Lookup1D_UWORD FNC_VALUES 1 UWORD COLUMN_DIR DIRECT /end RECORD_LAYOUT
/begin RECORD_LAYOUT Lookup1D_WORD FNC_VALUES 1 SWORD COLUMN_DIR DIRECT /end RECORD_LAYOUT
/begin RECORD_LAYOUT Lookup1D_X_WORD AXIS_PTS_X 1 SWORD INDEX_INCR DIRECT /end RECORD_LAYOUT
/begin COMPU_METHOD CM_T_BOOLEAN "Q = V" RAT_FUNC "%1.0" "Bool" COEFFS 0 1 0 0 0 1 /end COMPU_METHOD
/* EOF TSPC.a2l */
/begin RECORD_LAYOUT Scalar_BOOLEAN FNC_VALUES 1 UBYTE COLUMN_DIR DIRECT /end RECORD_LAYOUT
/begin RECORD_LAYOUT Scalar_UBYTE FNC_VALUES 1 UBYTE COLUMN_DIR DIRECT /end RECORD_LAYOUT
/begin RECORD_LAYOUT Scalar_UWORD FNC_VALUES 1 UWORD COLUMN_DIR DIRECT /end RECORD_LAYOUT
/begin RECORD_LAYOUT Scalar_SWORD FNC_VALUES 1 SWORD COLUMN_DIR DIRECT /end RECORD_LAYOUT
/begin RECORD_LAYOUT Scalar_ULONG FNC_VALUES 1 ULONG COLUMN_DIR DIRECT /end RECORD_LAYOUT
/begin RECORD_LAYOUT Scalar_FLOAT32_IEEE FNC_VALUES 1 FLOAT32_IEEE COLUMN_DIR DIRECT /end RECORD_LAYOUT
/begin RECORD_LAYOUT Lookup1D_UBYTE FNC_VALUES 1 UBYTE COLUMN_DIR DIRECT /end RECORD_LAYOUT
/begin RECORD_LAYOUT Lookup1D_UWORD FNC_VALUES 1 UWORD COLUMN_DIR DIRECT /end RECORD_LAYOUT
/begin RECORD_LAYOUT Lookup1D_WORD FNC_VALUES 1 SWORD COLUMN_DIR DIRECT /end RECORD_LAYOUT
/begin RECORD_LAYOUT Lookup1D_X_WORD AXIS_PTS_X 1 SWORD INDEX_INCR DIRECT /end RECORD_LAYOUT
/begin COMPU_METHOD CM_T_r_NA_Float32 "Q = V" RAT_FUNC "%8.6" "NA (none)" COEFFS 0 1 0 0 0 1 /end COMPU_METHOD
/begin COMPU_METHOD CM_T_n_rpm_1_1_s16 "Q = V" RAT_FUNC "%5.0" "rpm (revolutions / minute  (rpm))" COEFFS 0 1 0 0 0 1 /end COMPU_METHOD
/begin COMPU_METHOD CM_T_Cnt_Num_1_1_u16 "Q = V" RAT_FUNC "%5.0" "Num (counts)" COEFFS 0 1 0 0 0 1 /end COMPU_METHOD
/begin COMPU_METHOD CM_T_M_Nm_32_1_s16 "Q = V*32.000000" RAT_FUNC "%9.5" "Nm (newton-meters  (Nm))" COEFFS 0 32 0 0 0 1 /end COMPU_METHOD
/begin COMPU_METHOD CM_T_p_kPa_32_1_u16 "Q = V*32.000000" RAT_FUNC "%9.5" "kPa (kiloPascals  (kPa))" COEFFS 0 32 0 0 0 1 /end COMPU_METHOD
/begin COMPU_METHOD CM_T_K_NA_32768_1_u16 "Q = V*32768.000000" RAT_FUNC "%16.15" "NA (dependent upon the gain)" COEFFS 0 32768 0 0 0 1 /end COMPU_METHOD
/begin COMPU_METHOD CM_T_Cnt_Num_1_1_u8 "Q = V" RAT_FUNC "%3.0" "Num (counts)" COEFFS 0 1 0 0 0 1 /end COMPU_METHOD
/begin COMPU_METHOD CM_T_BOOLEAN "Q = V" RAT_FUNC "%1.0" "Bool" COEFFS 0 1 0 0 0 1 /end COMPU_METHOD
/begin COMPU_METHOD CM_SPARte_e_Validity "Enumerated data type: SPARte_e_Validity" TAB_VERB "%0.6" "" COMPU_TAB_REF VTAB_FOR_CM_SPARte_e_Validity /end COMPU_METHOD
/begin COMPU_VTAB VTAB_FOR_CM_SPARte_e_Validity "Enumerated data type: SPARte_e_Validity" TAB_VERB 4 0 "SPARce_e_Valid" 1 "SPARce_e_Invalid" 2 "SPARce_e_EstimatedReplaceValue" 3 "SPARce_e_NotEvaluatedYet" /end COMPU_VTAB
/begin COMPU_METHOD CM_T_y_BitFieldDiagStatus "Q = V" RAT_FUNC "%3.0" "BitField" COEFFS 0 1 0 0 0 1 /end COMPU_METHOD
/* EOF TSSD.a2l */
/begin RECORD_LAYOUT Scalar_BOOLEAN FNC_VALUES 1 UBYTE COLUMN_DIR DIRECT /end RECORD_LAYOUT
/begin RECORD_LAYOUT Scalar_UBYTE FNC_VALUES 1 UBYTE COLUMN_DIR DIRECT /end RECORD_LAYOUT
/begin RECORD_LAYOUT Scalar_UWORD FNC_VALUES 1 UWORD COLUMN_DIR DIRECT /end RECORD_LAYOUT
/begin RECORD_LAYOUT Scalar_SWORD FNC_VALUES 1 SWORD COLUMN_DIR DIRECT /end RECORD_LAYOUT
/begin RECORD_LAYOUT Scalar_ULONG FNC_VALUES 1 ULONG COLUMN_DIR DIRECT /end RECORD_LAYOUT
/begin RECORD_LAYOUT Scalar_FLOAT32_IEEE FNC_VALUES 1 FLOAT32_IEEE COLUMN_DIR DIRECT /end RECORD_LAYOUT
/begin RECORD_LAYOUT Lookup1D_UBYTE FNC_VALUES 1 UBYTE COLUMN_DIR DIRECT /end RECORD_LAYOUT
/begin RECORD_LAYOUT Lookup1D_UWORD FNC_VALUES 1 UWORD COLUMN_DIR DIRECT /end RECORD_LAYOUT
/begin RECORD_LAYOUT Lookup1D_WORD FNC_VALUES 1 SWORD COLUMN_DIR DIRECT /end RECORD_LAYOUT
/begin RECORD_LAYOUT Lookup1D_X_WORD AXIS_PTS_X 1 SWORD INDEX_INCR DIRECT /end RECORD_LAYOUT
/begin COMPU_METHOD CM_T_BOOLEAN "Q = V" RAT_FUNC "%1.0" "Bool" COEFFS 0 1 0 0 0 1 /end COMPU_METHOD
/begin COMPU_METHOD CM_T_y_BitField8 "Q = V" RAT_FUNC "%3.0" "BitField" COEFFS 0 1 0 0 0 1 /end COMPU_METHOD
/begin COMPU_METHOD CM_T_y_BitFieldDiagStatus "Q = V" RAT_FUNC "%3.0" "BitField" COEFFS 0 1 0 0 0 1 /end COMPU_METHOD
/* EOF V5RD.a2l */
/begin RECORD_LAYOUT Scalar_BOOLEAN FNC_VALUES 1 UBYTE COLUMN_DIR DIRECT /end RECORD_LAYOUT
/begin RECORD_LAYOUT Scalar_UBYTE FNC_VALUES 1 UBYTE COLUMN_DIR DIRECT /end RECORD_LAYOUT
/begin RECORD_LAYOUT Scalar_UWORD FNC_VALUES 1 UWORD COLUMN_DIR DIRECT /end RECORD_LAYOUT
/begin RECORD_LAYOUT Scalar_SWORD FNC_VALUES 1 SWORD COLUMN_DIR DIRECT /end RECORD_LAYOUT
/begin RECORD_LAYOUT Scalar_ULONG FNC_VALUES 1 ULONG COLUMN_DIR DIRECT /end RECORD_LAYOUT
/begin RECORD_LAYOUT Scalar_FLOAT32_IEEE FNC_VALUES 1 FLOAT32_IEEE COLUMN_DIR DIRECT /end RECORD_LAYOUT
/begin RECORD_LAYOUT Lookup1D_UBYTE FNC_VALUES 1 UBYTE COLUMN_DIR DIRECT /end RECORD_LAYOUT
/begin RECORD_LAYOUT Lookup1D_UWORD FNC_VALUES 1 UWORD COLUMN_DIR DIRECT /end RECORD_LAYOUT
/begin RECORD_LAYOUT Lookup1D_WORD FNC_VALUES 1 SWORD COLUMN_DIR DIRECT /end RECORD_LAYOUT
/begin RECORD_LAYOUT Lookup1D_X_WORD AXIS_PTS_X 1 SWORD INDEX_INCR DIRECT /end RECORD_LAYOUT
/begin COMPU_METHOD CM_T_BOOLEAN "Q = V" RAT_FUNC "%1.0" "Bool" COEFFS 0 1 0 0 0 1 /end COMPU_METHOD
/begin COMPU_METHOD CM_SPARte_e_Validity "Enumerated data type: SPARte_e_Validity" TAB_VERB "%0.6" "" COMPU_TAB_REF VTAB_FOR_CM_SPARte_e_Validity /end COMPU_METHOD
/begin COMPU_VTAB VTAB_FOR_CM_SPARte_e_Validity "Enumerated data type: SPARte_e_Validity" TAB_VERB 4 0 "SPARce_e_Valid" 1 "SPARce_e_Invalid" 2 "SPARce_e_EstimatedReplaceValue" 3 "SPARce_e_NotEvaluatedYet" /end COMPU_VTAB
/end MODULE
/end PROJECT
