ASAP2_VERSION 1 31
/begin PROJECT ProjectName "Project Comment Goes Here"
/begin HEADER "Header Comments go here" /end HEADER
/begin MODULE ModuleName "Module Comment Goes Here"
/begin MOD_COMMON "Mod Common Comment Here" BYTE_ORDER MSB_FIRST /end MOD_COMMON
/begin RECORD_LAYOUT Lookup1D_X_BYTE AXIS_PTS_X 1 SBYTE INDEX_INCR DIRECT /end RECORD_LAYOUT
/begin RECORD_LAYOUT Lookup1D_X_UBYTE AXIS_PTS_X 1 UBYTE INDEX_INCR DIRECT /end RECORD_LAYOUT
/begin MEASUREMENT CANDve_Cnt_DiagCounts "Diagnostic counter for the invalid data diagnosis." UWORD CM_T_Cnt_Num_1_1_u16 0 0 0 65535 ECU_ADDRESS 0x0000 /* @ECU_Address@CANDve_Cnt_DiagCounts@ */ /end MEASUREMENT
/begin MEASUREMENT CANDve_Cnt_DiagFails "Fail counter for the invalid data diagnosis." UWORD CM_T_Cnt_Num_1_1_u16 0 0 0 65535 ECU_ADDRESS 0x0000 /* @ECU_Address@CANDve_Cnt_DiagFails@ */ /end MEASUREMENT
/begin MEASUREMENT CANDve_y_VCUFAULT_DiagCounts "counts" UWORD CM_T_Cnt_Num_1_1_u16 0 0 0 65535 ECU_ADDRESS 0x0000 /* @ECU_Address@CANDve_y_VCUFAULT_DiagCounts@ */ /end MEASUREMENT
/begin MEASUREMENT CANDve_y_VCUFAULT_DiagFails "fails" UWORD CM_T_Cnt_Num_1_1_u16 0 0 0 65535 ECU_ADDRESS 0x0000 /* @ECU_Address@CANDve_y_VCUFAULT_DiagFails@ */ /end MEASUREMENT
/begin MEASUREMENT CANDve_y_ID_Status "Status of the invalid data diagnosis." UBYTE CM_T_y_BitFieldDiagStatus 0 0 0 255 ECU_ADDRESS 0x0000 /* @ECU_Address@CANDve_y_ID_Status@ */ /end MEASUREMENT
/begin MEASUREMENT CANDve_y_Progress "Progress of the invalid data diagnosis." UBYTE CM_T_y_BitFieldDiagProgress 0 0 0 255 ECU_ADDRESS 0x0000 /* @ECU_Address@CANDve_y_Progress@ */ /end MEASUREMENT
/begin MEASUREMENT CANDve_y_VCUFAULT_Progress "progress" UBYTE CM_T_y_BitFieldDiagProgress 0 0 0 255 ECU_ADDRESS 0x0000 /* @ECU_Address@CANDve_y_VCUFAULT_Progress@ */ /end MEASUREMENT
/begin MEASUREMENT CANDve_y_VCUFAULT_Status "Status" UBYTE CM_T_y_BitFieldDiagStatus 0 0 0 255 ECU_ADDRESS 0x0000 /* @ECU_Address@CANDve_y_VCUFAULT_Status@ */ /end MEASUREMENT
/begin COMPU_METHOD CM_T_Cnt_Num_1_1_u16 "Q = V" RAT_FUNC "%5.0" "Num (counts)" COEFFS 0 1 0 0 0 1 /end COMPU_METHOD
/begin COMPU_METHOD CM_T_BOOLEAN "Q = V" RAT_FUNC "%1.0" "Bool" COEFFS 0 1 0 0 0 1 /end COMPU_METHOD
/begin COMPU_METHOD CM_T_y_BitFieldDiagStatus "Q = V" RAT_FUNC "%3.0" "BitField" COEFFS 0 1 0 0 0 1 /end COMPU_METHOD
/begin COMPU_METHOD CM_T_y_BitFieldDiagProgress "Q = V" RAT_FUNC "%3.0" "BitField" COEFFS 0 1 0 0 0 1 /end COMPU_METHOD
/begin COMPU_METHOD CM_T_n_rpm_1_1_s16 "Q = V" RAT_FUNC "%5.0" "rpm (revolutions / minute  (rpm))" COEFFS 0 1 0 0 0 1 /end COMPU_METHOD
/begin COMPU_METHOD CM_T_Cnt_Num_1_1_u16 "Q = V" RAT_FUNC "%5.0" "Num (counts)" COEFFS 0 1 0 0 0 1 /end COMPU_METHOD
/begin COMPU_METHOD CM_T_BOOLEAN "Q = V" RAT_FUNC "%1.0" "Bool" COEFFS 0 1 0 0 0 1 /end COMPU_METHOD
/begin COMPU_METHOD CM_T_n_rpm_1_1_s16 "Q = V" RAT_FUNC "%5.0" "rpm (revolutions / minute  (rpm))" COEFFS 0 1 0 0 0 1 /end COMPU_METHOD
/begin COMPU_METHOD CM_T_Cnt_Num_1_1_u16 "Q = V" RAT_FUNC "%5.0" "Num (counts)" COEFFS 0 1 0 0 0 1 /end COMPU_METHOD
/begin COMPU_METHOD CM_T_BOOLEAN "Q = V" RAT_FUNC "%1.0" "Bool" COEFFS 0 1 0 0 0 1 /end COMPU_METHOD
/begin MEASUREMENT CLPCve_Pct_CAPMPS_DC_Actual "###Description
      Feedback from BLDC for CAPM, TCU_cyc_PwrStgActPWM" SWORD CM_T_Pct_pct_10_1_s16 0 0 -3276.8 3276.7 ECU_ADDRESS 0x0000 /* @ECU_Address@CLPCve_Pct_CAPMPS_DC_Actual@ */ /end MEASUREMENT
/begin MEASUREMENT CLPCve_r_CAP_Y "Normalized filtered CAP Phase Current, when this is above 1 the filtered CAP Phase Current is above the current limit" UWORD CM_T_r_NA_32768_1_u16 0 0 0 1.999969482421875 ECU_ADDRESS 0x0000 /* @ECU_Address@CLPCve_r_CAP_Y@ */ /end MEASUREMENT
/begin MEASUREMENT CLPCve_e_CAP_DID_Enabled "Intermediate variable, current ShortTermAdjustment DID interface active" UBYTE CM_CLPCte_e_DID_State 0 0 0 6 ECU_ADDRESS 0x0000 /* @ECU_Address@CLPCve_e_CAP_DID_Enabled@ */ /end MEASUREMENT
/begin MEASUREMENT CLPCve_n_C_n_CAP_Data "Intermediate variable, this is the CAP target speed request through DID interface" SWORD CM_T_n_rpm_1_1_s16 0 0 -32768.0 32767.0 ECU_ADDRESS 0x0000 /* @ECU_Address@CLPCve_n_C_n_CAP_Data@ */ /end MEASUREMENT
/begin MEASUREMENT CLPCve_p_C_p_CAP_Data "Intermediate variable, this is the CAP target pressure request through DID interface" UWORD CM_T_p_kPa_32_1_u16 0 0 0 2047.96875 ECU_ADDRESS 0x0000 /* @ECU_Address@CLPCve_p_C_p_CAP_Data@ */ /end MEASUREMENT
/begin MEASUREMENT CLPCve_p_KneePoint_Stored "This is the pressure knee-point" SWORD CM_T_p_kPa_64_1_s16 0 0 -512.0 511.984375 ECU_ADDRESS 0x0000 /* @ECU_Address@CLPCve_p_KneePoint_Stored@ */ /end MEASUREMENT
/begin MEASUREMENT CLPCve_Pct_C_Pct_CAP_Data "Intermediate variable, this is the CAP duty-cycle request through DID interface" SWORD CM_T_Pct_pct_10_1_s16 0 0 -100.0 100.0 ECU_ADDRESS 0x0000 /* @ECU_Address@CLPCve_Pct_C_Pct_CAP_Data@ */ /end MEASUREMENT
/begin MEASUREMENT CLPCve_b_NewKissPointAdaptionPointFound "Intermediate variable, the AdaptionFill kiss-point estimation has made a new kiss-point detection" UBYTE CM_T_BOOLEAN 0 0 0.0 1.0 ECU_ADDRESS 0x0000 /* @ECU_Address@CLPCve_b_NewKissPointAdaptionPointFound@ */ /end MEASUREMENT
/begin MEASUREMENT CLPCve_b_KneePoint_FirstDone "This indicates if a pressure knee-point has been found" UBYTE CM_T_BOOLEAN 0 0 0 1 ECU_ADDRESS 0x0000 /* @ECU_Address@CLPCve_b_KneePoint_FirstDone@ */ /end MEASUREMENT
/begin COMPU_METHOD CM_T_n_rpm_1_1_s16 "Q = V" RAT_FUNC "%5.0" "rpm (revolutions / minute  (rpm))" COEFFS 0 1 0 0 0 1 /end COMPU_METHOD
/begin COMPU_METHOD CM_T_p_kPa_32_1_u16 "Q = V*32.000000" RAT_FUNC "%9.5" "kPa (kiloPascals  (kPa))" COEFFS 0 32 0 0 0 1 /end COMPU_METHOD
/begin COMPU_METHOD CM_T_r_NA_32768_1_u16 "Q = V*32768.000000" RAT_FUNC "%16.15" "NA (none)" COEFFS 0 32768 0 0 0 1 /end COMPU_METHOD
/begin COMPU_METHOD CM_T_Cnt_Num_1_1_u16 "Q = V" RAT_FUNC "%5.0" "Num (counts)" COEFFS 0 1 0 0 0 1 /end COMPU_METHOD
/begin COMPU_METHOD CM_T_p_kPa_64_1_s16 "Q = V*64.000000" RAT_FUNC "%10.6" "kPa (kiloPascals  (kPa))" COEFFS 0 64 0 0 0 1 /end COMPU_METHOD
/begin COMPU_METHOD CM_T_Pct_pct_10_1_s16 "Q = V*10.000000" RAT_FUNC "%0.6" "pct (percent  (%))" COEFFS 0 10 0 0 0 1 /end COMPU_METHOD
/begin COMPU_METHOD CM_T_BOOLEAN "Q = V" RAT_FUNC "%1.0" "Bool" COEFFS 0 1 0 0 0 1 /end COMPU_METHOD
/begin COMPU_METHOD CM_CLPCte_e_DID_State "Enumerated data type: CLPCte_e_DID_State" TAB_VERB "%0.6" "" COMPU_TAB_REF VTAB_FOR_CM_CLPCte_e_DID_State /end COMPU_METHOD
/begin COMPU_VTAB VTAB_FOR_CM_CLPCte_e_DID_State "Enumerated data type: CLPCte_e_DID_State" TAB_VERB 4 0 "CLPCce_e_DID_NoActive" 3 "CLPCce_e_DID_DutyCycle" 5 "CLPCce_e_DID_Speed" 6 "CLPCce_e_DID_Pressure" /end COMPU_VTAB
/begin COMPU_METHOD CM_T_BOOLEAN "Q = V" RAT_FUNC "%1.0" "Bool" COEFFS 0 1 0 0 0 1 /end COMPU_METHOD
/begin COMPU_METHOD CM_T_n_rpm_1_1_s16 "Q = V" RAT_FUNC "%5.0" "rpm (revolutions / minute  (rpm))" COEFFS 0 1 0 0 0 1 /end COMPU_METHOD
/begin COMPU_METHOD CM_T_BOOLEAN "Q = V" RAT_FUNC "%1.0" "Bool" COEFFS 0 1 0 0 0 1 /end COMPU_METHOD
/* EOF PORS.a2l */
/begin RECORD_LAYOUT DATA_RECORD_UBYTE FNC_VALUES 1 UBYTE ROW_DIR DIRECT /end RECORD_LAYOUT
/begin RECORD_LAYOUT DATA_RECORD_UWORD FNC_VALUES 1 UWORD ROW_DIR DIRECT /end RECORD_LAYOUT
/begin CHARACTERISTIC ESM_bPowerOffModeInhC "ESM POWER_OFF_MODE state inhibition" VALUE 0x8009BA20 DATA_RECORD_UBYTE 1 Bool_ON_OFF 0 1 BIT_MASK 0x01 /end CHARACTERISTIC
/begin CHARACTERISTIC ESM_ku16AfterrunToutCntC "ESM_ku16AfterrunToutCntC" VALUE 0x80060AA8 DATA_RECORD_UWORD 327675 F_5_p0_28 0 327675 /end CHARACTERISTIC
/begin MEASUREMENT APSSve_Pct_AccPedPos "..." SWORD F_0v1_p0_2 1 2 -3276.8 3276.7 ECU_ADDRESS 0x70020FEE /end MEASUREMENT
/begin MEASUREMENT BPPDve_b_BrakeSwitchActive "..." UBYTE I_1 1 2 0 255 ECU_ADDRESS 0x70021313 /end MEASUREMENT
/begin MEASUREMENT CACEve_b_IgnitionOn "..." UBYTE Bool_ON_OFF 1 2 0 1 BIT_MASK 0x01 ECU_ADDRESS 0x70021312 /end MEASUREMENT
/begin MEASUREMENT CANDve_b_ATFailure "..." UBYTE I_1 1 2 0 255 ECU_ADDRESS 0x70021309 /end MEASUREMENT
/begin MEASUREMENT CANDve_e_VCU_InvalidDataVld "..." UBYTE I_1 1 2 0 255 ECU_ADDRESS 0x70021310 /end MEASUREMENT
/begin MEASUREMENT CANDve_y_HTCU_Fault "..." UBYTE I_1 1 2 0 255 ECU_ADDRESS 0x7002130C /end MEASUREMENT
/begin MEASUREMENT CANDve_y_HTCU_State "..." UBYTE I_1 1 2 0 255 ECU_ADDRESS 0x7002130B /end MEASUREMENT
/begin MEASUREMENT CANDve_y_Status "..." UBYTE I_1 1 2 0 255 ECU_ADDRESS 0x70021302 /end MEASUREMENT
/begin MEASUREMENT CANEve_b_ProdTestModeActive "..." UBYTE I_1 1 2 0 255 ECU_ADDRESS 0x7002130A /end MEASUREMENT
/begin MEASUREMENT CANEve_y_BSWDiagBcmCANFault "..." UBYTE I_1 1 2 0 255 ECU_ADDRESS 0x70020F68 /end MEASUREMENT
/begin MEASUREMENT CANEve_y_BSWDiagEmsCANFault "..." UBYTE I_1 1 2 0 255 ECU_ADDRESS 0x70020F67 /end MEASUREMENT
/begin MEASUREMENT CANEve_y_BSWDiagGcuCANFault "..." UBYTE I_1 1 2 0 255 ECU_ADDRESS 0x70020F66 /end MEASUREMENT
/begin MEASUREMENT CANEve_y_BSWDiagIpbCANFault "..." UBYTE I_1 1 2 0 255 ECU_ADDRESS 0x70020F65 /end MEASUREMENT
/begin MEASUREMENT CANEve_y_BSWDiagIviCANFault "..." UBYTE I_1 1 2 0 255 ECU_ADDRESS 0x70020F62 /end MEASUREMENT
/begin MEASUREMENT CANEve_y_BSWDiagPdcmCANFault "..." UBYTE I_1 1 2 0 255 ECU_ADDRESS 0x70020F64 /end MEASUREMENT
/begin MEASUREMENT CANEve_y_BSWDiagTboxCANFault "..." UBYTE I_1 1 2 0 255 ECU_ADDRESS 0x70020F63 /end MEASUREMENT
/begin MEASUREMENT CCAPve_M_EstClchTrnsfTrq "..." SWORD F_0v03125_p0_13 1 2 -1024 1023.96875 ECU_ADDRESS 0x700212FC /end MEASUREMENT
/begin MEASUREMENT CCAPve_M_InstantaneousCapabilityOdd "..." SWORD F_0v03125_p0_13 1 2 -1024 1023.96875 ECU_ADDRESS 0x700212F8 /end MEASUREMENT
/begin MEASUREMENT CCAPve_M_OddClutchMaxTransferTorque "..." SWORD F_0v03125_p0_13 1 2 -1024 1023.96875 ECU_ADDRESS 0x700212FA /end MEASUREMENT
/begin MEASUREMENT CCAPve_T_EvenClutchTemp "..." SWORD F_0v0625_p0_14 1 2 -2048 2047.9375 ECU_ADDRESS 0x700212F6 /end MEASUREMENT
/begin MEASUREMENT CCAPve_T_OddClutchTemp "..." SWORD F_0v0625_p0_14 1 2 -2048 2047.9375 ECU_ADDRESS 0x700212F4 /end MEASUREMENT
/begin MEASUREMENT CCAPve_e_ClutchState "..." UBYTE I_1 1 2 0 255 ECU_ADDRESS 0x700212F2 /end MEASUREMENT
/begin MEASUREMENT CCAPve_p_ReturnSpringEven "..." SWORD F_1_p0_4 1 2 -32768 32767 ECU_ADDRESS 0x700212F0 /end MEASUREMENT
/begin MEASUREMENT CCAPve_p_ReturnSpringOdd "..." SWORD F_1_p0_4 1 2 -32768 32767 ECU_ADDRESS 0x700212EE /end MEASUREMENT
/begin MEASUREMENT CLCOve_M_CurrentTorqueMargin "..." SWORD F_0v03125_p0_13 1 2 -1024 1023.96875 ECU_ADDRESS 0x700212EC /end MEASUREMENT
/begin MEASUREMENT CLCOve_M_EvenDesiredClutchTrq "..." SWORD F_0v03125_p0_13 1 2 -1024 1023.96875 ECU_ADDRESS 0x700212EA /end MEASUREMENT
/begin MEASUREMENT CLCOve_M_OddDesiredClutchTrq "..." SWORD F_0v03125_p0_13 1 2 -1024 1023.96875 ECU_ADDRESS 0x700212E8 /end MEASUREMENT
/begin MEASUREMENT CLCOve_b_EvenClutchOpenReq "..." UBYTE I_1 1 2 0 255 ECU_ADDRESS 0x700212E7 /end MEASUREMENT
/begin MEASUREMENT CLCOve_b_OddClutchOpenReq "..." UBYTE I_1 1 2 0 255 ECU_ADDRESS 0x700212E6 /end MEASUREMENT
/begin MEASUREMENT CLCOve_b_OddClutchSlipDetected "..." UBYTE Bool_ON_OFF 1 2 0 1 BIT_MASK 0x01 ECU_ADDRESS 0x70021205 /end MEASUREMENT
/begin MEASUREMENT CLCOve_e_EvenActualClutchState "..." UBYTE I_1 1 2 0 255 ECU_ADDRESS 0x700211AC /end MEASUREMENT
/begin MEASUREMENT CLCOve_e_EvenClutchProgress "..." UBYTE I_1 1 2 0 255 ECU_ADDRESS 0x700211AB /end MEASUREMENT
/begin MEASUREMENT CLCOve_e_OddActualClutchState "..." UBYTE I_1 1 2 0 255 ECU_ADDRESS 0x700212E5 /end MEASUREMENT
/begin MEASUREMENT CLCOve_e_OddClutchProgress "..." UBYTE I_1 1 2 0 255 ECU_ADDRESS 0x700212E4 /end MEASUREMENT
/begin MEASUREMENT CLPCve_Cf_PressureToTorqueEven "..." UWORD F_1_p0_4 1 2 0 65535 ECU_ADDRESS 0x700212E2 /end MEASUREMENT
/begin MEASUREMENT CLPCve_Cf_PressureToTorqueOdd "..." UWORD F_1_p0_4 1 2 0 65535 ECU_ADDRESS 0x700212E0 /end MEASUREMENT
/begin MEASUREMENT CLPCve_Cnt_CAPM_CommandDBC "..." UBYTE I_1 1 2 0 255 ECU_ADDRESS 0x70020F70 /end MEASUREMENT
/begin MEASUREMENT CLPCve_DC_CAPM_SpeedControllerPressureCompensation_IRV "..." SWORD F_0v00390625_p0_16 1 2 -128 127.9960938 ECU_ADDRESS 0x7002114C /end MEASUREMENT
/begin MEASUREMENT CLPCve_I_CAPM "..." SWORD F_0v03125_p0_13 1 2 -1024 1023.96875 ECU_ADDRESS 0x700212DE /end MEASUREMENT
/begin MEASUREMENT CLPCve_I_CAPM_CompletePhase "..." SWORD F_0v03125_p0_13 1 2 -1024 1023.96875 ECU_ADDRESS 0x700212DC /end MEASUREMENT
/begin MEASUREMENT CLPCve_I_CAPM_IRV "..." SWORD F_0v03125_p0_13 1 2 -1024 1023.96875 ECU_ADDRESS 0x7002114A /end MEASUREMENT
/begin MEASUREMENT CLPCve_I_CAP_ReducedMaxCurrent "..." SWORD F_0v03125_p0_13 1 2 -1024 1023.96875 ECU_ADDRESS 0x70021148 /end MEASUREMENT
/begin MEASUREMENT CLPCve_P_CAPM_IRV "..." FLOAT32_IEEE I_1 1 2 -3.402823466E+038 3.402823466E+038 ECU_ADDRESS 0x70021144 /end MEASUREMENT
/begin MEASUREMENT CLPCve_Pct_CAPM_DC "..." SWORD F_0v1_p0_2 1 2 -3276.8 3276.7 ECU_ADDRESS 0x70021134 /end MEASUREMENT
/begin MEASUREMENT CLPCve_Pct_CAPM_DC_DBC "..." SWORD F_0v1_p0_2 1 2 -3276.8 3276.7 ECU_ADDRESS 0x70020F5C /end MEASUREMENT
/begin MEASUREMENT CLPCve_Pct_CAPM_DC_IRV "..." SWORD F_0v1_p0_2 1 2 -3276.8 3276.7 ECU_ADDRESS 0x70021136 /end MEASUREMENT
/begin MEASUREMENT CLPCve_b_AdaptKissPointActive "..." UBYTE Bool_ON_OFF 1 2 0 1 BIT_MASK 0x01 ECU_ADDRESS 0x70021133 /end MEASUREMENT
/begin MEASUREMENT CLPCve_b_AdaptionFinished "..." UBYTE Bool_ON_OFF 1 2 0 1 BIT_MASK 0x01 ECU_ADDRESS 0x70021132 /end MEASUREMENT
/begin MEASUREMENT CLPCve_b_CAPM_DC_SaturatedHigh_IRV "..." UBYTE Bool_ON_OFF 1 2 0 1 BIT_MASK 0x01 ECU_ADDRESS 0x70021131 /end MEASUREMENT
/begin MEASUREMENT CLPCve_b_CAPM_DC_SaturatedLow_IRV "..." UBYTE Bool_ON_OFF 1 2 0 1 BIT_MASK 0x01 ECU_ADDRESS 0x70021130 /end MEASUREMENT
/begin MEASUREMENT CLPCve_b_CAP_TooCloseToOverCurrent "..." UBYTE I_1 1 2 0 255 ECU_ADDRESS 0x700212DA /end MEASUREMENT
/begin MEASUREMENT CLPCve_b_ClutchControlActive "..." UBYTE I_1 1 2 0 255 ECU_ADDRESS 0x700212D9 /end MEASUREMENT
/begin MEASUREMENT CLPCve_b_DisableCAP "..." UBYTE Bool_ON_OFF 1 2 0 1 BIT_MASK 0x01 ECU_ADDRESS 0x7002114E /end MEASUREMENT
/begin MEASUREMENT CLPCve_b_DisengageComplete "..." UBYTE I_1 1 2 0 255 ECU_ADDRESS 0x700212D8 /end MEASUREMENT
/begin MEASUREMENT CLPCve_b_InGearComplete "..." UBYTE I_1 1 2 0 255 ECU_ADDRESS 0x700212D7 /end MEASUREMENT
/begin MEASUREMENT CLPCve_b_PrepareComplete "..." UBYTE I_1 1 2 0 255 ECU_ADDRESS 0x700212D6 /end MEASUREMENT
/begin MEASUREMENT CLPCve_b_SpeedControllerActive_IRV "..." UBYTE Bool_ON_OFF 1 2 0 1 BIT_MASK 0x01 ECU_ADDRESS 0x7002112F /end MEASUREMENT
/begin MEASUREMENT CLPCve_e_CAP_DID_EnabledIndication "..." UBYTE I_1 1 2 0 255 ECU_ADDRESS 0x700212C8 /end MEASUREMENT
/begin MEASUREMENT CLPCve_e_NegativeResponseCode_IRV "..." UBYTE I_1 1 2 0 255 ECU_ADDRESS 0x7002112E /end MEASUREMENT
/begin MEASUREMENT CLPCve_n_CAPM_IRV "..." SWORD F_1_p0_4 1 2 -32768 32767 ECU_ADDRESS 0x7002112C /end MEASUREMENT
/begin MEASUREMENT CLPCve_n_CAPM_Overrequest_IRV "..." SWORD F_1_p0_4 1 2 -32768 32767 ECU_ADDRESS 0x7002112A /end MEASUREMENT
/begin MEASUREMENT CLPCve_n_CAPM_SpeedTgtDBC "..." SWORD F_1_p0_4 1 2 -32768 32767 ECU_ADDRESS 0x70020F5A /end MEASUREMENT
/begin MEASUREMENT CLPCve_p_CAPM_PressTgtDBC "..." UWORD F_1_p0_4 1 2 0 65535 ECU_ADDRESS 0x70020F52 /end MEASUREMENT
/begin MEASUREMENT CLPCve_p_ClutchPresReq "..." SWORD F_1_p0_4 1 2 -32768 32767 ECU_ADDRESS 0x70021126 /end MEASUREMENT
/begin MEASUREMENT CLPCve_p_ClutchTarget "..." UWORD F_0v03125_p0_13 1 2 0 2047.96875 ECU_ADDRESS 0x700212C6 /end MEASUREMENT
/begin MEASUREMENT CLPCve_p_EvenClutchPresReq "..." SWORD F_1_p0_4 1 2 -32768 32767 ECU_ADDRESS 0x700211A2 /end MEASUREMENT
/begin MEASUREMENT CLPCve_p_KissPoint "..." SWORD F_0v015625_p0_17 1 2 -512 511.984375 ECU_ADDRESS 0x700212C4 /end MEASUREMENT
/begin MEASUREMENT CLPCve_p_LastEstimatedKisspoint_IRV "..." SWORD F_1_p0_4 1 2 -32768 32767 ECU_ADDRESS 0x70021124 /end MEASUREMENT
/begin MEASUREMENT CLPCve_p_OddClutchPresReq "..." SWORD F_1_p0_4 1 2 -32768 32767 ECU_ADDRESS 0x700211A0 /end MEASUREMENT
/begin MEASUREMENT CLPCve_p_OddMaxAllowedClutchOilPress "..." SWORD F_1_p0_4 1 2 -32768 32767 ECU_ADDRESS 0x700212C2 /end MEASUREMENT
/begin MEASUREMENT CLPCve_p_PressureKneePoint "..." SWORD F_1_p0_4 1 2 -32768 32767 ECU_ADDRESS 0x70021120 /end MEASUREMENT
/begin MEASUREMENT CLPCve_r_CAP_Y_IRV "..." UWORD F_0v1_p0_2 1 2 0 6553.5 ECU_ADDRESS 0x70021122 /end MEASUREMENT
/begin MEASUREMENT CWTDve_T_EngineCoolant "..." SWORD F_0v0625_p0_14 1 2 -2048 2047.9375 ECU_ADDRESS 0x700210FE /end MEASUREMENT
/begin MEASUREMENT CWTDve_e_EngineCoolantVld "..." UBYTE I_1 1 2 0 255 ECU_ADDRESS 0x70021011 /end MEASUREMENT
/begin MEASUREMENT Core0_Asw100msStartTime "..." ULONG F_0v01_p0_20 1 2 0 42949672.95 ECU_ADDRESS 0x70006368 /end MEASUREMENT
/begin MEASUREMENT Core0_Asw100msStopTime "..." ULONG F_0v01_p0_20 1 2 0 42949672.95 ECU_ADDRESS 0x70006364 /end MEASUREMENT
/begin MEASUREMENT Core0_Asw100msTotalTime "..." ULONG F_0v01_p0_20 1 2 0 42949672.95 ECU_ADDRESS 0x70006360 /end MEASUREMENT
/begin MEASUREMENT Core0_Asw10msStartTime "..." ULONG F_0v01_p0_20 1 2 0 42949672.95 ECU_ADDRESS 0x7000635C /end MEASUREMENT
/begin MEASUREMENT Core0_Asw10msStopTime "..." ULONG F_0v01_p0_20 1 2 0 42949672.95 ECU_ADDRESS 0x70006358 /end MEASUREMENT
/begin MEASUREMENT Core0_Asw10msTotalTime "..." ULONG F_0v01_p0_20 1 2 0 42949672.95 ECU_ADDRESS 0x70006354 /end MEASUREMENT
/begin MEASUREMENT Core0_Bsw100msStartTime "..." ULONG F_0v01_p0_20 1 2 0 42949672.95 ECU_ADDRESS 0x70006350 /end MEASUREMENT
/begin MEASUREMENT Core0_Bsw100msStopTime "..." ULONG F_0v01_p0_20 1 2 0 42949672.95 ECU_ADDRESS 0x7000634C /end MEASUREMENT
/begin MEASUREMENT Core0_Bsw100msTotalTime "..." ULONG F_0v01_p0_20 1 2 0 42949672.95 ECU_ADDRESS 0x70006348 /end MEASUREMENT
/begin MEASUREMENT Core0_Bsw10msStartTime "..." ULONG F_0v01_p0_20 1 2 0 42949672.95 ECU_ADDRESS 0x70006344 /end MEASUREMENT
/begin MEASUREMENT Core0_Bsw10msStopTime "..." ULONG F_0v01_p0_20 1 2 0 42949672.95 ECU_ADDRESS 0x70006340 /end MEASUREMENT
/begin MEASUREMENT Core0_Bsw10msTotalTime "..." ULONG F_0v01_p0_20 1 2 0 42949672.95 ECU_ADDRESS 0x7000633C /end MEASUREMENT
/begin MEASUREMENT Core0_Bsw1msStartTime "..." ULONG F_0v01_p0_20 1 2 0 42949672.95 ECU_ADDRESS 0x70006338 /end MEASUREMENT
/begin MEASUREMENT Core0_Bsw1msStopTime "..." ULONG F_0v01_p0_20 1 2 0 42949672.95 ECU_ADDRESS 0x70006334 /end MEASUREMENT
/begin MEASUREMENT Core0_Bsw1msTotalTime "..." ULONG F_0v01_p0_20 1 2 0 42949672.95 ECU_ADDRESS 0x70006330 /end MEASUREMENT
/begin MEASUREMENT Core0_Bsw50msStartTime "..." ULONG F_0v01_p0_20 1 2 0 42949672.95 ECU_ADDRESS 0x7000632C /end MEASUREMENT
/begin MEASUREMENT Core0_Bsw50msStopTime "..." ULONG F_0v01_p0_20 1 2 0 42949672.95 ECU_ADDRESS 0x70006328 /end MEASUREMENT
/begin MEASUREMENT Core0_Bsw50msTotalTime "..." ULONG F_0v01_p0_20 1 2 0 42949672.95 ECU_ADDRESS 0x70006324 /end MEASUREMENT
/begin MEASUREMENT Core1_Asw10msStartTime "..." ULONG F_0v01_p0_20 1 2 0 42949672.95 ECU_ADDRESS 0x70006314 /end MEASUREMENT
/begin MEASUREMENT Core1_Asw10msStopTime "..." ULONG F_0v01_p0_20 1 2 0 42949672.95 ECU_ADDRESS 0x70006310 /end MEASUREMENT
/begin MEASUREMENT Core1_Asw10msTotalTime "..." ULONG F_0v01_p0_20 1 2 0 42949672.95 ECU_ADDRESS 0x7000630C /end MEASUREMENT
/begin MEASUREMENT Core1_Asw1msStartTime "..." ULONG F_0v01_p0_20 1 2 0 42949672.95 ECU_ADDRESS 0x70004A80 /end MEASUREMENT
/begin MEASUREMENT Core1_Asw1msStopTime "..." ULONG F_0v01_p0_20 1 2 0 42949672.95 ECU_ADDRESS 0x70004A7C /end MEASUREMENT
/begin MEASUREMENT Core1_Asw1msTotalTime "..." ULONG F_0v01_p0_20 1 2 0 42949672.95 ECU_ADDRESS 0x70004A78 /end MEASUREMENT
/begin MEASUREMENT Core1_Bsw10msStartTime "..." ULONG F_0v01_p0_20 1 2 0 42949672.95 ECU_ADDRESS 0x700062FC /end MEASUREMENT
/begin MEASUREMENT Core1_Bsw10msStopTime "..." ULONG F_0v01_p0_20 1 2 0 42949672.95 ECU_ADDRESS 0x700062F8 /end MEASUREMENT
/begin MEASUREMENT Core1_Bsw10msTotalTime "..." ULONG F_0v01_p0_20 1 2 0 42949672.95 ECU_ADDRESS 0x700062F4 /end MEASUREMENT
/begin MEASUREMENT Core2_Asw10msStartTime "..." ULONG F_0v01_p0_20 1 2 0 42949672.95 ECU_ADDRESS 0x700062E4 /end MEASUREMENT
/begin MEASUREMENT Core2_Asw10msStopTime "..." ULONG F_0v01_p0_20 1 2 0 42949672.95 ECU_ADDRESS 0x700062E0 /end MEASUREMENT
/begin MEASUREMENT Core2_Asw10msTotalTime "..." ULONG F_0v01_p0_20 1 2 0 42949672.95 ECU_ADDRESS 0x700062DC /end MEASUREMENT
/begin MEASUREMENT Core2_Asw1msStartTime "..." ULONG F_0v01_p0_20 1 2 0 42949672.95 ECU_ADDRESS 0x700062D8 /end MEASUREMENT
/begin MEASUREMENT Core2_Asw1msStopTime "..." ULONG F_0v01_p0_20 1 2 0 42949672.95 ECU_ADDRESS 0x700062D4 /end MEASUREMENT
/begin MEASUREMENT Core2_Asw1msTotalTime "..." ULONG F_0v01_p0_20 1 2 0 42949672.95 ECU_ADDRESS 0x700062D0 /end MEASUREMENT
/begin MEASUREMENT Core2_Bsw10msStartTime "..." ULONG F_0v01_p0_20 1 2 0 42949672.95 ECU_ADDRESS 0x700062CC /end MEASUREMENT
/begin MEASUREMENT Core2_Bsw10msStopTime "..." ULONG F_0v01_p0_20 1 2 0 42949672.95 ECU_ADDRESS 0x700062C8 /end MEASUREMENT
/begin MEASUREMENT Core2_Bsw10msTotalTime "..." ULONG F_0v01_p0_20 1 2 0 42949672.95 ECU_ADDRESS 0x700062C4 /end MEASUREMENT
/begin MEASUREMENT DGPSve_n_LaunchTargetSpeed "..." SWORD F_1_p0_4 1 2 -32768 32767 ECU_ADDRESS 0x7002123A /end MEASUREMENT
/begin MEASUREMENT DPSCve_e_VehicleActState "..." UBYTE I_1 1 2 0 255 ECU_ADDRESS 0x70021238 /end MEASUREMENT
/begin MEASUREMENT DRSPve_e_RangeSelPos "..." UBYTE I_1 1 2 0 255 ECU_ADDRESS 0x7002110C /end MEASUREMENT
/begin MEASUREMENT EMS_EngActualFlwTorque "..." UWORD F_0v125_m100_22 1 2 -100 8091.875 ECU_ADDRESS 0x70020F94 /end MEASUREMENT
/begin MEASUREMENT EMS_EngFlywh "..." UWORD F_0v1_m350_23 1 2 -350 6203.5 ECU_ADDRESS 0x70001C46 /end MEASUREMENT
/begin MEASUREMENT EMS_EngRunningStatus "..." UBYTE I_1 1 2 0 255 ECU_ADDRESS 0x700210BB /end MEASUREMENT
/begin MEASUREMENT EMS_EngSpd "..." UWORD F_0v125_p0_24 1 2 0 8191.875 ECU_ADDRESS 0x70020F8A /end MEASUREMENT
/begin MEASUREMENT EMS_EngSpdValid "..." UBYTE I_1 1 2 0 255 ECU_ADDRESS 0x70020F89 /end MEASUREMENT
/begin MEASUREMENT EOL1_CCP_control_DC "..." UWORD F_1_p0_4 1 2 0 65535 ECU_ADDRESS 0x70020F50 /end MEASUREMENT
/begin MEASUREMENT EOL1_CCP_control_Enable "..." UBYTE I_1 1 2 0 255 ECU_ADDRESS 0x70020F6F /end MEASUREMENT
/begin MEASUREMENT EOL1_CCP_control_flow "..." UWORD F_1_p0_4 1 2 0 65535 ECU_ADDRESS 0x70020F4E /end MEASUREMENT
/begin MEASUREMENT EOL1_CCP_control_speed "..." UWORD F_1_p0_4 1 2 0 65535 ECU_ADDRESS 0x70020F4C /end MEASUREMENT
/begin MEASUREMENT EOL2_CAP_control_DC "..." UWORD F_1_p0_4 1 2 0 65535 ECU_ADDRESS 0x70020F4A /end MEASUREMENT
/begin MEASUREMENT EOL2_CAP_control_Enable "..." UBYTE I_1 1 2 0 255 ECU_ADDRESS 0x70020F6E /end MEASUREMENT
/begin MEASUREMENT EOL2_CAP_control_pres "..." UWORD F_1_p0_4 1 2 0 65535 ECU_ADDRESS 0x70020F48 /end MEASUREMENT
/begin MEASUREMENT EOL2_CAP_control_speed "..." UWORD F_1_p0_4 1 2 0 65535 ECU_ADDRESS 0x70020F46 /end MEASUREMENT
/begin MEASUREMENT EOL3_CAP_DC "..." UWORD F_1_p0_4 1 2 0 65535 ECU_ADDRESS 0x70020F40 /end MEASUREMENT
/begin MEASUREMENT EOL3_CAP_current "..." UWORD F_1_p0_4 1 2 0 65535 ECU_ADDRESS 0x70020F3E /end MEASUREMENT
/begin MEASUREMENT EOL3_CAP_speed "..." UWORD F_1_p0_4 1 2 0 65535 ECU_ADDRESS 0x70020F3C /end MEASUREMENT
/begin MEASUREMENT EOL4_CCP_DC "..." UWORD F_1_p0_4 1 2 0 65535 ECU_ADDRESS 0x70020F3A /end MEASUREMENT
/begin MEASUREMENT EOL4_CCP_current "..." UWORD F_1_p0_4 1 2 0 65535 ECU_ADDRESS 0x70020F38 /end MEASUREMENT
/begin MEASUREMENT EOL4_CCP_flow "..." UWORD F_1_p0_4 1 2 0 65535 ECU_ADDRESS 0x70020F44 /end MEASUREMENT
/begin MEASUREMENT EOL4_CCP_speed "..." UWORD F_1_p0_4 1 2 0 65535 ECU_ADDRESS 0x70020F36 /end MEASUREMENT
/begin MEASUREMENT EOL5_clutch_pressure "..." UWORD F_1_p0_4 1 2 0 65535 ECU_ADDRESS 0x70020F42 /end MEASUREMENT
/begin MEASUREMENT EOL5_clutch_targetpressure "..." UWORD F_1_p0_4 1 2 0 65535 ECU_ADDRESS 0x70020F34 /end MEASUREMENT
/begin MEASUREMENT EOL5_oil_temp "..." UBYTE I_1 1 2 0 255 ECU_ADDRESS 0x70020F6C /end MEASUREMENT
/begin MEASUREMENT EPOSve_d2n_EngSpdAccel "..." SWORD F_0v25_p0_25 1 2 -8192 8191.75 ECU_ADDRESS 0x70021236 /end MEASUREMENT
/begin MEASUREMENT EPOSve_dn_EngSpdChangeRate "..." SWORD F_0v5_p0_26 1 2 -16384 16383.5 ECU_ADDRESS 0x70021234 /end MEASUREMENT
/begin MEASUREMENT EPOSve_e_EngSpdValidity "..." UBYTE I_1 1 2 0 255 ECU_ADDRESS 0x70021232 /end MEASUREMENT
/begin MEASUREMENT EPOSve_n_EngSpd "..." SWORD F_1_p0_4 1 2 -32768 32767 ECU_ADDRESS 0x70021230 /end MEASUREMENT
/begin MEASUREMENT EP_Tbox3_CoolantTemp "..." UBYTE F_1_m40_27 1 2 -40 215 ECU_ADDRESS 0x70020F8D /end MEASUREMENT
/begin MEASUREMENT EP_Tbox3_CoolantTempValid "..." UBYTE I_1 1 2 0 255 ECU_ADDRESS 0x70020F88 /end MEASUREMENT
/begin MEASUREMENT EP_Tbox3_WarmUpCycle "..." UBYTE I_1 1 2 0 255 ECU_ADDRESS 0x70020F85 /end MEASUREMENT
/begin MEASUREMENT ESM_ESM_MODE_FT "ESM_ESM_MODE_FT" UBYTE Bool_ON_OFF 1 2 0 1 BIT_MASK 0x04 ECU_ADDRESS 0x7001F50E /end MEASUREMENT
/begin MEASUREMENT ESM_ESM_MODE_NF "ESM_ESM_MODE_NF" UBYTE Bool_ON_OFF 1 2 0 1 BIT_MASK 0x01 ECU_ADDRESS 0x7001F50E /end MEASUREMENT
/begin MEASUREMENT ESM_EsmMode "ESM_EsmMode" UWORD ESM_EsmMode_conv 1 2 1 4 ECU_ADDRESS 0x7001F50E /end MEASUREMENT
/begin MEASUREMENT ESM_OpFtState "ESM_OpFtState" UWORD I_1 1 2 0 65535 ECU_ADDRESS 0x7001F502 /end MEASUREMENT
/begin MEASUREMENT ESM_OpNfState "ESM_OpNfState" UWORD I_1 1 2 0 65535 ECU_ADDRESS 0x7001F500 /end MEASUREMENT
/begin MEASUREMENT ESM_PwrLFtState "ESM_PwrLFtState" UWORD I_1 1 2 0 65535 ECU_ADDRESS 0x7001F4FE /end MEASUREMENT
/begin MEASUREMENT ESM_PwrLNfState "ESM_PwrLNfState" UWORD I_1 1 2 0 65535 ECU_ADDRESS 0x7001F4FC /end MEASUREMENT
/begin MEASUREMENT ESM_StpIIFtState "ESM_StpIIFtState" UWORD I_1 1 2 0 65535 ECU_ADDRESS 0x7001F4FA /end MEASUREMENT
/begin MEASUREMENT ESM_StpIINfState "ESM_StpIINfState" UWORD I_1 1 2 0 65535 ECU_ADDRESS 0x7001F4F8 /end MEASUREMENT
/begin MEASUREMENT ESM_StpIState "ESM_StpIState" UWORD I_1 1 2 0 65535 ECU_ADDRESS 0x7001F4F6 /end MEASUREMENT
/begin MEASUREMENT ESM_bAfterrunFin "ESM_bAfterrunFin" UBYTE Bool_ON_OFF 1 2 0 1 BIT_MASK 0x01 ECU_ADDRESS 0x7001F50C /end MEASUREMENT
/begin MEASUREMENT ESM_bAfterrunReq "ESM_bAfterrunReq" UBYTE Bool_ON_OFF 1 2 0 1 BIT_MASK 0x01 ECU_ADDRESS 0x7001F50B /end MEASUREMENT
/begin MEASUREMENT ESM_bCallAppliOn "ESM_bCallAppliOn" UBYTE Bool_ON_OFF 1 2 0 1 BIT_MASK 0x01 ECU_ADDRESS 0x7001F50A /end MEASUREMENT
/begin MEASUREMENT ESM_bMcuEnaReq "ESM_bMcuEnaReq" UBYTE Bool_ON_OFF 1 2 0 1 BIT_MASK 0x01 ECU_ADDRESS 0x7001F509 /end MEASUREMENT
/begin MEASUREMENT ESM_bPwrDnReadyFlg "ESM_bPwrDnReadyFlg" UBYTE Bool_ON_OFF 1 2 0 1 BIT_MASK 0x01 ECU_ADDRESS 0x7001F508 /end MEASUREMENT
/begin MEASUREMENT ESM_bPwrLNfClrFltFinsh "ESM_bPwrLNfClrFltFinsh" UBYTE Bool_ON_OFF 1 2 0 1 BIT_MASK 0x01 ECU_ADDRESS 0x7001F507 /end MEASUREMENT
/begin MEASUREMENT ESM_u16AfterrunCnt "ESM_u16AfterrunCnt" UWORD I_1 1 2 0 65535 ECU_ADDRESS 0x7001F4F4 /end MEASUREMENT
/begin MEASUREMENT ESM_u16CmdReq "ESM_u16CmdReq" UWORD I_1 1 2 0 65535 ECU_ADDRESS 0x7001F4F2 /end MEASUREMENT
/begin MEASUREMENT ESM_u16CmdReqNm1 "ESM_u16CmdReqNm1" UWORD I_1 1 2 0 65535 ECU_ADDRESS 0x7001F4F0 /end MEASUREMENT
/begin MEASUREMENT ESM_u16CmdRes "ESM_u16CmdRes" UWORD I_1 1 2 0 65535 ECU_ADDRESS 0x7001F4EE /end MEASUREMENT
/begin MEASUREMENT ESM_u8AllowPwrDnDelay "ESM_u8AllowPwrDnDelay" UBYTE I_1 1 2 0 255 ECU_ADDRESS 0x7001F506 /end MEASUREMENT
/begin MEASUREMENT ESM_u8PwrLNfStep "ESM_u8PwrLNfStep" UBYTE I_1 1 2 0 255 ECU_ADDRESS 0x7001F505 /end MEASUREMENT
/begin MEASUREMENT ESM_u8PwrOffTim "ESM_u8PwrOffTim" UBYTE I_1 1 2 0 255 ECU_ADDRESS 0x7001F504 /end MEASUREMENT
/begin MEASUREMENT ESM_u8RestartDelayCnt "ESM_u8RestartDelayCnt" UBYTE I_1 1 2 0 255 ECU_ADDRESS 0x7001F4ED /end MEASUREMENT
/begin MEASUREMENT FDMAve_Cnt_DID_NoOfInputsDrivingFA_TKO "..." SWORD F_1_p0_4 1 2 -32768 32767 ECU_ADDRESS 0x7002119E /end MEASUREMENT
/begin MEASUREMENT FDMAve_b_AcceleratorStuckErrExt "..." UBYTE Bool_ON_OFF 1 2 0 1 BIT_MASK 0x01 ECU_ADDRESS 0x70021204 /end MEASUREMENT
/begin MEASUREMENT FDMAve_b_ForceAC_CompressorCpbyPrioHigh "..." UBYTE Bool_ON_OFF 1 2 0 1 BIT_MASK 0x01 ECU_ADDRESS 0x70021203 /end MEASUREMENT
/begin MEASUREMENT FDMAve_b_ForceAC_CompressorToOff "..." UBYTE Bool_ON_OFF 1 2 0 1 BIT_MASK 0x01 ECU_ADDRESS 0x70021202 /end MEASUREMENT
/begin MEASUREMENT FDMAve_b_ForceAC_LoadCompensationToOff "..." UBYTE Bool_ON_OFF 1 2 0 1 BIT_MASK 0x01 ECU_ADDRESS 0x70021201 /end MEASUREMENT
/begin MEASUREMENT FDMAve_b_ForceActiveDischarge "..." UBYTE Bool_ON_OFF 1 2 0 1 BIT_MASK 0x01 ECU_ADDRESS 0x70021200 /end MEASUREMENT
/begin MEASUREMENT FDMAve_b_ForceAirEstimationByMAP_SensorToOff "..." UBYTE Bool_ON_OFF 1 2 0 1 BIT_MASK 0x01 ECU_ADDRESS 0x700211FF /end MEASUREMENT
/begin MEASUREMENT FDMAve_b_ForceAntiJerkControlOff "..." UBYTE Bool_ON_OFF 1 2 0 1 BIT_MASK 0x01 ECU_ADDRESS 0x700211FE /end MEASUREMENT
/begin MEASUREMENT FDMAve_b_ForceBackupPowerModeToActive "..." UBYTE Bool_ON_OFF 1 2 0 1 BIT_MASK 0x01 ECU_ADDRESS 0x700211FD /end MEASUREMENT
/begin MEASUREMENT FDMAve_b_ForceBoostPressureControlToLowPressure "..." UBYTE Bool_ON_OFF 1 2 0 1 BIT_MASK 0x01 ECU_ADDRESS 0x700211FC /end MEASUREMENT
/begin MEASUREMENT FDMAve_b_ForceBoostPressureControlToLowPressureIRV "..." UBYTE Bool_ON_OFF 1 2 0 1 BIT_MASK 0x01 ECU_ADDRESS 0x7002111F /end MEASUREMENT
/begin MEASUREMENT FDMAve_b_ForceBoostTorqueOff "..." UBYTE Bool_ON_OFF 1 2 0 1 BIT_MASK 0x01 ECU_ADDRESS 0x700211FB /end MEASUREMENT
/begin MEASUREMENT FDMAve_b_ForceBrakeRegenerationTorqueOff "..." UBYTE Bool_ON_OFF 1 2 0 1 BIT_MASK 0x01 ECU_ADDRESS 0x700211FA /end MEASUREMENT
/begin MEASUREMENT FDMAve_b_ForceCCPCancleSpdLimit "..." UBYTE I_1 1 2 0 255 ECU_ADDRESS 0x7002130F /end MEASUREMENT
/begin MEASUREMENT FDMAve_b_ForceCamPositionToParked "..." UBYTE Bool_ON_OFF 1 2 0 1 BIT_MASK 0x01 ECU_ADDRESS 0x700211F9 /end MEASUREMENT
/begin MEASUREMENT FDMAve_b_ForceCamPositionToParkedIRV "..." UBYTE Bool_ON_OFF 1 2 0 1 BIT_MASK 0x01 ECU_ADDRESS 0x7002111E /end MEASUREMENT
/begin MEASUREMENT FDMAve_b_ForceClutchOddOpen "..." UBYTE I_1 1 2 0 255 ECU_ADDRESS 0x7002120F /end MEASUREMENT
/begin MEASUREMENT FDMAve_b_ForceCoastRegenerationTorqueOff "..." UBYTE Bool_ON_OFF 1 2 0 1 BIT_MASK 0x01 ECU_ADDRESS 0x700211F8 /end MEASUREMENT
/begin MEASUREMENT FDMAve_b_ForceContactorsOpen "..." UBYTE Bool_ON_OFF 1 2 0 1 BIT_MASK 0x01 ECU_ADDRESS 0x700211F7 /end MEASUREMENT
/begin MEASUREMENT FDMAve_b_ForceCreepControlToOff "..." UBYTE Bool_ON_OFF 1 2 0 1 BIT_MASK 0x01 ECU_ADDRESS 0x700211F6 /end MEASUREMENT
/begin MEASUREMENT FDMAve_b_ForceCruiseControlToOff "..." UBYTE Bool_ON_OFF 1 2 0 1 BIT_MASK 0x01 ECU_ADDRESS 0x70021308 /end MEASUREMENT
/begin MEASUREMENT FDMAve_b_ForceDCDC_BuckConversionOff "..." UBYTE Bool_ON_OFF 1 2 0 1 BIT_MASK 0x01 ECU_ADDRESS 0x700211F5 /end MEASUREMENT
/begin MEASUREMENT FDMAve_b_ForceDCDC_ControlToDefault "..." UBYTE Bool_ON_OFF 1 2 0 1 BIT_MASK 0x01 ECU_ADDRESS 0x700211F4 /end MEASUREMENT
/begin MEASUREMENT FDMAve_b_ForceEGR_ControlToOff "..." UBYTE Bool_ON_OFF 1 2 0 1 BIT_MASK 0x01 ECU_ADDRESS 0x700211F3 /end MEASUREMENT
/begin MEASUREMENT FDMAve_b_ForceElectricLoadCompensationToOff "..." UBYTE Bool_ON_OFF 1 2 0 1 BIT_MASK 0x01 ECU_ADDRESS 0x700211F2 /end MEASUREMENT
/begin MEASUREMENT FDMAve_b_ForceElectricThermostatControlToLowTemp "..." UBYTE Bool_ON_OFF 1 2 0 1 BIT_MASK 0x01 ECU_ADDRESS 0x700211F1 /end MEASUREMENT
/begin MEASUREMENT FDMAve_b_ForceElectricThermostatToOff "..." UBYTE Bool_ON_OFF 1 2 0 1 BIT_MASK 0x01 ECU_ADDRESS 0x700211F0 /end MEASUREMENT
/begin MEASUREMENT FDMAve_b_ForceElectricVacuumPumpOff "..." UBYTE Bool_ON_OFF 1 2 0 1 BIT_MASK 0x01 ECU_ADDRESS 0x700211EF /end MEASUREMENT
/begin MEASUREMENT FDMAve_b_ForceElectricVacuumPumpPulseMode "..." UBYTE Bool_ON_OFF 1 2 0 1 BIT_MASK 0x01 ECU_ADDRESS 0x700211EE /end MEASUREMENT
/begin MEASUREMENT FDMAve_b_ForceEngCoolantTempToEstimationModel "..." UBYTE Bool_ON_OFF 1 2 0 1 BIT_MASK 0x01 ECU_ADDRESS 0x700211ED /end MEASUREMENT
/begin MEASUREMENT FDMAve_b_ForceEngTransientLimOff "..." UBYTE Bool_ON_OFF 1 2 0 1 BIT_MASK 0x01 ECU_ADDRESS 0x700211EC /end MEASUREMENT
/begin MEASUREMENT FDMAve_b_ForceEngineRunning "..." UBYTE Bool_ON_OFF 1 2 0 1 BIT_MASK 0x01 ECU_ADDRESS 0x700211EB /end MEASUREMENT
/begin MEASUREMENT FDMAve_b_ForceEngineStop "..." UBYTE Bool_ON_OFF 1 2 0 1 BIT_MASK 0x01 ECU_ADDRESS 0x70021307 /end MEASUREMENT
/begin MEASUREMENT FDMAve_b_ForceEngineStopIRV "..." UBYTE Bool_ON_OFF 1 2 0 1 BIT_MASK 0x01 ECU_ADDRESS 0x7002111D /end MEASUREMENT
/begin MEASUREMENT FDMAve_b_ForceEngineTorqueFillOff "..." UBYTE Bool_ON_OFF 1 2 0 1 BIT_MASK 0x01 ECU_ADDRESS 0x700211EA /end MEASUREMENT
/begin MEASUREMENT FDMAve_b_ForceEngineTorqueReductionToMedium "..." UBYTE Bool_ON_OFF 1 2 0 1 BIT_MASK 0x01 ECU_ADDRESS 0x700211E9 /end MEASUREMENT
/begin MEASUREMENT FDMAve_b_ForceEngineTorqueReductionToMediumIRV "..." UBYTE Bool_ON_OFF 1 2 0 1 BIT_MASK 0x01 ECU_ADDRESS 0x7002111C /end MEASUREMENT
/begin MEASUREMENT FDMAve_b_ForceFrntO2SnsrBnk1ToPrtctnMd "..." UBYTE Bool_ON_OFF 1 2 0 1 BIT_MASK 0x01 ECU_ADDRESS 0x700211E8 /end MEASUREMENT
/begin MEASUREMENT FDMAve_b_ForceFuelControlToOpenLoop "..." UBYTE Bool_ON_OFF 1 2 0 1 BIT_MASK 0x01 ECU_ADDRESS 0x700211E7 /end MEASUREMENT
/begin MEASUREMENT FDMAve_b_ForceFuelPressureActivationToOff "..." UBYTE Bool_ON_OFF 1 2 0 1 BIT_MASK 0x01 ECU_ADDRESS 0x700211E6 /end MEASUREMENT
/begin MEASUREMENT FDMAve_b_ForceFuelPressureActivationToOffIRV "..." UBYTE Bool_ON_OFF 1 2 0 1 BIT_MASK 0x01 ECU_ADDRESS 0x7002111B /end MEASUREMENT
/begin MEASUREMENT FDMAve_b_ForceFuelRailPressureFeedbackExclusion "..." UBYTE Bool_ON_OFF 1 2 0 1 BIT_MASK 0x01 ECU_ADDRESS 0x700211E5 /end MEASUREMENT
/begin MEASUREMENT FDMAve_b_ForceFuelRailPressureFeedbackExclusionIRV "..." UBYTE Bool_ON_OFF 1 2 0 1 BIT_MASK 0x01 ECU_ADDRESS 0x7002111A /end MEASUREMENT
/begin MEASUREMENT FDMAve_b_ForceGCUTrqToExclFromTransClutchPresTarget "..." UBYTE Bool_ON_OFF 1 2 0 1 BIT_MASK 0x01 ECU_ADDRESS 0x700211E4 /end MEASUREMENT
/begin MEASUREMENT FDMAve_b_ForceGearRecommendationToOff "..." UBYTE Bool_ON_OFF 1 2 0 1 BIT_MASK 0x01 ECU_ADDRESS 0x700211E3 /end MEASUREMENT
/begin MEASUREMENT FDMAve_b_ForceHVAC_ElectricHeaterOff "..." UBYTE Bool_ON_OFF 1 2 0 1 BIT_MASK 0x01 ECU_ADDRESS 0x700211E2 /end MEASUREMENT
/begin MEASUREMENT FDMAve_b_ForceHVBattSOC_ControlOff "..." UBYTE Bool_ON_OFF 1 2 0 1 BIT_MASK 0x01 ECU_ADDRESS 0x700211E1 /end MEASUREMENT
/begin MEASUREMENT FDMAve_b_ForceHiPressFuelPumpEnblToDisable "..." UBYTE Bool_ON_OFF 1 2 0 1 BIT_MASK 0x01 ECU_ADDRESS 0x700211E0 /end MEASUREMENT
/begin MEASUREMENT FDMAve_b_ForceHiPressFuelPumpEnblToDisableIRV "..." UBYTE Bool_ON_OFF 1 2 0 1 BIT_MASK 0x01 ECU_ADDRESS 0x70021119 /end MEASUREMENT
/begin MEASUREMENT FDMAve_b_ForceIdleControlToElevatedMode "..." UBYTE Bool_ON_OFF 1 2 0 1 BIT_MASK 0x01 ECU_ADDRESS 0x700211DF /end MEASUREMENT
/begin MEASUREMENT FDMAve_b_ForceIgnitionToLowOctane "..." UBYTE Bool_ON_OFF 1 2 0 1 BIT_MASK 0x01 ECU_ADDRESS 0x700211DE /end MEASUREMENT
/begin MEASUREMENT FDMAve_b_ForceIgnitionToOff "..." UBYTE Bool_ON_OFF 1 2 0 1 BIT_MASK 0x01 ECU_ADDRESS 0x700211DD /end MEASUREMENT
/begin MEASUREMENT FDMAve_b_ForceIgnitionToOffIRV "..." UBYTE Bool_ON_OFF 1 2 0 1 BIT_MASK 0x01 ECU_ADDRESS 0x70021118 /end MEASUREMENT
/begin MEASUREMENT FDMAve_b_ForceIntelligentGeneratorControlToDefault "..." UBYTE Bool_ON_OFF 1 2 0 1 BIT_MASK 0x01 ECU_ADDRESS 0x700211DC /end MEASUREMENT
/begin MEASUREMENT FDMAve_b_ForceLftDrvnWhlSpdInfoExclusion "..." UBYTE I_1 1 2 0 255 ECU_ADDRESS 0x7002120E /end MEASUREMENT
/begin MEASUREMENT FDMAve_b_ForceLftNnDrvnWhlSpdInfoExclusion "..." UBYTE I_1 1 2 0 255 ECU_ADDRESS 0x7002120D /end MEASUREMENT
/begin MEASUREMENT FDMAve_b_ForceLongTermAdaptionToOff "..." UBYTE Bool_ON_OFF 1 2 0 1 BIT_MASK 0x01 ECU_ADDRESS 0x700211DB /end MEASUREMENT
/begin MEASUREMENT FDMAve_b_ForceNeutralGear "..." UBYTE Bool_ON_OFF 1 2 0 1 BIT_MASK 0x01 ECU_ADDRESS 0x70021305 /end MEASUREMENT
/begin MEASUREMENT FDMAve_b_ForceP1ElectricMotorToNeutral "..." UBYTE Bool_ON_OFF 1 2 0 1 BIT_MASK 0x01 ECU_ADDRESS 0x700211DA /end MEASUREMENT
/begin MEASUREMENT FDMAve_b_ForceP1ElectricTorqueReserveOff "..." UBYTE Bool_ON_OFF 1 2 0 1 BIT_MASK 0x01 ECU_ADDRESS 0x700211D9 /end MEASUREMENT
/begin MEASUREMENT FDMAve_b_ForceP3MtrSpdInfoExclusion "..." UBYTE I_1 1 2 0 255 ECU_ADDRESS 0x7002120C /end MEASUREMENT
/begin MEASUREMENT FDMAve_b_ForcePF_ActiveRegenOff "..." UBYTE Bool_ON_OFF 1 2 0 1 BIT_MASK 0x01 ECU_ADDRESS 0x700211D8 /end MEASUREMENT
/begin MEASUREMENT FDMAve_b_ForcePF_PrssrSnsrAdptnOff "..." UBYTE Bool_ON_OFF 1 2 0 1 BIT_MASK 0x01 ECU_ADDRESS 0x700211D7 /end MEASUREMENT
/begin MEASUREMENT FDMAve_b_ForcePF_PrssrSnsrBasedSootEstOff "..." UBYTE Bool_ON_OFF 1 2 0 1 BIT_MASK 0x01 ECU_ADDRESS 0x700211D6 /end MEASUREMENT
/begin MEASUREMENT FDMAve_b_ForcePowerModeLock "..." UBYTE Bool_ON_OFF 1 2 0 1 BIT_MASK 0x01 ECU_ADDRESS 0x700211D5 /end MEASUREMENT
/begin MEASUREMENT FDMAve_b_ForcePowerSteeringCompensationToOff "..." UBYTE Bool_ON_OFF 1 2 0 1 BIT_MASK 0x01 ECU_ADDRESS 0x700211D4 /end MEASUREMENT
/begin MEASUREMENT FDMAve_b_ForcePropModeCalcToExcludeVehSpd "..." UBYTE Bool_ON_OFF 1 2 0 1 BIT_MASK 0x01 ECU_ADDRESS 0x700211D3 /end MEASUREMENT
/begin MEASUREMENT FDMAve_b_ForcePropulsionAllowedToNotAllowed "..." UBYTE Bool_ON_OFF 1 2 0 1 BIT_MASK 0x01 ECU_ADDRESS 0x700211D2 /end MEASUREMENT
/begin MEASUREMENT FDMAve_b_ForcePurgeControlToOff "..." UBYTE Bool_ON_OFF 1 2 0 1 BIT_MASK 0x01 ECU_ADDRESS 0x700211D1 /end MEASUREMENT
/begin MEASUREMENT FDMAve_b_ForceRearO2SensorFuelControlToOff "..." UBYTE Bool_ON_OFF 1 2 0 1 BIT_MASK 0x01 ECU_ADDRESS 0x700211D0 /end MEASUREMENT
/begin MEASUREMENT FDMAve_b_ForceRghtDrvnWhlSpdInfoExclusion "..." UBYTE I_1 1 2 0 255 ECU_ADDRESS 0x7002120B /end MEASUREMENT
/begin MEASUREMENT FDMAve_b_ForceRghtNnDrvnWhlSpdInfoExclusion "..." UBYTE I_1 1 2 0 255 ECU_ADDRESS 0x7002120A /end MEASUREMENT
/begin MEASUREMENT FDMAve_b_ForceTCU_CreepTorqueControlToOff "..." UBYTE Bool_ON_OFF 1 2 0 1 BIT_MASK 0x01 ECU_ADDRESS 0x700211CF /end MEASUREMENT
/begin MEASUREMENT FDMAve_b_ForceThrottleMassAirFlowToDefaultAir "..." UBYTE Bool_ON_OFF 1 2 0 1 BIT_MASK 0x01 ECU_ADDRESS 0x700211CE /end MEASUREMENT
/begin MEASUREMENT FDMAve_b_ForceThrottleMassAirFlowToDefaultAirIRV "..." UBYTE Bool_ON_OFF 1 2 0 1 BIT_MASK 0x01 ECU_ADDRESS 0x70021117 /end MEASUREMENT
/begin MEASUREMENT FDMAve_b_ForceTransIOCControlToOff "..." UBYTE I_1 1 2 0 255 ECU_ADDRESS 0x70021209 /end MEASUREMENT
/begin MEASUREMENT FDMAve_b_ForceTransOilCoolingToSafeCoolingMode "..." UBYTE I_1 1 2 0 255 ECU_ADDRESS 0x70021208 /end MEASUREMENT
/begin MEASUREMENT FDMAve_b_ForceTransOilLubricationToSafeLubricationMode "..." UBYTE I_1 1 2 0 255 ECU_ADDRESS 0x70021207 /end MEASUREMENT
/begin MEASUREMENT FDMAve_b_ForceUnderHoodCoolingToHigh "..." UBYTE Bool_ON_OFF 1 2 0 1 BIT_MASK 0x01 ECU_ADDRESS 0x700211CD /end MEASUREMENT
/begin MEASUREMENT FDMAve_b_ForceVehicleSpeedInfoExclusion "..." UBYTE I_1 1 2 0 255 ECU_ADDRESS 0x70021206 /end MEASUREMENT
/begin MEASUREMENT FDMAve_b_LimitHV_BattSOC_CntrlAuthorityToLow "..." UBYTE Bool_ON_OFF 1 2 0 1 BIT_MASK 0x01 ECU_ADDRESS 0x700211CC /end MEASUREMENT
/begin MEASUREMENT FDMAve_b_LockoutEngineStateChange "..." UBYTE Bool_ON_OFF 1 2 0 1 BIT_MASK 0x01 ECU_ADDRESS 0x700211CB /end MEASUREMENT
/begin MEASUREMENT FDMAve_b_LockoutPropulsionSystemStart "..." UBYTE Bool_ON_OFF 1 2 0 1 BIT_MASK 0x01 ECU_ADDRESS 0x700211CA /end MEASUREMENT
/begin MEASUREMENT FDMAve_b_LockoutPropulsionSystemStartIRV "..." UBYTE Bool_ON_OFF 1 2 0 1 BIT_MASK 0x01 ECU_ADDRESS 0x70021116 /end MEASUREMENT
/begin MEASUREMENT FDMAve_b_LockoutSpdDepCntctrAfterrun "..." UBYTE Bool_ON_OFF 1 2 0 1 BIT_MASK 0x01 ECU_ADDRESS 0x700211C9 /end MEASUREMENT
/begin MEASUREMENT FDMAve_b_LockoutStopStartEngineStateChange "..." UBYTE Bool_ON_OFF 1 2 0 1 BIT_MASK 0x01 ECU_ADDRESS 0x700211C8 /end MEASUREMENT
/begin MEASUREMENT FDMAve_b_SetAccPedPosToZero "..." UBYTE Bool_ON_OFF 1 2 0 1 BIT_MASK 0x01 ECU_ADDRESS 0x70021304 /end MEASUREMENT
/begin MEASUREMENT FDMAve_b_SetAccPedPosToZeroIRV "..." UBYTE Bool_ON_OFF 1 2 0 1 BIT_MASK 0x01 ECU_ADDRESS 0x70021115 /end MEASUREMENT
/begin MEASUREMENT FDMAve_b_SetAutoTransIdleSpdRqstToNoRqst "..." UBYTE Bool_ON_OFF 1 2 0 1 BIT_MASK 0x01 ECU_ADDRESS 0x700211C7 /end MEASUREMENT
/begin MEASUREMENT FDMAve_b_SetAutoTransTorqueRequestToNoRequest "..." UBYTE Bool_ON_OFF 1 2 0 1 BIT_MASK 0x01 ECU_ADDRESS 0x700211C6 /end MEASUREMENT
/begin MEASUREMENT FDMAve_b_SetDCDC_ActualLoadDefaultVal "..." UBYTE Bool_ON_OFF 1 2 0 1 BIT_MASK 0x01 ECU_ADDRESS 0x700211C5 /end MEASUREMENT
/begin MEASUREMENT FDMAve_b_SetDriversRequestToZero "..." UBYTE Bool_ON_OFF 1 2 0 1 BIT_MASK 0x01 ECU_ADDRESS 0x700211C4 /end MEASUREMENT
/begin MEASUREMENT FDMAve_b_SetDriversRequestToZeroIRV "..." UBYTE Bool_ON_OFF 1 2 0 1 BIT_MASK 0x01 ECU_ADDRESS 0x70021114 /end MEASUREMENT
/begin MEASUREMENT FDMAve_b_SetESP_TCS_TorqueRequestToNoRequest "..." UBYTE Bool_ON_OFF 1 2 0 1 BIT_MASK 0x01 ECU_ADDRESS 0x700211C3 /end MEASUREMENT
/begin MEASUREMENT FDMAve_b_SetFuelMassToZeroCylinder1 "..." UBYTE Bool_ON_OFF 1 2 0 1 BIT_MASK 0x01 ECU_ADDRESS 0x70021306 /end MEASUREMENT
/begin MEASUREMENT FDMAve_b_SetFuelMassToZeroCylinder1IRV "..." UBYTE Bool_ON_OFF 1 2 0 1 BIT_MASK 0x01 ECU_ADDRESS 0x70021113 /end MEASUREMENT
/begin MEASUREMENT FDMAve_b_SetFuelMassToZeroCylinder2 "..." UBYTE Bool_ON_OFF 1 2 0 1 BIT_MASK 0x01 ECU_ADDRESS 0x700211C2 /end MEASUREMENT
/begin MEASUREMENT FDMAve_b_SetFuelMassToZeroCylinder2IRV "..." UBYTE Bool_ON_OFF 1 2 0 1 BIT_MASK 0x01 ECU_ADDRESS 0x70021112 /end MEASUREMENT
/begin MEASUREMENT FDMAve_b_SetFuelMassToZeroCylinder3 "..." UBYTE Bool_ON_OFF 1 2 0 1 BIT_MASK 0x01 ECU_ADDRESS 0x700211C1 /end MEASUREMENT
/begin MEASUREMENT FDMAve_b_SetFuelMassToZeroCylinder3IRV "..." UBYTE Bool_ON_OFF 1 2 0 1 BIT_MASK 0x01 ECU_ADDRESS 0x70021111 /end MEASUREMENT
/begin MEASUREMENT FDMAve_b_SetFuelMassToZeroCylinder4 "..." UBYTE Bool_ON_OFF 1 2 0 1 BIT_MASK 0x01 ECU_ADDRESS 0x700211C0 /end MEASUREMENT
/begin MEASUREMENT FDMAve_b_SetFuelMassToZeroCylinder4IRV "..." UBYTE Bool_ON_OFF 1 2 0 1 BIT_MASK 0x01 ECU_ADDRESS 0x70021110 /end MEASUREMENT
/begin MEASUREMENT FDMAve_b_SetHVBattElectricPowerLimToHalf "..." UBYTE Bool_ON_OFF 1 2 0 1 BIT_MASK 0x01 ECU_ADDRESS 0x700211BF /end MEASUREMENT
/begin MEASUREMENT FDMAve_b_SetHVBattElectricPowerLimToHalfIRV "..." UBYTE Bool_ON_OFF 1 2 0 1 BIT_MASK 0x01 ECU_ADDRESS 0x7002110F /end MEASUREMENT
/begin MEASUREMENT FDMAve_b_SetICETrqCapToSafeVal "..." UBYTE Bool_ON_OFF 1 2 0 1 BIT_MASK 0x01 ECU_ADDRESS 0x70020F6B /end MEASUREMENT
/begin MEASUREMENT FDMAve_b_SetICETrqCapToSafeValIRV "..." UBYTE Bool_ON_OFF 1 2 0 1 BIT_MASK 0x01 ECU_ADDRESS 0x7002110E /end MEASUREMENT
/begin MEASUREMENT FDMAve_b_SetLoTempCoolantCircuitPumpFlowHigh "..." UBYTE Bool_ON_OFF 1 2 0 1 BIT_MASK 0x01 ECU_ADDRESS 0x700211BE /end MEASUREMENT
/begin MEASUREMENT FDMAve_b_SetMAT_ToTempBeforeThrottle "..." UBYTE Bool_ON_OFF 1 2 0 1 BIT_MASK 0x01 ECU_ADDRESS 0x700211BD /end MEASUREMENT
/begin MEASUREMENT FDMAve_b_SetP1ElectricMotorCapabilityToZero "..." UBYTE Bool_ON_OFF 1 2 0 1 BIT_MASK 0x01 ECU_ADDRESS 0x70021303 /end MEASUREMENT
/begin MEASUREMENT FDMAve_b_SetP3ElectricMotorCapabilityToZero "..." UBYTE Bool_ON_OFF 1 2 0 1 BIT_MASK 0x01 ECU_ADDRESS 0x700211BC /end MEASUREMENT
/begin MEASUREMENT FDMAve_b_SetShftLvrPstnToLstKnwnVal "..." UBYTE Bool_ON_OFF 1 2 0 1 BIT_MASK 0x01 ECU_ADDRESS 0x700211B9 /end MEASUREMENT
/begin MEASUREMENT FDMAve_b_SetShftLvrPstnToN "..." UBYTE Bool_ON_OFF 1 2 0 1 BIT_MASK 0x01 ECU_ADDRESS 0x700211BB /end MEASUREMENT
/begin MEASUREMENT FDMAve_b_SetShftLvrPstnToP "..." UBYTE Bool_ON_OFF 1 2 0 1 BIT_MASK 0x01 ECU_ADDRESS 0x700211BA /end MEASUREMENT
/begin MEASUREMENT FDMAve_e_ETC_ControlMode "..." UBYTE I_1 1 2 0 255 ECU_ADDRESS 0x700211AA /end MEASUREMENT
/begin MEASUREMENT FMCU24_CAP_DC "..." UWORD F_1_p0_4 1 2 0 65535 ECU_ADDRESS 0x70021172 /end MEASUREMENT
/begin MEASUREMENT FMCU24_CAP_current "..." UWORD F_0v01_m327v68_30 1 2 -327.68 327.67 ECU_ADDRESS 0x70021174 /end MEASUREMENT
/begin MEASUREMENT FMCU24_CAP_speed "..." UWORD F_1_m32768_31 1 2 -32768 32767 ECU_ADDRESS 0x70021170 /end MEASUREMENT
/begin MEASUREMENT FMCU25_CCP_DC "..." UWORD F_0v1_m3276v8_32 1 2 -3276.8 3276.7 ECU_ADDRESS 0x7002116A /end MEASUREMENT
/begin MEASUREMENT FMCU25_CCP_current "..." UWORD F_0v01_m327v68_30 1 2 -327.68 327.67 ECU_ADDRESS 0x7002116C /end MEASUREMENT
/begin MEASUREMENT FMCU25_CCP_speed "..." UWORD F_1_m32768_31 1 2 -32768 32767 ECU_ADDRESS 0x70021168 /end MEASUREMENT
/begin MEASUREMENT FMCU26_clutch_pressure "..." UWORD F_0v03125_p0_13 1 2 0 2047.96875 ECU_ADDRESS 0x70021164 /end MEASUREMENT
/begin MEASUREMENT FMCU26_clutch_targetpressure "..." UWORD F_0v03125_p0_13 1 2 0 2047.96875 ECU_ADDRESS 0x70021160 /end MEASUREMENT
/begin MEASUREMENT FMCU26_oil_temp "..." UBYTE F_1_m40_27 1 2 -40 215 ECU_ADDRESS 0x7002115B /end MEASUREMENT
/begin MEASUREMENT FMCU8_HTCUFault "..." UBYTE I_1 1 2 0 255 ECU_ADDRESS 0x7002115E /end MEASUREMENT
/begin MEASUREMENT FMCU8_HTCULimphomeSts "..." UBYTE I_1 1 2 0 255 ECU_ADDRESS 0x70021158 /end MEASUREMENT
/begin MEASUREMENT GCU_ActualTorque "..." SWORD F_0v1_m310_78 1 2 -3586.8 2966.7 ECU_ADDRESS 0x70021190 /end MEASUREMENT
/begin MEASUREMENT GCU_GeneratorSpd "..." ULONG F_1_m20000_33 1 2 -20000 4294947295 ECU_ADDRESS 0x70021194 /end MEASUREMENT
/begin MEASUREMENT GCU_MotorTemp "..." UBYTE F_1_m40_27 1 2 -40 215 ECU_ADDRESS 0x70021192 /end MEASUREMENT
/begin MEASUREMENT GERCve_e_ActualGear "..." UBYTE I_1 1 2 0 255 ECU_ADDRESS 0x700211B8 /end MEASUREMENT
/begin MEASUREMENT GERCve_r_TransP1SpdRatio "..." SWORD F_0v0009765625_p0_79 1 2 -32 31.99902344 ECU_ADDRESS 0x700211B6 /end MEASUREMENT
/begin MEASUREMENT GERCve_r_TransP3SpdRatio "..." SWORD F_0v0009765625_p0_79 1 2 -32 31.99902344 ECU_ADDRESS 0x7002102A /end MEASUREMENT
/begin MEASUREMENT GSCHve_b_GearAvailable "..." UBYTE I_1 1 2 0 255 ECU_ADDRESS 0x700211B4 /end MEASUREMENT
/begin MEASUREMENT GSCHve_b_ShiftToSameClutch "..." UBYTE I_1 1 2 0 255 ECU_ADDRESS 0x70021315 /end MEASUREMENT
/begin MEASUREMENT GSEQve_e_EvenClutchStateReq "..." UBYTE I_1 1 2 0 255 ECU_ADDRESS 0x700211B3 /end MEASUREMENT
/begin MEASUREMENT GSEQve_e_OddClutchStateReq "..." UBYTE I_1 1 2 0 255 ECU_ADDRESS 0x700211B2 /end MEASUREMENT
/begin MEASUREMENT GSEQve_e_ShiftType "..." UBYTE I_1 1 2 0 255 ECU_ADDRESS 0x700211B1 /end MEASUREMENT
/begin MEASUREMENT GSEQve_e_SpdCntrlTrgtCltch "..." UBYTE I_1 1 2 0 255 ECU_ADDRESS 0x70021316 /end MEASUREMENT
/begin MEASUREMENT GW_IBCMIgnitionSt "..." UBYTE I_1 1 2 0 255 ECU_ADDRESS 0x7002118E /end MEASUREMENT
/begin MEASUREMENT HBSCve_Pct_HVBattSOC "..." SWORD F_0v1_p0_2 1 2 -3276.8 3276.7 ECU_ADDRESS 0x7002117A /end MEASUREMENT
/begin MEASUREMENT HETEve_M_P1TotalActuatorDmn "..." SWORD F_0v03125_p0_13 1 2 -1024 1023.96875 ECU_ADDRESS 0x70021178 /end MEASUREMENT
/begin MEASUREMENT HTCU_ATFailure "..." UBYTE I_1 1 2 0 255 ECU_ADDRESS 0x70021177 /end MEASUREMENT
/begin MEASUREMENT HTCU_CAP_DutyCycle "..." FLOAT32_IEEE I_1 1 2 -3.402823466E+038 3.402823466E+038 ECU_ADDRESS 0x70021138 /end MEASUREMENT
/begin MEASUREMENT HTCU_CCPSpd "..." UWORD F_1_m32768_31 1 2 -32768 32767 ECU_ADDRESS 0x7002116E /end MEASUREMENT
/begin MEASUREMENT HTCU_CCP_DutyCycle "..." FLOAT32_IEEE I_1 1 2 -3.402823466E+038 3.402823466E+038 ECU_ADDRESS 0x7002113C /end MEASUREMENT
/begin MEASUREMENT HTCU_ClutchActualTransferTorque "..." UWORD F_0v125_m100_22 1 2 -100 8091.875 ECU_ADDRESS 0x70021166 /end MEASUREMENT
/begin MEASUREMENT HTCU_Clutch_Progress "..." UBYTE I_1 1 2 0 255 ECU_ADDRESS 0x70021163 /end MEASUREMENT
/begin MEASUREMENT HTCU_ObdCLRReq "..." UBYTE I_1 1 2 0 255 ECU_ADDRESS 0x7002115C /end MEASUREMENT
/begin MEASUREMENT HTCU_P1_OverTempWarning "..." UBYTE I_1 1 2 0 255 ECU_ADDRESS 0x7002115A /end MEASUREMENT
/begin MEASUREMENT HTCU_P3_OverTempWarning "..." UBYTE I_1 1 2 0 255 ECU_ADDRESS 0x70021159 /end MEASUREMENT
/begin MEASUREMENT IPB_vehicleSpeed "..." UWORD F_0v05625_p0_85 1 2 0 3686.34375 ECU_ADDRESS 0x70021222 /end MEASUREMENT
/begin MEASUREMENT IPB_vehicleSpeedValid "..." UBYTE I_1 1 2 0 255 ECU_ADDRESS 0x70021220 /end MEASUREMENT
/begin MEASUREMENT IPB_wheelSpeedFL "..." UWORD F_0v05625_p0_85 1 2 0 3686.34375 ECU_ADDRESS 0x7002122C /end MEASUREMENT
/begin MEASUREMENT IPB_wheelSpeedFLValid "..." UBYTE I_1 1 2 0 255 ECU_ADDRESS 0x7002122F /end MEASUREMENT
/begin MEASUREMENT IPB_wheelSpeedFR "..." UWORD F_0v05625_p0_85 1 2 0 3686.34375 ECU_ADDRESS 0x7002122A /end MEASUREMENT
/begin MEASUREMENT IPB_wheelSpeedFRValid "..." UBYTE I_1 1 2 0 255 ECU_ADDRESS 0x7002122E /end MEASUREMENT
/begin MEASUREMENT IPB_wheelSpeedRL "..." UWORD F_0v05625_p0_85 1 2 0 3686.34375 ECU_ADDRESS 0x70021226 /end MEASUREMENT
/begin MEASUREMENT IPB_wheelSpeedRLValid "..." UBYTE I_1 1 2 0 255 ECU_ADDRESS 0x70021229 /end MEASUREMENT
/begin MEASUREMENT IPB_wheelSpeedRR "..." UWORD F_0v05625_p0_85 1 2 0 3686.34375 ECU_ADDRESS 0x70021224 /end MEASUREMENT
/begin MEASUREMENT IPB_wheelSpeedRRValid "..." UBYTE I_1 1 2 0 255 ECU_ADDRESS 0x70021228 /end MEASUREMENT
/begin MEASUREMENT LMSCve_dV_LubeFlow "..." SWORD F_0v007813_p0_86 1 2 -256.016384 256.008571 ECU_ADDRESS 0x700210CA /end MEASUREMENT
/begin MEASUREMENT LSIDve_Cnt_PID_30_Server_Data_IRV "..." UBYTE I_1 1 2 0 255 ECU_ADDRESS 0x7002110D /end MEASUREMENT
/begin MEASUREMENT LSIDve_NA_VIT_06_Server_Data_IRV "..." ULONG F_1_p0_4 1 2 0 4294967295 ECU_ADDRESS 0x70021108 /end MEASUREMENT
/begin MEASUREMENT MCUF_ActualTorque "..." SWORD F_0v1_m450_107 1 2 -3726.8 2826.7 ECU_ADDRESS 0x7002118A /end MEASUREMENT
/begin MEASUREMENT MCUF_MotorPower "..." UWORD F_0v1_m260_108 1 2 -260 6293.5 ECU_ADDRESS 0x70021184 /end MEASUREMENT
/begin MEASUREMENT MCUF_MotorSpd "..." UWORD F_1_m20000_33 1 2 -20000 45535 ECU_ADDRESS 0x7002118C /end MEASUREMENT
/begin MEASUREMENT MCUF_MotorTemp "..." UBYTE F_1_m40_27 1 2 -40 215 ECU_ADDRESS 0x7002118F /end MEASUREMENT
/begin MEASUREMENT MILDve_e_MIL_RequestState "..." UBYTE I_1 1 2 0 255 ECU_ADDRESS 0x700210C8 /end MEASUREMENT
/begin MEASUREMENT MosSWOverCurrent "..." UBYTE I_1 1 2 0 255 ECU_ADDRESS 0x70020F84 /end MEASUREMENT
/begin MEASUREMENT PDCM_AccelPedal_Position "..." UWORD F_0v1_p0_2 1 2 0 6553.5 ECU_ADDRESS 0x70020F90 /end MEASUREMENT
/begin MEASUREMENT PDCM_AccelPedal_Status "..." UWORD F_0v1_p0_2 1 2 0 6553.5 ECU_ADDRESS 0x70020F92 /end MEASUREMENT
/begin MEASUREMENT PDCM_BrakePedal_Status "..." UBYTE Bool_ON_OFF 1 2 0 1 BIT_MASK 0x01 ECU_ADDRESS 0x70020F9E /end MEASUREMENT
/begin MEASUREMENT PDCM_ClutchCommand "..." UBYTE F_1_p0_4 1 2 0 255 ECU_ADDRESS 0x70020F9D /end MEASUREMENT
/begin MEASUREMENT PDCM_ClutchCommandTransferTorque "..." UWORD F_0v125_m100_22 1 2 -100 8091.875 ECU_ADDRESS 0x70020F96 /end MEASUREMENT
/begin MEASUREMENT PDCM_Dcy_valid "..." UBYTE I_1 1 2 0 255 ECU_ADDRESS 0x700210BA /end MEASUREMENT
/begin MEASUREMENT PDCM_DriveReady "..." UBYTE I_1 1 2 0 255 ECU_ADDRESS 0x700210C0 /end MEASUREMENT
/begin MEASUREMENT PDCM_DrivingCycle "..." UBYTE I_1 1 2 0 255 ECU_ADDRESS 0x700210B9 /end MEASUREMENT
/begin MEASUREMENT PDCM_OBD_DenoGenValid "..." UBYTE I_1 1 2 0 255 ECU_ADDRESS 0x70020F9B /end MEASUREMENT
/begin MEASUREMENT PDCM_OBD_DenoGeneral "..." UBYTE I_1 1 2 0 255 ECU_ADDRESS 0x70020F9C /end MEASUREMENT
/begin MEASUREMENT PDCM_OBD_FaultClrInhibit "..." UBYTE I_1 1 2 0 255 ECU_ADDRESS 0x70020F9A /end MEASUREMENT
/begin MEASUREMENT PDCM_OBD_PDTCClrSts "..." UBYTE I_1 1 2 0 255 ECU_ADDRESS 0x70020F99 /end MEASUREMENT
/begin MEASUREMENT PDCM_OBD_WarmCycleSts "..." UBYTE I_1 1 2 0 255 ECU_ADDRESS 0x70020F98 /end MEASUREMENT
/begin MEASUREMENT PDCM_SOC "..." UWORD F_0v05_p0_109 1 2 0 3276.75 ECU_ADDRESS 0x700211A4 /end MEASUREMENT
/begin MEASUREMENT PDCM_actualGear "..." UBYTE I_1 1 2 0 255 ECU_ADDRESS 0x700210BC /end MEASUREMENT
/begin MEASUREMENT PORSve_d2n_P1SecondDerivative "..." SWORD F_0v25_p0_25 1 2 -8192 8191.75 ECU_ADDRESS 0x7002119C /end MEASUREMENT
/begin MEASUREMENT PORSve_dn_P1Derivative "..." SWORD F_0v5_p0_26 1 2 -16384 16383.5 ECU_ADDRESS 0x7002119A /end MEASUREMENT
/begin MEASUREMENT PORSve_e_P1RotationalSpeedVld "..." UBYTE I_1 1 2 0 255 ECU_ADDRESS 0x700211A9 /end MEASUREMENT
/begin MEASUREMENT PORSve_n_P1RotationalSpeed "..." SWORD F_1_p0_4 1 2 -32768 32767 ECU_ADDRESS 0x70021040 /end MEASUREMENT
/begin MEASUREMENT PORSve_n_P1RotationalSpeedUnsigned "..." SWORD F_1_p0_4 1 2 -32768 32767 ECU_ADDRESS 0x70021198 /end MEASUREMENT
/begin MEASUREMENT PWRMve_e_SysPwrMd "..." UBYTE I_1 1 2 0 255 ECU_ADDRESS 0x7002103E /end MEASUREMENT
/begin MEASUREMENT Rte_CAPStuckFlag "..." UBYTE I_1 1 2 0 255 ECU_ADDRESS 0x70020F5E /end MEASUREMENT
/begin MEASUREMENT Rte_CCPStuckFlag "..." UBYTE I_1 1 2 0 255 ECU_ADDRESS 0x70020F5F /end MEASUREMENT
/begin MEASUREMENT Rte_CUTDve_T_PCB_Temperature "..." SWORD F_0v0625_p0_14 1 2 -2048 2047.9375 ECU_ADDRESS 0x7002123C /end MEASUREMENT
/begin MEASUREMENT Rte_FACTee_NA_Kisspoint "..." UWORD F_1_p0_4 1 2 0 65535 ECU_ADDRESS 0x7002121E /end MEASUREMENT
/begin MEASUREMENT Rte_FACTee_NA_Kisspoint_Inv "..." UWORD F_1_p0_4 1 2 0 65535 ECU_ADDRESS 0x7002121C /end MEASUREMENT
/begin MEASUREMENT Rte_FACTee_NA_TransferGain "..." UWORD F_1_p0_4 1 2 0 65535 ECU_ADDRESS 0x7002121A /end MEASUREMENT
/begin MEASUREMENT Rte_FACTee_NA_TransferGain_Inv "..." UWORD F_1_p0_4 1 2 0 65535 ECU_ADDRESS 0x70021218 /end MEASUREMENT
/begin MEASUREMENT Rte_FACTve_NA_CalibrationLength "..." ULONG F_1_p0_4 1 2 0 4294967295 ECU_ADDRESS 0x70021214 /end MEASUREMENT
/begin MEASUREMENT Rte_FACTve_NA_CalibrationStart "..." ULONG F_1_p0_4 1 2 0 4294967295 ECU_ADDRESS 0x70021210 /end MEASUREMENT
/begin MEASUREMENT Rte_FbVar_SWCI7_globalMode_currentMode "..." UBYTE I_1 1 2 0 255 ECU_ADDRESS 0x70001C49 /end MEASUREMENT
/begin MEASUREMENT Rte_FbVar_SWCI7_mode0_currentMode "..." UBYTE I_1 1 2 0 255 ECU_ADDRESS 0x70001C48 /end MEASUREMENT
/begin MEASUREMENT Rte_HAMFve_Cnt_CalMemChkSum "..." ULONG F_1_p0_4 1 2 0 4294967295 ECU_ADDRESS 0x70021180 /end MEASUREMENT
/begin MEASUREMENT Rte_HAMFve_b_CalMemChkSumReady "..." UBYTE Bool_ON_OFF 1 2 0 1 BIT_MASK 0x01 ECU_ADDRESS 0x7002117C /end MEASUREMENT
/begin MEASUREMENT Rte_ModeCurrent_0 "..." UBYTE I_1 1 2 0 255 ECU_ADDRESS 0x70000A04 /end MEASUREMENT
/begin MEASUREMENT Rte_ModeCurrent_19 "..." UBYTE I_1 1 2 0 255 ECU_ADDRESS 0x70001C40 /end MEASUREMENT
/begin MEASUREMENT Rte_ModeCurrent_20 "..." UBYTE I_1 1 2 0 255 ECU_ADDRESS 0x70001C3F /end MEASUREMENT
/begin MEASUREMENT Rte_ModeCurrent_4 "..." UBYTE I_1 1 2 0 255 ECU_ADDRESS 0x700050FD /end MEASUREMENT
/begin MEASUREMENT Rte_ModeStatus_4 "..." UBYTE I_1 1 2 0 255 ECU_ADDRESS 0x70001C3E /end MEASUREMENT
/begin MEASUREMENT Rte_Ms_ActvSession "..." UBYTE I_1 1 2 0 255 ECU_ADDRESS 0x700210BE /end MEASUREMENT
/begin MEASUREMENT Rte_Ms_ComCtlTyp "..." UBYTE I_1 1 2 0 255 ECU_ADDRESS 0x700210BD /end MEASUREMENT
/begin MEASUREMENT Rte_Ms_DisblMskbit "..." ULONG I_1 1 2 0 4294967295 ECU_ADDRESS 0x700210B4 /end MEASUREMENT
/begin MEASUREMENT Rte_Ms_DtcGrp "..." ULONG I_1 1 2 0 4294967295 ECU_ADDRESS 0x700210B0 /end MEASUREMENT
/begin MEASUREMENT Rte_Ms_ErrCode "..." UBYTE I_1 1 2 0 255 ECU_ADDRESS 0x700210AF /end MEASUREMENT
/begin MEASUREMENT Rte_Ms_Fus_SafeExec_L2Pfc100ms "..." UBYTE I_1 1 2 0 255 ECU_ADDRESS 0x700210AE /end MEASUREMENT
/begin MEASUREMENT Rte_Ms_Fus_SafeExec_L2Pfc10ms "..." UBYTE I_1 1 2 0 255 ECU_ADDRESS 0x700210AD /end MEASUREMENT
/begin MEASUREMENT Rte_Ms_Fus_SafeExec_L2Pfc2p5ms "..." UBYTE I_1 1 2 0 255 ECU_ADDRESS 0x700210AC /end MEASUREMENT
/begin MEASUREMENT Rte_Ms_Fus_SafeExec_L2Pfc5ms "..." UBYTE I_1 1 2 0 255 ECU_ADDRESS 0x700210AB /end MEASUREMENT
/begin MEASUREMENT Rte_Ms_Nrc "..." UBYTE I_1 1 2 0 255 ECU_ADDRESS 0x700210AA /end MEASUREMENT
/begin MEASUREMENT Rte_Ms_OP_FI_IUMPR_GenDenInh "..." UBYTE Bool_ON_OFF 1 2 0 1 BIT_MASK 0x01 ECU_ADDRESS 0x700210A9 /end MEASUREMENT
/begin MEASUREMENT Rte_Ms_OP_FI_IUMPR_PDTCClrCusPermission "..." UBYTE Bool_ON_OFF 1 2 0 1 BIT_MASK 0x01 ECU_ADDRESS 0x700210A8 /end MEASUREMENT
/begin MEASUREMENT Rte_Ms_OP_Fl_DrvCycl "..." UBYTE I_1 1 2 0 255 ECU_ADDRESS 0x700210A7 /end MEASUREMENT
/begin MEASUREMENT Rte_Ms_OP_Fl_IUMPR_GenDenInc "..." UBYTE Bool_ON_OFF 1 2 0 1 BIT_MASK 0x01 ECU_ADDRESS 0x700210A6 /end MEASUREMENT
/begin MEASUREMENT Rte_Ms_OP_Fl_IgnCycl "..." UBYTE I_1 1 2 0 255 ECU_ADDRESS 0x700210A5 /end MEASUREMENT
/begin MEASUREMENT Rte_Ms_OP_Fl_WrnUpCycl "..." UBYTE I_1 1 2 0 255 ECU_ADDRESS 0x700210A4 /end MEASUREMENT
/begin MEASUREMENT Rte_Ms_OP_Idx_Mot "..." UBYTE I_1 1 2 0 255 ECU_ADDRESS 0x700210A3 /end MEASUREMENT
/begin MEASUREMENT Rte_Ms_OP_Num_DayFrzFrm "..." UBYTE I_1 1 2 0 255 ECU_ADDRESS 0x700210A2 /end MEASUREMENT
/begin MEASUREMENT Rte_Ms_OP_Num_HourFrzFrm "..." UBYTE I_1 1 2 0 255 ECU_ADDRESS 0x700210A1 /end MEASUREMENT
/begin MEASUREMENT Rte_Ms_OP_Num_MinuteFrzFrm "..." UBYTE I_1 1 2 0 255 ECU_ADDRESS 0x700210A0 /end MEASUREMENT
/begin MEASUREMENT Rte_Ms_OP_Num_MonthFrzFrm "..." UBYTE I_1 1 2 0 255 ECU_ADDRESS 0x7002109F /end MEASUREMENT
/begin MEASUREMENT Rte_Ms_OP_Num_SecsFrzFrm "..." UBYTE I_1 1 2 0 255 ECU_ADDRESS 0x7002109E /end MEASUREMENT
/begin MEASUREMENT Rte_Ms_OP_Num_YearFrzFrm "..." UBYTE I_1 1 2 0 255 ECU_ADDRESS 0x7002109D /end MEASUREMENT
/begin MEASUREMENT Rte_Ms_OP_St_MotSt "..." UBYTE I_1 1 2 0 255 ECU_ADDRESS 0x7002109C /end MEASUREMENT
/begin MEASUREMENT Rte_Ms_OP_St_PwrModeFrzFrm "..." UBYTE I_1 1 2 0 255 ECU_ADDRESS 0x7002109B /end MEASUREMENT
/begin MEASUREMENT Rte_Ms_OP_Temp_EngClntTempFrzFrm "..." UBYTE I_1 1 2 0 255 ECU_ADDRESS 0x7002109A /end MEASUREMENT
/begin MEASUREMENT Rte_Ms_OP_cyc_MotDuty "..." SWORD F_0v1_p0_2 1 2 -3276.8 3276.7 ECU_ADDRESS 0x70021098 /end MEASUREMENT
/begin MEASUREMENT Rte_Ms_OP_s_ODOPrmrFrzFrm "..." ULONG F_1_p0_4 1 2 0 4294967295 ECU_ADDRESS 0x70021094 /end MEASUREMENT
/begin MEASUREMENT Rte_Ms_ReqSession "..." UBYTE I_1 1 2 0 255 ECU_ADDRESS 0x70021093 /end MEASUREMENT
/begin MEASUREMENT Rte_Ms_Sid "..." UBYTE I_1 1 2 0 255 ECU_ADDRESS 0x70021092 /end MEASUREMENT
/begin MEASUREMENT Rte_Ms_TCU_Ct_PwrStgActPosInc "..." SWORD F_1_p0_4 1 2 -32768 32767 ECU_ADDRESS 0x70021090 /end MEASUREMENT
/begin MEASUREMENT Rte_Ms_TCU_Fl_SysSycT15 "..." UBYTE I_1 1 2 0 255 ECU_ADDRESS 0x7002108E /end MEASUREMENT
/begin MEASUREMENT Rte_Ms_TCU_I_MotAvrgCrnt "..." SWORD F_0v01_p0_20 1 2 -327.68 327.67 ECU_ADDRESS 0x7002108C /end MEASUREMENT
/begin MEASUREMENT Rte_Ms_TCU_I_MotMaxCrnt "..." SWORD F_0v01_p0_20 1 2 -327.68 327.67 ECU_ADDRESS 0x7002108A /end MEASUREMENT
/begin MEASUREMENT Rte_Ms_TCU_Idx_Mot "..." UBYTE I_1 1 2 0 255 ECU_ADDRESS 0x70021088 /end MEASUREMENT
/begin MEASUREMENT Rte_Ms_TCU_St_5V1RawSt "..." UBYTE I_1 1 2 0 255 ECU_ADDRESS 0x70021087 /end MEASUREMENT
/begin MEASUREMENT Rte_Ms_TCU_St_5V2RawSt "..." UBYTE I_1 1 2 0 255 ECU_ADDRESS 0x70021086 /end MEASUREMENT
/begin MEASUREMENT Rte_Ms_TCU_St_5V3RawSt "..." UBYTE I_1 1 2 0 255 ECU_ADDRESS 0x70021085 /end MEASUREMENT
/begin MEASUREMENT Rte_Ms_TCU_St_ACCRawSt "..." UBYTE I_1 1 2 0 255 ECU_ADDRESS 0x70021084 /end MEASUREMENT
/begin MEASUREMENT Rte_Ms_TCU_St_IgnRawSt "..." UBYTE I_1 1 2 0 255 ECU_ADDRESS 0x70021083 /end MEASUREMENT
/begin MEASUREMENT Rte_Ms_TCU_St_MotCrntSt "..." UBYTE I_1 1 2 0 255 ECU_ADDRESS 0x70021082 /end MEASUREMENT
/begin MEASUREMENT Rte_Ms_TCU_St_MotSpdSt "..." UBYTE I_1 1 2 0 255 ECU_ADDRESS 0x70021081 /end MEASUREMENT
/begin MEASUREMENT Rte_Ms_TCU_St_PresRawSt "..." UBYTE I_1 1 2 0 255 ECU_ADDRESS 0x70021080 /end MEASUREMENT
/begin MEASUREMENT Rte_Ms_TCU_St_PwrStgMode "..." UBYTE I_1 1 2 0 255 ECU_ADDRESS 0x7002107F /end MEASUREMENT
/begin MEASUREMENT Rte_Ms_TCU_St_PwrStgPosSt "..." UBYTE I_1 1 2 0 255 ECU_ADDRESS 0x7002107E /end MEASUREMENT
/begin MEASUREMENT Rte_Ms_TCU_St_PwrStgSt "..." UBYTE I_1 1 2 0 255 ECU_ADDRESS 0x7002107D /end MEASUREMENT
/begin MEASUREMENT Rte_Ms_TCU_St_PwrStgTempSt "..." UBYTE I_1 1 2 0 255 ECU_ADDRESS 0x7002107C /end MEASUREMENT
/begin MEASUREMENT Rte_Ms_TCU_St_PwrTempWarnLvl "..." UBYTE I_1 1 2 0 255 ECU_ADDRESS 0x7002107B /end MEASUREMENT
/begin MEASUREMENT Rte_Ms_TCU_St_T30HiRawSt "..." UBYTE I_1 1 2 0 255 ECU_ADDRESS 0x7002107A /end MEASUREMENT
/begin MEASUREMENT Rte_Ms_TCU_St_T30LowRawSt "..." UBYTE I_1 1 2 0 255 ECU_ADDRESS 0x70021079 /end MEASUREMENT
/begin MEASUREMENT Rte_Ms_TCU_Temp_PwrStgTemp "..." UWORD F_1_m40_27 1 2 -40 65495 ECU_ADDRESS 0x70021076 /end MEASUREMENT
/begin MEASUREMENT Rte_Ms_TCU_U_5V1Raw "..." UWORD F_1_p0_4 1 2 0 65535 ECU_ADDRESS 0x70021074 /end MEASUREMENT
/begin MEASUREMENT Rte_Ms_TCU_U_5V2Raw "..." UWORD F_1_p0_4 1 2 0 65535 ECU_ADDRESS 0x70021072 /end MEASUREMENT
/begin MEASUREMENT Rte_Ms_TCU_U_5V3Raw "..." UWORD F_1_p0_4 1 2 0 65535 ECU_ADDRESS 0x70021070 /end MEASUREMENT
/begin MEASUREMENT Rte_Ms_TCU_U_ACCRaw "..." UWORD F_1_p0_4 1 2 0 65535 ECU_ADDRESS 0x7002106E /end MEASUREMENT
/begin MEASUREMENT Rte_Ms_TCU_U_IgnRaw "..." UWORD F_1_p0_4 1 2 0 65535 ECU_ADDRESS 0x7002106C /end MEASUREMENT
/begin MEASUREMENT Rte_Ms_TCU_U_T30HiRaw "..." UWORD F_1_p0_4 1 2 0 65535 ECU_ADDRESS 0x7002106A /end MEASUREMENT
/begin MEASUREMENT Rte_Ms_TCU_U_T30LowRaw "..." UWORD F_1_p0_4 1 2 0 65535 ECU_ADDRESS 0x70021068 /end MEASUREMENT
/begin MEASUREMENT Rte_Ms_TCU_U_TempRaw "..." UWORD F_1_p0_4 1 2 0 65535 ECU_ADDRESS 0x70021066 /end MEASUREMENT
/begin MEASUREMENT Rte_Ms_TCU_cyc_PwrStgActPWM "..." SWORD F_0v1_p0_2 1 2 -3276.8 3276.7 ECU_ADDRESS 0x70021064 /end MEASUREMENT
/begin MEASUREMENT Rte_Ms_TCU_n_MotRotSpd "..." SWORD F_1_p0_4 1 2 -32768 32767 ECU_ADDRESS 0x70021062 /end MEASUREMENT
/begin MEASUREMENT Rte_Ms_TCU_p_PresRaw "..." UWORD F_0v01_p0_20 1 2 0 655.35 ECU_ADDRESS 0x70021060 /end MEASUREMENT
/begin MEASUREMENT Rte_Ms_TCU_st_ChipTemp "..." UBYTE I_1 1 2 0 255 ECU_ADDRESS 0x70021058 /end MEASUREMENT
/begin MEASUREMENT Rte_Ms_TCU_t_ChipTemp "..." SWORD F_1_p0_4 1 2 -32768 32767 ECU_ADDRESS 0x70021056 /end MEASUREMENT
/begin MEASUREMENT Rte_Ms_TCU_u_PresRaw "..." UWORD F_0v001_p0_100 1 2 0 65.535 ECU_ADDRESS 0x70021054 /end MEASUREMENT
/begin MEASUREMENT Rte_Ms_busbarCur "..." SWORD F_1_p0_4 1 2 -32768 32767 ECU_ADDRESS 0x70021052 /end MEASUREMENT
/begin MEASUREMENT Rte_Ms_busbarCurLoad "..." UWORD F_1_p0_4 1 2 0 65535 ECU_ADDRESS 0x70021050 /end MEASUREMENT
/begin MEASUREMENT Rte_Ms_data_RxSignal "..." UBYTE I_1 1 2 0 255 ECU_ADDRESS 0x7002104F /end MEASUREMENT
/begin MEASUREMENT Rte_Ms_idx_RxAck "..." UBYTE I_1 1 2 0 255 ECU_ADDRESS 0x7002104E /end MEASUREMENT
/begin MEASUREMENT Rte_Ms_idx_RxDlcErr "..." UBYTE I_1 1 2 0 255 ECU_ADDRESS 0x7002104D /end MEASUREMENT
/begin MEASUREMENT Rte_Ms_idx_RxSignal "..." UBYTE I_1 1 2 0 255 ECU_ADDRESS 0x7002104C /end MEASUREMENT
/begin MEASUREMENT Rte_Ms_idx_RxTOut "..." UBYTE I_1 1 2 0 255 ECU_ADDRESS 0x7002104B /end MEASUREMENT
/begin MEASUREMENT Rte_Ms_idx_TxAck "..." UBYTE I_1 1 2 0 255 ECU_ADDRESS 0x7002104A /end MEASUREMENT
/begin MEASUREMENT Rte_Ms_idx_TxMessage "..." UBYTE I_1 1 2 0 255 ECU_ADDRESS 0x70021049 /end MEASUREMENT
/begin MEASUREMENT Rte_Ms_idx_TxTOut "..." UBYTE I_1 1 2 0 255 ECU_ADDRESS 0x70021048 /end MEASUREMENT
/begin MEASUREMENT Rte_Ms_length_TxMessage "..." UBYTE I_1 1 2 0 255 ECU_ADDRESS 0x70021047 /end MEASUREMENT
/begin MEASUREMENT Rte_Ms_motIdx "..." UBYTE I_1 1 2 0 255 ECU_ADDRESS 0x70021046 /end MEASUREMENT
/begin MEASUREMENT Rte_Ms_phaseCurLoad "..." UWORD F_1_p0_4 1 2 0 65535 ECU_ADDRESS 0x70021044 /end MEASUREMENT
/begin MEASUREMENT Rte_Ms_sumCurLoad "..." UWORD F_1_p0_4 1 2 0 65535 ECU_ADDRESS 0x70021042 /end MEASUREMENT
/begin MEASUREMENT Rte_RECount_Os_BswEnd_10ms_Task_divby1000_0 "..." UWORD F_1_p0_4 1 2 0 65535 ECU_ADDRESS 0x7002103C /end MEASUREMENT
/begin MEASUREMENT Rte_RECount_Os_BswEnd_10ms_Task_divby100_0 "..." UBYTE I_1 1 2 0 255 ECU_ADDRESS 0x7002103A /end MEASUREMENT
/begin MEASUREMENT Rte_TCU_p_PresRaw "..." UWORD F_1_p0_4 1 2 0 65535 ECU_ADDRESS 0x7002105C /end MEASUREMENT
/begin MEASUREMENT Rte_TCU_st_PresRawSt "..." UBYTE I_1 1 2 0 255 ECU_ADDRESS 0x70021078 /end MEASUREMENT
/begin MEASUREMENT Rte_TCU_u_OilTemp "..." UWORD F_0v001_p0_100 1 2 0 65.535 ECU_ADDRESS 0x7002105A /end MEASUREMENT
/begin MEASUREMENT Rte_TCU_u_PresRaw "..." UWORD F_1_p0_4 1 2 0 65535 ECU_ADDRESS 0x7002105E /end MEASUREMENT
/begin MEASUREMENT Rte_V5RDve_U_VRef1RawValue "..." UWORD F_1_p0_4 1 2 0 65535 ECU_ADDRESS 0x70020FAA /end MEASUREMENT
/begin MEASUREMENT Rte_V5RDve_U_VRef2RawValue "..." UWORD F_1_p0_4 1 2 0 65535 ECU_ADDRESS 0x70020FA8 /end MEASUREMENT
/begin MEASUREMENT Rte_V5RDve_U_VRef3RawValue "..." UWORD F_1_p0_4 1 2 0 65535 ECU_ADDRESS 0x70020FA6 /end MEASUREMENT
/begin MEASUREMENT Rte_V5RDve_y_EC_Ref1_Status "..." UBYTE I_1 1 2 0 255 ECU_ADDRESS 0x70020FA2 /end MEASUREMENT
/begin MEASUREMENT Rte_V5RDve_y_EC_Ref2_Status "..." UBYTE I_1 1 2 0 255 ECU_ADDRESS 0x70020FA1 /end MEASUREMENT
/begin MEASUREMENT Rte_V5RDve_y_EC_Ref3_Status "..." UBYTE I_1 1 2 0 255 ECU_ADDRESS 0x70020FA0 /end MEASUREMENT
/begin MEASUREMENT Rte_bClutchCapInsufficient "..." UBYTE Bool_ON_OFF 1 2 0 1 BIT_MASK 0x01 ECU_ADDRESS 0x700212CB /end MEASUREMENT
/begin MEASUREMENT Rte_bClutchDragTrqTooHigh "..." UBYTE Bool_ON_OFF 1 2 0 1 BIT_MASK 0x01 ECU_ADDRESS 0x700212CA /end MEASUREMENT
/begin MEASUREMENT Rte_bClutchPresAboveLim "..." UBYTE Bool_ON_OFF 1 2 0 1 BIT_MASK 0x01 ECU_ADDRESS 0x700212D4 /end MEASUREMENT
/begin MEASUREMENT Rte_bClutchPresSensPerf "..." UBYTE Bool_ON_OFF 1 2 0 1 BIT_MASK 0x01 ECU_ADDRESS 0x700212D3 /end MEASUREMENT
/begin MEASUREMENT Rte_bCoolingActSpdDev "..." UBYTE Bool_ON_OFF 1 2 0 1 BIT_MASK 0x01 ECU_ADDRESS 0x700212D5 /end MEASUREMENT
/begin MEASUREMENT Rte_bHighClutchPressure "..." UBYTE Bool_ON_OFF 1 2 0 1 BIT_MASK 0x01 ECU_ADDRESS 0x700212D2 /end MEASUREMENT
/begin MEASUREMENT Rte_bLowClutchPressure "..." UBYTE Bool_ON_OFF 1 2 0 1 BIT_MASK 0x01 ECU_ADDRESS 0x700212D1 /end MEASUREMENT
/begin MEASUREMENT Rte_bTransCtrlSysPerf "..." UBYTE Bool_ON_OFF 1 2 0 1 BIT_MASK 0x01 ECU_ADDRESS 0x700212D0 /end MEASUREMENT
/begin MEASUREMENT Rte_bTransOilTempCrit "..." UBYTE Bool_ON_OFF 1 2 0 1 BIT_MASK 0x01 ECU_ADDRESS 0x700212CF /end MEASUREMENT
/begin MEASUREMENT Rte_bTransOilTempWarn "..." UBYTE Bool_ON_OFF 1 2 0 1 BIT_MASK 0x01 ECU_ADDRESS 0x700212CE /end MEASUREMENT
/begin MEASUREMENT Rte_bUnreasonHighOilTemp "..." UBYTE Bool_ON_OFF 1 2 0 1 BIT_MASK 0x01 ECU_ADDRESS 0x700212CD /end MEASUREMENT
/begin MEASUREMENT Rte_bUnreasonLowOilTemp "..." UBYTE Bool_ON_OFF 1 2 0 1 BIT_MASK 0x01 ECU_ADDRESS 0x700212CC /end MEASUREMENT
/begin MEASUREMENT Rte_bVcuFault "..." UBYTE Bool_ON_OFF 1 2 0 1 BIT_MASK 0x01 ECU_ADDRESS 0x700212C9 /end MEASUREMENT
/begin MEASUREMENT Rte_b_IgnitionOn "..." UBYTE Bool_ON_OFF 1 2 0 1 BIT_MASK 0x01 ECU_ADDRESS 0x70021311 /end MEASUREMENT
/begin MEASUREMENT SBC_au16StatusRegsNvm "SBC_au16StatusRegsNvm" UWORD I_111 1 2 0 65535 MATRIX_DIM 18 1 1 ECU_ADDRESS 0x70017116 /end MEASUREMENT
/begin MEASUREMENT SBC_au16StatusRegsNvm[0] "SBC_au16StatusRegsNvm[0]" UWORD I_111 1 2 0 65535 ECU_ADDRESS 0x70017116 /end MEASUREMENT
/begin MEASUREMENT SBC_au16StatusRegsNvm[10] "SBC_au16StatusRegsNvm[10]" UWORD I_111 1 2 0 65535 ECU_ADDRESS 0x7001712A /end MEASUREMENT
/begin MEASUREMENT SBC_au16StatusRegsNvm[11] "SBC_au16StatusRegsNvm[11]" UWORD I_111 1 2 0 65535 ECU_ADDRESS 0x7001712C /end MEASUREMENT
/begin MEASUREMENT SBC_au16StatusRegsNvm[12] "SBC_au16StatusRegsNvm[12]" UWORD I_111 1 2 0 65535 ECU_ADDRESS 0x7001712E /end MEASUREMENT
/begin MEASUREMENT SBC_au16StatusRegsNvm[13] "SBC_au16StatusRegsNvm[13]" UWORD I_111 1 2 0 65535 ECU_ADDRESS 0x70017130 /end MEASUREMENT
/begin MEASUREMENT SBC_au16StatusRegsNvm[14] "SBC_au16StatusRegsNvm[14]" UWORD I_111 1 2 0 65535 ECU_ADDRESS 0x70017132 /end MEASUREMENT
/begin MEASUREMENT SBC_au16StatusRegsNvm[15] "SBC_au16StatusRegsNvm[15]" UWORD I_111 1 2 0 65535 ECU_ADDRESS 0x70017134 /end MEASUREMENT
/begin MEASUREMENT SBC_au16StatusRegsNvm[16] "SBC_au16StatusRegsNvm[16]" UWORD I_111 1 2 0 65535 ECU_ADDRESS 0x70017136 /end MEASUREMENT
/begin MEASUREMENT SBC_au16StatusRegsNvm[17] "SBC_au16StatusRegsNvm[17]" UWORD I_111 1 2 0 65535 ECU_ADDRESS 0x70017138 /end MEASUREMENT
/begin MEASUREMENT SBC_au16StatusRegsNvm[1] "SBC_au16StatusRegsNvm[1]" UWORD I_111 1 2 0 65535 ECU_ADDRESS 0x70017118 /end MEASUREMENT
/begin MEASUREMENT SBC_au16StatusRegsNvm[2] "SBC_au16StatusRegsNvm[2]" UWORD I_111 1 2 0 65535 ECU_ADDRESS 0x7001711A /end MEASUREMENT
/begin MEASUREMENT SBC_au16StatusRegsNvm[3] "SBC_au16StatusRegsNvm[3]" UWORD I_111 1 2 0 65535 ECU_ADDRESS 0x7001711C /end MEASUREMENT
/begin MEASUREMENT SBC_au16StatusRegsNvm[4] "SBC_au16StatusRegsNvm[4]" UWORD I_111 1 2 0 65535 ECU_ADDRESS 0x7001711E /end MEASUREMENT
/begin MEASUREMENT SBC_au16StatusRegsNvm[5] "SBC_au16StatusRegsNvm[5]" UWORD I_111 1 2 0 65535 ECU_ADDRESS 0x70017120 /end MEASUREMENT
/begin MEASUREMENT SBC_au16StatusRegsNvm[6] "SBC_au16StatusRegsNvm[6]" UWORD I_111 1 2 0 65535 ECU_ADDRESS 0x70017122 /end MEASUREMENT
/begin MEASUREMENT SBC_au16StatusRegsNvm[7] "SBC_au16StatusRegsNvm[7]" UWORD I_111 1 2 0 65535 ECU_ADDRESS 0x70017124 /end MEASUREMENT
/begin MEASUREMENT SBC_au16StatusRegsNvm[8] "SBC_au16StatusRegsNvm[8]" UWORD I_111 1 2 0 65535 ECU_ADDRESS 0x70017126 /end MEASUREMENT
/begin MEASUREMENT SBC_au16StatusRegsNvm[9] "SBC_au16StatusRegsNvm[9]" UWORD I_111 1 2 0 65535 ECU_ADDRESS 0x70017128 /end MEASUREMENT
/begin MEASUREMENT SBC_bDeintWdgCmd "SBC_bDeintWdgCmd" UBYTE Bool_ON_OFF 1 2 0 1 BIT_MASK 0x01 ECU_ADDRESS 0x70017190 /end MEASUREMENT
/begin MEASUREMENT SBC_f32BatteryVoltage "SBC_f32BatteryVoltage" FLOAT32_IEEE I_3 1 2 -3.402823466E+038 3.402823466E+038 ECU_ADDRESS 0x70017198 /end MEASUREMENT
/begin MEASUREMENT SBC_f32BkpVoltage "SBC_f32BkpVoltage" FLOAT32_IEEE I_3 1 2 -3.402823466E+038 3.402823466E+038 ECU_ADDRESS 0x70017194 /end MEASUREMENT
/begin MEASUREMENT SDADva_b_IUPR_GenDenStatus "..." UBYTE Bool_ON_OFF 1 2 0 1 BIT_MASK 0x01 MATRIX_DIM 2 1 1 ECU_ADDRESS 0x70021038 /end MEASUREMENT
/begin MEASUREMENT SDADva_b_IUPR_GenDenStatus[0] "SDADva_b_IUPR_GenDenStatus[0]" UBYTE Bool_ON_OFF 1 2 0 1 BIT_MASK 0x01 ECU_ADDRESS 0x70021038 /end MEASUREMENT
/begin MEASUREMENT SDADva_b_IUPR_GenDenStatus[1] "SDADva_b_IUPR_GenDenStatus[1]" UBYTE Bool_ON_OFF 1 2 0 1 BIT_MASK 0x01 ECU_ADDRESS 0x70021039 /end MEASUREMENT
/begin MEASUREMENT SPARve_l_WheelRadius "..." SWORD F_0v0009765625_p0_79 1 2 -32 31.99902344 ECU_ADDRESS 0x70021036 /end MEASUREMENT
/begin MEASUREMENT SPARve_r_P1MtrRatio "..." SWORD F_0v0009765625_p0_79 1 2 -32 31.99902344 ECU_ADDRESS 0x70021034 /end MEASUREMENT
/begin MEASUREMENT SPARve_r_P1Trans1stGearRatio "..." SWORD F_0v0009765625_p0_79 1 2 -32 31.99902344 ECU_ADDRESS 0x70021032 /end MEASUREMENT
/begin MEASUREMENT SPARve_r_P1Trans1stGearRatio_IRV "..." SWORD F_0v0009765625_p0_79 1 2 -32 31.99902344 ECU_ADDRESS 0x70021106 /end MEASUREMENT
/begin MEASUREMENT SPARve_r_P1Trans2ndGearRatio "..." SWORD F_0v0009765625_p0_79 1 2 -32 31.99902344 ECU_ADDRESS 0x70021030 /end MEASUREMENT
/begin MEASUREMENT SPARve_r_P3TransDM_Ratio "..." SWORD F_0v0009765625_p0_79 1 2 -32 31.99902344 ECU_ADDRESS 0x7002102E /end MEASUREMENT
/begin MEASUREMENT SPARve_r_P3TransDM_Ratio_IRV "..." SWORD F_0v0009765625_p0_79 1 2 -32 31.99902344 ECU_ADDRESS 0x70021104 /end MEASUREMENT
/begin MEASUREMENT SPARve_r_TransFnlDrvRatio "..." SWORD F_0v0009765625_p0_79 1 2 -32 31.99902344 ECU_ADDRESS 0x7002102C /end MEASUREMENT
/begin MEASUREMENT SPY_bBufFull "SPY_bBufFull" UBYTE Bool_ON_OFF 1 2 0 1 BIT_MASK 0x01 ECU_ADDRESS 0x7001F4EC /end MEASUREMENT
/begin MEASUREMENT SPY_u16DaqListFirstElmIdx "SPY_u16DaqListFirstElmIdx" UWORD I_1 1 2 0 65535 ECU_ADDRESS 0x7001F4EA /end MEASUREMENT
/begin MEASUREMENT SPY_u16NrOfElmsToTx "SPY_u16NrOfElmsToTx" UWORD I_1 1 2 0 65535 ECU_ADDRESS 0x7001F4E8 /end MEASUREMENT
/begin MEASUREMENT SPY_u16PreTrigSmplIdx "SPY_u16PreTrigSmplIdx" UWORD I_1 1 2 0 65535 ECU_ADDRESS 0x7001F4E6 /end MEASUREMENT
/begin MEASUREMENT SPY_u16RmngSmplIdx "SPY_u16RmngSmplIdx" UWORD I_1 1 2 0 65535 ECU_ADDRESS 0x7001F4E4 /end MEASUREMENT
/begin MEASUREMENT SPY_u16SmplIdx "SPY_u16SmplIdx" UWORD I_1 1 2 0 65535 ECU_ADDRESS 0x7001F4E2 /end MEASUREMENT
/begin MEASUREMENT SPY_u16TrigSmplIdx "SPY_u16TrigSmplIdx" UWORD I_1 1 2 0 65535 ECU_ADDRESS 0x7001F4E0 /end MEASUREMENT
/begin MEASUREMENT SSSCve_e_EngineStatus "..." UBYTE I_1 1 2 0 255 ECU_ADDRESS 0x70021028 /end MEASUREMENT
/begin MEASUREMENT SWINve_M_P1MtrTrq "..." SWORD F_0v03125_p0_13 1 2 -1024 1023.96875 ECU_ADDRESS 0x70021026 /end MEASUREMENT
/begin MEASUREMENT SWINve_M_P3MtrTrq "..." SWORD F_0v03125_p0_13 1 2 -1024 1023.96875 ECU_ADDRESS 0x70021024 /end MEASUREMENT
/begin MEASUREMENT SWINve_P_MotorPower "..." FLOAT32_IEEE F_1_p0_115 1 2 -3.402823466E+038 3.402823466E+038 ECU_ADDRESS 0x700210D0 /end MEASUREMENT
/begin MEASUREMENT SWINve_Pct_AccelPedalPosition "..." SWORD F_0v1_p0_2 1 2 -3276.8 3276.7 ECU_ADDRESS 0x70020FF4 /end MEASUREMENT
/begin MEASUREMENT SWINve_Pct_pepsPowerMode "..." SWORD F_0v1_p0_2 1 2 -3276.8 3276.7 ECU_ADDRESS 0x70020FF2 /end MEASUREMENT
/begin MEASUREMENT SWINve_T_P1Motor "..." SWORD F_0v0625_p0_14 1 2 -2048 2047.9375 ECU_ADDRESS 0x70021022 /end MEASUREMENT
/begin MEASUREMENT SWINve_T_P1Motor_IRV "..." SWORD F_0v0625_p0_14 1 2 -2048 2047.9375 ECU_ADDRESS 0x70021102 /end MEASUREMENT
/begin MEASUREMENT SWINve_T_P3Motor "..." SWORD F_0v0625_p0_14 1 2 -2048 2047.9375 ECU_ADDRESS 0x70021020 /end MEASUREMENT
/begin MEASUREMENT SWINve_T_P3Motor_IRV "..." SWORD F_0v0625_p0_14 1 2 -2048 2047.9375 ECU_ADDRESS 0x70021100 /end MEASUREMENT
/begin MEASUREMENT SWINve_U_ebsBATT "..." SWORD F_0v001953125_p0_116 1 2 -64 63.99804688 ECU_ADDRESS 0x70020FF0 /end MEASUREMENT
/begin MEASUREMENT SWINve_b_DrivingCycle "..." UBYTE Bool_ON_OFF 1 2 0 1 BIT_MASK 0x01 ECU_ADDRESS 0x700211B0 /end MEASUREMENT
/begin MEASUREMENT SWINve_b_FaultClrInhibit "..." UBYTE Bool_ON_OFF 1 2 0 1 BIT_MASK 0x01 ECU_ADDRESS 0x700211AF /end MEASUREMENT
/begin MEASUREMENT SWINve_b_PDTCClrSts "..." UBYTE Bool_ON_OFF 1 2 0 1 BIT_MASK 0x01 ECU_ADDRESS 0x700211AE /end MEASUREMENT
/begin MEASUREMENT SWINve_b_PropulsionActive "..." UBYTE Bool_ON_OFF 1 2 0 1 BIT_MASK 0x01 ECU_ADDRESS 0x7002101E /end MEASUREMENT
/begin MEASUREMENT SWINve_b_WarmUpCycleCompleted "..." UBYTE Bool_ON_OFF 1 2 0 1 BIT_MASK 0x01 ECU_ADDRESS 0x7002101D /end MEASUREMENT
/begin MEASUREMENT SWINve_e_Dcyvalid "..." UBYTE I_1 1 2 0 255 ECU_ADDRESS 0x700211AD /end MEASUREMENT
/begin MEASUREMENT SWINve_e_GCU_COM_Validity "..." UBYTE I_1 1 2 0 255 ECU_ADDRESS 0x7002101C /end MEASUREMENT
/begin MEASUREMENT SWINve_e_MCU_COM_Validity "..." UBYTE I_1 1 2 0 255 ECU_ADDRESS 0x7002101B /end MEASUREMENT
/begin MEASUREMENT SWINve_e_MCU_P1_COM_Validity "..." UBYTE I_1 1 2 0 255 ECU_ADDRESS 0x7002101A /end MEASUREMENT
/begin MEASUREMENT SWINve_e_MCU_P3_COM_Validity "..." UBYTE I_1 1 2 0 255 ECU_ADDRESS 0x70021019 /end MEASUREMENT
/begin MEASUREMENT SWINve_e_P1MtrSpdVld "..." UBYTE I_1 1 2 0 255 ECU_ADDRESS 0x70021018 /end MEASUREMENT
/begin MEASUREMENT SWINve_e_P1MtrTempVld "..." UBYTE I_1 1 2 0 255 ECU_ADDRESS 0x70021017 /end MEASUREMENT
/begin MEASUREMENT SWINve_e_P1MtrTrqVld "..." UBYTE I_1 1 2 0 255 ECU_ADDRESS 0x70021016 /end MEASUREMENT
/begin MEASUREMENT SWINve_e_P3MtrSpdVld "..." UBYTE I_1 1 2 0 255 ECU_ADDRESS 0x70021015 /end MEASUREMENT
/begin MEASUREMENT SWINve_e_P3MtrTempVld "..." UBYTE I_1 1 2 0 255 ECU_ADDRESS 0x70021014 /end MEASUREMENT
/begin MEASUREMENT SWINve_e_P3MtrTrqVld "..." UBYTE I_1 1 2 0 255 ECU_ADDRESS 0x70021013 /end MEASUREMENT
/begin MEASUREMENT SWINve_e_VCU_COM_Validity "..." UBYTE I_1 1 2 0 255 ECU_ADDRESS 0x70021012 /end MEASUREMENT
/begin MEASUREMENT SWINve_n_P1MtrSpd "..." SWORD F_1_p0_4 1 2 -32768 32767 ECU_ADDRESS 0x7002100A /end MEASUREMENT
/begin MEASUREMENT SWINve_n_P3MtrSpd "..." SWORD F_1_p0_4 1 2 -32768 32767 ECU_ADDRESS 0x70021008 /end MEASUREMENT
/begin MEASUREMENT SWINve_r_P1TransInput "..." SWORD F_0v0009765625_p0_79 1 2 -32 31.99902344 ECU_ADDRESS 0x70021006 /end MEASUREMENT
/begin MEASUREMENT SWINve_r_P1TransInput_IRV "..." SWORD F_0v0009765625_p0_79 1 2 -32 31.99902344 ECU_ADDRESS 0x700210FC /end MEASUREMENT
/begin MEASUREMENT SWINve_t_Day "..." UBYTE I_1 1 2 0 255 ECU_ADDRESS 0x70021004 /end MEASUREMENT
/begin MEASUREMENT SWINve_t_Hour "..." UBYTE I_1 1 2 0 255 ECU_ADDRESS 0x70021003 /end MEASUREMENT
/begin MEASUREMENT SWINve_t_Minute "..." UBYTE I_1 1 2 0 255 ECU_ADDRESS 0x70021002 /end MEASUREMENT
/begin MEASUREMENT SWINve_t_Month "..." UBYTE I_1 1 2 0 255 ECU_ADDRESS 0x70021001 /end MEASUREMENT
/begin MEASUREMENT SWINve_t_Second "..." UBYTE I_1 1 2 0 255 ECU_ADDRESS 0x70021000 /end MEASUREMENT
/begin MEASUREMENT SWINve_t_Year "..." UWORD F_1_p0_4 1 2 0 65535 ECU_ADDRESS 0x70020FFE /end MEASUREMENT
/begin MEASUREMENT SWINve_y_VCUFault "..." UBYTE I_1 1 2 0 255 ECU_ADDRESS 0x70020FFC /end MEASUREMENT
/begin MEASUREMENT SYVDve_U_MotorSupplyVoltage "..." SWORD F_0v001953125_p0_116 1 2 -64 63.99804688 ECU_ADDRESS 0x70020FFA /end MEASUREMENT
/begin MEASUREMENT SYVDve_U_SystemVoltage "..." SWORD F_0v001953125_p0_116 1 2 -64 63.99804688 ECU_ADDRESS 0x70020FF8 /end MEASUREMENT
/begin MEASUREMENT SYVDve_U_SystemVoltage_IRV "..." SWORD F_0v001953125_p0_116 1 2 -64 63.99804688 ECU_ADDRESS 0x700210FA /end MEASUREMENT
/begin MEASUREMENT SYVDve_y_BSWDiagBLDCSupOvrVolt "..." UBYTE I_1 1 2 0 255 ECU_ADDRESS 0x70020F69 /end MEASUREMENT
/begin MEASUREMENT SYVDve_y_BSWDiagBLDCSupUnrVolt "..." UBYTE I_1 1 2 0 255 ECU_ADDRESS 0x70020F6A /end MEASUREMENT
/begin MEASUREMENT TAMDve_I_HWIO_MotorCurrent_IRV "..." SWORD F_0v03125_p0_13 1 2 -1024 1023.96875 ECU_ADDRESS 0x700210F8 /end MEASUREMENT
/begin MEASUREMENT TAMDve_Pct_HWIO_MotorActPWM_IRV "..." SWORD F_0v1_p0_2 1 2 -3276.8 3276.7 ECU_ADDRESS 0x700210F6 /end MEASUREMENT
/begin MEASUREMENT TAMDve_T_ClutchActPwrStg "..." SWORD F_0v0625_p0_14 1 2 -2048 2047.9375 ECU_ADDRESS 0x70020FF6 /end MEASUREMENT
/begin MEASUREMENT TAMDve_e_ClutchActPwrStgTempVld "..." UBYTE I_1 1 2 0 255 ECU_ADDRESS 0x70020FEC /end MEASUREMENT
/begin MEASUREMENT TAMDve_e_ClutchActuatorVld "..." UBYTE I_1 1 2 0 255 ECU_ADDRESS 0x70020FEB /end MEASUREMENT
/begin MEASUREMENT TAMDve_e_MosfetVld "..." UBYTE I_1 1 2 0 255 ECU_ADDRESS 0x7002130D /end MEASUREMENT
/begin MEASUREMENT TAMDve_e_StuckVld "..." UBYTE I_1 1 2 0 255 ECU_ADDRESS 0x70020F60 /end MEASUREMENT
/begin MEASUREMENT TAMDve_n_HWIO_MotorRotSpd_IRV "..." SWORD F_1_p0_4 1 2 -32768 32767 ECU_ADDRESS 0x700210F4 /end MEASUREMENT
/begin MEASUREMENT TAMDve_y_BSWDiagDrvOvrCur "..." UBYTE I_1 1 2 0 255 ECU_ADDRESS 0x7000228B /end MEASUREMENT
/begin MEASUREMENT TAMDve_y_BSWDiagDrvOvrTemp "..." UBYTE I_1 1 2 0 255 ECU_ADDRESS 0x7000228A /end MEASUREMENT
/begin MEASUREMENT TAMDve_y_BSWDiagDrvSupOvrVolt "..." UBYTE I_1 1 2 0 255 ECU_ADDRESS 0x70002289 /end MEASUREMENT
/begin MEASUREMENT TAMDve_y_BSWDiagHALInvalFault "..." UBYTE I_1 1 2 0 255 ECU_ADDRESS 0x70002288 /end MEASUREMENT
/begin MEASUREMENT TAMDve_y_BSWDiagHALSigOvrVolt "..." UBYTE I_1 1 2 0 255 ECU_ADDRESS 0x70002287 /end MEASUREMENT
/begin MEASUREMENT TAMDve_y_BSWDiagHALSigUndrVolt "..." UBYTE I_1 1 2 0 255 ECU_ADDRESS 0x70002286 /end MEASUREMENT
/begin MEASUREMENT TAMDve_y_BSWDiagHALSupOvrVolt "..." UBYTE I_1 1 2 0 255 ECU_ADDRESS 0x70002285 /end MEASUREMENT
/begin MEASUREMENT TAMDve_y_BSWDiagHALSupUndrVolt "..." UBYTE I_1 1 2 0 255 ECU_ADDRESS 0x70002284 /end MEASUREMENT
/begin MEASUREMENT TAMDve_y_BSWDiagHALUndefFault "..." UBYTE I_1 1 2 0 255 ECU_ADDRESS 0x70002283 /end MEASUREMENT
/begin MEASUREMENT TAMDve_y_BSWDiagMosUnderVolt "..." UBYTE I_1 1 2 0 255 ECU_ADDRESS 0x7000227D /end MEASUREMENT
/begin MEASUREMENT TAMDve_y_BSWDiagPhaseHigh "..." UBYTE I_1 1 2 0 255 ECU_ADDRESS 0x7000227C /end MEASUREMENT
/begin MEASUREMENT TAMDve_y_BSWDiagPhaseLow "..." UBYTE I_1 1 2 0 255 ECU_ADDRESS 0x7000227B /end MEASUREMENT
/begin MEASUREMENT TAMDve_y_BSWDiagPhasePerf "..." UBYTE I_1 1 2 0 255 ECU_ADDRESS 0x7000227A /end MEASUREMENT
/begin MEASUREMENT TAMDve_y_EC_MosStatus "..." UBYTE I_1 1 2 0 255 ECU_ADDRESS 0x700212A8 /end MEASUREMENT
/begin MEASUREMENT TAMDve_y_EC_Status "..." UBYTE I_1 1 2 0 255 ECU_ADDRESS 0x700212A9 /end MEASUREMENT
/begin MEASUREMENT TAMDve_y_EC_StuckStatus "..." UBYTE I_1 1 2 0 255 ECU_ADDRESS 0x70021240 /end MEASUREMENT
/begin MEASUREMENT TCAPve_e_DrivelineState "..." UBYTE I_1 1 2 0 255 ECU_ADDRESS 0x70020FEA /end MEASUREMENT
/begin MEASUREMENT TCFCve_Cnt_CCPM_CommandDBC "..." UBYTE I_1 1 2 0 255 ECU_ADDRESS 0x70020F6D /end MEASUREMENT
/begin MEASUREMENT TCFCve_I_CCPM "..." SWORD F_0v03125_p0_13 1 2 -1024 1023.96875 ECU_ADDRESS 0x70020FE8 /end MEASUREMENT
/begin MEASUREMENT TCFCve_I_CCPM_CompletePhase "..." SWORD F_0v03125_p0_13 1 2 -1024 1023.96875 ECU_ADDRESS 0x70020FE6 /end MEASUREMENT
/begin MEASUREMENT TCFCve_I_CCPM_IRV "..." SWORD F_0v03125_p0_13 1 2 -1024 1023.96875 ECU_ADDRESS 0x700210F2 /end MEASUREMENT
/begin MEASUREMENT TCFCve_Pct_CCPM_DC "..." SWORD F_0v1_p0_2 1 2 -3276.8 3276.7 ECU_ADDRESS 0x700022CE /end MEASUREMENT
/begin MEASUREMENT TCFCve_Pct_CCPM_DC_DBC "..." SWORD F_0v1_p0_2 1 2 -3276.8 3276.7 ECU_ADDRESS 0x70020F54 /end MEASUREMENT
/begin MEASUREMENT TCFCve_Pct_CCPM_DC_IRV "..." SWORD F_0v1_p0_2 1 2 -3276.8 3276.7 ECU_ADDRESS 0x700210F0 /end MEASUREMENT
/begin MEASUREMENT TCFCve_Pct_C_Pct_CCP_Data "..." SWORD F_0v1_p0_2 1 2 -3276.8 3276.7 ECU_ADDRESS 0x700212A6 /end MEASUREMENT
/begin MEASUREMENT TCFCve_b_CCPM_SpeedControllerActive "..." UBYTE I_1 1 2 0 255 ECU_ADDRESS 0x700210EE /end MEASUREMENT
/begin MEASUREMENT TCFCve_b_TargetSpeedActive_IRV "..." UBYTE I_1 1 2 0 255 ECU_ADDRESS 0x700210EF /end MEASUREMENT
/begin MEASUREMENT TCFCve_dV_C_dV_CCP_Data "..." SWORD F_0v0078125_p0_117 1 2 -256 255.9921875 ECU_ADDRESS 0x700212A4 /end MEASUREMENT
/begin MEASUREMENT TCFCve_dV_CoolingFlow "..." SWORD F_0v0078125_p0_117 1 2 -256 255.9921875 ECU_ADDRESS 0x70020FE4 /end MEASUREMENT
/begin MEASUREMENT TCFCve_dV_CoolingFlowDBC "..." SWORD F_0v0078125_p0_117 1 2 -256 255.9921875 ECU_ADDRESS 0x70020F58 /end MEASUREMENT
/begin MEASUREMENT TCFCve_dV_CoolingFlow_IRV "..." SWORD F_0v0078125_p0_117 1 2 -256 255.9921875 ECU_ADDRESS 0x700210EC /end MEASUREMENT
/begin MEASUREMENT TCFCve_e_CCP_DID_Enabled "..." UBYTE I_1 1 2 0 255 ECU_ADDRESS 0x700212A2 /end MEASUREMENT
/begin MEASUREMENT TCFCve_e_NegativeResponseCode_IRV "..." UBYTE I_1 1 2 0 255 ECU_ADDRESS 0x700210EA /end MEASUREMENT
/begin MEASUREMENT TCFCve_n_CCPM_CurrentSpeedLimit "..." SWORD F_1_p0_4 1 2 -32768 32767 ECU_ADDRESS 0x700210E8 /end MEASUREMENT
/begin MEASUREMENT TCFCve_n_CCPM_IRV "..." SWORD F_1_p0_4 1 2 -32768 32767 ECU_ADDRESS 0x700210E6 /end MEASUREMENT
/begin MEASUREMENT TCFCve_n_CCPM_SpeedControllerTarget "..." SWORD F_1_p0_4 1 2 -32768 32767 ECU_ADDRESS 0x70020FE2 /end MEASUREMENT
/begin MEASUREMENT TCFCve_n_CCPM_SpeedControllerTarget_IRV "..." SWORD F_1_p0_4 1 2 -32768 32767 ECU_ADDRESS 0x700210E4 /end MEASUREMENT
/begin MEASUREMENT TCFCve_n_CCPM_SpeedTgtDBC "..." SWORD F_1_p0_4 1 2 -32768 32767 ECU_ADDRESS 0x70020F56 /end MEASUREMENT
/begin MEASUREMENT TCFCve_n_C_n_CCP_Data "..." SWORD F_1_p0_4 1 2 -32768 32767 ECU_ADDRESS 0x700212A0 /end MEASUREMENT
/begin MEASUREMENT TCFCve_r_CCP_Y "..." UWORD F_0v0000305176_p0_19 1 2 0 1.999969482 ECU_ADDRESS 0x700022A8 /end MEASUREMENT
/begin MEASUREMENT TCFRve_I_CAP_PhaseCurrentLimitation "..." SWORD F_0v03125_p0_13 1 2 -1024 1023.96875 ECU_ADDRESS 0x70020FE0 /end MEASUREMENT
/begin MEASUREMENT TCFRve_I_CurrentAvailableForClutch "..." SWORD F_0v03125_p0_13 1 2 -1024 1023.96875 ECU_ADDRESS 0x70020FDE /end MEASUREMENT
/begin MEASUREMENT TCFRve_Pct_FanRequest "..." SWORD F_1_p0_4 1 2 -32768 32767 ECU_ADDRESS 0x70020FDC /end MEASUREMENT
/begin MEASUREMENT TCFRve_b_AfterRunRequest "..." UBYTE I_1 1 2 0 255 ECU_ADDRESS 0x70020FDA /end MEASUREMENT
/begin MEASUREMENT TCFRve_b_AtMinLubrication_IRV "..." UBYTE I_1 1 2 0 255 ECU_ADDRESS 0x700210E3 /end MEASUREMENT
/begin MEASUREMENT TCFRve_b_ClutchAvailable "..." UBYTE Bool_ON_OFF 1 2 0 1 BIT_MASK 0x01 ECU_ADDRESS 0x70020FD9 /end MEASUREMENT
/begin MEASUREMENT TCFRve_b_CoolingNeedPreventsCoolingIOC "..." UBYTE I_1 1 2 0 255 ECU_ADDRESS 0x70020FD8 /end MEASUREMENT
/begin MEASUREMENT TCFRve_b_TooCloseToOverCurrent "..." UBYTE I_1 1 2 0 255 ECU_ADDRESS 0x700210E2 /end MEASUREMENT
/begin MEASUREMENT TCFRve_dV_CCP_OvercurrentLimitation "..." SWORD F_0v0078125_p0_117 1 2 -256 255.9921875 ECU_ADDRESS 0x700210E0 /end MEASUREMENT
/begin MEASUREMENT TCFRve_dV_CCP_UsedLimit "..." SWORD F_0v0078125_p0_117 1 2 -256 255.9921875 ECU_ADDRESS 0x700210DE /end MEASUREMENT
/begin MEASUREMENT TCFRve_dV_CoolingFlowCommand "..." SWORD F_0v0078125_p0_117 1 2 -256 255.9921875 ECU_ADDRESS 0x70020FD6 /end MEASUREMENT
/begin MEASUREMENT TCMDve_Cnt_RC_SpdDev_Diags "..." UWORD F_1_p0_4 1 2 0 65535 ECU_ADDRESS 0x7002129E /end MEASUREMENT
/begin MEASUREMENT TCMDve_Cnt_RC_SpdDev_Fails "..." UWORD F_1_p0_4 1 2 0 65535 ECU_ADDRESS 0x7002129C /end MEASUREMENT
/begin MEASUREMENT TCMDve_I_HWIO_MotorCurrent_IRV "..." SWORD F_0v03125_p0_13 1 2 -1024 1023.96875 ECU_ADDRESS 0x700210DC /end MEASUREMENT
/begin MEASUREMENT TCMDve_Pct_HWIO_MotorActPWM_IRV "..." SWORD F_1_p0_4 1 2 -32768 32767 ECU_ADDRESS 0x700210DA /end MEASUREMENT
/begin MEASUREMENT TCMDve_T_CoolingActPwrStg "..." SWORD F_0v0625_p0_14 1 2 -2048 2047.9375 ECU_ADDRESS 0x70020FD4 /end MEASUREMENT
/begin MEASUREMENT TCMDve_b_NewCycle "..." UBYTE Bool_ON_OFF 1 2 0 1 BIT_MASK 0x01 ECU_ADDRESS 0x7002129B /end MEASUREMENT
/begin MEASUREMENT TCMDve_b_StuckNewCycle "..." UBYTE Bool_ON_OFF 1 2 0 1 BIT_MASK 0x01 ECU_ADDRESS 0x7002123E /end MEASUREMENT
/begin MEASUREMENT TCMDve_e_CoolingActPwrStgTempVld "..." UBYTE I_1 1 2 0 255 ECU_ADDRESS 0x700211A8 /end MEASUREMENT
/begin MEASUREMENT TCMDve_e_CoolingActSpdDevVld "..." UBYTE I_1 1 2 0 255 ECU_ADDRESS 0x70020FBA /end MEASUREMENT
/begin MEASUREMENT TCMDve_e_CoolingActuatorVld "..." UBYTE I_1 1 2 0 255 ECU_ADDRESS 0x70020FB9 /end MEASUREMENT
/begin MEASUREMENT TCMDve_e_MosfetVld "..." UBYTE I_1 1 2 0 255 ECU_ADDRESS 0x70020FB8 /end MEASUREMENT
/begin MEASUREMENT TCMDve_e_StuckVld "..." UBYTE I_1 1 2 0 255 ECU_ADDRESS 0x70020F61 /end MEASUREMENT
/begin MEASUREMENT TCMDve_n_HWIO_MotorRotSpd_IRV "..." SWORD F_1_p0_4 1 2 -32768 32767 ECU_ADDRESS 0x700210D8 /end MEASUREMENT
/begin MEASUREMENT TCMDve_n_MotorSpeed "..." SWORD F_1_p0_4 1 2 -32768 32767 ECU_ADDRESS 0x70020FD2 /end MEASUREMENT
/begin MEASUREMENT TCMDve_y_BSWDiagDrvOvrCur "..." UBYTE I_1 1 2 0 255 ECU_ADDRESS 0x70002402 /end MEASUREMENT
/begin MEASUREMENT TCMDve_y_BSWDiagDrvOvrTemp "..." UBYTE I_1 1 2 0 255 ECU_ADDRESS 0x70002401 /end MEASUREMENT
/begin MEASUREMENT TCMDve_y_BSWDiagDrvSupOvrVolt "..." UBYTE I_1 1 2 0 255 ECU_ADDRESS 0x70002400 /end MEASUREMENT
/begin MEASUREMENT TCMDve_y_BSWDiagHALFault "..." UBYTE I_1 1 2 0 255 ECU_ADDRESS 0x700023FF /end MEASUREMENT
/begin MEASUREMENT TCMDve_y_BSWDiagHALSupOvrVolt "..." UBYTE I_1 1 2 0 255 ECU_ADDRESS 0x700023FD /end MEASUREMENT
/begin MEASUREMENT TCMDve_y_BSWDiagHALSupUndrVolt "..." UBYTE I_1 1 2 0 255 ECU_ADDRESS 0x700023FC /end MEASUREMENT
/begin MEASUREMENT TCMDve_y_BSWDiagPhaseHigh "..." UBYTE I_1 1 2 0 255 ECU_ADDRESS 0x700023F4 /end MEASUREMENT
/begin MEASUREMENT TCMDve_y_BSWDiagPhaseLow "..." UBYTE I_1 1 2 0 255 ECU_ADDRESS 0x700023F3 /end MEASUREMENT
/begin MEASUREMENT TCMDve_y_BSWDiagPhasePerf "..." UBYTE I_1 1 2 0 255 ECU_ADDRESS 0x700023F2 /end MEASUREMENT
/begin MEASUREMENT TCMDve_y_EC_MosStatus "..." UBYTE I_1 1 2 0 255 ECU_ADDRESS 0x70021298 /end MEASUREMENT
/begin MEASUREMENT TCMDve_y_EC_Status "..." UBYTE I_1 1 2 0 255 ECU_ADDRESS 0x70021299 /end MEASUREMENT
/begin MEASUREMENT TCMDve_y_EC_StuckStatus "..." UBYTE I_1 1 2 0 255 ECU_ADDRESS 0x7002123F /end MEASUREMENT
/begin MEASUREMENT TCMDve_y_RC_SpdDev_Progress "..." UBYTE I_1 1 2 0 255 ECU_ADDRESS 0x70021297 /end MEASUREMENT
/begin MEASUREMENT TCMDve_y_RC_SpdDev_Status "..." UBYTE I_1 1 2 0 255 ECU_ADDRESS 0x70021296 /end MEASUREMENT
/begin MEASUREMENT TCMDve_y_Status "..." UBYTE I_1 1 2 0 255 ECU_ADDRESS 0x70020FD0 /end MEASUREMENT
/begin MEASUREMENT TCPDne_p_BiasComp "..." FLOAT32_IEEE I_1 1 2 -3.402823466E+038 3.402823466E+038 ECU_ADDRESS 0x70021140 /end MEASUREMENT
/begin MEASUREMENT TCPDve_Cnt_RC_Bias_Diags "..." UWORD F_1_p0_4 1 2 0 65535 ECU_ADDRESS 0x70021294 /end MEASUREMENT
/begin MEASUREMENT TCPDve_Cnt_RC_Bias_Fails "..." UWORD F_1_p0_4 1 2 0 65535 ECU_ADDRESS 0x70021292 /end MEASUREMENT
/begin MEASUREMENT TCPDve_Cnt_RC_HighClutchPres_Diags "..." UWORD F_1_p0_4 1 2 0 65535 ECU_ADDRESS 0x70021290 /end MEASUREMENT
/begin MEASUREMENT TCPDve_Cnt_RC_HighClutchPres_Fails "..." UWORD F_1_p0_4 1 2 0 65535 ECU_ADDRESS 0x7002128E /end MEASUREMENT
/begin MEASUREMENT TCPDve_Cnt_RC_LowClutchPres_Diags "..." UWORD F_1_p0_4 1 2 0 65535 ECU_ADDRESS 0x7002128C /end MEASUREMENT
/begin MEASUREMENT TCPDve_Cnt_RC_LowClutchPres_Fails "..." UWORD F_1_p0_4 1 2 0 65535 ECU_ADDRESS 0x7002128A /end MEASUREMENT
/begin MEASUREMENT TCPDve_Cnt_RC_MaxPres_Diags "..." UWORD F_1_p0_4 1 2 0 65535 ECU_ADDRESS 0x70021288 /end MEASUREMENT
/begin MEASUREMENT TCPDve_Cnt_RC_MaxPres_Fails "..." UWORD F_1_p0_4 1 2 0 65535 ECU_ADDRESS 0x70021286 /end MEASUREMENT
/begin MEASUREMENT TCPDve_U_ClutchPressureRaw "..." SWORD F_1_p0_4 1 2 -32768 32767 ECU_ADDRESS 0x70002468 /end MEASUREMENT
/begin MEASUREMENT TCPDve_U_ClutchPressureVoltage "..." SWORD F_1_p0_4 1 2 -32768 32767 ECU_ADDRESS 0x70002466 /end MEASUREMENT
/begin MEASUREMENT TCPDve_b_ClearBiasComp "..." UBYTE Bool_ON_OFF 1 2 0 1 BIT_MASK 0x01 ECU_ADDRESS 0x70021284 /end MEASUREMENT
/begin MEASUREMENT TCPDve_e_ClutchPressureHighVld "..." UBYTE I_1 1 2 0 255 ECU_ADDRESS 0x70020FCF /end MEASUREMENT
/begin MEASUREMENT TCPDve_e_ClutchPressureLowVld "..." UBYTE I_1 1 2 0 255 ECU_ADDRESS 0x70020FCE /end MEASUREMENT
/begin MEASUREMENT TCPDve_e_ClutchPressureSensPerfVld "..." UBYTE I_1 1 2 0 255 ECU_ADDRESS 0x70020FCD /end MEASUREMENT
/begin MEASUREMENT TCPDve_e_ClutchPressureSensorVld "..." UBYTE I_1 1 2 0 255 ECU_ADDRESS 0x70020FCC /end MEASUREMENT
/begin MEASUREMENT TCPDve_p_AveragePresAtStart "..." FLOAT32_IEEE I_1 1 2 -3.402823466E+038 3.402823466E+038 ECU_ADDRESS 0x70021280 /end MEASUREMENT
/begin MEASUREMENT TCPDve_p_BiasComp_IRV "..." FLOAT32_IEEE I_1 1 2 -3.402823466E+038 3.402823466E+038 ECU_ADDRESS 0x700210D4 /end MEASUREMENT
/begin MEASUREMENT TCPDve_p_ClutchPressure "..." UWORD F_0v03125_p0_13 1 2 0 2047.96875 ECU_ADDRESS 0x70020FCA /end MEASUREMENT
/begin MEASUREMENT TCPDve_y_BSWDiagHigh "..." UBYTE I_1 1 2 0 255 ECU_ADDRESS 0x70002435 /end MEASUREMENT
/begin MEASUREMENT TCPDve_y_BSWDiagLow "..." UBYTE I_1 1 2 0 255 ECU_ADDRESS 0x70002434 /end MEASUREMENT
/begin MEASUREMENT TCPDve_y_EC_Status "..." UBYTE I_1 1 2 0 255 ECU_ADDRESS 0x7002127E /end MEASUREMENT
/begin MEASUREMENT TCPDve_y_RC_Bias_Progress "..." UBYTE I_1 1 2 0 255 ECU_ADDRESS 0x7002127D /end MEASUREMENT
/begin MEASUREMENT TCPDve_y_RC_Bias_Status "..." UBYTE I_1 1 2 0 255 ECU_ADDRESS 0x7002127C /end MEASUREMENT
/begin MEASUREMENT TCPDve_y_RC_HighClutchPres_Progress "..." UBYTE I_1 1 2 0 255 ECU_ADDRESS 0x7002127B /end MEASUREMENT
/begin MEASUREMENT TCPDve_y_RC_HighClutchPres_Status "..." UBYTE I_1 1 2 0 255 ECU_ADDRESS 0x7002127A /end MEASUREMENT
/begin MEASUREMENT TCPDve_y_RC_LowClutchPres_Progress "..." UBYTE I_1 1 2 0 255 ECU_ADDRESS 0x70021279 /end MEASUREMENT
/begin MEASUREMENT TCPDve_y_RC_LowClutchPres_Status "..." UBYTE I_1 1 2 0 255 ECU_ADDRESS 0x70021278 /end MEASUREMENT
/begin MEASUREMENT TCPDve_y_RC_MaxPres_Progress "..." UBYTE I_1 1 2 0 255 ECU_ADDRESS 0x70021277 /end MEASUREMENT
/begin MEASUREMENT TCPDve_y_RC_MaxPres_Status "..." UBYTE I_1 1 2 0 255 ECU_ADDRESS 0x70021276 /end MEASUREMENT
/begin MEASUREMENT TCPDve_y_Status "..." UBYTE I_1 1 2 0 255 ECU_ADDRESS 0x70020FC8 /end MEASUREMENT
/begin MEASUREMENT TCU_AirFlowRequest "..." UBYTE F_0v5_p0_26 1 2 0 127.5 ECU_ADDRESS 0x70021176 /end MEASUREMENT
/begin MEASUREMENT TCU_ClutchAvailableMaximumTorque "..." UWORD F_0v125_m100_22 1 2 -100 8091.875 ECU_ADDRESS 0x70001C44 /end MEASUREMENT
/begin MEASUREMENT TCU_ClutchAvailableMinimumTorque "..." UWORD F_0v125_m100_22 1 2 -100 8091.875 ECU_ADDRESS 0x70001C42 /end MEASUREMENT
/begin MEASUREMENT TCU_ClutchCapacityAct "..." UWORD F_0v125_m100_22 1 2 -100 8091.875 ECU_ADDRESS 0x70001C3C /end MEASUREMENT
/begin MEASUREMENT TCU_Clutch_Status "..." UBYTE I_1 1 2 0 255 ECU_ADDRESS 0x70021162 /end MEASUREMENT
/begin MEASUREMENT TCU_CrankingAuthorizationEnable "..." UBYTE I_1 1 2 0 255 ECU_ADDRESS 0x7002115F /end MEASUREMENT
/begin MEASUREMENT TCU_FaultLamp_Req "..." UBYTE I_1 1 2 0 255 ECU_ADDRESS 0x70021155 /end MEASUREMENT
/begin MEASUREMENT TCU_Fault_Reaction_Req "..." UBYTE I_1 1 2 0 255 ECU_ADDRESS 0x70021154 /end MEASUREMENT
/begin MEASUREMENT TCU_GearEngagementAvailable "..." UBYTE I_1 1 2 0 255 ECU_ADDRESS 0x7002115D /end MEASUREMENT
/begin MEASUREMENT TCU_MaxFrtMotPwr_Req "..." UWORD F_0v1_m260_108 1 2 -260 6293.5 ECU_ADDRESS 0x70021188 /end MEASUREMENT
/begin MEASUREMENT TCU_MaxGCUPwr_Req "..." UWORD F_0v1_m150_118 1 2 -150 6403.5 ECU_ADDRESS 0x70021186 /end MEASUREMENT
/begin MEASUREMENT TCU_OBD_Lamp "..." UBYTE I_1 1 2 0 255 ECU_ADDRESS 0x70021156 /end MEASUREMENT
/begin MEASUREMENT TCU_TransmissionFluidTemp "..." UBYTE I_1 1 2 0 255 ECU_ADDRESS 0x70021157 /end MEASUREMENT
/begin MEASUREMENT TIRCve_M_ReqAtLashRtLim "..." SWORD F_0v03125_p0_13 1 2 -1024 1023.96875 ECU_ADDRESS 0x70020FC4 /end MEASUREMENT
/begin MEASUREMENT TIRCve_M_TransInputTorqueImmd "..." SWORD F_0v03125_p0_13 1 2 -1024 1023.96875 ECU_ADDRESS 0x70020FC6 /end MEASUREMENT
/begin MEASUREMENT TISCve_n_TargetIdleSpd "..." SWORD F_1_p0_4 1 2 -32768 32767 ECU_ADDRESS 0x70020FC2 /end MEASUREMENT
/begin MEASUREMENT TLMDve_Cnt_TransCtrlSysPerf_Diags "..." UWORD F_1_p0_4 1 2 0 65535 ECU_ADDRESS 0x70021274 /end MEASUREMENT
/begin MEASUREMENT TLMDve_Cnt_TransCtrlSysPerf_Fails "..." UWORD F_1_p0_4 1 2 0 65535 ECU_ADDRESS 0x70021272 /end MEASUREMENT
/begin MEASUREMENT TLMDve_b_PwrstgCrrntlShtOffByTLMD "..." UBYTE Bool_ON_OFF 1 2 0 1 BIT_MASK 0x01 ECU_ADDRESS 0x70021270 /end MEASUREMENT
/begin MEASUREMENT TLMDve_e_TransCtrlSysPerfVld "..." UBYTE I_1 1 2 0 255 ECU_ADDRESS 0x7002130E /end MEASUREMENT
/begin MEASUREMENT TLMDve_y_Status "..." UBYTE I_1 1 2 0 255 ECU_ADDRESS 0x700211A7 /end MEASUREMENT
/begin MEASUREMENT TLMDve_y_TransCtrlSysPerf_Progress "..." UBYTE I_1 1 2 0 255 ECU_ADDRESS 0x7002126F /end MEASUREMENT
/begin MEASUREMENT TLMDve_y_TransCtrlSysPerf_Status "..." UBYTE I_1 1 2 0 255 ECU_ADDRESS 0x7002126E /end MEASUREMENT
/begin MEASUREMENT TOTDve_Cnt_RC_High_Diags "..." UWORD F_1_p0_4 1 2 0 65535 ECU_ADDRESS 0x7002126C /end MEASUREMENT
/begin MEASUREMENT TOTDve_Cnt_RC_High_Fails "..." UWORD F_1_p0_4 1 2 0 65535 ECU_ADDRESS 0x7002126A /end MEASUREMENT
/begin MEASUREMENT TOTDve_Cnt_RC_Low_Diags "..." UWORD F_1_p0_4 1 2 0 65535 ECU_ADDRESS 0x70021268 /end MEASUREMENT
/begin MEASUREMENT TOTDve_Cnt_RC_Low_Fails "..." UWORD F_1_p0_4 1 2 0 65535 ECU_ADDRESS 0x70021266 /end MEASUREMENT
/begin MEASUREMENT TOTDve_Cnt_RC_OilT_CritDiags "..." UWORD F_1_p0_4 1 2 0 65535 ECU_ADDRESS 0x70021264 /end MEASUREMENT
/begin MEASUREMENT TOTDve_Cnt_RC_OilT_CritFails "..." UWORD F_1_p0_4 1 2 0 65535 ECU_ADDRESS 0x70021262 /end MEASUREMENT
/begin MEASUREMENT TOTDve_Cnt_RC_OilT_WarnDiags "..." UWORD F_1_p0_4 1 2 0 65535 ECU_ADDRESS 0x70021260 /end MEASUREMENT
/begin MEASUREMENT TOTDve_Cnt_RC_OilT_WarnFails "..." UWORD F_1_p0_4 1 2 0 65535 ECU_ADDRESS 0x7002125E /end MEASUREMENT
/begin MEASUREMENT TOTDve_T_OilTemperature "..." SWORD F_0v0625_p0_14 1 2 -2048 2047.9375 ECU_ADDRESS 0x70020FC0 /end MEASUREMENT
/begin MEASUREMENT TOTDve_T_OilTemperature_IRV "..." SWORD F_0v0625_p0_14 1 2 -2048 2047.9375 ECU_ADDRESS 0x700210CC /end MEASUREMENT
/begin MEASUREMENT TOTDve_b_RC_DltFailRst "..." UBYTE Bool_ON_OFF 1 2 0 1 BIT_MASK 0x01 ECU_ADDRESS 0x7002125C /end MEASUREMENT
/begin MEASUREMENT TOTDve_e_TransmissionOilTempCritVld "..." UBYTE I_1 1 2 0 255 ECU_ADDRESS 0x70020FBE /end MEASUREMENT
/begin MEASUREMENT TOTDve_e_TransmissionOilTempWarnVld "..." UBYTE I_1 1 2 0 255 ECU_ADDRESS 0x70020FBD /end MEASUREMENT
/begin MEASUREMENT TOTDve_e_TransmissionTempSensorVld "..." UBYTE I_1 1 2 0 255 ECU_ADDRESS 0x70020FBC /end MEASUREMENT
/begin MEASUREMENT TOTDve_y_RC_High_Progress "..." UBYTE I_1 1 2 0 255 ECU_ADDRESS 0x7002125B /end MEASUREMENT
/begin MEASUREMENT TOTDve_y_RC_High_Status "..." UBYTE I_1 1 2 0 255 ECU_ADDRESS 0x7002125A /end MEASUREMENT
/begin MEASUREMENT TOTDve_y_RC_Low_Progress "..." UBYTE I_1 1 2 0 255 ECU_ADDRESS 0x70021259 /end MEASUREMENT
/begin MEASUREMENT TOTDve_y_RC_Low_Status "..." UBYTE I_1 1 2 0 255 ECU_ADDRESS 0x70021258 /end MEASUREMENT
/begin MEASUREMENT TOTDve_y_RC_OilT_CritProgress "..." UBYTE I_1 1 2 0 255 ECU_ADDRESS 0x70021257 /end MEASUREMENT
/begin MEASUREMENT TOTDve_y_RC_OilT_CritStatus "..." UBYTE I_1 1 2 0 255 ECU_ADDRESS 0x70021256 /end MEASUREMENT
/begin MEASUREMENT TOTDve_y_RC_OilT_WarnProgress "..." UBYTE I_1 1 2 0 255 ECU_ADDRESS 0x70021255 /end MEASUREMENT
/begin MEASUREMENT TOTDve_y_RC_OilT_WarnStatus "..." UBYTE I_1 1 2 0 255 ECU_ADDRESS 0x70021254 /end MEASUREMENT
/begin MEASUREMENT TOTDve_y_Status "..." UBYTE I_1 1 2 0 255 ECU_ADDRESS 0x70020FBB /end MEASUREMENT
/begin MEASUREMENT TSPCve_n_EvenClthSpeed "..." SWORD F_1_p0_4 1 2 -32768 32767 ECU_ADDRESS 0x70020FB6 /end MEASUREMENT
/begin MEASUREMENT TSPCve_n_OddClthSpeed "..." SWORD F_1_p0_4 1 2 -32768 32767 ECU_ADDRESS 0x70020FB4 /end MEASUREMENT
/begin MEASUREMENT TSPCve_n_TransOutputSpeed "..." SWORD F_1_p0_4 1 2 -32768 32767 ECU_ADDRESS 0x70020FB2 /end MEASUREMENT
/begin MEASUREMENT TSPCve_n_TransP1ClutchInputSpeed "..." SWORD F_1_p0_4 1 2 -32768 32767 ECU_ADDRESS 0x70020FB0 /end MEASUREMENT
/begin MEASUREMENT TSSDve_Cnt_ClutchDragTrqTooHighFail "..." UBYTE I_1 1 2 0 255 ECU_ADDRESS 0x7002124E /end MEASUREMENT
/begin MEASUREMENT TSSDve_Cnt_RC_ClTrq_Diags "..." UWORD F_1_p0_4 1 2 0 65535 ECU_ADDRESS 0x70021252 /end MEASUREMENT
/begin MEASUREMENT TSSDve_Cnt_RC_ClTrq_Fails "..." UWORD F_1_p0_4 1 2 0 65535 ECU_ADDRESS 0x70021250 /end MEASUREMENT
/begin MEASUREMENT TSSDve_Cnt_RC_DrgTrq_Diags "..." UWORD F_1_p0_4 1 2 0 65535 ECU_ADDRESS 0x7002124C /end MEASUREMENT
/begin MEASUREMENT TSSDve_Cnt_RC_DrgTrq_Fails "..." UWORD F_1_p0_4 1 2 0 65535 ECU_ADDRESS 0x7002124A /end MEASUREMENT
/begin MEASUREMENT TSSDve_e_ClutchCapacityInsuffVld "..." UBYTE I_1 1 2 0 255 ECU_ADDRESS 0x70020FAF /end MEASUREMENT
/begin MEASUREMENT TSSDve_e_ClutchDragTrqTooHighVld "..." UBYTE I_1 1 2 0 255 ECU_ADDRESS 0x70020FAE /end MEASUREMENT
/begin MEASUREMENT TSSDve_t_RC_DrgTrq_ClOpenTimer "..." UWORD F_1_p0_4 1 2 0 65535 ECU_ADDRESS 0x70021248 /end MEASUREMENT
/begin MEASUREMENT TSSDve_t_RC_DrgTrq_ICEOffTimer "..." UWORD F_1_p0_4 1 2 0 65535 ECU_ADDRESS 0x70021246 /end MEASUREMENT
/begin MEASUREMENT TSSDve_y_RC_ClTrq_Progress "..." UBYTE I_1 1 2 0 255 ECU_ADDRESS 0x70021244 /end MEASUREMENT
/begin MEASUREMENT TSSDve_y_RC_ClTrq_Status "..." UBYTE I_1 1 2 0 255 ECU_ADDRESS 0x70021243 /end MEASUREMENT
/begin MEASUREMENT TSSDve_y_RC_DrgTrq_Progress "..." UBYTE I_1 1 2 0 255 ECU_ADDRESS 0x70021242 /end MEASUREMENT
/begin MEASUREMENT TSSDve_y_RC_DrgTrq_Status "..." UBYTE I_1 1 2 0 255 ECU_ADDRESS 0x70021241 /end MEASUREMENT
/begin MEASUREMENT TSSDve_y_Status "..." UBYTE I_1 1 2 0 255 ECU_ADDRESS 0x700211A6 /end MEASUREMENT
/begin MEASUREMENT TTSSve_M_P1MaxTrqImmd "..." SWORD F_0v03125_p0_13 1 2 -1024 1023.96875 ECU_ADDRESS 0x70021300 /end MEASUREMENT
/begin MEASUREMENT TTSSve_M_P1MinTrqImmd "..." SWORD F_0v03125_p0_13 1 2 -1024 1023.96875 ECU_ADDRESS 0x700212FE /end MEASUREMENT
/begin MEASUREMENT TTSSve_b_P1TrqLimReq "..." UBYTE I_1 1 2 0 255 ECU_ADDRESS 0x70021314 /end MEASUREMENT
/begin MEASUREMENT TTSSve_e_SpdCntrlReqMod "..." UBYTE I_1 1 2 0 255 ECU_ADDRESS 0x70021317 /end MEASUREMENT
/begin MEASUREMENT TTSSve_n_SpdCntrlTarget "..." SWORD F_1_p0_4 1 2 -32768 32767 ECU_ADDRESS 0x70020FAC /end MEASUREMENT
/begin MEASUREMENT Tbox3_CoolantTempValid "..." UBYTE I_1 1 2 0 255 ECU_ADDRESS 0x700210C1 /end MEASUREMENT
/begin MEASUREMENT V5RDve_e_EC_StatusRef1Vld "..." UBYTE I_1 1 2 0 255 ECU_ADDRESS 0x70020FA5 /end MEASUREMENT
/begin MEASUREMENT V5RDve_e_EC_StatusRef2Vld "..." UBYTE I_1 1 2 0 255 ECU_ADDRESS 0x70020FA4 /end MEASUREMENT
/begin MEASUREMENT V5RDve_e_EC_StatusRef3Vld "..." UBYTE I_1 1 2 0 255 ECU_ADDRESS 0x70020FA3 /end MEASUREMENT
/begin MEASUREMENT VCU_Fault "..." UBYTE I_1 1 2 0 255 ECU_ADDRESS 0x70020F9F /end MEASUREMENT
/begin MEASUREMENT VECU_EngRunningStatusExpanded "..." UBYTE I_1 1 2 0 255 ECU_ADDRESS 0x70020F8C /end MEASUREMENT
/begin MEASUREMENT VECU_IUP_RATE_GEN_DEN "..." UBYTE I_1 1 2 0 255 ECU_ADDRESS 0x70020F87 /end MEASUREMENT
/begin MEASUREMENT VECU_IUP_RATE_GEN_INH "..." UBYTE I_1 1 2 0 255 ECU_ADDRESS 0x70020F86 /end MEASUREMENT
/begin MEASUREMENT VODOve_l_TotalOdometer "..." ULONG I_1 1 2 0 4294967295 ECU_ADDRESS 0x70020F80 /end MEASUREMENT
/begin MEASUREMENT VSPEve_v_DrvnWhlsSpd "..." SWORD F_0v015625_p0_17 1 2 -512 511.984375 ECU_ADDRESS 0x70020F7C /end MEASUREMENT
/begin MEASUREMENT VSSDve_e_VehicleSpeedVld "..." UBYTE I_1 1 2 0 255 ECU_ADDRESS 0x70021010 /end MEASUREMENT
/begin MEASUREMENT VSSDve_v_VehicleSpeed "..." SWORD F_0v015625_p0_17 1 2 -512 511.984375 ECU_ADDRESS 0x70020F7A /end MEASUREMENT
/begin MEASUREMENT WSSDve_e_DrvnWhlSpdLeftVld "..." UBYTE I_1 1 2 0 255 ECU_ADDRESS 0x7002100F /end MEASUREMENT
/begin MEASUREMENT WSSDve_e_DrvnWhlSpdRightVld "..." UBYTE I_1 1 2 0 255 ECU_ADDRESS 0x7002100E /end MEASUREMENT
/begin MEASUREMENT WSSDve_e_NonDrvnWhlSpdLeftVld "..." UBYTE I_1 1 2 0 255 ECU_ADDRESS 0x7002100D /end MEASUREMENT
/begin MEASUREMENT WSSDve_e_NonDrvnWhlSpdRightVld "..." UBYTE I_1 1 2 0 255 ECU_ADDRESS 0x7002100C /end MEASUREMENT
/begin MEASUREMENT WSSDve_v_DrvnWhlSpdLeft "..." SWORD F_0v015625_p0_17 1 2 -512 511.984375 ECU_ADDRESS 0x70020F78 /end MEASUREMENT
/begin MEASUREMENT WSSDve_v_DrvnWhlSpdRight "..." SWORD F_0v015625_p0_17 1 2 -512 511.984375 ECU_ADDRESS 0x70020F76 /end MEASUREMENT
/begin MEASUREMENT WSSDve_v_NonDrvnWhlSpdLeft "..." SWORD F_0v015625_p0_17 1 2 -512 511.984375 ECU_ADDRESS 0x70020F74 /end MEASUREMENT
/begin MEASUREMENT WSSDve_v_NonDrvnWhlSpdRight "..." SWORD F_0v015625_p0_17 1 2 -512 511.984375 ECU_ADDRESS 0x70020F72 /end MEASUREMENT
/begin MEASUREMENT bcm_pepsPowerMode "..." UBYTE I_1 1 2 0 255 ECU_ADDRESS 0x700210B8 /end MEASUREMENT
/begin MEASUREMENT ebs_U_BATT "..." UWORD F_0v0009765625_p0_79 1 2 0 63.99902344 ECU_ADDRESS 0x70020F8E /end MEASUREMENT
/begin MEASUREMENT ic_totalMileage "..." ULONG I_1 1 2 0 4294967295 ECU_ADDRESS 0x70021150 /end MEASUREMENT
/begin MEASUREMENT ivi_timeInfoDay "..." UBYTE I_1 1 2 0 255 ECU_ADDRESS 0x700210C7 /end MEASUREMENT
/begin MEASUREMENT ivi_timeInfoHour "..." UBYTE I_1 1 2 0 255 ECU_ADDRESS 0x700210C6 /end MEASUREMENT
/begin MEASUREMENT ivi_timeInfoMinute "..." UBYTE I_1 1 2 0 255 ECU_ADDRESS 0x700210C5 /end MEASUREMENT
/begin MEASUREMENT ivi_timeInfoMonth "..." UBYTE I_1 1 2 0 255 ECU_ADDRESS 0x700210C4 /end MEASUREMENT
/begin MEASUREMENT ivi_timeInfoSecond "..." UBYTE I_1 1 2 0 255 ECU_ADDRESS 0x700210C3 /end MEASUREMENT
/begin MEASUREMENT ivi_timeInfoYear "..." UBYTE F_1_p2000_119 1 2 2000 2255 ECU_ADDRESS 0x700210C2 /end MEASUREMENT
/begin COMPU_METHOD I_1 "" RAT_FUNC "%9.2" "-" COEFFS 0 1 0 0 0 1 /end COMPU_METHOD
/begin COMPU_METHOD F_0v1_p0_2 "" RAT_FUNC "%9.2" "-" COEFFS 0 1 0 0 0 0.1 /end COMPU_METHOD
/begin COMPU_METHOD I_3 "" RAT_FUNC "%9.2" "" COEFFS 0 1 0 0 0 1 /end COMPU_METHOD
/begin COMPU_METHOD F_1_p0_4 "" RAT_FUNC "%9.2" "-" COEFFS 0 1 0 0 0 1 /end COMPU_METHOD
/begin COMPU_METHOD F_0v03125_p0_13 "" RAT_FUNC "%9.2" "-" COEFFS 0 1 0 0 0 0.03125 /end COMPU_METHOD
/begin COMPU_METHOD F_0v0625_p0_14 "" RAT_FUNC "%9.2" "-" COEFFS 0 1 0 0 0 0.0625 /end COMPU_METHOD
/begin COMPU_METHOD F_0v00390625_p0_16 "" RAT_FUNC "%9.3" "-" COEFFS 0 1 0 0 0 0.00390625 /end COMPU_METHOD
/begin COMPU_METHOD F_0v015625_p0_17 "" RAT_FUNC "%9.2" "-" COEFFS 0 1 0 0 0 0.015625 /end COMPU_METHOD
/begin COMPU_METHOD F_0v0000305176_p0_19 "" RAT_FUNC "%9.5" "-" COEFFS 0 1 0 0 0 3.05176e-005 /end COMPU_METHOD
/begin COMPU_METHOD F_0v01_p0_20 "" RAT_FUNC "%9.2" "-" COEFFS 0 1 0 0 0 0.01 /end COMPU_METHOD
/begin COMPU_METHOD F_0v125_m100_22 "" RAT_FUNC "%9.2" "-" COEFFS 0 1 100 0 0 0.125 /end COMPU_METHOD
/begin COMPU_METHOD F_0v1_m350_23 "" RAT_FUNC "%9.2" "-" COEFFS 0 1 350 0 0 0.1 /end COMPU_METHOD
/begin COMPU_METHOD F_0v125_p0_24 "" RAT_FUNC "%9.2" "-" COEFFS 0 1 0 0 0 0.125 /end COMPU_METHOD
/begin COMPU_METHOD F_0v25_p0_25 "" RAT_FUNC "%9.2" "-" COEFFS 0 1 0 0 0 0.25 /end COMPU_METHOD
/begin COMPU_METHOD F_0v5_p0_26 "" RAT_FUNC "%9.2" "-" COEFFS 0 1 0 0 0 0.5 /end COMPU_METHOD
/begin COMPU_METHOD F_1_m40_27 "" RAT_FUNC "%9.2" "-" COEFFS 0 1 40 0 0 1 /end COMPU_METHOD
/begin COMPU_METHOD F_5_p0_28 "" RAT_FUNC "%9.2" "ms" COEFFS 0 1 0 0 0 5 /end COMPU_METHOD
/begin COMPU_METHOD F_0v01_m327v68_30 "" RAT_FUNC "%9.2" "-" COEFFS 0 1 327.68 0 0 0.01 /end COMPU_METHOD
/begin COMPU_METHOD F_1_m32768_31 "" RAT_FUNC "%9.2" "-" COEFFS 0 1 32768 0 0 1 /end COMPU_METHOD
/begin COMPU_METHOD F_0v1_m3276v8_32 "" RAT_FUNC "%9.2" "-" COEFFS 0 1 3276.8 0 0 0.1 /end COMPU_METHOD
/begin COMPU_METHOD F_1_m20000_33 "" RAT_FUNC "%9.2" "-" COEFFS 0 1 20000 0 0 1 /end COMPU_METHOD
/begin COMPU_METHOD F_0v1_m310_78 "" RAT_FUNC "%9.2" "-" COEFFS 0 1 310 0 0 0.1 /end COMPU_METHOD
/begin COMPU_METHOD F_0v0009765625_p0_79 "" RAT_FUNC "%9.4" "-" COEFFS 0 1 0 0 0 0.000976563 /end COMPU_METHOD
/begin COMPU_METHOD F_0v05625_p0_85 "" RAT_FUNC "%9.2" "-" COEFFS 0 1 0 0 0 0.05625 /end COMPU_METHOD
/begin COMPU_METHOD F_0v007813_p0_86 "" RAT_FUNC "%9.3" "-" COEFFS 0 1 0 0 0 0.007813 /end COMPU_METHOD
/begin COMPU_METHOD F_0v001_p0_100 "" RAT_FUNC "%9.3" "-" COEFFS 0 1 0 0 0 0.001 /end COMPU_METHOD
/begin COMPU_METHOD F_0v1_m450_107 "" RAT_FUNC "%9.2" "-" COEFFS 0 1 450 0 0 0.1 /end COMPU_METHOD
/begin COMPU_METHOD F_0v1_m260_108 "" RAT_FUNC "%9.2" "-" COEFFS 0 1 260 0 0 0.1 /end COMPU_METHOD
/begin COMPU_METHOD F_0v05_p0_109 "" RAT_FUNC "%9.2" "-" COEFFS 0 1 0 0 0 0.05 /end COMPU_METHOD
/begin COMPU_METHOD I_111 "" RAT_FUNC "%9.2" "uint16" COEFFS 0 1 0 0 0 1 /end COMPU_METHOD
/begin COMPU_METHOD F_1_p0_115 "" RAT_FUNC "%9.2" "kW" COEFFS 0 1 0 0 0 1 /end COMPU_METHOD
/begin COMPU_METHOD F_0v001953125_p0_116 "" RAT_FUNC "%9.3" "-" COEFFS 0 1 0 0 0 0.00195313 /end COMPU_METHOD
/begin COMPU_METHOD F_0v0078125_p0_117 "" RAT_FUNC "%9.3" "-" COEFFS 0 1 0 0 0 0.0078125 /end COMPU_METHOD
/begin COMPU_METHOD F_0v1_m150_118 "" RAT_FUNC "%9.2" "-" COEFFS 0 1 150 0 0 0.1 /end COMPU_METHOD
/begin COMPU_METHOD F_1_p2000_119 "" RAT_FUNC "%9.2" "-" COEFFS 0 1 -2000 0 0 1 /end COMPU_METHOD
/begin COMPU_METHOD Bool_ON_OFF "" TAB_VERB "%8.4" "." COMPU_TAB_REF Bool_ON_OFF_table /end COMPU_METHOD
/begin COMPU_VTAB Bool_ON_OFF_table "" TAB_VERB 2 0 "OFF" 1 "ON" /end COMPU_VTAB
/begin FUNCTION RTE ""
 /begin OUT_MEASUREMENT APSSve_Pct_AccPedPos bcm_pepsPowerMode BPPDve_b_BrakeSwitchActive CACEve_b_IgnitionOn CANDve_b_ATFailure CANDve_Cnt_DiagCounts CANDve_Cnt_DiagFails CANDve_e_VCU_InvalidDataVld CANDve_y_HTCU_Fault CANDve_y_HTCU_State CANDve_y_ID_Status CANDve_y_Progress CANDve_y_Status CANDve_y_VCUFAULT_DiagCounts CANDve_y_VCUFAULT_DiagFails CANDve_y_VCUFAULT_Progress CANDve_y_VCUFAULT_Status CANEve_b_ProdTestModeActive CANEve_y_BSWDiagBcmCANFault CANEve_y_BSWDiagEmsCANFault CANEve_y_BSWDiagGcuCANFault CANEve_y_BSWDiagIpbCANFault CANEve_y_BSWDiagIviCANFault CANEve_y_BSWDiagPdcmCANFault CANEve_y_BSWDiagTboxCANFault CCAPve_e_ClutchState CCAPve_M_EstClchTrnsfTrq CCAPve_M_InstantaneousCapabilityOdd CCAPve_M_OddClutchMaxTransferTorque CCAPve_p_ReturnSpringEven CCAPve_p_ReturnSpringOdd CCAPve_T_EvenClutchTemp CCAPve_T_OddClutchTemp CLCOve_b_EvenClutchOpenReq CLCOve_b_OddClutchOpenReq CLCOve_b_OddClutchSlipDetected CLCOve_e_EvenActualClutchState CLCOve_e_EvenClutchProgress CLCOve_e_OddActualClutchState CLCOve_e_OddClutchProgress CLCOve_M_CurrentTorqueMargin CLCOve_M_EvenDesiredClutchTrq CLCOve_M_OddDesiredClutchTrq CLPCve_b_AdaptionFinished CLPCve_b_AdaptKissPointActive CLPCve_b_CAP_TooCloseToOverCurrent CLPCve_b_CAPM_DC_SaturatedHigh_IRV CLPCve_b_CAPM_DC_SaturatedLow_IRV CLPCve_b_ClutchControlActive CLPCve_b_DisableCAP CLPCve_b_DisengageComplete CLPCve_b_InGearComplete CLPCve_b_KneePoint_FirstDone CLPCve_b_NewKissPointAdaptionPointFound CLPCve_b_PrepareComplete CLPCve_b_SpeedControllerActive_IRV CLPCve_Cf_PressureToTorqueEven CLPCve_Cf_PressureToTorqueOdd CLPCve_Cnt_CAPM_CommandDBC CLPCve_DC_CAPM_SpeedControllerPressureCompensation_IRV CLPCve_e_CAP_DID_Enabled CLPCve_e_CAP_DID_EnabledIndication CLPCve_e_NegativeResponseCode_IRV CLPCve_I_CAP_ReducedMaxCurrent CLPCve_I_CAPM CLPCve_I_CAPM_CompletePhase CLPCve_I_CAPM_IRV CLPCve_n_C_n_CAP_Data CLPCve_n_CAPM_IRV CLPCve_n_CAPM_Overrequest_IRV CLPCve_n_CAPM_SpeedTgtDBC CLPCve_p_C_p_CAP_Data CLPCve_P_CAPM_IRV CLPCve_p_CAPM_PressTgtDBC CLPCve_p_ClutchPresReq CLPCve_p_ClutchTarget CLPCve_p_EvenClutchPresReq CLPCve_p_KissPoint CLPCve_p_KneePoint_Stored CLPCve_p_LastEstimatedKisspoint_IRV CLPCve_p_OddClutchPresReq CLPCve_p_OddMaxAllowedClutchOilPress CLPCve_p_PressureKneePoint CLPCve_Pct_C_Pct_CAP_Data CLPCve_Pct_CAPM_DC CLPCve_Pct_CAPM_DC_DBC CLPCve_Pct_CAPM_DC_IRV CLPCve_Pct_CAPMPS_DC_Actual CLPCve_r_CAP_Y CLPCve_r_CAP_Y_IRV Core0_Asw100msStartTime Core0_Asw100msStopTime Core0_Asw100msTotalTime Core0_Asw10msStartTime Core0_Asw10msStopTime Core0_Asw10msTotalTime Core0_Bsw100msStartTime Core0_Bsw100msStopTime Core0_Bsw100msTotalTime Core0_Bsw10msStartTime Core0_Bsw10msStopTime Core0_Bsw10msTotalTime Core0_Bsw1msStartTime Core0_Bsw1msStopTime Core0_Bsw1msTotalTime Core0_Bsw50msStartTime Core0_Bsw50msStopTime Core0_Bsw50msTotalTime Core1_Asw10msStartTime Core1_Asw10msStopTime Core1_Asw10msTotalTime Core1_Asw1msStartTime Core1_Asw1msStopTime Core1_Asw1msTotalTime Core1_Bsw10msStartTime Core1_Bsw10msStopTime Core1_Bsw10msTotalTime Core2_Asw10msStartTime Core2_Asw10msStopTime Core2_Asw10msTotalTime Core2_Asw1msStartTime Core2_Asw1msStopTime Core2_Asw1msTotalTime Core2_Bsw10msStartTime Core2_Bsw10msStopTime Core2_Bsw10msTotalTime CWTDve_e_EngineCoolantVld CWTDve_T_EngineCoolant DGPSve_n_LaunchTargetSpeed DPSCve_e_VehicleActState DRSPve_e_RangeSelPos ebs_U_BATT EMS_EngActualFlwTorque EMS_EngFlywh EMS_EngRunningStatus EMS_EngSpd EMS_EngSpdValid EOL1_CCP_control_DC EOL1_CCP_control_Enable EOL1_CCP_control_flow EOL1_CCP_control_speed EOL2_CAP_control_DC EOL2_CAP_control_Enable EOL2_CAP_control_pres EOL2_CAP_control_speed EOL3_CAP_current EOL3_CAP_DC EOL3_CAP_speed EOL4_CCP_current EOL4_CCP_DC EOL4_CCP_flow EOL4_CCP_speed EOL5_clutch_pressure EOL5_clutch_targetpressure EOL5_oil_temp EP_Tbox3_CoolantTemp EP_Tbox3_CoolantTempValid EP_Tbox3_WarmUpCycle EPOSve_d2n_EngSpdAccel EPOSve_dn_EngSpdChangeRate EPOSve_e_EngSpdValidity EPOSve_n_EngSpd FDMAve_b_AcceleratorStuckErrExt FDMAve_b_ForceAC_CompressorCpbyPrioHigh FDMAve_b_ForceAC_CompressorToOff FDMAve_b_ForceAC_LoadCompensationToOff FDMAve_b_ForceActiveDischarge FDMAve_b_ForceAirEstimationByMAP_SensorToOff FDMAve_b_ForceAntiJerkControlOff FDMAve_b_ForceBackupPowerModeToActive FDMAve_b_ForceBoostPressureControlToLowPressure FDMAve_b_ForceBoostPressureControlToLowPressureIRV FDMAve_b_ForceBoostTorqueOff FDMAve_b_ForceBrakeRegenerationTorqueOff FDMAve_b_ForceCamPositionToParked FDMAve_b_ForceCamPositionToParkedIRV FDMAve_b_ForceCCPCancleSpdLimit FDMAve_b_ForceClutchOddOpen FDMAve_b_ForceCoastRegenerationTorqueOff FDMAve_b_ForceContactorsOpen FDMAve_b_ForceCreepControlToOff FDMAve_b_ForceCruiseControlToOff FDMAve_b_ForceDCDC_BuckConversionOff FDMAve_b_ForceDCDC_ControlToDefault FDMAve_b_ForceEGR_ControlToOff FDMAve_b_ForceElectricLoadCompensationToOff FDMAve_b_ForceElectricThermostatControlToLowTemp FDMAve_b_ForceElectricThermostatToOff FDMAve_b_ForceElectricVacuumPumpOff FDMAve_b_ForceElectricVacuumPumpPulseMode FDMAve_b_ForceEngCoolantTempToEstimationModel FDMAve_b_ForceEngineRunning FDMAve_b_ForceEngineStop FDMAve_b_ForceEngineStopIRV FDMAve_b_ForceEngineTorqueFillOff FDMAve_b_ForceEngineTorqueReductionToMedium FDMAve_b_ForceEngineTorqueReductionToMediumIRV FDMAve_b_ForceEngTransientLimOff FDMAve_b_ForceFrntO2SnsrBnk1ToPrtctnMd FDMAve_b_ForceFuelControlToOpenLoop FDMAve_b_ForceFuelPressureActivationToOff FDMAve_b_ForceFuelPressureActivationToOffIRV FDMAve_b_ForceFuelRailPressureFeedbackExclusion FDMAve_b_ForceFuelRailPressureFeedbackExclusionIRV FDMAve_b_ForceGCUTrqToExclFromTransClutchPresTarget FDMAve_b_ForceGearRecommendationToOff FDMAve_b_ForceHiPressFuelPumpEnblToDisable FDMAve_b_ForceHiPressFuelPumpEnblToDisableIRV FDMAve_b_ForceHVAC_ElectricHeaterOff FDMAve_b_ForceHVBattSOC_ControlOff FDMAve_b_ForceIdleControlToElevatedMode FDMAve_b_ForceIgnitionToLowOctane FDMAve_b_ForceIgnitionToOff FDMAve_b_ForceIgnitionToOffIRV FDMAve_b_ForceIntelligentGeneratorControlToDefault FDMAve_b_ForceLftDrvnWhlSpdInfoExclusion FDMAve_b_ForceLftNnDrvnWhlSpdInfoExclusion FDMAve_b_ForceLongTermAdaptionToOff FDMAve_b_ForceNeutralGear FDMAve_b_ForceP1ElectricMotorToNeutral FDMAve_b_ForceP1ElectricTorqueReserveOff FDMAve_b_ForceP3MtrSpdInfoExclusion FDMAve_b_ForcePF_ActiveRegenOff FDMAve_b_ForcePF_PrssrSnsrAdptnOff FDMAve_b_ForcePF_PrssrSnsrBasedSootEstOff FDMAve_b_ForcePowerModeLock FDMAve_b_ForcePowerSteeringCompensationToOff FDMAve_b_ForcePropModeCalcToExcludeVehSpd FDMAve_b_ForcePropulsionAllowedToNotAllowed FDMAve_b_ForcePurgeControlToOff FDMAve_b_ForceRearO2SensorFuelControlToOff FDMAve_b_ForceRghtDrvnWhlSpdInfoExclusion FDMAve_b_ForceRghtNnDrvnWhlSpdInfoExclusion FDMAve_b_ForceTCU_CreepTorqueControlToOff FDMAve_b_ForceThrottleMassAirFlowToDefaultAir FDMAve_b_ForceThrottleMassAirFlowToDefaultAirIRV FDMAve_b_ForceTransIOCControlToOff FDMAve_b_ForceTransOilCoolingToSafeCoolingMode FDMAve_b_ForceTransOilLubricationToSafeLubricationMode FDMAve_b_ForceUnderHoodCoolingToHigh FDMAve_b_ForceVehicleSpeedInfoExclusion FDMAve_b_LimitHV_BattSOC_CntrlAuthorityToLow FDMAve_b_LockoutEngineStateChange FDMAve_b_LockoutPropulsionSystemStart FDMAve_b_LockoutPropulsionSystemStartIRV FDMAve_b_LockoutSpdDepCntctrAfterrun FDMAve_b_LockoutStopStartEngineStateChange FDMAve_b_SetAccPedPosToZero FDMAve_b_SetAccPedPosToZeroIRV FDMAve_b_SetAutoTransIdleSpdRqstToNoRqst FDMAve_b_SetAutoTransTorqueRequestToNoRequest FDMAve_b_SetDCDC_ActualLoadDefaultVal FDMAve_b_SetDriversRequestToZero FDMAve_b_SetDriversRequestToZeroIRV FDMAve_b_SetESP_TCS_TorqueRequestToNoRequest FDMAve_b_SetFuelMassToZeroCylinder1 FDMAve_b_SetFuelMassToZeroCylinder1IRV FDMAve_b_SetFuelMassToZeroCylinder2 FDMAve_b_SetFuelMassToZeroCylinder2IRV FDMAve_b_SetFuelMassToZeroCylinder3 FDMAve_b_SetFuelMassToZeroCylinder3IRV FDMAve_b_SetFuelMassToZeroCylinder4 FDMAve_b_SetFuelMassToZeroCylinder4IRV FDMAve_b_SetHVBattElectricPowerLimToHalf FDMAve_b_SetHVBattElectricPowerLimToHalfIRV FDMAve_b_SetICETrqCapToSafeVal FDMAve_b_SetICETrqCapToSafeValIRV FDMAve_b_SetLoTempCoolantCircuitPumpFlowHigh FDMAve_b_SetMAT_ToTempBeforeThrottle FDMAve_b_SetP1ElectricMotorCapabilityToZero FDMAve_b_SetP3ElectricMotorCapabilityToZero FDMAve_b_SetShftLvrPstnToLstKnwnVal FDMAve_b_SetShftLvrPstnToN FDMAve_b_SetShftLvrPstnToP FDMAve_Cnt_DID_NoOfInputsDrivingFA_TKO FDMAve_e_ETC_ControlMode FMCU24_CAP_current FMCU24_CAP_DC FMCU24_CAP_speed FMCU25_CCP_current FMCU25_CCP_DC FMCU25_CCP_speed FMCU26_clutch_pressure FMCU26_clutch_targetpressure FMCU26_oil_temp FMCU8_HTCUFault FMCU8_HTCULimphomeSts GCU_ActualTorque GCU_GeneratorSpd GCU_MotorTemp GERCve_e_ActualGear GERCve_r_TransP1SpdRatio GERCve_r_TransP3SpdRatio GSCHve_b_GearAvailable GSCHve_b_ShiftToSameClutch GSEQve_e_EvenClutchStateReq GSEQve_e_OddClutchStateReq GSEQve_e_ShiftType GSEQve_e_SpdCntrlTrgtCltch GW_IBCMIgnitionSt HBSCve_Pct_HVBattSOC HETEve_M_P1TotalActuatorDmn HTCU_ATFailure HTCU_CAP_DutyCycle HTCU_CCP_DutyCycle HTCU_CCPSpd HTCU_Clutch_Progress HTCU_ClutchActualTransferTorque HTCU_ObdCLRReq HTCU_P1_OverTempWarning HTCU_P3_OverTempWarning ic_totalMileage IPB_vehicleSpeed IPB_vehicleSpeedValid IPB_wheelSpeedFL IPB_wheelSpeedFLValid IPB_wheelSpeedFR IPB_wheelSpeedFRValid IPB_wheelSpeedRL IPB_wheelSpeedRLValid IPB_wheelSpeedRR IPB_wheelSpeedRRValid ivi_timeInfoDay ivi_timeInfoHour ivi_timeInfoMinute ivi_timeInfoMonth ivi_timeInfoSecond ivi_timeInfoYear LMSCve_dV_LubeFlow LSIDve_Cnt_PID_30_Server_Data_IRV LSIDve_NA_VIT_06_Server_Data_IRV MCUF_ActualTorque MCUF_MotorPower MCUF_MotorSpd MCUF_MotorTemp MILDve_e_MIL_RequestState MosSWOverCurrent PDCM_AccelPedal_Position PDCM_AccelPedal_Status PDCM_actualGear PDCM_BrakePedal_Status PDCM_ClutchCommand PDCM_ClutchCommandTransferTorque PDCM_Dcy_valid PDCM_DriveReady PDCM_DrivingCycle PDCM_OBD_DenoGeneral PDCM_OBD_DenoGenValid PDCM_OBD_FaultClrInhibit PDCM_OBD_PDTCClrSts PDCM_OBD_WarmCycleSts PDCM_SOC PORSve_d2n_P1SecondDerivative PORSve_dn_P1Derivative PORSve_e_P1RotationalSpeedVld PORSve_n_P1RotationalSpeed PORSve_n_P1RotationalSpeedUnsigned PWRMve_e_SysPwrMd Rte_b_IgnitionOn Rte_bClutchCapInsufficient Rte_bClutchDragTrqTooHigh Rte_bClutchPresAboveLim Rte_bClutchPresSensPerf Rte_bCoolingActSpdDev Rte_bHighClutchPressure Rte_bLowClutchPressure Rte_bTransCtrlSysPerf Rte_bTransOilTempCrit Rte_bTransOilTempWarn Rte_bUnreasonHighOilTemp Rte_bUnreasonLowOilTemp Rte_bVcuFault Rte_CAPStuckFlag Rte_CCPStuckFlag Rte_CUTDve_T_PCB_Temperature Rte_FACTee_NA_Kisspoint Rte_FACTee_NA_Kisspoint_Inv Rte_FACTee_NA_TransferGain Rte_FACTee_NA_TransferGain_Inv Rte_FACTve_NA_CalibrationLength Rte_FACTve_NA_CalibrationStart Rte_FbVar_SWCI7_globalMode_currentMode Rte_FbVar_SWCI7_mode0_currentMode Rte_HAMFve_b_CalMemChkSumReady Rte_HAMFve_Cnt_CalMemChkSum Rte_ModeCurrent_0 Rte_ModeCurrent_19 Rte_ModeCurrent_20 Rte_ModeCurrent_4 Rte_ModeStatus_4 Rte_Ms_ActvSession Rte_Ms_busbarCur Rte_Ms_busbarCurLoad Rte_Ms_ComCtlTyp Rte_Ms_data_RxSignal Rte_Ms_DisblMskbit Rte_Ms_DtcGrp Rte_Ms_ErrCode Rte_Ms_Fus_SafeExec_L2Pfc100ms Rte_Ms_Fus_SafeExec_L2Pfc10ms Rte_Ms_Fus_SafeExec_L2Pfc2p5ms Rte_Ms_Fus_SafeExec_L2Pfc5ms Rte_Ms_idx_RxAck Rte_Ms_idx_RxDlcErr Rte_Ms_idx_RxSignal Rte_Ms_idx_RxTOut Rte_Ms_idx_TxAck Rte_Ms_idx_TxMessage Rte_Ms_idx_TxTOut Rte_Ms_length_TxMessage Rte_Ms_motIdx Rte_Ms_Nrc Rte_Ms_OP_cyc_MotDuty Rte_Ms_OP_FI_IUMPR_GenDenInh Rte_Ms_OP_FI_IUMPR_PDTCClrCusPermission Rte_Ms_OP_Fl_DrvCycl Rte_Ms_OP_Fl_IgnCycl Rte_Ms_OP_Fl_IUMPR_GenDenInc Rte_Ms_OP_Fl_WrnUpCycl Rte_Ms_OP_Idx_Mot Rte_Ms_OP_Num_DayFrzFrm Rte_Ms_OP_Num_HourFrzFrm Rte_Ms_OP_Num_MinuteFrzFrm Rte_Ms_OP_Num_MonthFrzFrm Rte_Ms_OP_Num_SecsFrzFrm Rte_Ms_OP_Num_YearFrzFrm Rte_Ms_OP_s_ODOPrmrFrzFrm Rte_Ms_OP_St_MotSt Rte_Ms_OP_St_PwrModeFrzFrm Rte_Ms_OP_Temp_EngClntTempFrzFrm Rte_Ms_phaseCurLoad Rte_Ms_ReqSession Rte_Ms_Sid Rte_Ms_sumCurLoad Rte_Ms_TCU_Ct_PwrStgActPosInc Rte_Ms_TCU_cyc_PwrStgActPWM Rte_Ms_TCU_Fl_SysSycT15 Rte_Ms_TCU_I_MotAvrgCrnt Rte_Ms_TCU_I_MotMaxCrnt Rte_Ms_TCU_Idx_Mot Rte_Ms_TCU_n_MotRotSpd Rte_Ms_TCU_p_PresRaw Rte_Ms_TCU_St_5V1RawSt Rte_Ms_TCU_St_5V2RawSt Rte_Ms_TCU_St_5V3RawSt Rte_Ms_TCU_St_ACCRawSt Rte_Ms_TCU_st_ChipTemp Rte_Ms_TCU_St_IgnRawSt Rte_Ms_TCU_St_MotCrntSt Rte_Ms_TCU_St_MotSpdSt Rte_Ms_TCU_St_PresRawSt Rte_Ms_TCU_St_PwrStgMode Rte_Ms_TCU_St_PwrStgPosSt Rte_Ms_TCU_St_PwrStgSt Rte_Ms_TCU_St_PwrStgTempSt Rte_Ms_TCU_St_PwrTempWarnLvl Rte_Ms_TCU_St_T30HiRawSt Rte_Ms_TCU_St_T30LowRawSt Rte_Ms_TCU_t_ChipTemp Rte_Ms_TCU_Temp_PwrStgTemp Rte_Ms_TCU_U_5V1Raw Rte_Ms_TCU_U_5V2Raw Rte_Ms_TCU_U_5V3Raw Rte_Ms_TCU_U_ACCRaw Rte_Ms_TCU_U_IgnRaw Rte_Ms_TCU_u_PresRaw Rte_Ms_TCU_U_T30HiRaw Rte_Ms_TCU_U_T30LowRaw Rte_Ms_TCU_U_TempRaw Rte_RECount_Os_BswEnd_10ms_Task_divby1000_0 Rte_RECount_Os_BswEnd_10ms_Task_divby100_0 Rte_TCU_p_PresRaw Rte_TCU_st_PresRawSt Rte_TCU_u_OilTemp Rte_TCU_u_PresRaw Rte_V5RDve_U_VRef1RawValue Rte_V5RDve_U_VRef2RawValue Rte_V5RDve_U_VRef3RawValue Rte_V5RDve_y_EC_Ref1_Status Rte_V5RDve_y_EC_Ref2_Status Rte_V5RDve_y_EC_Ref3_Status SDADva_b_IUPR_GenDenStatus SDADva_b_IUPR_GenDenStatus[0] SDADva_b_IUPR_GenDenStatus[1] SPARve_l_WheelRadius SPARve_r_P1MtrRatio SPARve_r_P1Trans1stGearRatio SPARve_r_P1Trans1stGearRatio_IRV SPARve_r_P1Trans2ndGearRatio SPARve_r_P3TransDM_Ratio SPARve_r_P3TransDM_Ratio_IRV SPARve_r_TransFnlDrvRatio SSSCve_e_EngineStatus SWINve_b_DrivingCycle SWINve_b_FaultClrInhibit SWINve_b_PDTCClrSts SWINve_b_PropulsionActive SWINve_b_WarmUpCycleCompleted SWINve_e_Dcyvalid SWINve_e_GCU_COM_Validity SWINve_e_MCU_COM_Validity SWINve_e_MCU_P1_COM_Validity SWINve_e_MCU_P3_COM_Validity SWINve_e_P1MtrSpdVld SWINve_e_P1MtrTempVld SWINve_e_P1MtrTrqVld SWINve_e_P3MtrSpdVld SWINve_e_P3MtrTempVld SWINve_e_P3MtrTrqVld SWINve_e_VCU_COM_Validity SWINve_M_P1MtrTrq SWINve_M_P3MtrTrq SWINve_n_P1MtrSpd SWINve_n_P3MtrSpd SWINve_P_MotorPower SWINve_Pct_AccelPedalPosition SWINve_Pct_pepsPowerMode SWINve_r_P1TransInput SWINve_r_P1TransInput_IRV SWINve_t_Day SWINve_t_Hour SWINve_t_Minute SWINve_t_Month SWINve_T_P1Motor SWINve_T_P1Motor_IRV SWINve_T_P3Motor SWINve_T_P3Motor_IRV SWINve_t_Second SWINve_t_Year SWINve_U_ebsBATT SWINve_y_VCUFault SYVDve_U_MotorSupplyVoltage SYVDve_U_SystemVoltage SYVDve_U_SystemVoltage_IRV SYVDve_y_BSWDiagBLDCSupOvrVolt SYVDve_y_BSWDiagBLDCSupUnrVolt TAMDve_e_ClutchActPwrStgTempVld TAMDve_e_ClutchActuatorVld TAMDve_e_MosfetVld TAMDve_e_StuckVld TAMDve_I_HWIO_MotorCurrent_IRV TAMDve_n_HWIO_MotorRotSpd_IRV TAMDve_Pct_HWIO_MotorActPWM_IRV TAMDve_T_ClutchActPwrStg TAMDve_y_BSWDiagDrvOvrCur TAMDve_y_BSWDiagDrvOvrTemp TAMDve_y_BSWDiagDrvSupOvrVolt TAMDve_y_BSWDiagHALInvalFault TAMDve_y_BSWDiagHALSigOvrVolt TAMDve_y_BSWDiagHALSigUndrVolt TAMDve_y_BSWDiagHALSupOvrVolt TAMDve_y_BSWDiagHALSupUndrVolt TAMDve_y_BSWDiagHALUndefFault TAMDve_y_BSWDiagMosUnderVolt TAMDve_y_BSWDiagPhaseHigh TAMDve_y_BSWDiagPhaseLow TAMDve_y_BSWDiagPhasePerf TAMDve_y_EC_MosStatus TAMDve_y_EC_Status TAMDve_y_EC_StuckStatus Tbox3_CoolantTempValid TCAPve_e_DrivelineState TCFCve_b_CCPM_SpeedControllerActive TCFCve_b_TargetSpeedActive_IRV TCFCve_Cnt_CCPM_CommandDBC TCFCve_dV_C_dV_CCP_Data TCFCve_dV_CoolingFlow TCFCve_dV_CoolingFlow_IRV TCFCve_dV_CoolingFlowDBC TCFCve_e_CCP_DID_Enabled TCFCve_e_NegativeResponseCode_IRV TCFCve_I_CCPM TCFCve_I_CCPM_CompletePhase TCFCve_I_CCPM_IRV TCFCve_n_C_n_CCP_Data TCFCve_n_CCPM_CurrentSpeedLimit TCFCve_n_CCPM_IRV TCFCve_n_CCPM_SpeedControllerTarget TCFCve_n_CCPM_SpeedControllerTarget_IRV TCFCve_n_CCPM_SpeedTgtDBC TCFCve_Pct_C_Pct_CCP_Data TCFCve_Pct_CCPM_DC TCFCve_Pct_CCPM_DC_DBC TCFCve_Pct_CCPM_DC_IRV TCFCve_r_CCP_Y TCFRve_b_AfterRunRequest TCFRve_b_AtMinLubrication_IRV TCFRve_b_ClutchAvailable TCFRve_b_CoolingNeedPreventsCoolingIOC TCFRve_b_TooCloseToOverCurrent TCFRve_dV_CCP_OvercurrentLimitation TCFRve_dV_CCP_UsedLimit TCFRve_dV_CoolingFlowCommand TCFRve_I_CAP_PhaseCurrentLimitation TCFRve_I_CurrentAvailableForClutch TCFRve_Pct_FanRequest TCMDve_b_NewCycle TCMDve_b_StuckNewCycle TCMDve_Cnt_RC_SpdDev_Diags TCMDve_Cnt_RC_SpdDev_Fails TCMDve_e_CoolingActPwrStgTempVld TCMDve_e_CoolingActSpdDevVld TCMDve_e_CoolingActuatorVld TCMDve_e_MosfetVld TCMDve_e_StuckVld TCMDve_I_HWIO_MotorCurrent_IRV TCMDve_n_HWIO_MotorRotSpd_IRV TCMDve_n_MotorSpeed TCMDve_Pct_HWIO_MotorActPWM_IRV TCMDve_T_CoolingActPwrStg TCMDve_y_BSWDiagDrvOvrCur TCMDve_y_BSWDiagDrvOvrTemp TCMDve_y_BSWDiagDrvSupOvrVolt TCMDve_y_BSWDiagHALFault TCMDve_y_BSWDiagHALSupOvrVolt TCMDve_y_BSWDiagHALSupUndrVolt TCMDve_y_BSWDiagPhaseHigh TCMDve_y_BSWDiagPhaseLow TCMDve_y_BSWDiagPhasePerf TCMDve_y_EC_MosStatus TCMDve_y_EC_Status TCMDve_y_EC_StuckStatus TCMDve_y_RC_SpdDev_Progress TCMDve_y_RC_SpdDev_Status TCMDve_y_Status TCPDne_p_BiasComp TCPDve_b_ClearBiasComp TCPDve_Cnt_RC_Bias_Diags TCPDve_Cnt_RC_Bias_Fails TCPDve_Cnt_RC_HighClutchPres_Diags TCPDve_Cnt_RC_HighClutchPres_Fails TCPDve_Cnt_RC_LowClutchPres_Diags TCPDve_Cnt_RC_LowClutchPres_Fails TCPDve_Cnt_RC_MaxPres_Diags TCPDve_Cnt_RC_MaxPres_Fails TCPDve_e_ClutchPressureHighVld TCPDve_e_ClutchPressureLowVld TCPDve_e_ClutchPressureSensorVld TCPDve_e_ClutchPressureSensPerfVld TCPDve_p_AveragePresAtStart TCPDve_p_BiasComp_IRV TCPDve_p_ClutchPressure TCPDve_U_ClutchPressureRaw TCPDve_U_ClutchPressureVoltage TCPDve_y_BSWDiagHigh TCPDve_y_BSWDiagLow TCPDve_y_EC_Status TCPDve_y_RC_Bias_Progress TCPDve_y_RC_Bias_Status TCPDve_y_RC_HighClutchPres_Progress TCPDve_y_RC_HighClutchPres_Status TCPDve_y_RC_LowClutchPres_Progress TCPDve_y_RC_LowClutchPres_Status TCPDve_y_RC_MaxPres_Progress TCPDve_y_RC_MaxPres_Status TCPDve_y_Status TCU_AirFlowRequest TCU_Clutch_Status TCU_ClutchAvailableMaximumTorque TCU_ClutchAvailableMinimumTorque TCU_ClutchCapacityAct TCU_CrankingAuthorizationEnable TCU_Fault_Reaction_Req TCU_FaultLamp_Req TCU_GearEngagementAvailable TCU_MaxFrtMotPwr_Req TCU_MaxGCUPwr_Req TCU_OBD_Lamp TCU_TransmissionFluidTemp TIRCve_M_ReqAtLashRtLim TIRCve_M_TransInputTorqueImmd TISCve_n_TargetIdleSpd TLMDve_b_PwrstgCrrntlShtOffByTLMD TLMDve_Cnt_TransCtrlSysPerf_Diags TLMDve_Cnt_TransCtrlSysPerf_Fails TLMDve_e_TransCtrlSysPerfVld TLMDve_y_Status TLMDve_y_TransCtrlSysPerf_Progress TLMDve_y_TransCtrlSysPerf_Status TOTDve_b_RC_DltFailRst TOTDve_Cnt_RC_High_Diags TOTDve_Cnt_RC_High_Fails TOTDve_Cnt_RC_Low_Diags TOTDve_Cnt_RC_Low_Fails TOTDve_Cnt_RC_OilT_CritDiags TOTDve_Cnt_RC_OilT_CritFails TOTDve_Cnt_RC_OilT_WarnDiags TOTDve_Cnt_RC_OilT_WarnFails TOTDve_e_TransmissionOilTempCritVld TOTDve_e_TransmissionOilTempWarnVld TOTDve_e_TransmissionTempSensorVld TOTDve_T_OilTemperature TOTDve_T_OilTemperature_IRV TOTDve_y_RC_High_Progress TOTDve_y_RC_High_Status TOTDve_y_RC_Low_Progress TOTDve_y_RC_Low_Status TOTDve_y_RC_OilT_CritProgress TOTDve_y_RC_OilT_CritStatus TOTDve_y_RC_OilT_WarnProgress TOTDve_y_RC_OilT_WarnStatus TOTDve_y_Status TSPCve_n_EvenClthSpeed TSPCve_n_OddClthSpeed TSPCve_n_TransOutputSpeed TSPCve_n_TransP1ClutchInputSpeed TSSDve_Cnt_ClutchDragTrqTooHighFail TSSDve_Cnt_RC_ClTrq_Diags TSSDve_Cnt_RC_ClTrq_Fails TSSDve_Cnt_RC_DrgTrq_Diags TSSDve_Cnt_RC_DrgTrq_Fails TSSDve_e_ClutchCapacityInsuffVld TSSDve_e_ClutchDragTrqTooHighVld TSSDve_t_RC_DrgTrq_ClOpenTimer TSSDve_t_RC_DrgTrq_ICEOffTimer TSSDve_y_RC_ClTrq_Progress TSSDve_y_RC_ClTrq_Status TSSDve_y_RC_DrgTrq_Progress TSSDve_y_RC_DrgTrq_Status TSSDve_y_Status TTSSve_b_P1TrqLimReq TTSSve_e_SpdCntrlReqMod TTSSve_M_P1MaxTrqImmd TTSSve_M_P1MinTrqImmd TTSSve_n_SpdCntrlTarget V5RDve_e_EC_StatusRef1Vld V5RDve_e_EC_StatusRef2Vld V5RDve_e_EC_StatusRef3Vld VCU_Fault VECU_EngRunningStatusExpanded VECU_IUP_RATE_GEN_DEN VECU_IUP_RATE_GEN_INH VODOve_l_TotalOdometer VSPEve_v_DrvnWhlsSpd VSSDve_e_VehicleSpeedVld VSSDve_v_VehicleSpeed WSSDve_e_DrvnWhlSpdLeftVld WSSDve_e_DrvnWhlSpdRightVld WSSDve_e_NonDrvnWhlSpdLeftVld WSSDve_e_NonDrvnWhlSpdRightVld WSSDve_v_DrvnWhlSpdLeft WSSDve_v_DrvnWhlSpdRight WSSDve_v_NonDrvnWhlSpdLeft WSSDve_v_NonDrvnWhlSpdRight /end OUT_MEASUREMENT
/end FUNCTION
/begin FUNCTION SBC ""
 /begin OUT_MEASUREMENT SBC_au16StatusRegsNvm SBC_au16StatusRegsNvm[0] SBC_au16StatusRegsNvm[10] SBC_au16StatusRegsNvm[11] SBC_au16StatusRegsNvm[12] SBC_au16StatusRegsNvm[13] SBC_au16StatusRegsNvm[14] SBC_au16StatusRegsNvm[15] SBC_au16StatusRegsNvm[16] SBC_au16StatusRegsNvm[17] SBC_au16StatusRegsNvm[1] SBC_au16StatusRegsNvm[2] SBC_au16StatusRegsNvm[3] SBC_au16StatusRegsNvm[4] SBC_au16StatusRegsNvm[5] SBC_au16StatusRegsNvm[6] SBC_au16StatusRegsNvm[7] SBC_au16StatusRegsNvm[8] SBC_au16StatusRegsNvm[9] SBC_bDeintWdgCmd SBC_f32BatteryVoltage SBC_f32BkpVoltage /end OUT_MEASUREMENT
/end FUNCTION
/begin FUNCTION SPY ""
 /begin OUT_MEASUREMENT SPY_bBufFull SPY_u16DaqListFirstElmIdx SPY_u16NrOfElmsToTx SPY_u16PreTrigSmplIdx SPY_u16RmngSmplIdx SPY_u16SmplIdx SPY_u16TrigSmplIdx /end OUT_MEASUREMENT
/end FUNCTION
/begin FUNCTION STFSRV "" /begin DEF_CHARACTERISTIC ESM_bPowerOffModeInhC ESM_ku16AfterrunToutCntC /end DEF_CHARACTERISTIC
 /begin OUT_MEASUREMENT ESM_bAfterrunFin ESM_bAfterrunReq ESM_bCallAppliOn ESM_bMcuEnaReq ESM_bPwrDnReadyFlg ESM_bPwrLNfClrFltFinsh ESM_ESM_MODE_FT ESM_ESM_MODE_NF ESM_EsmMode ESM_OpFtState ESM_OpNfState ESM_PwrLFtState ESM_PwrLNfState ESM_StpIIFtState ESM_StpIINfState ESM_StpIState ESM_u16AfterrunCnt ESM_u16CmdReq ESM_u16CmdReqNm1 ESM_u16CmdRes ESM_u8AllowPwrDnDelay ESM_u8PwrLNfStep ESM_u8PwrOffTim ESM_u8RestartDelayCnt /end OUT_MEASUREMENT
/end FUNCTION
/begin COMPU_METHOD ESM_EsmMode_conv "" TAB_VERB "%8.4" "." COMPU_TAB_REF ESM_EsmMode_table /end COMPU_METHOD
/begin COMPU_VTAB ESM_EsmMode_table "" TAB_VERB 2 1 "ESM_ESM_MODE_NF" 4 "ESM_ESM_MODE_FT" /end COMPU_VTAB
/begin COMPU_METHOD CM_T_n_rpm_1_1_s16 "Q = V" RAT_FUNC "%5.0" "rpm (revolutions / minute  (rpm))" COEFFS 0 1 0 0 0 1 /end COMPU_METHOD
/begin COMPU_METHOD CM_T_Cnt_Num_1_1_u16 "Q = V" RAT_FUNC "%5.0" "Num (counts)" COEFFS 0 1 0 0 0 1 /end COMPU_METHOD
/begin COMPU_METHOD CM_T_p_kPa_32_1_u16 "Q = V*32.000000" RAT_FUNC "%9.5" "kPa (kiloPascals  (kPa))" COEFFS 0 32 0 0 0 1 /end COMPU_METHOD
/begin COMPU_METHOD CM_T_BOOLEAN "Q = V" RAT_FUNC "%1.0" "Bool" COEFFS 0 1 0 0 0 1 /end COMPU_METHOD
/begin COMPU_METHOD CM_T_BOOLEAN "Q = V" RAT_FUNC "%1.0" "Bool" COEFFS 0 1 0 0 0 1 /end COMPU_METHOD
/begin COMPU_METHOD CM_T_n_rpm_1_1_s16 "Q = V" RAT_FUNC "%5.0" "rpm (revolutions / minute  (rpm))" COEFFS 0 1 0 0 0 1 /end COMPU_METHOD
/begin COMPU_METHOD CM_T_Pct_pct_10_1_s16 "Q = V*10.000000" RAT_FUNC "%0.6" "pct (percent  (%))" COEFFS 0 10 0 0 0 1 /end COMPU_METHOD
/begin COMPU_METHOD CM_T_y_BitFieldDiagStatus "Q = V" RAT_FUNC "%3.0" "BitField" COEFFS 0 1 0 0 0 1 /end COMPU_METHOD
/begin COMPU_METHOD CM_T_n_rpm_1_1_s16 "Q = V" RAT_FUNC "%5.0" "rpm (revolutions / minute  (rpm))" COEFFS 0 1 0 0 0 1 /end COMPU_METHOD
/begin COMPU_METHOD CM_T_Cnt_Num_1_1_u16 "Q = V" RAT_FUNC "%5.0" "Num (counts)" COEFFS 0 1 0 0 0 1 /end COMPU_METHOD
/begin COMPU_METHOD CM_T_Pct_pct_10_1_s16 "Q = V*10.000000" RAT_FUNC "%0.6" "pct (percent  (%))" COEFFS 0 10 0 0 0 1 /end COMPU_METHOD
/begin COMPU_METHOD CM_T_r_NA_32768_1_u16 "Q = V*32768.000000" RAT_FUNC "%16.15" "NA (none)" COEFFS 0 32768 0 0 0 1 /end COMPU_METHOD
/begin COMPU_METHOD CM_T_BOOLEAN "Q = V" RAT_FUNC "%1.0" "Bool" COEFFS 0 1 0 0 0 1 /end COMPU_METHOD
/begin COMPU_METHOD CM_T_r_NA_32768_1_u16 "Q = V*32768.000000" RAT_FUNC "%16.15" "NA (none)" COEFFS 0 32768 0 0 0 1 /end COMPU_METHOD
/begin COMPU_METHOD CM_T_n_rpm_1_1_s16 "Q = V" RAT_FUNC "%5.0" "rpm (revolutions / minute  (rpm))" COEFFS 0 1 0 0 0 1 /end COMPU_METHOD
/begin COMPU_METHOD CM_T_Cnt_Num_1_1_u16 "Q = V" RAT_FUNC "%5.0" "Num (counts)" COEFFS 0 1 0 0 0 1 /end COMPU_METHOD
/begin COMPU_METHOD CM_T_BOOLEAN "Q = V" RAT_FUNC "%1.0" "Bool" COEFFS 0 1 0 0 0 1 /end COMPU_METHOD
/begin COMPU_METHOD CM_T_n_rpm_1_1_s16 "Q = V" RAT_FUNC "%5.0" "rpm (revolutions / minute  (rpm))" COEFFS 0 1 0 0 0 1 /end COMPU_METHOD
/begin COMPU_METHOD CM_T_Cnt_Num_1_1_u16 "Q = V" RAT_FUNC "%5.0" "Num (counts)" COEFFS 0 1 0 0 0 1 /end COMPU_METHOD
/begin COMPU_METHOD CM_T_BOOLEAN "Q = V" RAT_FUNC "%1.0" "Bool" COEFFS 0 1 0 0 0 1 /end COMPU_METHOD
/begin COMPU_METHOD CM_T_Pct_pct_10_1_s16 "Q = V*10.000000" RAT_FUNC "%0.6" "pct (percent  (%))" COEFFS 0 10 0 0 0 1 /end COMPU_METHOD
/begin COMPU_METHOD CM_T_y_BitFieldDiagStatus "Q = V" RAT_FUNC "%3.0" "BitField" COEFFS 0 1 0 0 0 1 /end COMPU_METHOD
/begin COMPU_METHOD CM_T_y_BitFieldDiagProgress "Q = V" RAT_FUNC "%3.0" "BitField" COEFFS 0 1 0 0 0 1 /end COMPU_METHOD
/begin COMPU_METHOD CM_T_Cnt_Num_1_1_u16 "Q = V" RAT_FUNC "%5.0" "Num (counts)" COEFFS 0 1 0 0 0 1 /end COMPU_METHOD
/begin COMPU_METHOD CM_T_p_kPa_32_1_u16 "Q = V*32.000000" RAT_FUNC "%9.5" "kPa (kiloPascals  (kPa))" COEFFS 0 32 0 0 0 1 /end COMPU_METHOD
/begin COMPU_METHOD CM_T_p_kPa_64_1_s16 "Q = V*64.000000" RAT_FUNC "%10.6" "kPa (kiloPascals  (kPa))" COEFFS 0 64 0 0 0 1 /end COMPU_METHOD
/begin COMPU_METHOD CM_T_BOOLEAN "Q = V" RAT_FUNC "%1.0" "Bool" COEFFS 0 1 0 0 0 1 /end COMPU_METHOD
/begin COMPU_METHOD CM_T_y_BitFieldDiagStatus "Q = V" RAT_FUNC "%3.0" "BitField" COEFFS 0 1 0 0 0 1 /end COMPU_METHOD
/begin COMPU_METHOD CM_T_y_BitFieldDiagProgress "Q = V" RAT_FUNC "%3.0" "BitField" COEFFS 0 1 0 0 0 1 /end COMPU_METHOD
/begin COMPU_METHOD CM_T_Cnt_Num_1_1_u16 "Q = V" RAT_FUNC "%5.0" "Num (counts)" COEFFS 0 1 0 0 0 1 /end COMPU_METHOD
/begin COMPU_METHOD CM_T_BOOLEAN "Q = V" RAT_FUNC "%1.0" "Bool" COEFFS 0 1 0 0 0 1 /end COMPU_METHOD
/begin COMPU_METHOD CM_T_y_BitFieldDiagProgress "Q = V" RAT_FUNC "%3.0" "BitField" COEFFS 0 1 0 0 0 1 /end COMPU_METHOD
/begin COMPU_METHOD CM_T_y_BitFieldDiagStatus "Q = V" RAT_FUNC "%3.0" "BitField" COEFFS 0 1 0 0 0 1 /end COMPU_METHOD
/begin COMPU_METHOD CM_T_n_rpm_1_1_s16 "Q = V" RAT_FUNC "%5.0" "rpm (revolutions / minute  (rpm))" COEFFS 0 1 0 0 0 1 /end COMPU_METHOD
/begin COMPU_METHOD CM_T_Cnt_Num_1_1_u16 "Q = V" RAT_FUNC "%5.0" "Num (counts)" COEFFS 0 1 0 0 0 1 /end COMPU_METHOD
/begin COMPU_METHOD CM_T_BOOLEAN "Q = V" RAT_FUNC "%1.0" "Bool" COEFFS 0 1 0 0 0 1 /end COMPU_METHOD
/begin COMPU_METHOD CM_T_y_BitFieldDiagStatus "Q = V" RAT_FUNC "%3.0" "BitField" COEFFS 0 1 0 0 0 1 /end COMPU_METHOD
/begin COMPU_METHOD CM_T_y_BitFieldDiagProgress "Q = V" RAT_FUNC "%3.0" "BitField" COEFFS 0 1 0 0 0 1 /end COMPU_METHOD
/begin COMPU_METHOD CM_T_BOOLEAN "Q = V" RAT_FUNC "%1.0" "Bool" COEFFS 0 1 0 0 0 1 /end COMPU_METHOD
/begin COMPU_METHOD CM_T_n_rpm_1_1_s16 "Q = V" RAT_FUNC "%5.0" "rpm (revolutions / minute  (rpm))" COEFFS 0 1 0 0 0 1 /end COMPU_METHOD
/begin COMPU_METHOD CM_T_Cnt_Num_1_1_u16 "Q = V" RAT_FUNC "%5.0" "Num (counts)" COEFFS 0 1 0 0 0 1 /end COMPU_METHOD
/begin COMPU_METHOD CM_T_p_kPa_32_1_u16 "Q = V*32.000000" RAT_FUNC "%9.5" "kPa (kiloPascals  (kPa))" COEFFS 0 32 0 0 0 1 /end COMPU_METHOD
/begin COMPU_METHOD CM_T_BOOLEAN "Q = V" RAT_FUNC "%1.0" "Bool" COEFFS 0 1 0 0 0 1 /end COMPU_METHOD
/begin COMPU_METHOD CM_T_y_BitFieldDiagStatus "Q = V" RAT_FUNC "%3.0" "BitField" COEFFS 0 1 0 0 0 1 /end COMPU_METHOD
/begin COMPU_METHOD CM_T_y_BitFieldDiagProgress "Q = V" RAT_FUNC "%3.0" "BitField" COEFFS 0 1 0 0 0 1 /end COMPU_METHOD
/begin COMPU_METHOD CM_T_BOOLEAN "Q = V" RAT_FUNC "%1.0" "Bool" COEFFS 0 1 0 0 0 1 /end COMPU_METHOD
/begin COMPU_METHOD CM_T_y_BitFieldDiagStatus "Q = V" RAT_FUNC "%3.0" "BitField" COEFFS 0 1 0 0 0 1 /end COMPU_METHOD
/begin COMPU_METHOD CM_T_BOOLEAN "Q = V" RAT_FUNC "%1.0" "Bool" COEFFS 0 1 0 0 0 1 /end COMPU_METHOD
/end MODULE
/end PROJECT
