ASAP2_VERSION 1 3
/begin PROJECT P_TC387_PLATFORM_0_0 "P_TC387_PLATFORM_0_0"
/begin HEADER "" VERSION "5210.00" PROJECT_NO D0 /end HEADER
/begin MODULE P_TC387_PLATFORM_0_0 "Invt"
/begin MOD_COMMON "" DEPOSIT ABSOLUTE ALIGNMENT_BYTE 1 ALIGNMENT_WORD 2 ALIGNMENT_LONG 4 ALIGNMENT_FLOAT32_IEEE 4 ALIGNMENT_FLOAT64_IEEE 8 BYTE_ORDER MSB_LAST /end MOD_COMMON
/begin RECORD_LAYOUT DATA_RECORD_UBYTE FNC_VALUES 1 UBYTE ROW_DIR DIRECT /end RECORD_LAYOUT
/begin RECORD_LAYOUT DATA_RECORD_UWORD FNC_VALUES 1 UWORD ROW_DIR DIRECT /end RECORD_LAYOUT
/begin RECORD_LAYOUT DATA_RECORD_FLOAT32_IEEE FNC_VALUES 1 FLOAT32_IEEE ROW_DIR DIRECT /end RECORD_LAYOUT
/begin RECORD_LAYOUT AXIS_PTS_X_SBYTE_VEMS AXIS_PTS_X 1 SBYTE INDEX_INCR DIRECT /end RECORD_LAYOUT
/begin RECORD_LAYOUT AXIS_PTS_X_UWORD_VEMS AXIS_PTS_X 1 UWORD INDEX_INCR DIRECT /end RECORD_LAYOUT
/begin RECORD_LAYOUT AXIS_PTS_X_SWORD_VEMS AXIS_PTS_X 1 SWORD INDEX_INCR DIRECT /end RECORD_LAYOUT
/begin RECORD_LAYOUT AXIS_PTS_X_ULONG_VEMS AXIS_PTS_X 1 ULONG INDEX_INCR DIRECT /end RECORD_LAYOUT
/begin RECORD_LAYOUT AXIS_PTS_X_SLONG_VEMS AXIS_PTS_X 1 SLONG INDEX_INCR DIRECT /end RECORD_LAYOUT
/begin RECORD_LAYOUT AXIS_PTS_X_FLOAT32_IEEE_VEMS AXIS_PTS_X 1 FLOAT32_IEEE INDEX_INCR DIRECT /end RECORD_LAYOUT
/begin RECORD_LAYOUT AXIS_PTS_X_FLOAT64_IEEE_VEMS AXIS_PTS_X 1 FLOAT64_IEEE INDEX_INCR DIRECT /end RECORD_LAYOUT
/begin RECORD_LAYOUT AXIS_PTS_X_UBYTE NO_AXIS_PTS_X 1 UBYTE AXIS_PTS_X 2 UBYTE INDEX_INCR DIRECT /end RECORD_LAYOUT
/begin RECORD_LAYOUT AXIS_PTS_X_SBYTE NO_AXIS_PTS_X 1 SBYTE AXIS_PTS_X 2 SBYTE INDEX_INCR DIRECT /end RECORD_LAYOUT
/begin RECORD_LAYOUT AXIS_PTS_X_UWORD NO_AXIS_PTS_X 1 UWORD AXIS_PTS_X 2 UWORD INDEX_INCR DIRECT /end RECORD_LAYOUT
/begin RECORD_LAYOUT AXIS_PTS_X_SWORD NO_AXIS_PTS_X 1 SWORD AXIS_PTS_X 2 SWORD INDEX_INCR DIRECT /end RECORD_LAYOUT
/begin RECORD_LAYOUT AXIS_PTS_X_ULONG NO_AXIS_PTS_X 1 ULONG AXIS_PTS_X 2 ULONG INDEX_INCR DIRECT /end RECORD_LAYOUT
/begin RECORD_LAYOUT AXIS_PTS_X_SLONG NO_AXIS_PTS_X 1 SLONG AXIS_PTS_X 2 SLONG INDEX_INCR DIRECT /end RECORD_LAYOUT
/begin RECORD_LAYOUT AXIS_PTS_X_FLOAT32_IEEE NO_AXIS_PTS_X 1 FLOAT32_IEEE AXIS_PTS_X 2 FLOAT32_IEEE INDEX_INCR DIRECT /end RECORD_LAYOUT
/begin RECORD_LAYOUT AXIS_PTS_X_FLOAT64_IEEE NO_AXIS_PTS_X 1 FLOAT64_IEEE AXIS_PTS_X 2 FLOAT64_IEEE INDEX_INCR DIRECT /end RECORD_LAYOUT
/begin CHARACTERISTIC DRV8340_ku16EnaResetTimeC "Spare" VALUE 0x80058ABA DATA_RECORD_UWORD 65535 F_1_p0_10 0 65535 /end CHARACTERISTIC
/begin CHARACTERISTIC DRV8340_ku16ErrPinChkTimC "Spare" VALUE 0x80058AB8 DATA_RECORD_UWORD 65535 F_1_p0_10 0 65535 /end CHARACTERISTIC
/begin CHARACTERISTIC ESM_bPowerOffModeInhC "ESM POWER_OFF_MODE state inhibition" VALUE 0x8009CF9B DATA_RECORD_UBYTE 1 Bool_ON_OFF 0 1 BIT_MASK 0x01 /end CHARACTERISTIC
/begin CHARACTERISTIC ESM_ku16AfterrunToutCntC "ESM_ku16AfterrunToutCntC" VALUE 0x80058ACE DATA_RECORD_UWORD 327675 F_5_p0_12 0 327675 /end CHARACTERISTIC
/begin CHARACTERISTIC GESM_bPowerOffModeInhC "ESM POWER_OFF_MODE state inhibition" VALUE 0x8009CF99 DATA_RECORD_UBYTE 1 Bool_ON_OFF 0 1 BIT_MASK 0x01 /end CHARACTERISTIC
/begin CHARACTERISTIC GESM_ku16AfterrunToutCntC "GESM_ku16AfterrunToutCntC" VALUE 0x80058ACA DATA_RECORD_UWORD 327675 F_5_p0_12 0 327675 /end CHARACTERISTIC
/begin CHARACTERISTIC RES_bGenerateSyncPosC "Enable generation of the SyncPos signal" VALUE 0x8005804B DATA_RECORD_UBYTE 1 Bool_ON_OFF 0 1 BIT_MASK 0x01 /end CHARACTERISTIC
/begin CHARACTERISTIC RES_u16ExcitDelayC "Resolver excitation delay" VALUE 0x80058AC6 DATA_RECORD_UWORD 6553.5 F_0v1_p0_25 0 6553.5 /end CHARACTERISTIC
/begin CHARACTERISTIC RES_u16SyncDelay2C "Delay time between the failing eadg of the CS to the generation of SyncPos signal" VALUE 0x80058AC2 DATA_RECORD_UWORD 6553.5 F_0v1_p0_25 0 6553.5 /end CHARACTERISTIC
/begin CHARACTERISTIC RES_u16SyncDelayC "Delay time between the failing eadg of the CS to the generation of SyncPos signal" VALUE 0x80058AC4 DATA_RECORD_UWORD 6553.5 F_0v1_p0_25 0 6553.5 /end CHARACTERISTIC
/begin CHARACTERISTIC RES_u16VSICkreqPeriodDefC "Resolver default value for VSI Ckreq period" VALUE 0x80058AC0 DATA_RECORD_UWORD 6553.5 F_0v1_p0_25 0 6553.5 /end CHARACTERISTIC
/begin CHARACTERISTIC RES_u8ExcitDutyPercentC "Resolver excitation duty cycle value" VALUE 0x8005806F DATA_RECORD_UBYTE 255 F_1_p0_26 0 255 /end CHARACTERISTIC
/begin CHARACTERISTIC RES_u8SyncDutyPercentC "Resolver excitation duty cycle value" VALUE 0x8005806E DATA_RECORD_UBYTE 255 F_1_p0_26 0 255 /end CHARACTERISTIC
/begin CHARACTERISTIC SBC_ku16IntUnderVoltThdC "..." VALUE 0x80058B04 DATA_RECORD_UWORD 65535 F_1_p0_2 0 65535 /end CHARACTERISTIC
/begin CHARACTERISTIC SBC_ku16IntUvTimoutC "..." VALUE 0x80058B00 DATA_RECORD_UWORD 65535 F_1_p0_2 0 65535 /end CHARACTERISTIC
/begin CHARACTERISTIC TLE9180_bManualReadRegC "TLE9180_bManualReadRegC" VALUE 0x8005804A DATA_RECORD_UBYTE 1 Bool_ON_OFF 0 1 BIT_MASK 0x01 /end CHARACTERISTIC
/begin CHARACTERISTIC TLE9180_kf32PhsTempFaultC "TLE9180_kf32PhsTempFaultC" VALUE 0x80058BEC DATA_RECORD_FLOAT32_IEEE 3.402823466E+038 I_1 -3.402823466E+038 3.402823466E+038 /end CHARACTERISTIC
/begin CHARACTERISTIC TLE9180_ku16EnaResetTimeC "TLE9180_ku16EnaResetTimeC" VALUE 0x80058ABE DATA_RECORD_UWORD 65535 I_1 0 65535 /end CHARACTERISTIC
/begin CHARACTERISTIC TLE9180_ku16ErrPinChkTimC "TLE9180_ku16ErrPinChkTimC" VALUE 0x80058ABC DATA_RECORD_UWORD 65535 I_1 0 65535 /end CHARACTERISTIC
/begin CHARACTERISTIC TLE9180_ku8ErrRecvMaxNumC "TLE9180_ku8ErrRecvMaxNumC" VALUE 0x80058069 DATA_RECORD_UBYTE 255 I_1 0 255 /end CHARACTERISTIC
/begin MEASUREMENT Core0_Asw100msStartTime "..." ULONG F_0v01_p0_9 1 2 0 42949672.95 ECU_ADDRESS 0x7001FF6C /end MEASUREMENT
/begin MEASUREMENT Core0_Asw100msStopTime "..." ULONG F_0v01_p0_9 1 2 0 42949672.95 ECU_ADDRESS 0x7001FF68 /end MEASUREMENT
/begin MEASUREMENT Core0_Asw100msTotalTime "..." ULONG F_0v01_p0_9 1 2 0 42949672.95 ECU_ADDRESS 0x7001FF64 /end MEASUREMENT
/begin MEASUREMENT Core0_Asw10msStartTime "..." ULONG F_0v01_p0_9 1 2 0 42949672.95 ECU_ADDRESS 0x7001FF60 /end MEASUREMENT
/begin MEASUREMENT Core0_Asw10msStopTime "..." ULONG F_0v01_p0_9 1 2 0 42949672.95 ECU_ADDRESS 0x7001FF5C /end MEASUREMENT
/begin MEASUREMENT Core0_Asw10msTotalTime "..." ULONG F_0v01_p0_9 1 2 0 42949672.95 ECU_ADDRESS 0x7001FF58 /end MEASUREMENT
/begin MEASUREMENT Core0_Bsw100msStartTime "..." ULONG F_0v01_p0_9 1 2 0 42949672.95 ECU_ADDRESS 0x7001FF54 /end MEASUREMENT
/begin MEASUREMENT Core0_Bsw100msStopTime "..." ULONG F_0v01_p0_9 1 2 0 42949672.95 ECU_ADDRESS 0x7001FF50 /end MEASUREMENT
/begin MEASUREMENT Core0_Bsw100msTotalTime "..." ULONG F_0v01_p0_9 1 2 0 42949672.95 ECU_ADDRESS 0x7001FF4C /end MEASUREMENT
/begin MEASUREMENT Core0_Bsw10msStartTime "..." ULONG F_0v01_p0_9 1 2 0 42949672.95 ECU_ADDRESS 0x7001FF48 /end MEASUREMENT
/begin MEASUREMENT Core0_Bsw10msStopTime "..." ULONG F_0v01_p0_9 1 2 0 42949672.95 ECU_ADDRESS 0x7001FF44 /end MEASUREMENT
/begin MEASUREMENT Core0_Bsw10msTotalTime "..." ULONG F_0v01_p0_9 1 2 0 42949672.95 ECU_ADDRESS 0x7001FF40 /end MEASUREMENT
/begin MEASUREMENT Core0_Bsw1msStartTime "..." ULONG F_0v01_p0_9 1 2 0 42949672.95 ECU_ADDRESS 0x7001FF3C /end MEASUREMENT
/begin MEASUREMENT Core0_Bsw1msStopTime "..." ULONG F_0v01_p0_9 1 2 0 42949672.95 ECU_ADDRESS 0x7001FF38 /end MEASUREMENT
/begin MEASUREMENT Core0_Bsw1msTotalTime "..." ULONG F_0v01_p0_9 1 2 0 42949672.95 ECU_ADDRESS 0x7001FF34 /end MEASUREMENT
/begin MEASUREMENT Core0_Bsw50msStartTime "..." ULONG F_0v01_p0_9 1 2 0 42949672.95 ECU_ADDRESS 0x7001FF30 /end MEASUREMENT
/begin MEASUREMENT Core0_Bsw50msStopTime "..." ULONG F_0v01_p0_9 1 2 0 42949672.95 ECU_ADDRESS 0x7001FF2C /end MEASUREMENT
/begin MEASUREMENT Core0_Bsw50msTotalTime "..." ULONG F_0v01_p0_9 1 2 0 42949672.95 ECU_ADDRESS 0x7001FF28 /end MEASUREMENT
/begin MEASUREMENT Core1_Asw10msStartTime "..." ULONG F_0v01_p0_9 1 2 0 42949672.95 ECU_ADDRESS 0x7001FF18 /end MEASUREMENT
/begin MEASUREMENT Core1_Asw10msStopTime "..." ULONG F_0v01_p0_9 1 2 0 42949672.95 ECU_ADDRESS 0x7001FF14 /end MEASUREMENT
/begin MEASUREMENT Core1_Asw10msTotalTime "..." ULONG F_0v01_p0_9 1 2 0 42949672.95 ECU_ADDRESS 0x7001FF10 /end MEASUREMENT
/begin MEASUREMENT Core1_Asw1msStartTime "..." ULONG F_0v01_p0_9 1 2 0 42949672.95 ECU_ADDRESS 0x7001FF0C /end MEASUREMENT
/begin MEASUREMENT Core1_Asw1msStopTime "..." ULONG F_0v01_p0_9 1 2 0 42949672.95 ECU_ADDRESS 0x7001FF08 /end MEASUREMENT
/begin MEASUREMENT Core1_Asw1msTotalTime "..." ULONG F_0v01_p0_9 1 2 0 42949672.95 ECU_ADDRESS 0x7001FF04 /end MEASUREMENT
/begin MEASUREMENT Core1_Bsw10msStartTime "..." ULONG F_0v01_p0_9 1 2 0 42949672.95 ECU_ADDRESS 0x7001FF00 /end MEASUREMENT
/begin MEASUREMENT Core1_Bsw10msStopTime "..." ULONG F_0v01_p0_9 1 2 0 42949672.95 ECU_ADDRESS 0x7001FEFC /end MEASUREMENT
/begin MEASUREMENT Core1_Bsw10msTotalTime "..." ULONG F_0v01_p0_9 1 2 0 42949672.95 ECU_ADDRESS 0x7001FEF8 /end MEASUREMENT
/begin MEASUREMENT Core2_Asw10msStartTime "..." ULONG F_0v01_p0_9 1 2 0 42949672.95 ECU_ADDRESS 0x7001FEE8 /end MEASUREMENT
/begin MEASUREMENT Core2_Asw10msStopTime "..." ULONG F_0v01_p0_9 1 2 0 42949672.95 ECU_ADDRESS 0x7001FEE4 /end MEASUREMENT
/begin MEASUREMENT Core2_Asw10msTotalTime "..." ULONG F_0v01_p0_9 1 2 0 42949672.95 ECU_ADDRESS 0x7001FEE0 /end MEASUREMENT
/begin MEASUREMENT Core2_Asw1msStartTime "..." ULONG F_0v01_p0_9 1 2 0 42949672.95 ECU_ADDRESS 0x7001FEDC /end MEASUREMENT
/begin MEASUREMENT Core2_Asw1msStopTime "..." ULONG F_0v01_p0_9 1 2 0 42949672.95 ECU_ADDRESS 0x7001FED8 /end MEASUREMENT
/begin MEASUREMENT Core2_Asw1msTotalTime "..." ULONG F_0v01_p0_9 1 2 0 42949672.95 ECU_ADDRESS 0x7001FED4 /end MEASUREMENT
/begin MEASUREMENT Core2_Bsw10msStartTime "..." ULONG F_0v01_p0_9 1 2 0 42949672.95 ECU_ADDRESS 0x7001FED0 /end MEASUREMENT
/begin MEASUREMENT Core2_Bsw10msStopTime "..." ULONG F_0v01_p0_9 1 2 0 42949672.95 ECU_ADDRESS 0x7001FECC /end MEASUREMENT
/begin MEASUREMENT Core2_Bsw10msTotalTime "..." ULONG F_0v01_p0_9 1 2 0 42949672.95 ECU_ADDRESS 0x7001FEC8 /end MEASUREMENT
/begin MEASUREMENT DRV8340_au8FaultRegsVal "DRV8340_au8FaultRegsVal" UBYTE I_1 1 2 0 255 MATRIX_DIM 4 1 1 ECU_ADDRESS 0x70013FB0 /end MEASUREMENT
/begin MEASUREMENT DRV8340_au8FaultRegsVal[0] "DRV8340_au8FaultRegsVal[0]" UBYTE I_1 1 2 0 255 ECU_ADDRESS 0x70013FB0 /end MEASUREMENT
/begin MEASUREMENT DRV8340_au8FaultRegsVal[1] "DRV8340_au8FaultRegsVal[1]" UBYTE I_1 1 2 0 255 ECU_ADDRESS 0x70013FB1 /end MEASUREMENT
/begin MEASUREMENT DRV8340_au8FaultRegsVal[2] "DRV8340_au8FaultRegsVal[2]" UBYTE I_1 1 2 0 255 ECU_ADDRESS 0x70013FB2 /end MEASUREMENT
/begin MEASUREMENT DRV8340_au8FaultRegsVal[3] "DRV8340_au8FaultRegsVal[3]" UBYTE I_1 1 2 0 255 ECU_ADDRESS 0x70013FB3 /end MEASUREMENT
/begin MEASUREMENT DRV8340_bDrvOverCurrent "..." UBYTE Bool_ON_OFF 1 2 0 1 BIT_MASK 0x01 ECU_ADDRESS 0x70013FBE /end MEASUREMENT
/begin MEASUREMENT DRV8340_bDrvOverTemp "..." UBYTE Bool_ON_OFF 1 2 0 1 BIT_MASK 0x01 ECU_ADDRESS 0x70013FBC /end MEASUREMENT
/begin MEASUREMENT DRV8340_bDrvOverVoltage "..." UBYTE Bool_ON_OFF 1 2 0 1 BIT_MASK 0x01 ECU_ADDRESS 0x70013FBF /end MEASUREMENT
/begin MEASUREMENT DRV8340_bDrvUnderVoltage "..." UBYTE Bool_ON_OFF 1 2 0 1 BIT_MASK 0x01 ECU_ADDRESS 0x70013FC0 /end MEASUREMENT
/begin MEASUREMENT DRV8340_bErrorPinLevel "..." UBYTE Bool_ON_OFF 1 2 0 1 BIT_MASK 0x01 ECU_ADDRESS 0x70013FD7 /end MEASUREMENT
/begin MEASUREMENT DRV8340_bIsInitDone "..." UBYTE Bool_ON_OFF 1 2 0 1 BIT_MASK 0x01 ECU_ADDRESS 0x70013FB6 /end MEASUREMENT
/begin MEASUREMENT DRV8340_bIsLatched "..." UBYTE Bool_ON_OFF 1 2 0 1 BIT_MASK 0x01 ECU_ADDRESS 0x70013FB7 /end MEASUREMENT
/begin MEASUREMENT DRV8340_bIsShutdown "..." UBYTE Bool_ON_OFF 1 2 0 1 BIT_MASK 0x01 ECU_ADDRESS 0x70013FB8 /end MEASUREMENT
/begin MEASUREMENT DRV8340_bPhaseShort "..." UBYTE Bool_ON_OFF 1 2 0 1 BIT_MASK 0x01 ECU_ADDRESS 0x70013FBB /end MEASUREMENT
/begin MEASUREMENT DRV8340_bUserReadReq "..." UBYTE Bool_ON_OFF 1 2 0 1 BIT_MASK 0x01 ECU_ADDRESS 0x70013FB5 /end MEASUREMENT
/begin MEASUREMENT DRV8340_bUserWriteReq "..." UBYTE Bool_ON_OFF 1 2 0 1 BIT_MASK 0x01 ECU_ADDRESS 0x70013FB4 /end MEASUREMENT
/begin MEASUREMENT DRV8340_u16CfgChkTimer "..." UWORD I_1 1 2 0 65535 ECU_ADDRESS 0x70013FC4 /end MEASUREMENT
/begin MEASUREMENT DRV8340_u16EnaResetTime "..." UWORD I_1 1 2 0 65535 ECU_ADDRESS 0x70013FCA /end MEASUREMENT
/begin MEASUREMENT DRV8340_u8AsyncComState "..." UBYTE I_1 1 2 0 255 ECU_ADDRESS 0x70013FCE /end MEASUREMENT
/begin MEASUREMENT DRV8340_u8ErrRecoverCnt "..." UBYTE I_1 1 2 0 255 ECU_ADDRESS 0x70013FD4 /end MEASUREMENT
/begin MEASUREMENT DRV8340_u8Mode "..." UBYTE I_1 1 2 0 255 ECU_ADDRESS 0x70013FD6 /end MEASUREMENT
/begin MEASUREMENT DRV8340_u8TgtMode "..." UBYTE I_1 1 2 0 255 ECU_ADDRESS 0x70013FD5 /end MEASUREMENT
/begin MEASUREMENT DRV83xxHAL_xRegMapRxBuf "DRV83xxHAL_xRegMapRxBuf" ULONG I_1 1 2 0 4294967295 MATRIX_DIM 20 1 1 ECU_ADDRESS 0x70014060 /end MEASUREMENT
/begin MEASUREMENT DRV83xxHAL_xRegMapRxBuf[0] "DRV83xxHAL_xRegMapRxBuf[0]" ULONG I_1 1 2 0 4294967295 ECU_ADDRESS 0x70014060 /end MEASUREMENT
/begin MEASUREMENT DRV83xxHAL_xRegMapRxBuf[10] "DRV83xxHAL_xRegMapRxBuf[10]" ULONG I_1 1 2 0 4294967295 ECU_ADDRESS 0x70014088 /end MEASUREMENT
/begin MEASUREMENT DRV83xxHAL_xRegMapRxBuf[11] "DRV83xxHAL_xRegMapRxBuf[11]" ULONG I_1 1 2 0 4294967295 ECU_ADDRESS 0x7001408C /end MEASUREMENT
/begin MEASUREMENT DRV83xxHAL_xRegMapRxBuf[12] "DRV83xxHAL_xRegMapRxBuf[12]" ULONG I_1 1 2 0 4294967295 ECU_ADDRESS 0x70014090 /end MEASUREMENT
/begin MEASUREMENT DRV83xxHAL_xRegMapRxBuf[13] "DRV83xxHAL_xRegMapRxBuf[13]" ULONG I_1 1 2 0 4294967295 ECU_ADDRESS 0x70014094 /end MEASUREMENT
/begin MEASUREMENT DRV83xxHAL_xRegMapRxBuf[14] "DRV83xxHAL_xRegMapRxBuf[14]" ULONG I_1 1 2 0 4294967295 ECU_ADDRESS 0x70014098 /end MEASUREMENT
/begin MEASUREMENT DRV83xxHAL_xRegMapRxBuf[15] "DRV83xxHAL_xRegMapRxBuf[15]" ULONG I_1 1 2 0 4294967295 ECU_ADDRESS 0x7001409C /end MEASUREMENT
/begin MEASUREMENT DRV83xxHAL_xRegMapRxBuf[16] "DRV83xxHAL_xRegMapRxBuf[16]" ULONG I_1 1 2 0 4294967295 ECU_ADDRESS 0x700140A0 /end MEASUREMENT
/begin MEASUREMENT DRV83xxHAL_xRegMapRxBuf[17] "DRV83xxHAL_xRegMapRxBuf[17]" ULONG I_1 1 2 0 4294967295 ECU_ADDRESS 0x700140A4 /end MEASUREMENT
/begin MEASUREMENT DRV83xxHAL_xRegMapRxBuf[18] "DRV83xxHAL_xRegMapRxBuf[18]" ULONG I_1 1 2 0 4294967295 ECU_ADDRESS 0x700140A8 /end MEASUREMENT
/begin MEASUREMENT DRV83xxHAL_xRegMapRxBuf[19] "DRV83xxHAL_xRegMapRxBuf[19]" ULONG I_1 1 2 0 4294967295 ECU_ADDRESS 0x700140AC /end MEASUREMENT
/begin MEASUREMENT DRV83xxHAL_xRegMapRxBuf[1] "DRV83xxHAL_xRegMapRxBuf[1]" ULONG I_1 1 2 0 4294967295 ECU_ADDRESS 0x70014064 /end MEASUREMENT
/begin MEASUREMENT DRV83xxHAL_xRegMapRxBuf[2] "DRV83xxHAL_xRegMapRxBuf[2]" ULONG I_1 1 2 0 4294967295 ECU_ADDRESS 0x70014068 /end MEASUREMENT
/begin MEASUREMENT DRV83xxHAL_xRegMapRxBuf[3] "DRV83xxHAL_xRegMapRxBuf[3]" ULONG I_1 1 2 0 4294967295 ECU_ADDRESS 0x7001406C /end MEASUREMENT
/begin MEASUREMENT DRV83xxHAL_xRegMapRxBuf[4] "DRV83xxHAL_xRegMapRxBuf[4]" ULONG I_1 1 2 0 4294967295 ECU_ADDRESS 0x70014070 /end MEASUREMENT
/begin MEASUREMENT DRV83xxHAL_xRegMapRxBuf[5] "DRV83xxHAL_xRegMapRxBuf[5]" ULONG I_1 1 2 0 4294967295 ECU_ADDRESS 0x70014074 /end MEASUREMENT
/begin MEASUREMENT DRV83xxHAL_xRegMapRxBuf[6] "DRV83xxHAL_xRegMapRxBuf[6]" ULONG I_1 1 2 0 4294967295 ECU_ADDRESS 0x70014078 /end MEASUREMENT
/begin MEASUREMENT DRV83xxHAL_xRegMapRxBuf[7] "DRV83xxHAL_xRegMapRxBuf[7]" ULONG I_1 1 2 0 4294967295 ECU_ADDRESS 0x7001407C /end MEASUREMENT
/begin MEASUREMENT DRV83xxHAL_xRegMapRxBuf[8] "DRV83xxHAL_xRegMapRxBuf[8]" ULONG I_1 1 2 0 4294967295 ECU_ADDRESS 0x70014080 /end MEASUREMENT
/begin MEASUREMENT DRV83xxHAL_xRegMapRxBuf[9] "DRV83xxHAL_xRegMapRxBuf[9]" ULONG I_1 1 2 0 4294967295 ECU_ADDRESS 0x70014084 /end MEASUREMENT
/begin MEASUREMENT DRV83xxHAL_xRegMapTxBuf "DRV83xxHAL_xRegMapTxBuf" ULONG I_1 1 2 0 4294967295 MATRIX_DIM 20 1 1 ECU_ADDRESS 0x70014010 /end MEASUREMENT
/begin MEASUREMENT DRV83xxHAL_xRegMapTxBuf[0] "DRV83xxHAL_xRegMapTxBuf[0]" ULONG I_1 1 2 0 4294967295 ECU_ADDRESS 0x70014010 /end MEASUREMENT
/begin MEASUREMENT DRV83xxHAL_xRegMapTxBuf[10] "DRV83xxHAL_xRegMapTxBuf[10]" ULONG I_1 1 2 0 4294967295 ECU_ADDRESS 0x70014038 /end MEASUREMENT
/begin MEASUREMENT DRV83xxHAL_xRegMapTxBuf[11] "DRV83xxHAL_xRegMapTxBuf[11]" ULONG I_1 1 2 0 4294967295 ECU_ADDRESS 0x7001403C /end MEASUREMENT
/begin MEASUREMENT DRV83xxHAL_xRegMapTxBuf[12] "DRV83xxHAL_xRegMapTxBuf[12]" ULONG I_1 1 2 0 4294967295 ECU_ADDRESS 0x70014040 /end MEASUREMENT
/begin MEASUREMENT DRV83xxHAL_xRegMapTxBuf[13] "DRV83xxHAL_xRegMapTxBuf[13]" ULONG I_1 1 2 0 4294967295 ECU_ADDRESS 0x70014044 /end MEASUREMENT
/begin MEASUREMENT DRV83xxHAL_xRegMapTxBuf[14] "DRV83xxHAL_xRegMapTxBuf[14]" ULONG I_1 1 2 0 4294967295 ECU_ADDRESS 0x70014048 /end MEASUREMENT
/begin MEASUREMENT DRV83xxHAL_xRegMapTxBuf[15] "DRV83xxHAL_xRegMapTxBuf[15]" ULONG I_1 1 2 0 4294967295 ECU_ADDRESS 0x7001404C /end MEASUREMENT
/begin MEASUREMENT DRV83xxHAL_xRegMapTxBuf[16] "DRV83xxHAL_xRegMapTxBuf[16]" ULONG I_1 1 2 0 4294967295 ECU_ADDRESS 0x70014050 /end MEASUREMENT
/begin MEASUREMENT DRV83xxHAL_xRegMapTxBuf[17] "DRV83xxHAL_xRegMapTxBuf[17]" ULONG I_1 1 2 0 4294967295 ECU_ADDRESS 0x70014054 /end MEASUREMENT
/begin MEASUREMENT DRV83xxHAL_xRegMapTxBuf[18] "DRV83xxHAL_xRegMapTxBuf[18]" ULONG I_1 1 2 0 4294967295 ECU_ADDRESS 0x70014058 /end MEASUREMENT
/begin MEASUREMENT DRV83xxHAL_xRegMapTxBuf[19] "DRV83xxHAL_xRegMapTxBuf[19]" ULONG I_1 1 2 0 4294967295 ECU_ADDRESS 0x7001405C /end MEASUREMENT
/begin MEASUREMENT DRV83xxHAL_xRegMapTxBuf[1] "DRV83xxHAL_xRegMapTxBuf[1]" ULONG I_1 1 2 0 4294967295 ECU_ADDRESS 0x70014014 /end MEASUREMENT
/begin MEASUREMENT DRV83xxHAL_xRegMapTxBuf[2] "DRV83xxHAL_xRegMapTxBuf[2]" ULONG I_1 1 2 0 4294967295 ECU_ADDRESS 0x70014018 /end MEASUREMENT
/begin MEASUREMENT DRV83xxHAL_xRegMapTxBuf[3] "DRV83xxHAL_xRegMapTxBuf[3]" ULONG I_1 1 2 0 4294967295 ECU_ADDRESS 0x7001401C /end MEASUREMENT
/begin MEASUREMENT DRV83xxHAL_xRegMapTxBuf[4] "DRV83xxHAL_xRegMapTxBuf[4]" ULONG I_1 1 2 0 4294967295 ECU_ADDRESS 0x70014020 /end MEASUREMENT
/begin MEASUREMENT DRV83xxHAL_xRegMapTxBuf[5] "DRV83xxHAL_xRegMapTxBuf[5]" ULONG I_1 1 2 0 4294967295 ECU_ADDRESS 0x70014024 /end MEASUREMENT
/begin MEASUREMENT DRV83xxHAL_xRegMapTxBuf[6] "DRV83xxHAL_xRegMapTxBuf[6]" ULONG I_1 1 2 0 4294967295 ECU_ADDRESS 0x70014028 /end MEASUREMENT
/begin MEASUREMENT DRV83xxHAL_xRegMapTxBuf[7] "DRV83xxHAL_xRegMapTxBuf[7]" ULONG I_1 1 2 0 4294967295 ECU_ADDRESS 0x7001402C /end MEASUREMENT
/begin MEASUREMENT DRV83xxHAL_xRegMapTxBuf[8] "DRV83xxHAL_xRegMapTxBuf[8]" ULONG I_1 1 2 0 4294967295 ECU_ADDRESS 0x70014030 /end MEASUREMENT
/begin MEASUREMENT DRV83xxHAL_xRegMapTxBuf[9] "DRV83xxHAL_xRegMapTxBuf[9]" ULONG I_1 1 2 0 4294967295 ECU_ADDRESS 0x70014034 /end MEASUREMENT
/begin MEASUREMENT DRV83xxRegDriverCur "DRV83xxRegDriverCur" UBYTE I_1 1 2 0 255 ECU_ADDRESS 0x7001400C /end MEASUREMENT
/begin MEASUREMENT ESM_ESM_MODE_FT "ESM_ESM_MODE_FT" UBYTE Bool_ON_OFF 1 2 0 1 BIT_MASK 0x04 ECU_ADDRESS 0x70014764 /end MEASUREMENT
/begin MEASUREMENT ESM_ESM_MODE_NF "ESM_ESM_MODE_NF" UBYTE Bool_ON_OFF 1 2 0 1 BIT_MASK 0x01 ECU_ADDRESS 0x70014764 /end MEASUREMENT
/begin MEASUREMENT ESM_EsmMode "ESM_EsmMode" UWORD ESM_EsmMode_conv 1 2 1 4 ECU_ADDRESS 0x70014764 /end MEASUREMENT
/begin MEASUREMENT ESM_OpFtState "ESM_OpFtState" UWORD I_1 1 2 0 65535 ECU_ADDRESS 0x70014756 /end MEASUREMENT
/begin MEASUREMENT ESM_OpNfState "ESM_OpNfState" UWORD I_1 1 2 0 65535 ECU_ADDRESS 0x70014754 /end MEASUREMENT
/begin MEASUREMENT ESM_PwrLFtState "ESM_PwrLFtState" UWORD I_1 1 2 0 65535 ECU_ADDRESS 0x70014752 /end MEASUREMENT
/begin MEASUREMENT ESM_PwrLNfState "ESM_PwrLNfState" UWORD I_1 1 2 0 65535 ECU_ADDRESS 0x70014750 /end MEASUREMENT
/begin MEASUREMENT ESM_StpIIFtState "ESM_StpIIFtState" UWORD I_1 1 2 0 65535 ECU_ADDRESS 0x7001474A /end MEASUREMENT
/begin MEASUREMENT ESM_StpIINfState "ESM_StpIINfState" UWORD I_1 1 2 0 65535 ECU_ADDRESS 0x70014748 /end MEASUREMENT
/begin MEASUREMENT ESM_StpIState "ESM_StpIState" UWORD I_1 1 2 0 65535 ECU_ADDRESS 0x70014746 /end MEASUREMENT
/begin MEASUREMENT ESM_bAfterrunFin "ESM_bAfterrunFin" UBYTE Bool_ON_OFF 1 2 0 1 BIT_MASK 0x01 ECU_ADDRESS 0x70014762 /end MEASUREMENT
/begin MEASUREMENT ESM_bAfterrunReq "ESM_bAfterrunReq" UBYTE Bool_ON_OFF 1 2 0 1 BIT_MASK 0x01 ECU_ADDRESS 0x70014761 /end MEASUREMENT
/begin MEASUREMENT ESM_bCallAppliOn "ESM_bCallAppliOn" UBYTE Bool_ON_OFF 1 2 0 1 BIT_MASK 0x01 ECU_ADDRESS 0x70014760 /end MEASUREMENT
/begin MEASUREMENT ESM_bMcuEnaReq "ESM_bMcuEnaReq" UBYTE Bool_ON_OFF 1 2 0 1 BIT_MASK 0x01 ECU_ADDRESS 0x7001475F /end MEASUREMENT
/begin MEASUREMENT ESM_bPwrDnReadyFlg "ESM_bPwrDnReadyFlg" UBYTE Bool_ON_OFF 1 2 0 1 BIT_MASK 0x01 ECU_ADDRESS 0x7001475E /end MEASUREMENT
/begin MEASUREMENT ESM_bPwrLNfClrFltFinsh "ESM_bPwrLNfClrFltFinsh" UBYTE Bool_ON_OFF 1 2 0 1 BIT_MASK 0x01 ECU_ADDRESS 0x7001475D /end MEASUREMENT
/begin MEASUREMENT ESM_u16CmdReq "ESM_u16CmdReq" UWORD I_1 1 2 0 65535 ECU_ADDRESS 0x70014744 /end MEASUREMENT
/begin MEASUREMENT ESM_u16CmdReqNm1 "ESM_u16CmdReqNm1" UWORD I_1 1 2 0 65535 ECU_ADDRESS 0x70014742 /end MEASUREMENT
/begin MEASUREMENT ESM_u16CmdRes "ESM_u16CmdRes" UWORD I_1 1 2 0 65535 ECU_ADDRESS 0x70014740 /end MEASUREMENT
/begin MEASUREMENT ESM_u8AllowPwrDnDelay "ESM_u8AllowPwrDnDelay" UBYTE I_1 1 2 0 255 ECU_ADDRESS 0x7001475C /end MEASUREMENT
/begin MEASUREMENT ESM_u8PwrLNfStep "ESM_u8PwrLNfStep" UBYTE I_1 1 2 0 255 ECU_ADDRESS 0x7001475B /end MEASUREMENT
/begin MEASUREMENT ESM_u8PwrOffTim "ESM_u8PwrOffTim" UBYTE I_1 1 2 0 255 ECU_ADDRESS 0x7001475A /end MEASUREMENT
/begin MEASUREMENT ESM_u8RestartDelayCnt "ESM_u8RestartDelayCnt" UBYTE I_1 1 2 0 255 ECU_ADDRESS 0x7001473E /end MEASUREMENT
/begin MEASUREMENT GESM_ESM_MODE_FT "GESM_ESM_MODE_FT" UBYTE Bool_ON_OFF 1 2 0 1 BIT_MASK 0x04 ECU_ADDRESS 0x70014714 /end MEASUREMENT
/begin MEASUREMENT GESM_ESM_MODE_NF "GESM_ESM_MODE_NF" UBYTE Bool_ON_OFF 1 2 0 1 BIT_MASK 0x01 ECU_ADDRESS 0x70014714 /end MEASUREMENT
/begin MEASUREMENT GESM_EsmMode "GESM_EsmMode" UWORD GESM_EsmMode_conv 1 2 1 4 ECU_ADDRESS 0x70014714 /end MEASUREMENT
/begin MEASUREMENT GESM_OpFtState "GESM_OpFtState" UWORD I_1 1 2 0 65535 ECU_ADDRESS 0x70014708 /end MEASUREMENT
/begin MEASUREMENT GESM_OpNfState "GESM_OpNfState" UWORD I_1 1 2 0 65535 ECU_ADDRESS 0x70014706 /end MEASUREMENT
/begin MEASUREMENT GESM_PwrLFtState "GESM_PwrLFtState" UWORD I_1 1 2 0 65535 ECU_ADDRESS 0x70014704 /end MEASUREMENT
/begin MEASUREMENT GESM_PwrLNfState "GESM_PwrLNfState" UWORD I_1 1 2 0 65535 ECU_ADDRESS 0x70014702 /end MEASUREMENT
/begin MEASUREMENT GESM_StpIIFtState "GESM_StpIIFtState" UWORD I_1 1 2 0 65535 ECU_ADDRESS 0x700146FC /end MEASUREMENT
/begin MEASUREMENT GESM_StpIINfState "GESM_StpIINfState" UWORD I_1 1 2 0 65535 ECU_ADDRESS 0x700146FA /end MEASUREMENT
/begin MEASUREMENT GESM_StpIState "GESM_StpIState" UWORD I_1 1 2 0 65535 ECU_ADDRESS 0x700146F8 /end MEASUREMENT
/begin MEASUREMENT GESM_bAfterrunFin "GESM_bAfterrunFin" UBYTE Bool_ON_OFF 1 2 0 1 BIT_MASK 0x01 ECU_ADDRESS 0x70014712 /end MEASUREMENT
/begin MEASUREMENT GESM_bAfterrunReq "GESM_bAfterrunReq" UBYTE Bool_ON_OFF 1 2 0 1 BIT_MASK 0x01 ECU_ADDRESS 0x70014711 /end MEASUREMENT
/begin MEASUREMENT GESM_bCallAppliOn "GESM_bCallAppliOn" UBYTE Bool_ON_OFF 1 2 0 1 BIT_MASK 0x01 ECU_ADDRESS 0x70014710 /end MEASUREMENT
/begin MEASUREMENT GESM_bMcuEnaReq "GESM_bMcuEnaReq" UBYTE Bool_ON_OFF 1 2 0 1 BIT_MASK 0x01 ECU_ADDRESS 0x7001470F /end MEASUREMENT
/begin MEASUREMENT GESM_bPwrDnReadyFlg "GESM_bPwrDnReadyFlg" UBYTE Bool_ON_OFF 1 2 0 1 BIT_MASK 0x01 ECU_ADDRESS 0x7001470E /end MEASUREMENT
/begin MEASUREMENT GESM_bPwrLNfClrFltFinsh "GESM_bPwrLNfClrFltFinsh" UBYTE Bool_ON_OFF 1 2 0 1 BIT_MASK 0x01 ECU_ADDRESS 0x7001470D /end MEASUREMENT
/begin MEASUREMENT GESM_u16AfterrunCnt "GESM_u16AfterrunCnt" UWORD I_1 1 2 0 65535 ECU_ADDRESS 0x700146F6 /end MEASUREMENT
/begin MEASUREMENT GESM_u16CmdReq "GESM_u16CmdReq" UWORD I_1 1 2 0 65535 ECU_ADDRESS 0x700146F4 /end MEASUREMENT
/begin MEASUREMENT GESM_u16CmdReqNm1 "GESM_u16CmdReqNm1" UWORD I_1 1 2 0 65535 ECU_ADDRESS 0x700146F2 /end MEASUREMENT
/begin MEASUREMENT GESM_u16CmdRes "GESM_u16CmdRes" UWORD I_1 1 2 0 65535 ECU_ADDRESS 0x700146F0 /end MEASUREMENT
/begin MEASUREMENT GESM_u8AllowPwrDnDelay "GESM_u8AllowPwrDnDelay" UBYTE I_1 1 2 0 255 ECU_ADDRESS 0x7001470C /end MEASUREMENT
/begin MEASUREMENT GESM_u8PwrLNfStep "GESM_u8PwrLNfStep" UBYTE I_1 1 2 0 255 ECU_ADDRESS 0x7001470B /end MEASUREMENT
/begin MEASUREMENT GESM_u8PwrOffTim "GESM_u8PwrOffTim" UBYTE I_1 1 2 0 255 ECU_ADDRESS 0x7001470A /end MEASUREMENT
/begin MEASUREMENT GESM_u8RestartDelayCnt "GESM_u8RestartDelayCnt" UBYTE I_1 1 2 0 255 ECU_ADDRESS 0x700146EE /end MEASUREMENT
/begin MEASUREMENT Reg_Map_Cache "Reg_Map_Cache" UBYTE I_1 1 2 0 255 MATRIX_DIM 18 1 1 ECU_ADDRESS 0x70013FF8 /end MEASUREMENT
/begin MEASUREMENT Reg_Map_Cache[0] "Reg_Map_Cache[0]" UBYTE I_1 1 2 0 255 ECU_ADDRESS 0x70013FF8 /end MEASUREMENT
/begin MEASUREMENT Reg_Map_Cache[10] "Reg_Map_Cache[10]" UBYTE I_1 1 2 0 255 ECU_ADDRESS 0x70014002 /end MEASUREMENT
/begin MEASUREMENT Reg_Map_Cache[11] "Reg_Map_Cache[11]" UBYTE I_1 1 2 0 255 ECU_ADDRESS 0x70014003 /end MEASUREMENT
/begin MEASUREMENT Reg_Map_Cache[12] "Reg_Map_Cache[12]" UBYTE I_1 1 2 0 255 ECU_ADDRESS 0x70014004 /end MEASUREMENT
/begin MEASUREMENT Reg_Map_Cache[13] "Reg_Map_Cache[13]" UBYTE I_1 1 2 0 255 ECU_ADDRESS 0x70014005 /end MEASUREMENT
/begin MEASUREMENT Reg_Map_Cache[14] "Reg_Map_Cache[14]" UBYTE I_1 1 2 0 255 ECU_ADDRESS 0x70014006 /end MEASUREMENT
/begin MEASUREMENT Reg_Map_Cache[15] "Reg_Map_Cache[15]" UBYTE I_1 1 2 0 255 ECU_ADDRESS 0x70014007 /end MEASUREMENT
/begin MEASUREMENT Reg_Map_Cache[16] "Reg_Map_Cache[16]" UBYTE I_1 1 2 0 255 ECU_ADDRESS 0x70014008 /end MEASUREMENT
/begin MEASUREMENT Reg_Map_Cache[17] "Reg_Map_Cache[17]" UBYTE I_1 1 2 0 255 ECU_ADDRESS 0x70014009 /end MEASUREMENT
/begin MEASUREMENT Reg_Map_Cache[1] "Reg_Map_Cache[1]" UBYTE I_1 1 2 0 255 ECU_ADDRESS 0x70013FF9 /end MEASUREMENT
/begin MEASUREMENT Reg_Map_Cache[2] "Reg_Map_Cache[2]" UBYTE I_1 1 2 0 255 ECU_ADDRESS 0x70013FFA /end MEASUREMENT
/begin MEASUREMENT Reg_Map_Cache[3] "Reg_Map_Cache[3]" UBYTE I_1 1 2 0 255 ECU_ADDRESS 0x70013FFB /end MEASUREMENT
/begin MEASUREMENT Reg_Map_Cache[4] "Reg_Map_Cache[4]" UBYTE I_1 1 2 0 255 ECU_ADDRESS 0x70013FFC /end MEASUREMENT
/begin MEASUREMENT Reg_Map_Cache[5] "Reg_Map_Cache[5]" UBYTE I_1 1 2 0 255 ECU_ADDRESS 0x70013FFD /end MEASUREMENT
/begin MEASUREMENT Reg_Map_Cache[6] "Reg_Map_Cache[6]" UBYTE I_1 1 2 0 255 ECU_ADDRESS 0x70013FFE /end MEASUREMENT
/begin MEASUREMENT Reg_Map_Cache[7] "Reg_Map_Cache[7]" UBYTE I_1 1 2 0 255 ECU_ADDRESS 0x70013FFF /end MEASUREMENT
/begin MEASUREMENT Reg_Map_Cache[8] "Reg_Map_Cache[8]" UBYTE I_1 1 2 0 255 ECU_ADDRESS 0x70014000 /end MEASUREMENT
/begin MEASUREMENT Reg_Map_Cache[9] "Reg_Map_Cache[9]" UBYTE I_1 1 2 0 255 ECU_ADDRESS 0x70014001 /end MEASUREMENT
/begin MEASUREMENT Rte_ModeCurrent_0 "..." UBYTE I_1 1 2 0 255 ECU_ADDRESS 0x70001AE0 /end MEASUREMENT
/begin MEASUREMENT Rte_ModeCurrent_4 "..." UBYTE I_1 1 2 0 255 ECU_ADDRESS 0x70014E16 /end MEASUREMENT
/begin MEASUREMENT SBC_au16StatusRegsNvm "SBC_au16StatusRegsNvm" UWORD I_27 1 2 0 65535 MATRIX_DIM 18 1 1 ECU_ADDRESS 0x7001468E /end MEASUREMENT
/begin MEASUREMENT SBC_au16StatusRegsNvm[0] "SBC_au16StatusRegsNvm[0]" UWORD I_27 1 2 0 65535 ECU_ADDRESS 0x7001468E /end MEASUREMENT
/begin MEASUREMENT SBC_au16StatusRegsNvm[10] "SBC_au16StatusRegsNvm[10]" UWORD I_27 1 2 0 65535 ECU_ADDRESS 0x700146A2 /end MEASUREMENT
/begin MEASUREMENT SBC_au16StatusRegsNvm[11] "SBC_au16StatusRegsNvm[11]" UWORD I_27 1 2 0 65535 ECU_ADDRESS 0x700146A4 /end MEASUREMENT
/begin MEASUREMENT SBC_au16StatusRegsNvm[12] "SBC_au16StatusRegsNvm[12]" UWORD I_27 1 2 0 65535 ECU_ADDRESS 0x700146A6 /end MEASUREMENT
/begin MEASUREMENT SBC_au16StatusRegsNvm[13] "SBC_au16StatusRegsNvm[13]" UWORD I_27 1 2 0 65535 ECU_ADDRESS 0x700146A8 /end MEASUREMENT
/begin MEASUREMENT SBC_au16StatusRegsNvm[14] "SBC_au16StatusRegsNvm[14]" UWORD I_27 1 2 0 65535 ECU_ADDRESS 0x700146AA /end MEASUREMENT
/begin MEASUREMENT SBC_au16StatusRegsNvm[15] "SBC_au16StatusRegsNvm[15]" UWORD I_27 1 2 0 65535 ECU_ADDRESS 0x700146AC /end MEASUREMENT
/begin MEASUREMENT SBC_au16StatusRegsNvm[16] "SBC_au16StatusRegsNvm[16]" UWORD I_27 1 2 0 65535 ECU_ADDRESS 0x700146AE /end MEASUREMENT
/begin MEASUREMENT SBC_au16StatusRegsNvm[17] "SBC_au16StatusRegsNvm[17]" UWORD I_27 1 2 0 65535 ECU_ADDRESS 0x700146B0 /end MEASUREMENT
/begin MEASUREMENT SBC_au16StatusRegsNvm[1] "SBC_au16StatusRegsNvm[1]" UWORD I_27 1 2 0 65535 ECU_ADDRESS 0x70014690 /end MEASUREMENT
/begin MEASUREMENT SBC_au16StatusRegsNvm[2] "SBC_au16StatusRegsNvm[2]" UWORD I_27 1 2 0 65535 ECU_ADDRESS 0x70014692 /end MEASUREMENT
/begin MEASUREMENT SBC_au16StatusRegsNvm[3] "SBC_au16StatusRegsNvm[3]" UWORD I_27 1 2 0 65535 ECU_ADDRESS 0x70014694 /end MEASUREMENT
/begin MEASUREMENT SBC_au16StatusRegsNvm[4] "SBC_au16StatusRegsNvm[4]" UWORD I_27 1 2 0 65535 ECU_ADDRESS 0x70014696 /end MEASUREMENT
/begin MEASUREMENT SBC_au16StatusRegsNvm[5] "SBC_au16StatusRegsNvm[5]" UWORD I_27 1 2 0 65535 ECU_ADDRESS 0x70014698 /end MEASUREMENT
/begin MEASUREMENT SBC_au16StatusRegsNvm[6] "SBC_au16StatusRegsNvm[6]" UWORD I_27 1 2 0 65535 ECU_ADDRESS 0x7001469A /end MEASUREMENT
/begin MEASUREMENT SBC_au16StatusRegsNvm[7] "SBC_au16StatusRegsNvm[7]" UWORD I_27 1 2 0 65535 ECU_ADDRESS 0x7001469C /end MEASUREMENT
/begin MEASUREMENT SBC_au16StatusRegsNvm[8] "SBC_au16StatusRegsNvm[8]" UWORD I_27 1 2 0 65535 ECU_ADDRESS 0x7001469E /end MEASUREMENT
/begin MEASUREMENT SBC_au16StatusRegsNvm[9] "SBC_au16StatusRegsNvm[9]" UWORD I_27 1 2 0 65535 ECU_ADDRESS 0x700146A0 /end MEASUREMENT
/begin MEASUREMENT SBC_bDeintWdgCmd "SBC_bDeintWdgCmd" UBYTE Bool_ON_OFF 1 2 0 1 BIT_MASK 0x01 ECU_ADDRESS 0x7001463C /end MEASUREMENT
/begin MEASUREMENT SBC_bOtherSttFailFlg "SBC_bOtherSttFailFlg" UBYTE Bool_ON_OFF 1 2 0 1 BIT_MASK 0x01 ECU_ADDRESS 0x70014630 /end MEASUREMENT
/begin MEASUREMENT SBC_f32BatteryVoltage "SBC_f32BatteryVoltage" FLOAT32_IEEE I_28 1 2 -3.402823466E+038 3.402823466E+038 ECU_ADDRESS 0x70014634 /end MEASUREMENT
/begin MEASUREMENT SBC_f32BkpVoltage "SBC_f32BkpVoltage" FLOAT32_IEEE I_28 1 2 -3.402823466E+038 3.402823466E+038 ECU_ADDRESS 0x7001462C /end MEASUREMENT
/begin MEASUREMENT SBC_u16GatewayRaw "SBC_u16GatewayRaw" UWORD I_1 1 2 0 65535 ECU_ADDRESS 0x7001468A /end MEASUREMENT
/begin MEASUREMENT SBC_u16IntUvTimCnt "SBC_u16IntUvTimCnt" UWORD I_1 1 2 0 65535 ECU_ADDRESS 0x70014682 /end MEASUREMENT
/begin MEASUREMENT SBC_u16MainSupRaw "SBC_u16MainSupRaw" UWORD I_1 1 2 0 65535 ECU_ADDRESS 0x70014688 /end MEASUREMENT
/begin MEASUREMENT SBC_u16OtherAbnormCnt "SBC_u16OtherAbnormCnt" UWORD I_1 1 2 0 65535 ECU_ADDRESS 0x70014680 /end MEASUREMENT
/begin MEASUREMENT SBC_u16P5vAD2SRaw "SBC_u16P5vAD2SRaw" UWORD I_1 1 2 0 65535 ECU_ADDRESS 0x7001468C /end MEASUREMENT
/begin MEASUREMENT SBC_u16P5vRefProtRaw "SBC_u16P5vRefProtRaw" UWORD I_1 1 2 0 65535 ECU_ADDRESS 0x70014686 /end MEASUREMENT
/begin MEASUREMENT SPY_bBufFull "SPY_bBufFull" UBYTE Bool_ON_OFF 1 2 0 1 BIT_MASK 0x01 ECU_ADDRESS 0x70012108 /end MEASUREMENT
/begin MEASUREMENT SPY_u16DaqListFirstElmIdx "SPY_u16DaqListFirstElmIdx" UWORD I_1 1 2 0 65535 ECU_ADDRESS 0x70012106 /end MEASUREMENT
/begin MEASUREMENT SPY_u16NrOfElmsToTx "SPY_u16NrOfElmsToTx" UWORD I_1 1 2 0 65535 ECU_ADDRESS 0x70012104 /end MEASUREMENT
/begin MEASUREMENT SPY_u16PreTrigSmplIdx "SPY_u16PreTrigSmplIdx" UWORD I_1 1 2 0 65535 ECU_ADDRESS 0x70012102 /end MEASUREMENT
/begin MEASUREMENT SPY_u16RmngSmplIdx "SPY_u16RmngSmplIdx" UWORD I_1 1 2 0 65535 ECU_ADDRESS 0x70012100 /end MEASUREMENT
/begin MEASUREMENT SPY_u16SmplIdx "SPY_u16SmplIdx" UWORD I_1 1 2 0 65535 ECU_ADDRESS 0x700120FE /end MEASUREMENT
/begin MEASUREMENT SPY_u16TrigSmplIdx "SPY_u16TrigSmplIdx" UWORD I_1 1 2 0 65535 ECU_ADDRESS 0x700120FC /end MEASUREMENT
/begin MEASUREMENT TLE9180_af32ReadPhsTempPhys "TLE9180_af32ReadPhsTempPhys" FLOAT32_IEEE I_1 1 2 -3.402823466E+038 3.402823466E+038 MATRIX_DIM 6 1 1 ECU_ADDRESS 0x70014484 /end MEASUREMENT
/begin MEASUREMENT TLE9180_af32ReadPhsTempPhys[0] "TLE9180_af32ReadPhsTempPhys[0]" FLOAT32_IEEE I_1 1 2 -3.402823466E+038 3.402823466E+038 ECU_ADDRESS 0x70014484 /end MEASUREMENT
/begin MEASUREMENT TLE9180_af32ReadPhsTempPhys[1] "TLE9180_af32ReadPhsTempPhys[1]" FLOAT32_IEEE I_1 1 2 -3.402823466E+038 3.402823466E+038 ECU_ADDRESS 0x70014488 /end MEASUREMENT
/begin MEASUREMENT TLE9180_af32ReadPhsTempPhys[2] "TLE9180_af32ReadPhsTempPhys[2]" FLOAT32_IEEE I_1 1 2 -3.402823466E+038 3.402823466E+038 ECU_ADDRESS 0x7001448C /end MEASUREMENT
/begin MEASUREMENT TLE9180_af32ReadPhsTempPhys[3] "TLE9180_af32ReadPhsTempPhys[3]" FLOAT32_IEEE I_1 1 2 -3.402823466E+038 3.402823466E+038 ECU_ADDRESS 0x70014490 /end MEASUREMENT
/begin MEASUREMENT TLE9180_af32ReadPhsTempPhys[4] "TLE9180_af32ReadPhsTempPhys[4]" FLOAT32_IEEE I_1 1 2 -3.402823466E+038 3.402823466E+038 ECU_ADDRESS 0x70014494 /end MEASUREMENT
/begin MEASUREMENT TLE9180_af32ReadPhsTempPhys[5] "TLE9180_af32ReadPhsTempPhys[5]" FLOAT32_IEEE I_1 1 2 -3.402823466E+038 3.402823466E+038 ECU_ADDRESS 0x70014498 /end MEASUREMENT
/begin MEASUREMENT TLE9180_au32SpiReadFrame "TLE9180_au32SpiReadFrame" ULONG I_1 1 2 0 4294967295 MATRIX_DIM 30 1 1 ECU_ADDRESS 0x70014404 /end MEASUREMENT
/begin MEASUREMENT TLE9180_au32SpiReadFrame[0] "TLE9180_au32SpiReadFrame[0]" ULONG I_1 1 2 0 4294967295 ECU_ADDRESS 0x70014404 /end MEASUREMENT
/begin MEASUREMENT TLE9180_au32SpiReadFrame[10] "TLE9180_au32SpiReadFrame[10]" ULONG I_1 1 2 0 4294967295 ECU_ADDRESS 0x7001442C /end MEASUREMENT
/begin MEASUREMENT TLE9180_au32SpiReadFrame[11] "TLE9180_au32SpiReadFrame[11]" ULONG I_1 1 2 0 4294967295 ECU_ADDRESS 0x70014430 /end MEASUREMENT
/begin MEASUREMENT TLE9180_au32SpiReadFrame[12] "TLE9180_au32SpiReadFrame[12]" ULONG I_1 1 2 0 4294967295 ECU_ADDRESS 0x70014434 /end MEASUREMENT
/begin MEASUREMENT TLE9180_au32SpiReadFrame[13] "TLE9180_au32SpiReadFrame[13]" ULONG I_1 1 2 0 4294967295 ECU_ADDRESS 0x70014438 /end MEASUREMENT
/begin MEASUREMENT TLE9180_au32SpiReadFrame[14] "TLE9180_au32SpiReadFrame[14]" ULONG I_1 1 2 0 4294967295 ECU_ADDRESS 0x7001443C /end MEASUREMENT
/begin MEASUREMENT TLE9180_au32SpiReadFrame[15] "TLE9180_au32SpiReadFrame[15]" ULONG I_1 1 2 0 4294967295 ECU_ADDRESS 0x70014440 /end MEASUREMENT
/begin MEASUREMENT TLE9180_au32SpiReadFrame[16] "TLE9180_au32SpiReadFrame[16]" ULONG I_1 1 2 0 4294967295 ECU_ADDRESS 0x70014444 /end MEASUREMENT
/begin MEASUREMENT TLE9180_au32SpiReadFrame[17] "TLE9180_au32SpiReadFrame[17]" ULONG I_1 1 2 0 4294967295 ECU_ADDRESS 0x70014448 /end MEASUREMENT
/begin MEASUREMENT TLE9180_au32SpiReadFrame[18] "TLE9180_au32SpiReadFrame[18]" ULONG I_1 1 2 0 4294967295 ECU_ADDRESS 0x7001444C /end MEASUREMENT
/begin MEASUREMENT TLE9180_au32SpiReadFrame[19] "TLE9180_au32SpiReadFrame[19]" ULONG I_1 1 2 0 4294967295 ECU_ADDRESS 0x70014450 /end MEASUREMENT
/begin MEASUREMENT TLE9180_au32SpiReadFrame[1] "TLE9180_au32SpiReadFrame[1]" ULONG I_1 1 2 0 4294967295 ECU_ADDRESS 0x70014408 /end MEASUREMENT
/begin MEASUREMENT TLE9180_au32SpiReadFrame[20] "TLE9180_au32SpiReadFrame[20]" ULONG I_1 1 2 0 4294967295 ECU_ADDRESS 0x70014454 /end MEASUREMENT
/begin MEASUREMENT TLE9180_au32SpiReadFrame[21] "TLE9180_au32SpiReadFrame[21]" ULONG I_1 1 2 0 4294967295 ECU_ADDRESS 0x70014458 /end MEASUREMENT
/begin MEASUREMENT TLE9180_au32SpiReadFrame[22] "TLE9180_au32SpiReadFrame[22]" ULONG I_1 1 2 0 4294967295 ECU_ADDRESS 0x7001445C /end MEASUREMENT
/begin MEASUREMENT TLE9180_au32SpiReadFrame[23] "TLE9180_au32SpiReadFrame[23]" ULONG I_1 1 2 0 4294967295 ECU_ADDRESS 0x70014460 /end MEASUREMENT
/begin MEASUREMENT TLE9180_au32SpiReadFrame[24] "TLE9180_au32SpiReadFrame[24]" ULONG I_1 1 2 0 4294967295 ECU_ADDRESS 0x70014464 /end MEASUREMENT
/begin MEASUREMENT TLE9180_au32SpiReadFrame[25] "TLE9180_au32SpiReadFrame[25]" ULONG I_1 1 2 0 4294967295 ECU_ADDRESS 0x70014468 /end MEASUREMENT
/begin MEASUREMENT TLE9180_au32SpiReadFrame[26] "TLE9180_au32SpiReadFrame[26]" ULONG I_1 1 2 0 4294967295 ECU_ADDRESS 0x7001446C /end MEASUREMENT
/begin MEASUREMENT TLE9180_au32SpiReadFrame[27] "TLE9180_au32SpiReadFrame[27]" ULONG I_1 1 2 0 4294967295 ECU_ADDRESS 0x70014470 /end MEASUREMENT
/begin MEASUREMENT TLE9180_au32SpiReadFrame[28] "TLE9180_au32SpiReadFrame[28]" ULONG I_1 1 2 0 4294967295 ECU_ADDRESS 0x70014474 /end MEASUREMENT
/begin MEASUREMENT TLE9180_au32SpiReadFrame[29] "TLE9180_au32SpiReadFrame[29]" ULONG I_1 1 2 0 4294967295 ECU_ADDRESS 0x70014478 /end MEASUREMENT
/begin MEASUREMENT TLE9180_au32SpiReadFrame[2] "TLE9180_au32SpiReadFrame[2]" ULONG I_1 1 2 0 4294967295 ECU_ADDRESS 0x7001440C /end MEASUREMENT
/begin MEASUREMENT TLE9180_au32SpiReadFrame[3] "TLE9180_au32SpiReadFrame[3]" ULONG I_1 1 2 0 4294967295 ECU_ADDRESS 0x70014410 /end MEASUREMENT
/begin MEASUREMENT TLE9180_au32SpiReadFrame[4] "TLE9180_au32SpiReadFrame[4]" ULONG I_1 1 2 0 4294967295 ECU_ADDRESS 0x70014414 /end MEASUREMENT
/begin MEASUREMENT TLE9180_au32SpiReadFrame[5] "TLE9180_au32SpiReadFrame[5]" ULONG I_1 1 2 0 4294967295 ECU_ADDRESS 0x70014418 /end MEASUREMENT
/begin MEASUREMENT TLE9180_au32SpiReadFrame[6] "TLE9180_au32SpiReadFrame[6]" ULONG I_1 1 2 0 4294967295 ECU_ADDRESS 0x7001441C /end MEASUREMENT
/begin MEASUREMENT TLE9180_au32SpiReadFrame[7] "TLE9180_au32SpiReadFrame[7]" ULONG I_1 1 2 0 4294967295 ECU_ADDRESS 0x70014420 /end MEASUREMENT
/begin MEASUREMENT TLE9180_au32SpiReadFrame[8] "TLE9180_au32SpiReadFrame[8]" ULONG I_1 1 2 0 4294967295 ECU_ADDRESS 0x70014424 /end MEASUREMENT
/begin MEASUREMENT TLE9180_au32SpiReadFrame[9] "TLE9180_au32SpiReadFrame[9]" ULONG I_1 1 2 0 4294967295 ECU_ADDRESS 0x70014428 /end MEASUREMENT
/begin MEASUREMENT TLE9180_au32SpiWriteFrame "TLE9180_au32SpiWriteFrame" ULONG I_1 1 2 0 4294967295 MATRIX_DIM 30 1 1 ECU_ADDRESS 0x70014224 /end MEASUREMENT
/begin MEASUREMENT TLE9180_au32SpiWriteFrame[0] "TLE9180_au32SpiWriteFrame[0]" ULONG I_1 1 2 0 4294967295 ECU_ADDRESS 0x70014224 /end MEASUREMENT
/begin MEASUREMENT TLE9180_au32SpiWriteFrame[10] "TLE9180_au32SpiWriteFrame[10]" ULONG I_1 1 2 0 4294967295 ECU_ADDRESS 0x7001424C /end MEASUREMENT
/begin MEASUREMENT TLE9180_au32SpiWriteFrame[11] "TLE9180_au32SpiWriteFrame[11]" ULONG I_1 1 2 0 4294967295 ECU_ADDRESS 0x70014250 /end MEASUREMENT
/begin MEASUREMENT TLE9180_au32SpiWriteFrame[12] "TLE9180_au32SpiWriteFrame[12]" ULONG I_1 1 2 0 4294967295 ECU_ADDRESS 0x70014254 /end MEASUREMENT
/begin MEASUREMENT TLE9180_au32SpiWriteFrame[13] "TLE9180_au32SpiWriteFrame[13]" ULONG I_1 1 2 0 4294967295 ECU_ADDRESS 0x70014258 /end MEASUREMENT
/begin MEASUREMENT TLE9180_au32SpiWriteFrame[14] "TLE9180_au32SpiWriteFrame[14]" ULONG I_1 1 2 0 4294967295 ECU_ADDRESS 0x7001425C /end MEASUREMENT
/begin MEASUREMENT TLE9180_au32SpiWriteFrame[15] "TLE9180_au32SpiWriteFrame[15]" ULONG I_1 1 2 0 4294967295 ECU_ADDRESS 0x70014260 /end MEASUREMENT
/begin MEASUREMENT TLE9180_au32SpiWriteFrame[16] "TLE9180_au32SpiWriteFrame[16]" ULONG I_1 1 2 0 4294967295 ECU_ADDRESS 0x70014264 /end MEASUREMENT
/begin MEASUREMENT TLE9180_au32SpiWriteFrame[17] "TLE9180_au32SpiWriteFrame[17]" ULONG I_1 1 2 0 4294967295 ECU_ADDRESS 0x70014268 /end MEASUREMENT
/begin MEASUREMENT TLE9180_au32SpiWriteFrame[18] "TLE9180_au32SpiWriteFrame[18]" ULONG I_1 1 2 0 4294967295 ECU_ADDRESS 0x7001426C /end MEASUREMENT
/begin MEASUREMENT TLE9180_au32SpiWriteFrame[19] "TLE9180_au32SpiWriteFrame[19]" ULONG I_1 1 2 0 4294967295 ECU_ADDRESS 0x70014270 /end MEASUREMENT
/begin MEASUREMENT TLE9180_au32SpiWriteFrame[1] "TLE9180_au32SpiWriteFrame[1]" ULONG I_1 1 2 0 4294967295 ECU_ADDRESS 0x70014228 /end MEASUREMENT
/begin MEASUREMENT TLE9180_au32SpiWriteFrame[20] "TLE9180_au32SpiWriteFrame[20]" ULONG I_1 1 2 0 4294967295 ECU_ADDRESS 0x70014274 /end MEASUREMENT
/begin MEASUREMENT TLE9180_au32SpiWriteFrame[21] "TLE9180_au32SpiWriteFrame[21]" ULONG I_1 1 2 0 4294967295 ECU_ADDRESS 0x70014278 /end MEASUREMENT
/begin MEASUREMENT TLE9180_au32SpiWriteFrame[22] "TLE9180_au32SpiWriteFrame[22]" ULONG I_1 1 2 0 4294967295 ECU_ADDRESS 0x7001427C /end MEASUREMENT
/begin MEASUREMENT TLE9180_au32SpiWriteFrame[23] "TLE9180_au32SpiWriteFrame[23]" ULONG I_1 1 2 0 4294967295 ECU_ADDRESS 0x70014280 /end MEASUREMENT
/begin MEASUREMENT TLE9180_au32SpiWriteFrame[24] "TLE9180_au32SpiWriteFrame[24]" ULONG I_1 1 2 0 4294967295 ECU_ADDRESS 0x70014284 /end MEASUREMENT
/begin MEASUREMENT TLE9180_au32SpiWriteFrame[25] "TLE9180_au32SpiWriteFrame[25]" ULONG I_1 1 2 0 4294967295 ECU_ADDRESS 0x70014288 /end MEASUREMENT
/begin MEASUREMENT TLE9180_au32SpiWriteFrame[26] "TLE9180_au32SpiWriteFrame[26]" ULONG I_1 1 2 0 4294967295 ECU_ADDRESS 0x7001428C /end MEASUREMENT
/begin MEASUREMENT TLE9180_au32SpiWriteFrame[27] "TLE9180_au32SpiWriteFrame[27]" ULONG I_1 1 2 0 4294967295 ECU_ADDRESS 0x70014290 /end MEASUREMENT
/begin MEASUREMENT TLE9180_au32SpiWriteFrame[28] "TLE9180_au32SpiWriteFrame[28]" ULONG I_1 1 2 0 4294967295 ECU_ADDRESS 0x70014294 /end MEASUREMENT
/begin MEASUREMENT TLE9180_au32SpiWriteFrame[29] "TLE9180_au32SpiWriteFrame[29]" ULONG I_1 1 2 0 4294967295 ECU_ADDRESS 0x70014298 /end MEASUREMENT
/begin MEASUREMENT TLE9180_au32SpiWriteFrame[2] "TLE9180_au32SpiWriteFrame[2]" ULONG I_1 1 2 0 4294967295 ECU_ADDRESS 0x7001422C /end MEASUREMENT
/begin MEASUREMENT TLE9180_au32SpiWriteFrame[3] "TLE9180_au32SpiWriteFrame[3]" ULONG I_1 1 2 0 4294967295 ECU_ADDRESS 0x70014230 /end MEASUREMENT
/begin MEASUREMENT TLE9180_au32SpiWriteFrame[4] "TLE9180_au32SpiWriteFrame[4]" ULONG I_1 1 2 0 4294967295 ECU_ADDRESS 0x70014234 /end MEASUREMENT
/begin MEASUREMENT TLE9180_au32SpiWriteFrame[5] "TLE9180_au32SpiWriteFrame[5]" ULONG I_1 1 2 0 4294967295 ECU_ADDRESS 0x70014238 /end MEASUREMENT
/begin MEASUREMENT TLE9180_au32SpiWriteFrame[6] "TLE9180_au32SpiWriteFrame[6]" ULONG I_1 1 2 0 4294967295 ECU_ADDRESS 0x7001423C /end MEASUREMENT
/begin MEASUREMENT TLE9180_au32SpiWriteFrame[7] "TLE9180_au32SpiWriteFrame[7]" ULONG I_1 1 2 0 4294967295 ECU_ADDRESS 0x70014240 /end MEASUREMENT
/begin MEASUREMENT TLE9180_au32SpiWriteFrame[8] "TLE9180_au32SpiWriteFrame[8]" ULONG I_1 1 2 0 4294967295 ECU_ADDRESS 0x70014244 /end MEASUREMENT
/begin MEASUREMENT TLE9180_au32SpiWriteFrame[9] "TLE9180_au32SpiWriteFrame[9]" ULONG I_1 1 2 0 4294967295 ECU_ADDRESS 0x70014248 /end MEASUREMENT
/begin MEASUREMENT TLE9180_au8CfgRegReadBk "TLE9180_au8CfgRegReadBk" UBYTE I_1 1 2 0 255 MATRIX_DIM 30 1 1 ECU_ADDRESS 0x700140F8 /end MEASUREMENT
/begin MEASUREMENT TLE9180_au8CfgRegReadBk[0] "TLE9180_au8CfgRegReadBk[0]" UBYTE I_1 1 2 0 255 ECU_ADDRESS 0x700140F8 /end MEASUREMENT
/begin MEASUREMENT TLE9180_au8CfgRegReadBk[10] "TLE9180_au8CfgRegReadBk[10]" UBYTE I_1 1 2 0 255 ECU_ADDRESS 0x70014102 /end MEASUREMENT
/begin MEASUREMENT TLE9180_au8CfgRegReadBk[11] "TLE9180_au8CfgRegReadBk[11]" UBYTE I_1 1 2 0 255 ECU_ADDRESS 0x70014103 /end MEASUREMENT
/begin MEASUREMENT TLE9180_au8CfgRegReadBk[12] "TLE9180_au8CfgRegReadBk[12]" UBYTE I_1 1 2 0 255 ECU_ADDRESS 0x70014104 /end MEASUREMENT
/begin MEASUREMENT TLE9180_au8CfgRegReadBk[13] "TLE9180_au8CfgRegReadBk[13]" UBYTE I_1 1 2 0 255 ECU_ADDRESS 0x70014105 /end MEASUREMENT
/begin MEASUREMENT TLE9180_au8CfgRegReadBk[14] "TLE9180_au8CfgRegReadBk[14]" UBYTE I_1 1 2 0 255 ECU_ADDRESS 0x70014106 /end MEASUREMENT
/begin MEASUREMENT TLE9180_au8CfgRegReadBk[15] "TLE9180_au8CfgRegReadBk[15]" UBYTE I_1 1 2 0 255 ECU_ADDRESS 0x70014107 /end MEASUREMENT
/begin MEASUREMENT TLE9180_au8CfgRegReadBk[16] "TLE9180_au8CfgRegReadBk[16]" UBYTE I_1 1 2 0 255 ECU_ADDRESS 0x70014108 /end MEASUREMENT
/begin MEASUREMENT TLE9180_au8CfgRegReadBk[17] "TLE9180_au8CfgRegReadBk[17]" UBYTE I_1 1 2 0 255 ECU_ADDRESS 0x70014109 /end MEASUREMENT
/begin MEASUREMENT TLE9180_au8CfgRegReadBk[18] "TLE9180_au8CfgRegReadBk[18]" UBYTE I_1 1 2 0 255 ECU_ADDRESS 0x7001410A /end MEASUREMENT
/begin MEASUREMENT TLE9180_au8CfgRegReadBk[19] "TLE9180_au8CfgRegReadBk[19]" UBYTE I_1 1 2 0 255 ECU_ADDRESS 0x7001410B /end MEASUREMENT
/begin MEASUREMENT TLE9180_au8CfgRegReadBk[1] "TLE9180_au8CfgRegReadBk[1]" UBYTE I_1 1 2 0 255 ECU_ADDRESS 0x700140F9 /end MEASUREMENT
/begin MEASUREMENT TLE9180_au8CfgRegReadBk[20] "TLE9180_au8CfgRegReadBk[20]" UBYTE I_1 1 2 0 255 ECU_ADDRESS 0x7001410C /end MEASUREMENT
/begin MEASUREMENT TLE9180_au8CfgRegReadBk[21] "TLE9180_au8CfgRegReadBk[21]" UBYTE I_1 1 2 0 255 ECU_ADDRESS 0x7001410D /end MEASUREMENT
/begin MEASUREMENT TLE9180_au8CfgRegReadBk[22] "TLE9180_au8CfgRegReadBk[22]" UBYTE I_1 1 2 0 255 ECU_ADDRESS 0x7001410E /end MEASUREMENT
/begin MEASUREMENT TLE9180_au8CfgRegReadBk[23] "TLE9180_au8CfgRegReadBk[23]" UBYTE I_1 1 2 0 255 ECU_ADDRESS 0x7001410F /end MEASUREMENT
/begin MEASUREMENT TLE9180_au8CfgRegReadBk[24] "TLE9180_au8CfgRegReadBk[24]" UBYTE I_1 1 2 0 255 ECU_ADDRESS 0x70014110 /end MEASUREMENT
/begin MEASUREMENT TLE9180_au8CfgRegReadBk[25] "TLE9180_au8CfgRegReadBk[25]" UBYTE I_1 1 2 0 255 ECU_ADDRESS 0x70014111 /end MEASUREMENT
/begin MEASUREMENT TLE9180_au8CfgRegReadBk[26] "TLE9180_au8CfgRegReadBk[26]" UBYTE I_1 1 2 0 255 ECU_ADDRESS 0x70014112 /end MEASUREMENT
/begin MEASUREMENT TLE9180_au8CfgRegReadBk[27] "TLE9180_au8CfgRegReadBk[27]" UBYTE I_1 1 2 0 255 ECU_ADDRESS 0x70014113 /end MEASUREMENT
/begin MEASUREMENT TLE9180_au8CfgRegReadBk[28] "TLE9180_au8CfgRegReadBk[28]" UBYTE I_1 1 2 0 255 ECU_ADDRESS 0x70014114 /end MEASUREMENT
/begin MEASUREMENT TLE9180_au8CfgRegReadBk[29] "TLE9180_au8CfgRegReadBk[29]" UBYTE I_1 1 2 0 255 ECU_ADDRESS 0x70014115 /end MEASUREMENT
/begin MEASUREMENT TLE9180_au8CfgRegReadBk[2] "TLE9180_au8CfgRegReadBk[2]" UBYTE I_1 1 2 0 255 ECU_ADDRESS 0x700140FA /end MEASUREMENT
/begin MEASUREMENT TLE9180_au8CfgRegReadBk[3] "TLE9180_au8CfgRegReadBk[3]" UBYTE I_1 1 2 0 255 ECU_ADDRESS 0x700140FB /end MEASUREMENT
/begin MEASUREMENT TLE9180_au8CfgRegReadBk[4] "TLE9180_au8CfgRegReadBk[4]" UBYTE I_1 1 2 0 255 ECU_ADDRESS 0x700140FC /end MEASUREMENT
/begin MEASUREMENT TLE9180_au8CfgRegReadBk[5] "TLE9180_au8CfgRegReadBk[5]" UBYTE I_1 1 2 0 255 ECU_ADDRESS 0x700140FD /end MEASUREMENT
/begin MEASUREMENT TLE9180_au8CfgRegReadBk[6] "TLE9180_au8CfgRegReadBk[6]" UBYTE I_1 1 2 0 255 ECU_ADDRESS 0x700140FE /end MEASUREMENT
/begin MEASUREMENT TLE9180_au8CfgRegReadBk[7] "TLE9180_au8CfgRegReadBk[7]" UBYTE I_1 1 2 0 255 ECU_ADDRESS 0x700140FF /end MEASUREMENT
/begin MEASUREMENT TLE9180_au8CfgRegReadBk[8] "TLE9180_au8CfgRegReadBk[8]" UBYTE I_1 1 2 0 255 ECU_ADDRESS 0x70014100 /end MEASUREMENT
/begin MEASUREMENT TLE9180_au8CfgRegReadBk[9] "TLE9180_au8CfgRegReadBk[9]" UBYTE I_1 1 2 0 255 ECU_ADDRESS 0x70014101 /end MEASUREMENT
/begin MEASUREMENT TLE9180_au8CfgRegister "TLE9180_au8CfgRegister" UBYTE I_1 1 2 0 255 MATRIX_DIM 30 1 1 ECU_ADDRESS 0x70014116 /end MEASUREMENT
/begin MEASUREMENT TLE9180_au8CfgRegister[0] "TLE9180_au8CfgRegister[0]" UBYTE I_1 1 2 0 255 ECU_ADDRESS 0x70014116 /end MEASUREMENT
/begin MEASUREMENT TLE9180_au8CfgRegister[10] "TLE9180_au8CfgRegister[10]" UBYTE I_1 1 2 0 255 ECU_ADDRESS 0x70014120 /end MEASUREMENT
/begin MEASUREMENT TLE9180_au8CfgRegister[11] "TLE9180_au8CfgRegister[11]" UBYTE I_1 1 2 0 255 ECU_ADDRESS 0x70014121 /end MEASUREMENT
/begin MEASUREMENT TLE9180_au8CfgRegister[12] "TLE9180_au8CfgRegister[12]" UBYTE I_1 1 2 0 255 ECU_ADDRESS 0x70014122 /end MEASUREMENT
/begin MEASUREMENT TLE9180_au8CfgRegister[13] "TLE9180_au8CfgRegister[13]" UBYTE I_1 1 2 0 255 ECU_ADDRESS 0x70014123 /end MEASUREMENT
/begin MEASUREMENT TLE9180_au8CfgRegister[14] "TLE9180_au8CfgRegister[14]" UBYTE I_1 1 2 0 255 ECU_ADDRESS 0x70014124 /end MEASUREMENT
/begin MEASUREMENT TLE9180_au8CfgRegister[15] "TLE9180_au8CfgRegister[15]" UBYTE I_1 1 2 0 255 ECU_ADDRESS 0x70014125 /end MEASUREMENT
/begin MEASUREMENT TLE9180_au8CfgRegister[16] "TLE9180_au8CfgRegister[16]" UBYTE I_1 1 2 0 255 ECU_ADDRESS 0x70014126 /end MEASUREMENT
/begin MEASUREMENT TLE9180_au8CfgRegister[17] "TLE9180_au8CfgRegister[17]" UBYTE I_1 1 2 0 255 ECU_ADDRESS 0x70014127 /end MEASUREMENT
/begin MEASUREMENT TLE9180_au8CfgRegister[18] "TLE9180_au8CfgRegister[18]" UBYTE I_1 1 2 0 255 ECU_ADDRESS 0x70014128 /end MEASUREMENT
/begin MEASUREMENT TLE9180_au8CfgRegister[19] "TLE9180_au8CfgRegister[19]" UBYTE I_1 1 2 0 255 ECU_ADDRESS 0x70014129 /end MEASUREMENT
/begin MEASUREMENT TLE9180_au8CfgRegister[1] "TLE9180_au8CfgRegister[1]" UBYTE I_1 1 2 0 255 ECU_ADDRESS 0x70014117 /end MEASUREMENT
/begin MEASUREMENT TLE9180_au8CfgRegister[20] "TLE9180_au8CfgRegister[20]" UBYTE I_1 1 2 0 255 ECU_ADDRESS 0x7001412A /end MEASUREMENT
/begin MEASUREMENT TLE9180_au8CfgRegister[21] "TLE9180_au8CfgRegister[21]" UBYTE I_1 1 2 0 255 ECU_ADDRESS 0x7001412B /end MEASUREMENT
/begin MEASUREMENT TLE9180_au8CfgRegister[22] "TLE9180_au8CfgRegister[22]" UBYTE I_1 1 2 0 255 ECU_ADDRESS 0x7001412C /end MEASUREMENT
/begin MEASUREMENT TLE9180_au8CfgRegister[23] "TLE9180_au8CfgRegister[23]" UBYTE I_1 1 2 0 255 ECU_ADDRESS 0x7001412D /end MEASUREMENT
/begin MEASUREMENT TLE9180_au8CfgRegister[24] "TLE9180_au8CfgRegister[24]" UBYTE I_1 1 2 0 255 ECU_ADDRESS 0x7001412E /end MEASUREMENT
/begin MEASUREMENT TLE9180_au8CfgRegister[25] "TLE9180_au8CfgRegister[25]" UBYTE I_1 1 2 0 255 ECU_ADDRESS 0x7001412F /end MEASUREMENT
/begin MEASUREMENT TLE9180_au8CfgRegister[26] "TLE9180_au8CfgRegister[26]" UBYTE I_1 1 2 0 255 ECU_ADDRESS 0x70014130 /end MEASUREMENT
/begin MEASUREMENT TLE9180_au8CfgRegister[27] "TLE9180_au8CfgRegister[27]" UBYTE I_1 1 2 0 255 ECU_ADDRESS 0x70014131 /end MEASUREMENT
/begin MEASUREMENT TLE9180_au8CfgRegister[28] "TLE9180_au8CfgRegister[28]" UBYTE I_1 1 2 0 255 ECU_ADDRESS 0x70014132 /end MEASUREMENT
/begin MEASUREMENT TLE9180_au8CfgRegister[29] "TLE9180_au8CfgRegister[29]" UBYTE I_1 1 2 0 255 ECU_ADDRESS 0x70014133 /end MEASUREMENT
/begin MEASUREMENT TLE9180_au8CfgRegister[2] "TLE9180_au8CfgRegister[2]" UBYTE I_1 1 2 0 255 ECU_ADDRESS 0x70014118 /end MEASUREMENT
/begin MEASUREMENT TLE9180_au8CfgRegister[3] "TLE9180_au8CfgRegister[3]" UBYTE I_1 1 2 0 255 ECU_ADDRESS 0x70014119 /end MEASUREMENT
/begin MEASUREMENT TLE9180_au8CfgRegister[4] "TLE9180_au8CfgRegister[4]" UBYTE I_1 1 2 0 255 ECU_ADDRESS 0x7001411A /end MEASUREMENT
/begin MEASUREMENT TLE9180_au8CfgRegister[5] "TLE9180_au8CfgRegister[5]" UBYTE I_1 1 2 0 255 ECU_ADDRESS 0x7001411B /end MEASUREMENT
/begin MEASUREMENT TLE9180_au8CfgRegister[6] "TLE9180_au8CfgRegister[6]" UBYTE I_1 1 2 0 255 ECU_ADDRESS 0x7001411C /end MEASUREMENT
/begin MEASUREMENT TLE9180_au8CfgRegister[7] "TLE9180_au8CfgRegister[7]" UBYTE I_1 1 2 0 255 ECU_ADDRESS 0x7001411D /end MEASUREMENT
/begin MEASUREMENT TLE9180_au8CfgRegister[8] "TLE9180_au8CfgRegister[8]" UBYTE I_1 1 2 0 255 ECU_ADDRESS 0x7001411E /end MEASUREMENT
/begin MEASUREMENT TLE9180_au8CfgRegister[9] "TLE9180_au8CfgRegister[9]" UBYTE I_1 1 2 0 255 ECU_ADDRESS 0x7001411F /end MEASUREMENT
/begin MEASUREMENT TLE9180_au8ReadPhsTemp "TLE9180_au8ReadPhsTemp" UBYTE I_1 1 2 0 255 MATRIX_DIM 6 1 1 ECU_ADDRESS 0x700140F2 /end MEASUREMENT
/begin MEASUREMENT TLE9180_au8ReadPhsTemp[0] "TLE9180_au8ReadPhsTemp[0]" UBYTE I_1 1 2 0 255 ECU_ADDRESS 0x700140F2 /end MEASUREMENT
/begin MEASUREMENT TLE9180_au8ReadPhsTemp[1] "TLE9180_au8ReadPhsTemp[1]" UBYTE I_1 1 2 0 255 ECU_ADDRESS 0x700140F3 /end MEASUREMENT
/begin MEASUREMENT TLE9180_au8ReadPhsTemp[2] "TLE9180_au8ReadPhsTemp[2]" UBYTE I_1 1 2 0 255 ECU_ADDRESS 0x700140F4 /end MEASUREMENT
/begin MEASUREMENT TLE9180_au8ReadPhsTemp[3] "TLE9180_au8ReadPhsTemp[3]" UBYTE I_1 1 2 0 255 ECU_ADDRESS 0x700140F5 /end MEASUREMENT
/begin MEASUREMENT TLE9180_au8ReadPhsTemp[4] "TLE9180_au8ReadPhsTemp[4]" UBYTE I_1 1 2 0 255 ECU_ADDRESS 0x700140F6 /end MEASUREMENT
/begin MEASUREMENT TLE9180_au8ReadPhsTemp[5] "TLE9180_au8ReadPhsTemp[5]" UBYTE I_1 1 2 0 255 ECU_ADDRESS 0x700140F7 /end MEASUREMENT
/begin MEASUREMENT TLE9180_au8ReadRegs "TLE9180_au8ReadRegs" UBYTE I_1 1 2 0 255 MATRIX_DIM 30 1 1 ECU_ADDRESS 0x700140D4 /end MEASUREMENT
/begin MEASUREMENT TLE9180_au8ReadRegs[0] "TLE9180_au8ReadRegs[0]" UBYTE I_1 1 2 0 255 ECU_ADDRESS 0x700140D4 /end MEASUREMENT
/begin MEASUREMENT TLE9180_au8ReadRegs[10] "TLE9180_au8ReadRegs[10]" UBYTE I_1 1 2 0 255 ECU_ADDRESS 0x700140DE /end MEASUREMENT
/begin MEASUREMENT TLE9180_au8ReadRegs[11] "TLE9180_au8ReadRegs[11]" UBYTE I_1 1 2 0 255 ECU_ADDRESS 0x700140DF /end MEASUREMENT
/begin MEASUREMENT TLE9180_au8ReadRegs[12] "TLE9180_au8ReadRegs[12]" UBYTE I_1 1 2 0 255 ECU_ADDRESS 0x700140E0 /end MEASUREMENT
/begin MEASUREMENT TLE9180_au8ReadRegs[13] "TLE9180_au8ReadRegs[13]" UBYTE I_1 1 2 0 255 ECU_ADDRESS 0x700140E1 /end MEASUREMENT
/begin MEASUREMENT TLE9180_au8ReadRegs[14] "TLE9180_au8ReadRegs[14]" UBYTE I_1 1 2 0 255 ECU_ADDRESS 0x700140E2 /end MEASUREMENT
/begin MEASUREMENT TLE9180_au8ReadRegs[15] "TLE9180_au8ReadRegs[15]" UBYTE I_1 1 2 0 255 ECU_ADDRESS 0x700140E3 /end MEASUREMENT
/begin MEASUREMENT TLE9180_au8ReadRegs[16] "TLE9180_au8ReadRegs[16]" UBYTE I_1 1 2 0 255 ECU_ADDRESS 0x700140E4 /end MEASUREMENT
/begin MEASUREMENT TLE9180_au8ReadRegs[17] "TLE9180_au8ReadRegs[17]" UBYTE I_1 1 2 0 255 ECU_ADDRESS 0x700140E5 /end MEASUREMENT
/begin MEASUREMENT TLE9180_au8ReadRegs[18] "TLE9180_au8ReadRegs[18]" UBYTE I_1 1 2 0 255 ECU_ADDRESS 0x700140E6 /end MEASUREMENT
/begin MEASUREMENT TLE9180_au8ReadRegs[19] "TLE9180_au8ReadRegs[19]" UBYTE I_1 1 2 0 255 ECU_ADDRESS 0x700140E7 /end MEASUREMENT
/begin MEASUREMENT TLE9180_au8ReadRegs[1] "TLE9180_au8ReadRegs[1]" UBYTE I_1 1 2 0 255 ECU_ADDRESS 0x700140D5 /end MEASUREMENT
/begin MEASUREMENT TLE9180_au8ReadRegs[20] "TLE9180_au8ReadRegs[20]" UBYTE I_1 1 2 0 255 ECU_ADDRESS 0x700140E8 /end MEASUREMENT
/begin MEASUREMENT TLE9180_au8ReadRegs[21] "TLE9180_au8ReadRegs[21]" UBYTE I_1 1 2 0 255 ECU_ADDRESS 0x700140E9 /end MEASUREMENT
/begin MEASUREMENT TLE9180_au8ReadRegs[22] "TLE9180_au8ReadRegs[22]" UBYTE I_1 1 2 0 255 ECU_ADDRESS 0x700140EA /end MEASUREMENT
/begin MEASUREMENT TLE9180_au8ReadRegs[23] "TLE9180_au8ReadRegs[23]" UBYTE I_1 1 2 0 255 ECU_ADDRESS 0x700140EB /end MEASUREMENT
/begin MEASUREMENT TLE9180_au8ReadRegs[24] "TLE9180_au8ReadRegs[24]" UBYTE I_1 1 2 0 255 ECU_ADDRESS 0x700140EC /end MEASUREMENT
/begin MEASUREMENT TLE9180_au8ReadRegs[25] "TLE9180_au8ReadRegs[25]" UBYTE I_1 1 2 0 255 ECU_ADDRESS 0x700140ED /end MEASUREMENT
/begin MEASUREMENT TLE9180_au8ReadRegs[26] "TLE9180_au8ReadRegs[26]" UBYTE I_1 1 2 0 255 ECU_ADDRESS 0x700140EE /end MEASUREMENT
/begin MEASUREMENT TLE9180_au8ReadRegs[27] "TLE9180_au8ReadRegs[27]" UBYTE I_1 1 2 0 255 ECU_ADDRESS 0x700140EF /end MEASUREMENT
/begin MEASUREMENT TLE9180_au8ReadRegs[28] "TLE9180_au8ReadRegs[28]" UBYTE I_1 1 2 0 255 ECU_ADDRESS 0x700140F0 /end MEASUREMENT
/begin MEASUREMENT TLE9180_au8ReadRegs[29] "TLE9180_au8ReadRegs[29]" UBYTE I_1 1 2 0 255 ECU_ADDRESS 0x700140F1 /end MEASUREMENT
/begin MEASUREMENT TLE9180_au8ReadRegs[2] "TLE9180_au8ReadRegs[2]" UBYTE I_1 1 2 0 255 ECU_ADDRESS 0x700140D6 /end MEASUREMENT
/begin MEASUREMENT TLE9180_au8ReadRegs[3] "TLE9180_au8ReadRegs[3]" UBYTE I_1 1 2 0 255 ECU_ADDRESS 0x700140D7 /end MEASUREMENT
/begin MEASUREMENT TLE9180_au8ReadRegs[4] "TLE9180_au8ReadRegs[4]" UBYTE I_1 1 2 0 255 ECU_ADDRESS 0x700140D8 /end MEASUREMENT
/begin MEASUREMENT TLE9180_au8ReadRegs[5] "TLE9180_au8ReadRegs[5]" UBYTE I_1 1 2 0 255 ECU_ADDRESS 0x700140D9 /end MEASUREMENT
/begin MEASUREMENT TLE9180_au8ReadRegs[6] "TLE9180_au8ReadRegs[6]" UBYTE I_1 1 2 0 255 ECU_ADDRESS 0x700140DA /end MEASUREMENT
/begin MEASUREMENT TLE9180_au8ReadRegs[7] "TLE9180_au8ReadRegs[7]" UBYTE I_1 1 2 0 255 ECU_ADDRESS 0x700140DB /end MEASUREMENT
/begin MEASUREMENT TLE9180_au8ReadRegs[8] "TLE9180_au8ReadRegs[8]" UBYTE I_1 1 2 0 255 ECU_ADDRESS 0x700140DC /end MEASUREMENT
/begin MEASUREMENT TLE9180_au8ReadRegs[9] "TLE9180_au8ReadRegs[9]" UBYTE I_1 1 2 0 255 ECU_ADDRESS 0x700140DD /end MEASUREMENT
/begin MEASUREMENT TLE9180_bDrvOverCurrent "..." UBYTE Bool_ON_OFF 1 2 0 1 BIT_MASK 0x01 ECU_ADDRESS 0x700144B3 /end MEASUREMENT
/begin MEASUREMENT TLE9180_bDrvOverTemp "..." UBYTE Bool_ON_OFF 1 2 0 1 BIT_MASK 0x01 ECU_ADDRESS 0x700144B2 /end MEASUREMENT
/begin MEASUREMENT TLE9180_bDrvOverVoltage "..." UBYTE Bool_ON_OFF 1 2 0 1 BIT_MASK 0x01 ECU_ADDRESS 0x700144B1 /end MEASUREMENT
/begin MEASUREMENT TLE9180_bDrvUnderVoltage "..." UBYTE Bool_ON_OFF 1 2 0 1 BIT_MASK 0x01 ECU_ADDRESS 0x700144B0 /end MEASUREMENT
/begin MEASUREMENT TLE9180_bErrorPinLevel "..." UBYTE Bool_ON_OFF 1 2 0 1 BIT_MASK 0x01 ECU_ADDRESS 0x700144AF /end MEASUREMENT
/begin MEASUREMENT TLE9180_bInitFailFlg "..." UBYTE Bool_ON_OFF 1 2 0 1 BIT_MASK 0x01 ECU_ADDRESS 0x700144AE /end MEASUREMENT
/begin MEASUREMENT TLE9180_bPhaseShortHigh "..." UBYTE Bool_ON_OFF 1 2 0 1 BIT_MASK 0x01 ECU_ADDRESS 0x700144AD /end MEASUREMENT
/begin MEASUREMENT TLE9180_bPhaseShortLow "..." UBYTE Bool_ON_OFF 1 2 0 1 BIT_MASK 0x01 ECU_ADDRESS 0x700144AC /end MEASUREMENT
/begin MEASUREMENT TLE9180_bPhsOverVolt "..." UBYTE Bool_ON_OFF 1 2 0 1 BIT_MASK 0x01 ECU_ADDRESS 0x700144AB /end MEASUREMENT
/begin MEASUREMENT TLE9180_bReadErrInfoFlg "..." UBYTE Bool_ON_OFF 1 2 0 1 BIT_MASK 0x01 ECU_ADDRESS 0x700144AA /end MEASUREMENT
/begin MEASUREMENT TLE9180_bTestReadReg "..." UBYTE Bool_ON_OFF 1 2 0 1 BIT_MASK 0x01 ECU_ADDRESS 0x700144A9 /end MEASUREMENT
/begin MEASUREMENT TLE9180_bTestWriteReg "..." UBYTE Bool_ON_OFF 1 2 0 1 BIT_MASK 0x01 ECU_ADDRESS 0x700144A8 /end MEASUREMENT
/begin MEASUREMENT TLE9180_f32MaxPhsTempPhys "..." FLOAT32_IEEE I_1 1 2 -3.402823466E+038 3.402823466E+038 ECU_ADDRESS 0x70014480 /end MEASUREMENT
/begin MEASUREMENT TLE9180_u16EnaResetTime "..." UWORD I_1 1 2 0 65535 ECU_ADDRESS 0x700140C8 /end MEASUREMENT
/begin MEASUREMENT TLE9180_u16ErrPinChkCnt "..." UWORD I_1 1 2 0 65535 ECU_ADDRESS 0x700140C6 /end MEASUREMENT
/begin MEASUREMENT TLE9180_u8ErrRecoverCnt "..." UBYTE I_1 1 2 0 255 ECU_ADDRESS 0x700140D1 /end MEASUREMENT
/begin MEASUREMENT TLE9180_u8Mode "..." UBYTE I_1 1 2 0 255 ECU_ADDRESS 0x700140D0 /end MEASUREMENT
/begin MEASUREMENT TLE9180_u8RdRegTimCnt "..." UBYTE I_1 1 2 0 255 ECU_ADDRESS 0x700140CF /end MEASUREMENT
/begin MEASUREMENT TLE9180_u8ReadRegAddr "..." UBYTE I_1 1 2 0 255 ECU_ADDRESS 0x700140CE /end MEASUREMENT
/begin MEASUREMENT TLE9180_u8SelfTestStep "..." UBYTE I_1 1 2 0 255 ECU_ADDRESS 0x700140CD /end MEASUREMENT
/begin MEASUREMENT TLE9180_u8SpiTxFrameMaxNb "..." UBYTE I_1 1 2 0 255 ECU_ADDRESS 0x700140CC /end MEASUREMENT
/begin MEASUREMENT TLE9180_u8WriteData "..." UBYTE I_1 1 2 0 255 ECU_ADDRESS 0x700140CB /end MEASUREMENT
/begin MEASUREMENT TLE9180_u8WriteRegAddr "..." UBYTE I_1 1 2 0 255 ECU_ADDRESS 0x700140CA /end MEASUREMENT
/begin MEASUREMENT TPPC_bClrFaultReq_ACM "..." UBYTE Bool_ON_OFF 1 2 0 1 BIT_MASK 0x01 ECU_ADDRESS 0x7001476D /end MEASUREMENT
/begin MEASUREMENT TPPC_bClrFaultReq_EPS "..." UBYTE Bool_ON_OFF 1 2 0 1 BIT_MASK 0x01 ECU_ADDRESS 0x70014783 /end MEASUREMENT
/begin MEASUREMENT TPPC_bHwFaultDcOvVolt_ACM "..." UBYTE Bool_ON_OFF 1 2 0 1 BIT_MASK 0x01 ECU_ADDRESS 0x70014766 /end MEASUREMENT
/begin MEASUREMENT TPPC_bHwFaultDcOvVolt_EPS "..." UBYTE Bool_ON_OFF 1 2 0 1 BIT_MASK 0x01 ECU_ADDRESS 0x7001477C /end MEASUREMENT
/begin MEASUREMENT TPPC_bHwFaultIgbtH_ACM "..." UBYTE Bool_ON_OFF 1 2 0 1 BIT_MASK 0x01 ECU_ADDRESS 0x70014768 /end MEASUREMENT
/begin MEASUREMENT TPPC_bHwFaultIgbtH_EPS "..." UBYTE Bool_ON_OFF 1 2 0 1 BIT_MASK 0x01 ECU_ADDRESS 0x7001477E /end MEASUREMENT
/begin MEASUREMENT TPPC_bHwFaultIgbtL_ACM "..." UBYTE Bool_ON_OFF 1 2 0 1 BIT_MASK 0x01 ECU_ADDRESS 0x70014769 /end MEASUREMENT
/begin MEASUREMENT TPPC_bHwFaultIgbtL_EPS "..." UBYTE Bool_ON_OFF 1 2 0 1 BIT_MASK 0x01 ECU_ADDRESS 0x7001477F /end MEASUREMENT
/begin MEASUREMENT TPPC_bHwFaultIgbt_ACM "..." UBYTE Bool_ON_OFF 1 2 0 1 BIT_MASK 0x01 ECU_ADDRESS 0x70014767 /end MEASUREMENT
/begin MEASUREMENT TPPC_bHwFaultIgbt_EPS "..." UBYTE Bool_ON_OFF 1 2 0 1 BIT_MASK 0x01 ECU_ADDRESS 0x7001477D /end MEASUREMENT
/begin MEASUREMENT TPPC_bIsStart_ACM "..." UBYTE Bool_ON_OFF 1 2 0 1 BIT_MASK 0x01 ECU_ADDRESS 0x70014778 /end MEASUREMENT
/begin MEASUREMENT TPPC_bIsStart_EPS "..." UBYTE Bool_ON_OFF 1 2 0 1 BIT_MASK 0x01 ECU_ADDRESS 0x7001478E /end MEASUREMENT
/begin MEASUREMENT TPPC_bMotorSpdRdy_ACM "..." UBYTE Bool_ON_OFF 1 2 0 1 BIT_MASK 0x01 ECU_ADDRESS 0x7001476C /end MEASUREMENT
/begin MEASUREMENT TPPC_bMotorSpdRdy_EPS "..." UBYTE Bool_ON_OFF 1 2 0 1 BIT_MASK 0x01 ECU_ADDRESS 0x70014782 /end MEASUREMENT
/begin MEASUREMENT TPPC_bP5VHSFltFlg_ACM "..." UBYTE Bool_ON_OFF 1 2 0 1 BIT_MASK 0x01 ECU_ADDRESS 0x7001476A /end MEASUREMENT
/begin MEASUREMENT TPPC_bP5VHSFltFlg_EPS "..." UBYTE Bool_ON_OFF 1 2 0 1 BIT_MASK 0x01 ECU_ADDRESS 0x70014780 /end MEASUREMENT
/begin MEASUREMENT TPPC_bP5VLSFltFlg_ACM "..." UBYTE Bool_ON_OFF 1 2 0 1 BIT_MASK 0x01 ECU_ADDRESS 0x7001476B /end MEASUREMENT
/begin MEASUREMENT TPPC_bP5VLSFltFlg_EPS "..." UBYTE Bool_ON_OFF 1 2 0 1 BIT_MASK 0x01 ECU_ADDRESS 0x70014781 /end MEASUREMENT
/begin MEASUREMENT TPPC_bPwmOnGoingFlg_ACM "..." UBYTE Bool_ON_OFF 1 2 0 1 BIT_MASK 0x01 ECU_ADDRESS 0x70014779 /end MEASUREMENT
/begin MEASUREMENT TPPC_bPwmOnGoingFlg_EPS "..." UBYTE Bool_ON_OFF 1 2 0 1 BIT_MASK 0x01 ECU_ADDRESS 0x7001478F /end MEASUREMENT
/begin MEASUREMENT TPPC_u16McuAscSttDelay_ACM "..." UWORD I_1 1 2 0 65535 ECU_ADDRESS 0x70014772 /end MEASUREMENT
/begin MEASUREMENT TPPC_u16McuAscSttDelay_EPS "..." UWORD I_1 1 2 0 65535 ECU_ADDRESS 0x70014788 /end MEASUREMENT
/begin MEASUREMENT TPPC_u16PowerOnDelay_ACM "..." UWORD I_1 1 2 0 65535 ECU_ADDRESS 0x70014776 /end MEASUREMENT
/begin MEASUREMENT TPPC_u16PowerOnDelay_EPS "..." UWORD I_1 1 2 0 65535 ECU_ADDRESS 0x7001478C /end MEASUREMENT
/begin MEASUREMENT TPPC_u16PwmModReq_ACM "..." UWORD I_1 1 2 0 65535 ECU_ADDRESS 0x70014774 /end MEASUREMENT
/begin MEASUREMENT TPPC_u16PwmModReq_EPS "..." UWORD I_1 1 2 0 65535 ECU_ADDRESS 0x7001478A /end MEASUREMENT
/begin MEASUREMENT TPPC_u8AscRecoverCnt_ACM "..." UBYTE I_1 1 2 0 255 ECU_ADDRESS 0x70014770 /end MEASUREMENT
/begin MEASUREMENT TPPC_u8AscRecoverCnt_EPS "..." UBYTE I_1 1 2 0 255 ECU_ADDRESS 0x70014786 /end MEASUREMENT
/begin MEASUREMENT TPPC_u8AscStep_ACM "..." UBYTE I_1 1 2 0 255 ECU_ADDRESS 0x7001476F /end MEASUREMENT
/begin MEASUREMENT TPPC_u8AscStep_EPS "..." UBYTE I_1 1 2 0 255 ECU_ADDRESS 0x70014785 /end MEASUREMENT
/begin MEASUREMENT TPPC_u8AscType_ACM "..." UBYTE I_1 1 2 0 255 ECU_ADDRESS 0x7001476E /end MEASUREMENT
/begin MEASUREMENT TPPC_u8AscType_EPS "..." UBYTE I_1 1 2 0 255 ECU_ADDRESS 0x70014784 /end MEASUREMENT
/begin MEASUREMENT TPPC_u8PwmState_ACM "..." UBYTE I_1 1 2 0 255 ECU_ADDRESS 0x7001477A /end MEASUREMENT
/begin MEASUREMENT TPPC_u8PwmState_EPS "..." UBYTE I_1 1 2 0 255 ECU_ADDRESS 0x70014790 /end MEASUREMENT
/begin MEASUREMENT UDS_au8CalibSoftId "UDS_au8CalibSoftId" UBYTE F_1_p0_2 1 2 0 255 MATRIX_DIM 16 1 1 ECU_ADDRESS 0x7001FE8A /end MEASUREMENT
/begin MEASUREMENT UDS_au8CalibSoftId[0] "UDS_au8CalibSoftId[0]" UBYTE F_1_p0_2 1 2 0 255 ECU_ADDRESS 0x7001FE8A /end MEASUREMENT
/begin MEASUREMENT UDS_au8CalibSoftId[10] "UDS_au8CalibSoftId[10]" UBYTE F_1_p0_2 1 2 0 255 ECU_ADDRESS 0x7001FE94 /end MEASUREMENT
/begin MEASUREMENT UDS_au8CalibSoftId[11] "UDS_au8CalibSoftId[11]" UBYTE F_1_p0_2 1 2 0 255 ECU_ADDRESS 0x7001FE95 /end MEASUREMENT
/begin MEASUREMENT UDS_au8CalibSoftId[12] "UDS_au8CalibSoftId[12]" UBYTE F_1_p0_2 1 2 0 255 ECU_ADDRESS 0x7001FE96 /end MEASUREMENT
/begin MEASUREMENT UDS_au8CalibSoftId[13] "UDS_au8CalibSoftId[13]" UBYTE F_1_p0_2 1 2 0 255 ECU_ADDRESS 0x7001FE97 /end MEASUREMENT
/begin MEASUREMENT UDS_au8CalibSoftId[14] "UDS_au8CalibSoftId[14]" UBYTE F_1_p0_2 1 2 0 255 ECU_ADDRESS 0x7001FE98 /end MEASUREMENT
/begin MEASUREMENT UDS_au8CalibSoftId[15] "UDS_au8CalibSoftId[15]" UBYTE F_1_p0_2 1 2 0 255 ECU_ADDRESS 0x7001FE99 /end MEASUREMENT
/begin MEASUREMENT UDS_au8CalibSoftId[1] "UDS_au8CalibSoftId[1]" UBYTE F_1_p0_2 1 2 0 255 ECU_ADDRESS 0x7001FE8B /end MEASUREMENT
/begin MEASUREMENT UDS_au8CalibSoftId[2] "UDS_au8CalibSoftId[2]" UBYTE F_1_p0_2 1 2 0 255 ECU_ADDRESS 0x7001FE8C /end MEASUREMENT
/begin MEASUREMENT UDS_au8CalibSoftId[3] "UDS_au8CalibSoftId[3]" UBYTE F_1_p0_2 1 2 0 255 ECU_ADDRESS 0x7001FE8D /end MEASUREMENT
/begin MEASUREMENT UDS_au8CalibSoftId[4] "UDS_au8CalibSoftId[4]" UBYTE F_1_p0_2 1 2 0 255 ECU_ADDRESS 0x7001FE8E /end MEASUREMENT
/begin MEASUREMENT UDS_au8CalibSoftId[5] "UDS_au8CalibSoftId[5]" UBYTE F_1_p0_2 1 2 0 255 ECU_ADDRESS 0x7001FE8F /end MEASUREMENT
/begin MEASUREMENT UDS_au8CalibSoftId[6] "UDS_au8CalibSoftId[6]" UBYTE F_1_p0_2 1 2 0 255 ECU_ADDRESS 0x7001FE90 /end MEASUREMENT
/begin MEASUREMENT UDS_au8CalibSoftId[7] "UDS_au8CalibSoftId[7]" UBYTE F_1_p0_2 1 2 0 255 ECU_ADDRESS 0x7001FE91 /end MEASUREMENT
/begin MEASUREMENT UDS_au8CalibSoftId[8] "UDS_au8CalibSoftId[8]" UBYTE F_1_p0_2 1 2 0 255 ECU_ADDRESS 0x7001FE92 /end MEASUREMENT
/begin MEASUREMENT UDS_au8CalibSoftId[9] "UDS_au8CalibSoftId[9]" UBYTE F_1_p0_2 1 2 0 255 ECU_ADDRESS 0x7001FE93 /end MEASUREMENT
/begin MEASUREMENT UDS_au8DidBuf_0x0B01 "..." UBYTE I_1 1 2 0 255 MATRIX_DIM 2 1 1 ECU_ADDRESS 0x70014C8B /end MEASUREMENT
/begin MEASUREMENT UDS_au8DidBuf_0x0B01[0] "UDS_au8DidBuf_0x0B01[0]" UBYTE I_1 1 2 0 255 ECU_ADDRESS 0x70014C8B /end MEASUREMENT
/begin MEASUREMENT UDS_au8DidBuf_0x0B01[1] "UDS_au8DidBuf_0x0B01[1]" UBYTE I_1 1 2 0 255 ECU_ADDRESS 0x70014C8C /end MEASUREMENT
/begin MEASUREMENT UDS_au8DidBuf_0x0B02 "..." UBYTE I_1 1 2 0 255 MATRIX_DIM 4 1 1 ECU_ADDRESS 0x70014C87 /end MEASUREMENT
/begin MEASUREMENT UDS_au8DidBuf_0x0B02[0] "UDS_au8DidBuf_0x0B02[0]" UBYTE I_1 1 2 0 255 ECU_ADDRESS 0x70014C87 /end MEASUREMENT
/begin MEASUREMENT UDS_au8DidBuf_0x0B02[1] "UDS_au8DidBuf_0x0B02[1]" UBYTE I_1 1 2 0 255 ECU_ADDRESS 0x70014C88 /end MEASUREMENT
/begin MEASUREMENT UDS_au8DidBuf_0x0B02[2] "UDS_au8DidBuf_0x0B02[2]" UBYTE I_1 1 2 0 255 ECU_ADDRESS 0x70014C89 /end MEASUREMENT
/begin MEASUREMENT UDS_au8DidBuf_0x0B02[3] "UDS_au8DidBuf_0x0B02[3]" UBYTE I_1 1 2 0 255 ECU_ADDRESS 0x70014C8A /end MEASUREMENT
/begin MEASUREMENT UDS_au8DidBuf_0x0B03 "..." UBYTE I_1 1 2 0 255 MATRIX_DIM 2 1 1 ECU_ADDRESS 0x70014C85 /end MEASUREMENT
/begin MEASUREMENT UDS_au8DidBuf_0x0B03[0] "UDS_au8DidBuf_0x0B03[0]" UBYTE I_1 1 2 0 255 ECU_ADDRESS 0x70014C85 /end MEASUREMENT
/begin MEASUREMENT UDS_au8DidBuf_0x0B03[1] "UDS_au8DidBuf_0x0B03[1]" UBYTE I_1 1 2 0 255 ECU_ADDRESS 0x70014C86 /end MEASUREMENT
/begin MEASUREMENT UDS_au8DidBuf_0x0B08 "..." UBYTE I_1 1 2 0 255 MATRIX_DIM 2 1 1 ECU_ADDRESS 0x70014C83 /end MEASUREMENT
/begin MEASUREMENT UDS_au8DidBuf_0x0B08[0] "UDS_au8DidBuf_0x0B08[0]" UBYTE I_1 1 2 0 255 ECU_ADDRESS 0x70014C83 /end MEASUREMENT
/begin MEASUREMENT UDS_au8DidBuf_0x0B08[1] "UDS_au8DidBuf_0x0B08[1]" UBYTE I_1 1 2 0 255 ECU_ADDRESS 0x70014C84 /end MEASUREMENT
/begin MEASUREMENT UDS_au8DidBuf_0x0B0B "..." UBYTE I_1 1 2 0 255 ECU_ADDRESS 0x70014C82 /end MEASUREMENT
/begin MEASUREMENT UDS_au8DidBuf_0x0D00 "..." UBYTE I_1 1 2 0 255 ECU_ADDRESS 0x70014C81 /end MEASUREMENT
/begin MEASUREMENT UDS_au8DidBuf_0x0D10 "..." UBYTE I_1 1 2 0 255 ECU_ADDRESS 0x70014C80 /end MEASUREMENT
/begin MEASUREMENT UDS_au8DidBuf_0x0D11 "..." UBYTE I_1 1 2 0 255 MATRIX_DIM 2 1 1 ECU_ADDRESS 0x70014C7E /end MEASUREMENT
/begin MEASUREMENT UDS_au8DidBuf_0x0D11[0] "UDS_au8DidBuf_0x0D11[0]" UBYTE I_1 1 2 0 255 ECU_ADDRESS 0x70014C7E /end MEASUREMENT
/begin MEASUREMENT UDS_au8DidBuf_0x0D11[1] "UDS_au8DidBuf_0x0D11[1]" UBYTE I_1 1 2 0 255 ECU_ADDRESS 0x70014C7F /end MEASUREMENT
/begin MEASUREMENT UDS_au8DidBuf_0x0D12 "..." UBYTE I_1 1 2 0 255 MATRIX_DIM 2 1 1 ECU_ADDRESS 0x70014C7C /end MEASUREMENT
/begin MEASUREMENT UDS_au8DidBuf_0x0D12[0] "UDS_au8DidBuf_0x0D12[0]" UBYTE I_1 1 2 0 255 ECU_ADDRESS 0x70014C7C /end MEASUREMENT
/begin MEASUREMENT UDS_au8DidBuf_0x0D12[1] "UDS_au8DidBuf_0x0D12[1]" UBYTE I_1 1 2 0 255 ECU_ADDRESS 0x70014C7D /end MEASUREMENT
/begin MEASUREMENT UDS_au8DidBuf_0x0D2B "..." UBYTE I_1 1 2 0 255 ECU_ADDRESS 0x70014C7B /end MEASUREMENT
/begin MEASUREMENT UDS_au8DidBuf_0x1D00 "..." UBYTE I_1 1 2 0 255 ECU_ADDRESS 0x70014C7A /end MEASUREMENT
/begin MEASUREMENT UDS_au8DidBuf_0x1D10 "..." UBYTE I_1 1 2 0 255 ECU_ADDRESS 0x70014C79 /end MEASUREMENT
/begin MEASUREMENT UDS_au8DidBuf_0x1D11 "..." UBYTE I_1 1 2 0 255 MATRIX_DIM 2 1 1 ECU_ADDRESS 0x70014C77 /end MEASUREMENT
/begin MEASUREMENT UDS_au8DidBuf_0x1D11[0] "UDS_au8DidBuf_0x1D11[0]" UBYTE I_1 1 2 0 255 ECU_ADDRESS 0x70014C77 /end MEASUREMENT
/begin MEASUREMENT UDS_au8DidBuf_0x1D11[1] "UDS_au8DidBuf_0x1D11[1]" UBYTE I_1 1 2 0 255 ECU_ADDRESS 0x70014C78 /end MEASUREMENT
/begin MEASUREMENT UDS_au8DidBuf_0x1D12 "..." UBYTE I_1 1 2 0 255 MATRIX_DIM 2 1 1 ECU_ADDRESS 0x70014C75 /end MEASUREMENT
/begin MEASUREMENT UDS_au8DidBuf_0x1D12[0] "UDS_au8DidBuf_0x1D12[0]" UBYTE I_1 1 2 0 255 ECU_ADDRESS 0x70014C75 /end MEASUREMENT
/begin MEASUREMENT UDS_au8DidBuf_0x1D12[1] "UDS_au8DidBuf_0x1D12[1]" UBYTE I_1 1 2 0 255 ECU_ADDRESS 0x70014C76 /end MEASUREMENT
/begin MEASUREMENT UDS_au8DidBuf_0x1D2B "..." UBYTE I_1 1 2 0 255 ECU_ADDRESS 0x70014C74 /end MEASUREMENT
/begin MEASUREMENT UDS_au8DidBuf_0x2D09 "..." UBYTE I_1 1 2 0 255 ECU_ADDRESS 0x70014C73 /end MEASUREMENT
/begin MEASUREMENT UDS_au8DidBuf_0x2D0A "..." UBYTE I_1 1 2 0 255 ECU_ADDRESS 0x70014C72 /end MEASUREMENT
/begin MEASUREMENT UDS_au8DidBuf_0x2D0C "..." UBYTE I_1 1 2 0 255 MATRIX_DIM 2 1 1 ECU_ADDRESS 0x70014C70 /end MEASUREMENT
/begin MEASUREMENT UDS_au8DidBuf_0x2D0C[0] "UDS_au8DidBuf_0x2D0C[0]" UBYTE I_1 1 2 0 255 ECU_ADDRESS 0x70014C70 /end MEASUREMENT
/begin MEASUREMENT UDS_au8DidBuf_0x2D0C[1] "UDS_au8DidBuf_0x2D0C[1]" UBYTE I_1 1 2 0 255 ECU_ADDRESS 0x70014C71 /end MEASUREMENT
/begin MEASUREMENT UDS_au8DidBuf_0x2D0C_1 "..." UBYTE I_1 1 2 0 255 MATRIX_DIM 2 1 1 ECU_ADDRESS 0x70014C6E /end MEASUREMENT
/begin MEASUREMENT UDS_au8DidBuf_0x2D0C_1[0] "UDS_au8DidBuf_0x2D0C_1[0]" UBYTE I_1 1 2 0 255 ECU_ADDRESS 0x70014C6E /end MEASUREMENT
/begin MEASUREMENT UDS_au8DidBuf_0x2D0C_1[1] "UDS_au8DidBuf_0x2D0C_1[1]" UBYTE I_1 1 2 0 255 ECU_ADDRESS 0x70014C6F /end MEASUREMENT
/begin MEASUREMENT UDS_au8DidBuf_0x2D0C_2 "..." UBYTE I_1 1 2 0 255 MATRIX_DIM 2 1 1 ECU_ADDRESS 0x70014C6C /end MEASUREMENT
/begin MEASUREMENT UDS_au8DidBuf_0x2D0C_2[0] "UDS_au8DidBuf_0x2D0C_2[0]" UBYTE I_1 1 2 0 255 ECU_ADDRESS 0x70014C6C /end MEASUREMENT
/begin MEASUREMENT UDS_au8DidBuf_0x2D0C_2[1] "UDS_au8DidBuf_0x2D0C_2[1]" UBYTE I_1 1 2 0 255 ECU_ADDRESS 0x70014C6D /end MEASUREMENT
/begin MEASUREMENT UDS_au8DidBuf_0x2D0D "..." UBYTE I_1 1 2 0 255 MATRIX_DIM 2 1 1 ECU_ADDRESS 0x70014C6A /end MEASUREMENT
/begin MEASUREMENT UDS_au8DidBuf_0x2D0D[0] "UDS_au8DidBuf_0x2D0D[0]" UBYTE I_1 1 2 0 255 ECU_ADDRESS 0x70014C6A /end MEASUREMENT
/begin MEASUREMENT UDS_au8DidBuf_0x2D0D[1] "UDS_au8DidBuf_0x2D0D[1]" UBYTE I_1 1 2 0 255 ECU_ADDRESS 0x70014C6B /end MEASUREMENT
/begin MEASUREMENT UDS_au8DidBuf_0x2D11 "..." UBYTE I_1 1 2 0 255 MATRIX_DIM 2 1 1 ECU_ADDRESS 0x70014C68 /end MEASUREMENT
/begin MEASUREMENT UDS_au8DidBuf_0x2D11[0] "UDS_au8DidBuf_0x2D11[0]" UBYTE I_1 1 2 0 255 ECU_ADDRESS 0x70014C68 /end MEASUREMENT
/begin MEASUREMENT UDS_au8DidBuf_0x2D11[1] "UDS_au8DidBuf_0x2D11[1]" UBYTE I_1 1 2 0 255 ECU_ADDRESS 0x70014C69 /end MEASUREMENT
/begin MEASUREMENT UDS_au8DidBuf_0x2D12 "..." UBYTE I_1 1 2 0 255 MATRIX_DIM 2 1 1 ECU_ADDRESS 0x70014C66 /end MEASUREMENT
/begin MEASUREMENT UDS_au8DidBuf_0x2D12[0] "UDS_au8DidBuf_0x2D12[0]" UBYTE I_1 1 2 0 255 ECU_ADDRESS 0x70014C66 /end MEASUREMENT
/begin MEASUREMENT UDS_au8DidBuf_0x2D12[1] "UDS_au8DidBuf_0x2D12[1]" UBYTE I_1 1 2 0 255 ECU_ADDRESS 0x70014C67 /end MEASUREMENT
/begin MEASUREMENT UDS_au8DidBuf_0x2D23 "..." UBYTE I_1 1 2 0 255 MATRIX_DIM 2 1 1 ECU_ADDRESS 0x70014C64 /end MEASUREMENT
/begin MEASUREMENT UDS_au8DidBuf_0x2D23[0] "UDS_au8DidBuf_0x2D23[0]" UBYTE I_1 1 2 0 255 ECU_ADDRESS 0x70014C64 /end MEASUREMENT
/begin MEASUREMENT UDS_au8DidBuf_0x2D23[1] "UDS_au8DidBuf_0x2D23[1]" UBYTE I_1 1 2 0 255 ECU_ADDRESS 0x70014C65 /end MEASUREMENT
/begin MEASUREMENT UDS_au8DidBuf_0x2D24 "..." UBYTE I_1 1 2 0 255 MATRIX_DIM 2 1 1 ECU_ADDRESS 0x70014C62 /end MEASUREMENT
/begin MEASUREMENT UDS_au8DidBuf_0x2D24[0] "UDS_au8DidBuf_0x2D24[0]" UBYTE I_1 1 2 0 255 ECU_ADDRESS 0x70014C62 /end MEASUREMENT
/begin MEASUREMENT UDS_au8DidBuf_0x2D24[1] "UDS_au8DidBuf_0x2D24[1]" UBYTE I_1 1 2 0 255 ECU_ADDRESS 0x70014C63 /end MEASUREMENT
/begin MEASUREMENT UDS_au8DidBuf_0x2D27 "..." UBYTE I_1 1 2 0 255 MATRIX_DIM 2 1 1 ECU_ADDRESS 0x70014C60 /end MEASUREMENT
/begin MEASUREMENT UDS_au8DidBuf_0x2D27[0] "UDS_au8DidBuf_0x2D27[0]" UBYTE I_1 1 2 0 255 ECU_ADDRESS 0x70014C60 /end MEASUREMENT
/begin MEASUREMENT UDS_au8DidBuf_0x2D27[1] "UDS_au8DidBuf_0x2D27[1]" UBYTE I_1 1 2 0 255 ECU_ADDRESS 0x70014C61 /end MEASUREMENT
/begin MEASUREMENT UDS_au8DidBuf_0x2D28 "..." UBYTE I_1 1 2 0 255 MATRIX_DIM 2 1 1 ECU_ADDRESS 0x70014C5E /end MEASUREMENT
/begin MEASUREMENT UDS_au8DidBuf_0x2D28[0] "UDS_au8DidBuf_0x2D28[0]" UBYTE I_1 1 2 0 255 ECU_ADDRESS 0x70014C5E /end MEASUREMENT
/begin MEASUREMENT UDS_au8DidBuf_0x2D28[1] "UDS_au8DidBuf_0x2D28[1]" UBYTE I_1 1 2 0 255 ECU_ADDRESS 0x70014C5F /end MEASUREMENT
/begin MEASUREMENT UDS_au8DidBuf_0x3D09 "..." UBYTE I_1 1 2 0 255 ECU_ADDRESS 0x70014C5D /end MEASUREMENT
/begin MEASUREMENT UDS_au8DidBuf_0x3D0A "..." UBYTE I_1 1 2 0 255 ECU_ADDRESS 0x70014C5C /end MEASUREMENT
/begin MEASUREMENT UDS_au8DidBuf_0x3D0C "..." UBYTE I_1 1 2 0 255 MATRIX_DIM 2 1 1 ECU_ADDRESS 0x70014C5A /end MEASUREMENT
/begin MEASUREMENT UDS_au8DidBuf_0x3D0C[0] "UDS_au8DidBuf_0x3D0C[0]" UBYTE I_1 1 2 0 255 ECU_ADDRESS 0x70014C5A /end MEASUREMENT
/begin MEASUREMENT UDS_au8DidBuf_0x3D0C[1] "UDS_au8DidBuf_0x3D0C[1]" UBYTE I_1 1 2 0 255 ECU_ADDRESS 0x70014C5B /end MEASUREMENT
/begin MEASUREMENT UDS_au8DidBuf_0x3D0C_1 "..." UBYTE I_1 1 2 0 255 MATRIX_DIM 2 1 1 ECU_ADDRESS 0x70014C58 /end MEASUREMENT
/begin MEASUREMENT UDS_au8DidBuf_0x3D0C_1[0] "UDS_au8DidBuf_0x3D0C_1[0]" UBYTE I_1 1 2 0 255 ECU_ADDRESS 0x70014C58 /end MEASUREMENT
/begin MEASUREMENT UDS_au8DidBuf_0x3D0C_1[1] "UDS_au8DidBuf_0x3D0C_1[1]" UBYTE I_1 1 2 0 255 ECU_ADDRESS 0x70014C59 /end MEASUREMENT
/begin MEASUREMENT UDS_au8DidBuf_0x3D0C_2 "..." UBYTE I_1 1 2 0 255 MATRIX_DIM 2 1 1 ECU_ADDRESS 0x70014C56 /end MEASUREMENT
/begin MEASUREMENT UDS_au8DidBuf_0x3D0C_2[0] "UDS_au8DidBuf_0x3D0C_2[0]" UBYTE I_1 1 2 0 255 ECU_ADDRESS 0x70014C56 /end MEASUREMENT
/begin MEASUREMENT UDS_au8DidBuf_0x3D0C_2[1] "UDS_au8DidBuf_0x3D0C_2[1]" UBYTE I_1 1 2 0 255 ECU_ADDRESS 0x70014C57 /end MEASUREMENT
/begin MEASUREMENT UDS_au8DidBuf_0x3D0D "..." UBYTE I_1 1 2 0 255 MATRIX_DIM 2 1 1 ECU_ADDRESS 0x70014C54 /end MEASUREMENT
/begin MEASUREMENT UDS_au8DidBuf_0x3D0D[0] "UDS_au8DidBuf_0x3D0D[0]" UBYTE I_1 1 2 0 255 ECU_ADDRESS 0x70014C54 /end MEASUREMENT
/begin MEASUREMENT UDS_au8DidBuf_0x3D0D[1] "UDS_au8DidBuf_0x3D0D[1]" UBYTE I_1 1 2 0 255 ECU_ADDRESS 0x70014C55 /end MEASUREMENT
/begin MEASUREMENT UDS_au8DidBuf_0x3D11 "..." UBYTE I_1 1 2 0 255 MATRIX_DIM 2 1 1 ECU_ADDRESS 0x70014C52 /end MEASUREMENT
/begin MEASUREMENT UDS_au8DidBuf_0x3D11[0] "UDS_au8DidBuf_0x3D11[0]" UBYTE I_1 1 2 0 255 ECU_ADDRESS 0x70014C52 /end MEASUREMENT
/begin MEASUREMENT UDS_au8DidBuf_0x3D11[1] "UDS_au8DidBuf_0x3D11[1]" UBYTE I_1 1 2 0 255 ECU_ADDRESS 0x70014C53 /end MEASUREMENT
/begin MEASUREMENT UDS_au8DidBuf_0x3D12 "..." UBYTE I_1 1 2 0 255 MATRIX_DIM 2 1 1 ECU_ADDRESS 0x70014C50 /end MEASUREMENT
/begin MEASUREMENT UDS_au8DidBuf_0x3D12[0] "UDS_au8DidBuf_0x3D12[0]" UBYTE I_1 1 2 0 255 ECU_ADDRESS 0x70014C50 /end MEASUREMENT
/begin MEASUREMENT UDS_au8DidBuf_0x3D12[1] "UDS_au8DidBuf_0x3D12[1]" UBYTE I_1 1 2 0 255 ECU_ADDRESS 0x70014C51 /end MEASUREMENT
/begin MEASUREMENT UDS_au8DidBuf_0x3D23 "..." UBYTE I_1 1 2 0 255 MATRIX_DIM 2 1 1 ECU_ADDRESS 0x70014C4E /end MEASUREMENT
/begin MEASUREMENT UDS_au8DidBuf_0x3D23[0] "UDS_au8DidBuf_0x3D23[0]" UBYTE I_1 1 2 0 255 ECU_ADDRESS 0x70014C4E /end MEASUREMENT
/begin MEASUREMENT UDS_au8DidBuf_0x3D23[1] "UDS_au8DidBuf_0x3D23[1]" UBYTE I_1 1 2 0 255 ECU_ADDRESS 0x70014C4F /end MEASUREMENT
/begin MEASUREMENT UDS_au8DidBuf_0x3D24 "..." UBYTE I_1 1 2 0 255 MATRIX_DIM 2 1 1 ECU_ADDRESS 0x70014C4C /end MEASUREMENT
/begin MEASUREMENT UDS_au8DidBuf_0x3D24[0] "UDS_au8DidBuf_0x3D24[0]" UBYTE I_1 1 2 0 255 ECU_ADDRESS 0x70014C4C /end MEASUREMENT
/begin MEASUREMENT UDS_au8DidBuf_0x3D24[1] "UDS_au8DidBuf_0x3D24[1]" UBYTE I_1 1 2 0 255 ECU_ADDRESS 0x70014C4D /end MEASUREMENT
/begin MEASUREMENT UDS_au8DidBuf_0x3D27 "..." UBYTE I_1 1 2 0 255 MATRIX_DIM 2 1 1 ECU_ADDRESS 0x70014C4A /end MEASUREMENT
/begin MEASUREMENT UDS_au8DidBuf_0x3D27[0] "UDS_au8DidBuf_0x3D27[0]" UBYTE I_1 1 2 0 255 ECU_ADDRESS 0x70014C4A /end MEASUREMENT
/begin MEASUREMENT UDS_au8DidBuf_0x3D27[1] "UDS_au8DidBuf_0x3D27[1]" UBYTE I_1 1 2 0 255 ECU_ADDRESS 0x70014C4B /end MEASUREMENT
/begin MEASUREMENT UDS_au8DidBuf_0x3D28 "..." UBYTE I_1 1 2 0 255 MATRIX_DIM 2 1 1 ECU_ADDRESS 0x70014C48 /end MEASUREMENT
/begin MEASUREMENT UDS_au8DidBuf_0x3D28[0] "UDS_au8DidBuf_0x3D28[0]" UBYTE I_1 1 2 0 255 ECU_ADDRESS 0x70014C48 /end MEASUREMENT
/begin MEASUREMENT UDS_au8DidBuf_0x3D28[1] "UDS_au8DidBuf_0x3D28[1]" UBYTE I_1 1 2 0 255 ECU_ADDRESS 0x70014C49 /end MEASUREMENT
/begin MEASUREMENT UDS_au8DidBuf_0x4D00 "..." UBYTE I_1 1 2 0 255 ECU_ADDRESS 0x70014C47 /end MEASUREMENT
/begin MEASUREMENT UDS_au8DidBuf_0x4D01 "..." UBYTE I_1 1 2 0 255 ECU_ADDRESS 0x70014C46 /end MEASUREMENT
/begin MEASUREMENT UDS_au8DidBuf_0x4D02 "..." UBYTE I_1 1 2 0 255 ECU_ADDRESS 0x70014C45 /end MEASUREMENT
/begin MEASUREMENT UDS_au8DidBuf_0x4D03 "..." UBYTE I_1 1 2 0 255 ECU_ADDRESS 0x70014C44 /end MEASUREMENT
/begin MEASUREMENT UDS_au8DidBuf_0x4D04 "..." UBYTE I_1 1 2 0 255 ECU_ADDRESS 0x70014C43 /end MEASUREMENT
/begin MEASUREMENT UDS_au8DidBuf_0x4D05 "..." UBYTE I_1 1 2 0 255 ECU_ADDRESS 0x70014C42 /end MEASUREMENT
/begin MEASUREMENT UDS_au8DidBuf_0x4D06 "..." UBYTE I_1 1 2 0 255 ECU_ADDRESS 0x70014C41 /end MEASUREMENT
/begin MEASUREMENT UDS_au8DidBuf_0x4D07 "..." UBYTE I_1 1 2 0 255 ECU_ADDRESS 0x70014C40 /end MEASUREMENT
/begin MEASUREMENT UDS_au8DidBuf_0x4D08 "..." UBYTE I_1 1 2 0 255 ECU_ADDRESS 0x70014C3F /end MEASUREMENT
/begin MEASUREMENT UDS_au8DidBuf_0x4D09 "..." UBYTE I_1 1 2 0 255 ECU_ADDRESS 0x70014C3E /end MEASUREMENT
/begin MEASUREMENT UDS_au8DidBuf_0x4D0A "..." UBYTE I_1 1 2 0 255 ECU_ADDRESS 0x70014C3D /end MEASUREMENT
/begin MEASUREMENT UDS_au8DidBuf_0x4D0B "..." UBYTE I_1 1 2 0 255 ECU_ADDRESS 0x70014C3C /end MEASUREMENT
/begin MEASUREMENT UDS_au8DidBuf_0x4D0C "..." UBYTE I_1 1 2 0 255 ECU_ADDRESS 0x70014C3B /end MEASUREMENT
/begin MEASUREMENT UDS_au8DidBuf_0x4D0D "..." UBYTE I_1 1 2 0 255 ECU_ADDRESS 0x70014C3A /end MEASUREMENT
/begin MEASUREMENT UDS_au8DidBuf_0x4D0E "..." UBYTE I_1 1 2 0 255 ECU_ADDRESS 0x70014C39 /end MEASUREMENT
/begin MEASUREMENT UDS_au8DidBuf_0x4D0F "..." UBYTE I_1 1 2 0 255 ECU_ADDRESS 0x70014C38 /end MEASUREMENT
/begin MEASUREMENT UDS_au8DidBuf_0x4D10 "..." UBYTE I_1 1 2 0 255 ECU_ADDRESS 0x70014C37 /end MEASUREMENT
/begin MEASUREMENT UDS_au8DidBuf_0x4D11 "..." UBYTE I_1 1 2 0 255 ECU_ADDRESS 0x70014C36 /end MEASUREMENT
/begin MEASUREMENT UDS_au8DidBuf_0x4D12 "..." UBYTE I_1 1 2 0 255 ECU_ADDRESS 0x70014C35 /end MEASUREMENT
/begin MEASUREMENT UDS_au8DidBuf_0x4D13 "..." UBYTE I_1 1 2 0 255 ECU_ADDRESS 0x70014C34 /end MEASUREMENT
/begin MEASUREMENT UDS_au8DidBuf_0x4D14 "..." UBYTE I_1 1 2 0 255 ECU_ADDRESS 0x70014C33 /end MEASUREMENT
/begin MEASUREMENT UDS_au8DidBuf_0x4D15 "..." UBYTE I_1 1 2 0 255 ECU_ADDRESS 0x70014C32 /end MEASUREMENT
/begin MEASUREMENT UDS_au8DidBuf_0x4D16 "..." UBYTE I_1 1 2 0 255 ECU_ADDRESS 0x70014C31 /end MEASUREMENT
/begin MEASUREMENT UDS_au8DidBuf_0x4D17 "..." UBYTE I_1 1 2 0 255 ECU_ADDRESS 0x70014C30 /end MEASUREMENT
/begin MEASUREMENT UDS_au8DidBuf_0x4D18 "..." UBYTE I_1 1 2 0 255 ECU_ADDRESS 0x70014C2F /end MEASUREMENT
/begin MEASUREMENT UDS_au8DidBuf_0x4D19 "..." UBYTE I_1 1 2 0 255 ECU_ADDRESS 0x70014C2E /end MEASUREMENT
/begin MEASUREMENT UDS_au8DidBuf_0x4D1A "..." UBYTE I_1 1 2 0 255 ECU_ADDRESS 0x70014C2D /end MEASUREMENT
/begin MEASUREMENT UDS_au8DidBuf_0x4D1B "..." UBYTE I_1 1 2 0 255 ECU_ADDRESS 0x70014C2C /end MEASUREMENT
/begin MEASUREMENT UDS_au8DidBuf_0x4D1C "..." UBYTE I_1 1 2 0 255 ECU_ADDRESS 0x70014C2B /end MEASUREMENT
/begin MEASUREMENT UDS_au8DidBuf_0x4D1D "..." UBYTE I_1 1 2 0 255 ECU_ADDRESS 0x70014C2A /end MEASUREMENT
/begin MEASUREMENT UDS_au8DidBuf_0x4D1E "..." UBYTE I_1 1 2 0 255 ECU_ADDRESS 0x70014C29 /end MEASUREMENT
/begin MEASUREMENT UDS_au8DidBuf_0x4D1F "..." UBYTE I_1 1 2 0 255 ECU_ADDRESS 0x70014C28 /end MEASUREMENT
/begin MEASUREMENT UDS_au8DidBuf_0x4D20 "..." UBYTE I_1 1 2 0 255 ECU_ADDRESS 0x70014C27 /end MEASUREMENT
/begin MEASUREMENT UDS_au8DidBuf_0x4D21 "..." UBYTE I_1 1 2 0 255 ECU_ADDRESS 0x70014C26 /end MEASUREMENT
/begin MEASUREMENT UDS_au8DidBuf_0x4D22 "..." UBYTE I_1 1 2 0 255 ECU_ADDRESS 0x70014C25 /end MEASUREMENT
/begin MEASUREMENT UDS_au8DidBuf_0x4D23 "..." UBYTE I_1 1 2 0 255 ECU_ADDRESS 0x70014C24 /end MEASUREMENT
/begin MEASUREMENT UDS_au8DidBuf_0x4D24 "..." UBYTE I_1 1 2 0 255 ECU_ADDRESS 0x70014C23 /end MEASUREMENT
/begin MEASUREMENT UDS_au8DidBuf_0x4D25 "..." UBYTE I_1 1 2 0 255 ECU_ADDRESS 0x70014C22 /end MEASUREMENT
/begin MEASUREMENT UDS_au8DidBuf_0x4D26 "..." UBYTE I_1 1 2 0 255 ECU_ADDRESS 0x70014C21 /end MEASUREMENT
/begin COMPU_METHOD I_1 "" RAT_FUNC "%9.2" "-" COEFFS 0 1 0 0 0 1 /end COMPU_METHOD
/begin COMPU_METHOD F_1_p0_2 "" RAT_FUNC "%9.2" "-" COEFFS 0 1 0 0 0 1 /end COMPU_METHOD
/begin COMPU_METHOD F_0v01_p0_9 "" RAT_FUNC "%9.2" "-" COEFFS 0 1 0 0 0 0.01 /end COMPU_METHOD
/begin COMPU_METHOD F_1_p0_10 "" RAT_FUNC "%9.2" "ms" COEFFS 0 1 0 0 0 1 /end COMPU_METHOD
/begin COMPU_METHOD F_5_p0_12 "" RAT_FUNC "%9.2" "ms" COEFFS 0 1 0 0 0 5 /end COMPU_METHOD
/begin COMPU_METHOD F_0v1_p0_25 "" RAT_FUNC "%9.2" "µs" COEFFS 0 1 0 0 0 0.1 /end COMPU_METHOD
/begin COMPU_METHOD F_1_p0_26 "" RAT_FUNC "%9.2" "%" COEFFS 0 1 0 0 0 1 /end COMPU_METHOD
/begin COMPU_METHOD I_27 "" RAT_FUNC "%9.2" "uint16" COEFFS 0 1 0 0 0 1 /end COMPU_METHOD
/begin COMPU_METHOD I_28 "" RAT_FUNC "%9.2" "" COEFFS 0 1 0 0 0 1 /end COMPU_METHOD
/begin COMPU_METHOD Bool_ON_OFF "" TAB_VERB "%8.4" "." COMPU_TAB_REF Bool_ON_OFF_table /end COMPU_METHOD
/begin COMPU_VTAB Bool_ON_OFF_table "" TAB_VERB 2 0 "OFF" 1 "ON" /end COMPU_VTAB
/begin FUNCTION PreDrv "" /begin DEF_CHARACTERISTIC DRV8340_ku16EnaResetTimeC DRV8340_ku16ErrPinChkTimC /end DEF_CHARACTERISTIC
 /begin OUT_MEASUREMENT DRV8340_au8FaultRegsVal DRV8340_au8FaultRegsVal[0] DRV8340_au8FaultRegsVal[1] DRV8340_au8FaultRegsVal[2] DRV8340_au8FaultRegsVal[3] DRV8340_bDrvOverCurrent DRV8340_bDrvOverTemp DRV8340_bDrvOverVoltage DRV8340_bDrvUnderVoltage DRV8340_bErrorPinLevel DRV8340_bIsInitDone DRV8340_bIsLatched DRV8340_bIsShutdown DRV8340_bPhaseShort DRV8340_bUserReadReq DRV8340_bUserWriteReq DRV8340_u16CfgChkTimer DRV8340_u16EnaResetTime DRV8340_u8AsyncComState DRV8340_u8ErrRecoverCnt DRV8340_u8Mode DRV8340_u8TgtMode DRV83xxHAL_xRegMapRxBuf DRV83xxHAL_xRegMapRxBuf[0] DRV83xxHAL_xRegMapRxBuf[10] DRV83xxHAL_xRegMapRxBuf[11] DRV83xxHAL_xRegMapRxBuf[12] DRV83xxHAL_xRegMapRxBuf[13] DRV83xxHAL_xRegMapRxBuf[14] DRV83xxHAL_xRegMapRxBuf[15] DRV83xxHAL_xRegMapRxBuf[16] DRV83xxHAL_xRegMapRxBuf[17] DRV83xxHAL_xRegMapRxBuf[18] DRV83xxHAL_xRegMapRxBuf[19] DRV83xxHAL_xRegMapRxBuf[1] DRV83xxHAL_xRegMapRxBuf[2] DRV83xxHAL_xRegMapRxBuf[3] DRV83xxHAL_xRegMapRxBuf[4] DRV83xxHAL_xRegMapRxBuf[5] DRV83xxHAL_xRegMapRxBuf[6] DRV83xxHAL_xRegMapRxBuf[7] DRV83xxHAL_xRegMapRxBuf[8] DRV83xxHAL_xRegMapRxBuf[9] DRV83xxHAL_xRegMapTxBuf DRV83xxHAL_xRegMapTxBuf[0] DRV83xxHAL_xRegMapTxBuf[10] DRV83xxHAL_xRegMapTxBuf[11] DRV83xxHAL_xRegMapTxBuf[12] DRV83xxHAL_xRegMapTxBuf[13] DRV83xxHAL_xRegMapTxBuf[14] DRV83xxHAL_xRegMapTxBuf[15] DRV83xxHAL_xRegMapTxBuf[16] DRV83xxHAL_xRegMapTxBuf[17] DRV83xxHAL_xRegMapTxBuf[18] DRV83xxHAL_xRegMapTxBuf[19] DRV83xxHAL_xRegMapTxBuf[1] DRV83xxHAL_xRegMapTxBuf[2] DRV83xxHAL_xRegMapTxBuf[3] DRV83xxHAL_xRegMapTxBuf[4] DRV83xxHAL_xRegMapTxBuf[5] DRV83xxHAL_xRegMapTxBuf[6] DRV83xxHAL_xRegMapTxBuf[7] DRV83xxHAL_xRegMapTxBuf[8] DRV83xxHAL_xRegMapTxBuf[9] DRV83xxRegDriverCur Reg_Map_Cache Reg_Map_Cache[0] Reg_Map_Cache[10] Reg_Map_Cache[11] Reg_Map_Cache[12] Reg_Map_Cache[13] Reg_Map_Cache[14] Reg_Map_Cache[15] Reg_Map_Cache[16] Reg_Map_Cache[17] Reg_Map_Cache[1] Reg_Map_Cache[2] Reg_Map_Cache[3] Reg_Map_Cache[4] Reg_Map_Cache[5] Reg_Map_Cache[6] Reg_Map_Cache[7] Reg_Map_Cache[8] Reg_Map_Cache[9] /end OUT_MEASUREMENT
/end FUNCTION
/begin FUNCTION RES ""
 /begin DEF_CHARACTERISTIC RES_bGenerateSyncPosC RES_u16ExcitDelayC RES_u16SyncDelay2C RES_u16SyncDelayC RES_u16VSICkreqPeriodDefC RES_u8ExcitDutyPercentC RES_u8SyncDutyPercentC /end DEF_CHARACTERISTIC
/end FUNCTION
/begin FUNCTION RTE ""
 /begin OUT_MEASUREMENT Core0_Asw100msStartTime Core0_Asw100msStopTime Core0_Asw100msTotalTime Core0_Asw10msStartTime Core0_Asw10msStopTime Core0_Asw10msTotalTime Core0_Bsw100msStartTime Core0_Bsw100msStopTime Core0_Bsw100msTotalTime Core0_Bsw10msStartTime Core0_Bsw10msStopTime Core0_Bsw10msTotalTime Core0_Bsw1msStartTime Core0_Bsw1msStopTime Core0_Bsw1msTotalTime Core0_Bsw50msStartTime Core0_Bsw50msStopTime Core0_Bsw50msTotalTime Core1_Asw10msStartTime Core1_Asw10msStopTime Core1_Asw10msTotalTime Core1_Asw1msStartTime Core1_Asw1msStopTime Core1_Asw1msTotalTime Core1_Bsw10msStartTime Core1_Bsw10msStopTime Core1_Bsw10msTotalTime Core2_Asw10msStartTime Core2_Asw10msStopTime Core2_Asw10msTotalTime Core2_Asw1msStartTime Core2_Asw1msStopTime Core2_Asw1msTotalTime Core2_Bsw10msStartTime Core2_Bsw10msStopTime Core2_Bsw10msTotalTime Rte_ModeCurrent_0 Rte_ModeCurrent_4 /end OUT_MEASUREMENT
/end FUNCTION
/begin FUNCTION SBC "" /begin DEF_CHARACTERISTIC SBC_ku16IntUnderVoltThdC SBC_ku16IntUvTimoutC /end DEF_CHARACTERISTIC
 /begin OUT_MEASUREMENT SBC_au16StatusRegsNvm SBC_au16StatusRegsNvm[0] SBC_au16StatusRegsNvm[10] SBC_au16StatusRegsNvm[11] SBC_au16StatusRegsNvm[12] SBC_au16StatusRegsNvm[13] SBC_au16StatusRegsNvm[14] SBC_au16StatusRegsNvm[15] SBC_au16StatusRegsNvm[16] SBC_au16StatusRegsNvm[17] SBC_au16StatusRegsNvm[1] SBC_au16StatusRegsNvm[2] SBC_au16StatusRegsNvm[3] SBC_au16StatusRegsNvm[4] SBC_au16StatusRegsNvm[5] SBC_au16StatusRegsNvm[6] SBC_au16StatusRegsNvm[7] SBC_au16StatusRegsNvm[8] SBC_au16StatusRegsNvm[9] SBC_bDeintWdgCmd SBC_bOtherSttFailFlg SBC_f32BatteryVoltage SBC_f32BkpVoltage SBC_u16GatewayRaw SBC_u16IntUvTimCnt SBC_u16MainSupRaw SBC_u16OtherAbnormCnt SBC_u16P5vAD2SRaw SBC_u16P5vRefProtRaw /end OUT_MEASUREMENT
/end FUNCTION
/begin FUNCTION SPY ""
 /begin OUT_MEASUREMENT SPY_bBufFull SPY_u16DaqListFirstElmIdx SPY_u16NrOfElmsToTx SPY_u16PreTrigSmplIdx SPY_u16RmngSmplIdx SPY_u16SmplIdx SPY_u16TrigSmplIdx /end OUT_MEASUREMENT
/end FUNCTION
/begin FUNCTION STFSRV ""
 /begin DEF_CHARACTERISTIC ESM_bPowerOffModeInhC ESM_ku16AfterrunToutCntC GESM_bPowerOffModeInhC GESM_ku16AfterrunToutCntC /end DEF_CHARACTERISTIC
 /begin OUT_MEASUREMENT ESM_bAfterrunFin ESM_bAfterrunReq ESM_bCallAppliOn ESM_bMcuEnaReq ESM_bPwrDnReadyFlg ESM_bPwrLNfClrFltFinsh ESM_ESM_MODE_FT ESM_ESM_MODE_NF ESM_EsmMode ESM_OpFtState ESM_OpNfState ESM_PwrLFtState ESM_PwrLNfState ESM_StpIIFtState ESM_StpIINfState ESM_StpIState ESM_u16CmdReq ESM_u16CmdReqNm1 ESM_u16CmdRes ESM_u8AllowPwrDnDelay ESM_u8PwrLNfStep ESM_u8PwrOffTim ESM_u8RestartDelayCnt GESM_bAfterrunFin GESM_bAfterrunReq GESM_bCallAppliOn GESM_bMcuEnaReq GESM_bPwrDnReadyFlg GESM_bPwrLNfClrFltFinsh GESM_ESM_MODE_FT GESM_ESM_MODE_NF GESM_EsmMode GESM_OpFtState GESM_OpNfState GESM_PwrLFtState GESM_PwrLNfState GESM_StpIIFtState GESM_StpIINfState GESM_StpIState GESM_u16AfterrunCnt GESM_u16CmdReq GESM_u16CmdReqNm1 GESM_u16CmdRes GESM_u8AllowPwrDnDelay GESM_u8PwrLNfStep GESM_u8PwrOffTim GESM_u8RestartDelayCnt /end OUT_MEASUREMENT
/end FUNCTION
/begin FUNCTION TLE9180 ""
 /begin DEF_CHARACTERISTIC TLE9180_bManualReadRegC TLE9180_kf32PhsTempFaultC TLE9180_ku16EnaResetTimeC TLE9180_ku16ErrPinChkTimC TLE9180_ku8ErrRecvMaxNumC /end DEF_CHARACTERISTIC
 /begin OUT_MEASUREMENT TLE9180_af32ReadPhsTempPhys TLE9180_af32ReadPhsTempPhys[0] TLE9180_af32ReadPhsTempPhys[1] TLE9180_af32ReadPhsTempPhys[2] TLE9180_af32ReadPhsTempPhys[3] TLE9180_af32ReadPhsTempPhys[4] TLE9180_af32ReadPhsTempPhys[5] TLE9180_au32SpiReadFrame TLE9180_au32SpiReadFrame[0] TLE9180_au32SpiReadFrame[10] TLE9180_au32SpiReadFrame[11] TLE9180_au32SpiReadFrame[12] TLE9180_au32SpiReadFrame[13] TLE9180_au32SpiReadFrame[14] TLE9180_au32SpiReadFrame[15] TLE9180_au32SpiReadFrame[16] TLE9180_au32SpiReadFrame[17] TLE9180_au32SpiReadFrame[18] TLE9180_au32SpiReadFrame[19] TLE9180_au32SpiReadFrame[1] TLE9180_au32SpiReadFrame[20] TLE9180_au32SpiReadFrame[21] TLE9180_au32SpiReadFrame[22] TLE9180_au32SpiReadFrame[23] TLE9180_au32SpiReadFrame[24] TLE9180_au32SpiReadFrame[25] TLE9180_au32SpiReadFrame[26] TLE9180_au32SpiReadFrame[27] TLE9180_au32SpiReadFrame[28] TLE9180_au32SpiReadFrame[29] TLE9180_au32SpiReadFrame[2] TLE9180_au32SpiReadFrame[3] TLE9180_au32SpiReadFrame[4] TLE9180_au32SpiReadFrame[5] TLE9180_au32SpiReadFrame[6] TLE9180_au32SpiReadFrame[7] TLE9180_au32SpiReadFrame[8] TLE9180_au32SpiReadFrame[9] TLE9180_au32SpiWriteFrame TLE9180_au32SpiWriteFrame[0] TLE9180_au32SpiWriteFrame[10] TLE9180_au32SpiWriteFrame[11] TLE9180_au32SpiWriteFrame[12] TLE9180_au32SpiWriteFrame[13] TLE9180_au32SpiWriteFrame[14] TLE9180_au32SpiWriteFrame[15] TLE9180_au32SpiWriteFrame[16] TLE9180_au32SpiWriteFrame[17] TLE9180_au32SpiWriteFrame[18] TLE9180_au32SpiWriteFrame[19] TLE9180_au32SpiWriteFrame[1] TLE9180_au32SpiWriteFrame[20] TLE9180_au32SpiWriteFrame[21] TLE9180_au32SpiWriteFrame[22] TLE9180_au32SpiWriteFrame[23] TLE9180_au32SpiWriteFrame[24] TLE9180_au32SpiWriteFrame[25] TLE9180_au32SpiWriteFrame[26] TLE9180_au32SpiWriteFrame[27] TLE9180_au32SpiWriteFrame[28] TLE9180_au32SpiWriteFrame[29] TLE9180_au32SpiWriteFrame[2] TLE9180_au32SpiWriteFrame[3] TLE9180_au32SpiWriteFrame[4] TLE9180_au32SpiWriteFrame[5] TLE9180_au32SpiWriteFrame[6] TLE9180_au32SpiWriteFrame[7] TLE9180_au32SpiWriteFrame[8] TLE9180_au32SpiWriteFrame[9] TLE9180_au8CfgRegister TLE9180_au8CfgRegister[0] TLE9180_au8CfgRegister[10] TLE9180_au8CfgRegister[11] TLE9180_au8CfgRegister[12] TLE9180_au8CfgRegister[13] TLE9180_au8CfgRegister[14] TLE9180_au8CfgRegister[15] TLE9180_au8CfgRegister[16] TLE9180_au8CfgRegister[17] TLE9180_au8CfgRegister[18] TLE9180_au8CfgRegister[19] TLE9180_au8CfgRegister[1] TLE9180_au8CfgRegister[20] TLE9180_au8CfgRegister[21] TLE9180_au8CfgRegister[22] TLE9180_au8CfgRegister[23] TLE9180_au8CfgRegister[24] TLE9180_au8CfgRegister[25] TLE9180_au8CfgRegister[26] TLE9180_au8CfgRegister[27] TLE9180_au8CfgRegister[28] TLE9180_au8CfgRegister[29] TLE9180_au8CfgRegister[2] TLE9180_au8CfgRegister[3] TLE9180_au8CfgRegister[4] TLE9180_au8CfgRegister[5] TLE9180_au8CfgRegister[6] TLE9180_au8CfgRegister[7] TLE9180_au8CfgRegister[8] TLE9180_au8CfgRegister[9] TLE9180_au8CfgRegReadBk TLE9180_au8CfgRegReadBk[0] TLE9180_au8CfgRegReadBk[10] TLE9180_au8CfgRegReadBk[11] TLE9180_au8CfgRegReadBk[12] TLE9180_au8CfgRegReadBk[13] TLE9180_au8CfgRegReadBk[14] TLE9180_au8CfgRegReadBk[15] TLE9180_au8CfgRegReadBk[16] TLE9180_au8CfgRegReadBk[17] TLE9180_au8CfgRegReadBk[18] TLE9180_au8CfgRegReadBk[19] TLE9180_au8CfgRegReadBk[1] TLE9180_au8CfgRegReadBk[20] TLE9180_au8CfgRegReadBk[21] TLE9180_au8CfgRegReadBk[22] TLE9180_au8CfgRegReadBk[23] TLE9180_au8CfgRegReadBk[24] TLE9180_au8CfgRegReadBk[25] TLE9180_au8CfgRegReadBk[26] TLE9180_au8CfgRegReadBk[27] TLE9180_au8CfgRegReadBk[28] TLE9180_au8CfgRegReadBk[29] TLE9180_au8CfgRegReadBk[2] TLE9180_au8CfgRegReadBk[3] TLE9180_au8CfgRegReadBk[4] TLE9180_au8CfgRegReadBk[5] TLE9180_au8CfgRegReadBk[6] TLE9180_au8CfgRegReadBk[7] TLE9180_au8CfgRegReadBk[8] TLE9180_au8CfgRegReadBk[9] TLE9180_au8ReadPhsTemp TLE9180_au8ReadPhsTemp[0] TLE9180_au8ReadPhsTemp[1] TLE9180_au8ReadPhsTemp[2] TLE9180_au8ReadPhsTemp[3] TLE9180_au8ReadPhsTemp[4] TLE9180_au8ReadPhsTemp[5] TLE9180_au8ReadRegs TLE9180_au8ReadRegs[0] TLE9180_au8ReadRegs[10] TLE9180_au8ReadRegs[11] TLE9180_au8ReadRegs[12] TLE9180_au8ReadRegs[13] TLE9180_au8ReadRegs[14] TLE9180_au8ReadRegs[15] TLE9180_au8ReadRegs[16] TLE9180_au8ReadRegs[17] TLE9180_au8ReadRegs[18] TLE9180_au8ReadRegs[19] TLE9180_au8ReadRegs[1] TLE9180_au8ReadRegs[20] TLE9180_au8ReadRegs[21] TLE9180_au8ReadRegs[22] TLE9180_au8ReadRegs[23] TLE9180_au8ReadRegs[24] TLE9180_au8ReadRegs[25] TLE9180_au8ReadRegs[26] TLE9180_au8ReadRegs[27] TLE9180_au8ReadRegs[28] TLE9180_au8ReadRegs[29] TLE9180_au8ReadRegs[2] TLE9180_au8ReadRegs[3] TLE9180_au8ReadRegs[4] TLE9180_au8ReadRegs[5] TLE9180_au8ReadRegs[6] TLE9180_au8ReadRegs[7] TLE9180_au8ReadRegs[8] TLE9180_au8ReadRegs[9] TLE9180_bDrvOverCurrent TLE9180_bDrvOverTemp TLE9180_bDrvOverVoltage TLE9180_bDrvUnderVoltage TLE9180_bErrorPinLevel TLE9180_bInitFailFlg TLE9180_bPhaseShortHigh TLE9180_bPhaseShortLow TLE9180_bPhsOverVolt TLE9180_bReadErrInfoFlg TLE9180_bTestReadReg TLE9180_bTestWriteReg TLE9180_f32MaxPhsTempPhys TLE9180_u16EnaResetTime TLE9180_u16ErrPinChkCnt TLE9180_u8ErrRecoverCnt TLE9180_u8Mode TLE9180_u8RdRegTimCnt TLE9180_u8ReadRegAddr TLE9180_u8SelfTestStep TLE9180_u8SpiTxFrameMaxNb TLE9180_u8WriteData TLE9180_u8WriteRegAddr /end OUT_MEASUREMENT
/end FUNCTION
/begin FUNCTION TPPC ""
 /begin OUT_MEASUREMENT TPPC_bClrFaultReq_ACM TPPC_bClrFaultReq_EPS TPPC_bHwFaultDcOvVolt_ACM TPPC_bHwFaultDcOvVolt_EPS TPPC_bHwFaultIgbt_ACM TPPC_bHwFaultIgbt_EPS TPPC_bHwFaultIgbtH_ACM TPPC_bHwFaultIgbtH_EPS TPPC_bHwFaultIgbtL_ACM TPPC_bHwFaultIgbtL_EPS TPPC_bIsStart_ACM TPPC_bIsStart_EPS TPPC_bMotorSpdRdy_ACM TPPC_bMotorSpdRdy_EPS TPPC_bP5VHSFltFlg_ACM TPPC_bP5VHSFltFlg_EPS TPPC_bP5VLSFltFlg_ACM TPPC_bP5VLSFltFlg_EPS TPPC_bPwmOnGoingFlg_ACM TPPC_bPwmOnGoingFlg_EPS TPPC_u16McuAscSttDelay_ACM TPPC_u16McuAscSttDelay_EPS TPPC_u16PowerOnDelay_ACM TPPC_u16PowerOnDelay_EPS TPPC_u16PwmModReq_ACM TPPC_u16PwmModReq_EPS TPPC_u8AscRecoverCnt_ACM TPPC_u8AscRecoverCnt_EPS TPPC_u8AscStep_ACM TPPC_u8AscStep_EPS TPPC_u8AscType_ACM TPPC_u8AscType_EPS TPPC_u8PwmState_ACM TPPC_u8PwmState_EPS /end OUT_MEASUREMENT
/end FUNCTION
/begin FUNCTION UDS ""
 /begin OUT_MEASUREMENT UDS_au8CalibSoftId UDS_au8CalibSoftId[0] UDS_au8CalibSoftId[10] UDS_au8CalibSoftId[11] UDS_au8CalibSoftId[12] UDS_au8CalibSoftId[13] UDS_au8CalibSoftId[14] UDS_au8CalibSoftId[15] UDS_au8CalibSoftId[1] UDS_au8CalibSoftId[2] UDS_au8CalibSoftId[3] UDS_au8CalibSoftId[4] UDS_au8CalibSoftId[5] UDS_au8CalibSoftId[6] UDS_au8CalibSoftId[7] UDS_au8CalibSoftId[8] UDS_au8CalibSoftId[9] UDS_au8DidBuf_0x0B01 UDS_au8DidBuf_0x0B01[0] UDS_au8DidBuf_0x0B01[1] UDS_au8DidBuf_0x0B02 UDS_au8DidBuf_0x0B02[0] UDS_au8DidBuf_0x0B02[1] UDS_au8DidBuf_0x0B02[2] UDS_au8DidBuf_0x0B02[3] UDS_au8DidBuf_0x0B03 UDS_au8DidBuf_0x0B03[0] UDS_au8DidBuf_0x0B03[1] UDS_au8DidBuf_0x0B08 UDS_au8DidBuf_0x0B08[0] UDS_au8DidBuf_0x0B08[1] UDS_au8DidBuf_0x0B0B UDS_au8DidBuf_0x0D00 UDS_au8DidBuf_0x0D10 UDS_au8DidBuf_0x0D11 UDS_au8DidBuf_0x0D11[0] UDS_au8DidBuf_0x0D11[1] UDS_au8DidBuf_0x0D12 UDS_au8DidBuf_0x0D12[0] UDS_au8DidBuf_0x0D12[1] UDS_au8DidBuf_0x0D2B UDS_au8DidBuf_0x1D00 UDS_au8DidBuf_0x1D10 UDS_au8DidBuf_0x1D11 UDS_au8DidBuf_0x1D11[0] UDS_au8DidBuf_0x1D11[1] UDS_au8DidBuf_0x1D12 UDS_au8DidBuf_0x1D12[0] UDS_au8DidBuf_0x1D12[1] UDS_au8DidBuf_0x1D2B UDS_au8DidBuf_0x2D09 UDS_au8DidBuf_0x2D0A UDS_au8DidBuf_0x2D0C UDS_au8DidBuf_0x2D0C[0] UDS_au8DidBuf_0x2D0C[1] UDS_au8DidBuf_0x2D0C_1 UDS_au8DidBuf_0x2D0C_1[0] UDS_au8DidBuf_0x2D0C_1[1] UDS_au8DidBuf_0x2D0C_2 UDS_au8DidBuf_0x2D0C_2[0] UDS_au8DidBuf_0x2D0C_2[1] UDS_au8DidBuf_0x2D0D UDS_au8DidBuf_0x2D0D[0] UDS_au8DidBuf_0x2D0D[1] UDS_au8DidBuf_0x2D11 UDS_au8DidBuf_0x2D11[0] UDS_au8DidBuf_0x2D11[1] UDS_au8DidBuf_0x2D12 UDS_au8DidBuf_0x2D12[0] UDS_au8DidBuf_0x2D12[1] UDS_au8DidBuf_0x2D23 UDS_au8DidBuf_0x2D23[0] UDS_au8DidBuf_0x2D23[1] UDS_au8DidBuf_0x2D24 UDS_au8DidBuf_0x2D24[0] UDS_au8DidBuf_0x2D24[1] UDS_au8DidBuf_0x2D27 UDS_au8DidBuf_0x2D27[0] UDS_au8DidBuf_0x2D27[1] UDS_au8DidBuf_0x2D28 UDS_au8DidBuf_0x2D28[0] UDS_au8DidBuf_0x2D28[1] UDS_au8DidBuf_0x3D09 UDS_au8DidBuf_0x3D0A UDS_au8DidBuf_0x3D0C UDS_au8DidBuf_0x3D0C[0] UDS_au8DidBuf_0x3D0C[1] UDS_au8DidBuf_0x3D0C_1 UDS_au8DidBuf_0x3D0C_1[0] UDS_au8DidBuf_0x3D0C_1[1] UDS_au8DidBuf_0x3D0C_2 UDS_au8DidBuf_0x3D0C_2[0] UDS_au8DidBuf_0x3D0C_2[1] UDS_au8DidBuf_0x3D0D UDS_au8DidBuf_0x3D0D[0] UDS_au8DidBuf_0x3D0D[1] UDS_au8DidBuf_0x3D11 UDS_au8DidBuf_0x3D11[0] UDS_au8DidBuf_0x3D11[1] UDS_au8DidBuf_0x3D12 UDS_au8DidBuf_0x3D12[0] UDS_au8DidBuf_0x3D12[1] UDS_au8DidBuf_0x3D23 UDS_au8DidBuf_0x3D23[0] UDS_au8DidBuf_0x3D23[1] UDS_au8DidBuf_0x3D24 UDS_au8DidBuf_0x3D24[0] UDS_au8DidBuf_0x3D24[1] UDS_au8DidBuf_0x3D27 UDS_au8DidBuf_0x3D27[0] UDS_au8DidBuf_0x3D27[1] UDS_au8DidBuf_0x3D28 UDS_au8DidBuf_0x3D28[0] UDS_au8DidBuf_0x3D28[1] UDS_au8DidBuf_0x4D00 UDS_au8DidBuf_0x4D01 UDS_au8DidBuf_0x4D02 UDS_au8DidBuf_0x4D03 UDS_au8DidBuf_0x4D04 UDS_au8DidBuf_0x4D05 UDS_au8DidBuf_0x4D06 UDS_au8DidBuf_0x4D07 UDS_au8DidBuf_0x4D08 UDS_au8DidBuf_0x4D09 UDS_au8DidBuf_0x4D0A UDS_au8DidBuf_0x4D0B UDS_au8DidBuf_0x4D0C UDS_au8DidBuf_0x4D0D UDS_au8DidBuf_0x4D0E UDS_au8DidBuf_0x4D0F UDS_au8DidBuf_0x4D10 UDS_au8DidBuf_0x4D11 UDS_au8DidBuf_0x4D12 UDS_au8DidBuf_0x4D13 UDS_au8DidBuf_0x4D14 UDS_au8DidBuf_0x4D15 UDS_au8DidBuf_0x4D16 UDS_au8DidBuf_0x4D17 UDS_au8DidBuf_0x4D18 UDS_au8DidBuf_0x4D19 UDS_au8DidBuf_0x4D1A UDS_au8DidBuf_0x4D1B UDS_au8DidBuf_0x4D1C UDS_au8DidBuf_0x4D1D UDS_au8DidBuf_0x4D1E UDS_au8DidBuf_0x4D1F UDS_au8DidBuf_0x4D20 UDS_au8DidBuf_0x4D21 UDS_au8DidBuf_0x4D22 UDS_au8DidBuf_0x4D23 UDS_au8DidBuf_0x4D24 UDS_au8DidBuf_0x4D25 UDS_au8DidBuf_0x4D26 /end OUT_MEASUREMENT
/end FUNCTION
/begin GROUP ADS1115 "ADS1115_GROUP" ROOT /begin FUNCTION_LIST ADS1115 /end FUNCTION_LIST /end GROUP
/begin GROUP AMAIN "AMAIN_GROUP" ROOT /begin FUNCTION_LIST AMAIN /end FUNCTION_LIST /end GROUP
/begin GROUP Acquisitions "Acquisitions_GROUP" ROOT /begin FUNCTION_LIST MAIN /end FUNCTION_LIST /end GROUP
/begin GROUP Application "Application_GROUP" ROOT /begin FUNCTION_LIST ESM HARD /end FUNCTION_LIST /end GROUP
/begin GROUP AutoMSGCan01_Rx01_PDUMC1 "AutoMSGCan01_Rx01_PDUMC1_GROUP" ROOT /begin FUNCTION_LIST MAIN /end FUNCTION_LIST /end GROUP
/begin GROUP AutoMSGCan01_Rx02_HSMC1 "AutoMSGCan01_Rx02_HSMC1_GROUP" ROOT /begin FUNCTION_LIST MAIN /end FUNCTION_LIST /end GROUP
/begin GROUP AutoMSGCan01_Rx03_HSSTC "AutoMSGCan01_Rx03_HSSTC_GROUP" ROOT /begin FUNCTION_LIST MAIN /end FUNCTION_LIST /end GROUP
/begin GROUP AutoMSGCan01_Rx04_ACUMC1 "AutoMSGCan01_Rx04_ACUMC1_GROUP" ROOT /begin FUNCTION_LIST MAIN /end FUNCTION_LIST /end GROUP
/begin GROUP AutoMSGCan01_Rx05_AIR1 "AutoMSGCan01_Rx05_AIR1_GROUP" ROOT /begin FUNCTION_LIST MAIN /end FUNCTION_LIST /end GROUP
/begin GROUP AutoMSGCan01_Rx06_AIR1 "AutoMSGCan01_Rx06_AIR1_GROUP" ROOT /begin FUNCTION_LIST MAIN /end FUNCTION_LIST /end GROUP
/begin GROUP AutoMSGCan01_Tx01_PDUST1 "AutoMSGCan01_Tx01_PDUST1_GROUP" ROOT /begin FUNCTION_LIST MAIN /end FUNCTION_LIST /end GROUP
/begin GROUP AutoMSGCan01_Tx02_PDUST2 "AutoMSGCan01_Tx02_PDUST2_GROUP" ROOT /begin FUNCTION_LIST MAIN /end FUNCTION_LIST /end GROUP
/begin GROUP AutoMSGCan01_Tx03_PDUST3 "AutoMSGCan01_Tx03_PDUST3_GROUP" ROOT /begin FUNCTION_LIST MAIN /end FUNCTION_LIST /end GROUP
/begin GROUP AutoMSGCan01_Tx04_PDUST4 "AutoMSGCan01_Tx04_PDUST4_GROUP" ROOT /begin FUNCTION_LIST MAIN /end FUNCTION_LIST /end GROUP
/begin GROUP AutoMSGCan01_Tx05_HSST1 "AutoMSGCan01_Tx05_HSST1_GROUP" ROOT /begin FUNCTION_LIST MAIN /end FUNCTION_LIST /end GROUP
/begin GROUP AutoMSGCan01_Tx06_HSST2 "AutoMSGCan01_Tx06_HSST2_GROUP" ROOT /begin FUNCTION_LIST MAIN /end FUNCTION_LIST /end GROUP
/begin GROUP AutoMSGCan01_Tx07_ACUST1 "AutoMSGCan01_Tx07_ACUST1_GROUP" ROOT /begin FUNCTION_LIST MAIN /end FUNCTION_LIST /end GROUP
/begin GROUP AutoMSGCan01_Tx08_ACUST2 "AutoMSGCan01_Tx08_ACUST2_GROUP" ROOT /begin FUNCTION_LIST MAIN /end FUNCTION_LIST /end GROUP
/begin GROUP AutoMSGCan02_Rx01_MC2 "AutoMSGCan02_Rx01_MC2_GROUP" ROOT /begin FUNCTION_LIST MAIN /end FUNCTION_LIST /end GROUP
/begin GROUP AutoMSGCan02_Rx02_CCVS "AutoMSGCan02_Rx02_CCVS_GROUP" ROOT /begin FUNCTION_LIST MAIN /end FUNCTION_LIST /end GROUP
/begin GROUP AutoMSGCan02_Rx03_TS1 "AutoMSGCan02_Rx03_TS1_GROUP" ROOT /begin FUNCTION_LIST MAIN /end FUNCTION_LIST /end GROUP
/begin GROUP AutoMSGCan02_Tx01_MS0 "AutoMSGCan02_Tx01_MS0_GROUP" ROOT /begin FUNCTION_LIST MAIN /end FUNCTION_LIST /end GROUP
/begin GROUP AutoMSGCan02_Tx02_MS1 "AutoMSGCan02_Tx02_MS1_GROUP" ROOT /begin FUNCTION_LIST MAIN /end FUNCTION_LIST /end GROUP
/begin GROUP AutoMSGCan02_Tx03_MS2 "AutoMSGCan02_Tx03_MS2_GROUP" ROOT /begin FUNCTION_LIST MAIN /end FUNCTION_LIST /end GROUP
/begin GROUP AutoMSGCan02_Tx04_MDM1 "AutoMSGCan02_Tx04_MDM1_GROUP" ROOT /begin FUNCTION_LIST MAIN /end FUNCTION_LIST /end GROUP
/begin GROUP AutoMSGCan02_Tx05_MS3 "AutoMSGCan02_Tx05_MS3_GROUP" ROOT /begin FUNCTION_LIST MAIN /end FUNCTION_LIST /end GROUP
/begin GROUP AutoMSG_Rx27 "AutoMSG_Rx27_GROUP" ROOT /end GROUP
/begin GROUP BLDC "BLDC_GROUP" ROOT /begin FUNCTION_LIST BLDC /end FUNCTION_LIST /end GROUP
/begin GROUP BSW "BSW_GROUP" ROOT /begin FUNCTION_LIST BSW FAIL UDS /end FUNCTION_LIST /end GROUP
/begin GROUP CALUSR "CALUSR_GROUP" ROOT /begin FUNCTION_LIST CALUSR /end FUNCTION_LIST /end GROUP
/begin GROUP CCU6 "CCU6_GROUP" ROOT /begin FUNCTION_LIST CCU6 /end FUNCTION_LIST /end GROUP
/begin GROUP COMMUSR "COMMUSR_GROUP" ROOT /end GROUP
/begin GROUP Calib "Calib_GROUP" ROOT /begin FUNCTION_LIST MAIN /end FUNCTION_LIST /end GROUP
/begin GROUP Calibration "Calibration_GROUP" /begin SUB_GROUP DEV /end SUB_GROUP /end GROUP
/begin GROUP Com "Com_GROUP" ROOT /begin FUNCTION_LIST MAIN /end FUNCTION_LIST /end GROUP
/begin GROUP Communication "Communication_GROUP" /begin FUNCTION_LIST CCU6 /end FUNCTION_LIST /end GROUP
/begin GROUP DCU_1 "DCU_1_GROUP" /begin SUB_GROUP Communication /end SUB_GROUP /end GROUP
/begin GROUP DEV "DEV_GROUP" /end GROUP
/begin GROUP DFLASH "DFLASH_GROUP" ROOT /end GROUP
/begin GROUP DSM "DSM_GROUP" /begin FUNCTION_LIST FAULT_FF /end FUNCTION_LIST /end GROUP
/begin GROUP Develop "Develop_GROUP" ROOT /begin FUNCTION_LIST MAIN /end FUNCTION_LIST /end GROUP
/begin GROUP Development_z "Development_z_GROUP" ROOT /begin FUNCTION_LIST DEVHAL SPY /end FUNCTION_LIST /end GROUP
/begin GROUP Developpement "Developpement_GROUP" ROOT /begin FUNCTION_LIST BSW HARD /end FUNCTION_LIST /end GROUP
/begin GROUP Diagnostic "Diagnostic_GROUP" ROOT /begin FUNCTION_LIST BSW DSM FAULT MAIN /end FUNCTION_LIST /end GROUP
/begin GROUP Divers "Divers_GROUP" ROOT /begin FUNCTION_LIST MAIN /end FUNCTION_LIST /end GROUP
/begin GROUP Driver "Driver_GROUP" ROOT /begin FUNCTION_LIST COMMUSR MAIN RES SBC STFSRV /end FUNCTION_LIST /end GROUP
/begin GROUP EAS "EAS_GROUP" ROOT /begin FUNCTION_LIST EAS /end FUNCTION_LIST /end GROUP
/begin GROUP FAIL "FAIL_GROUP" ROOT /begin FUNCTION_LIST FAIL /end FUNCTION_LIST /end GROUP
/begin GROUP FAULT_FF "FAULT_FF_GROUP" ROOT /begin SUB_GROUP DSM /end SUB_GROUP /end GROUP
/begin GROUP FRecord "FRecord_GROUP" ROOT /end GROUP
/begin GROUP GCCU6 "GCCU6_GROUP" ROOT /begin FUNCTION_LIST GCCU6 /end FUNCTION_LIST /end GROUP
/begin GROUP GMAIN "GMAIN_GROUP" ROOT /begin FUNCTION_LIST GMAIN MAIN /end FUNCTION_LIST /end GROUP
/begin GROUP HardAN "HardAN_GROUP" ROOT /begin FUNCTION_LIST HARD /end FUNCTION_LIST /end GROUP
/begin GROUP HardRead "HardRead_GROUP" ROOT /begin FUNCTION_LIST HARD /end FUNCTION_LIST /end GROUP
/begin GROUP HardWrite "HardWrite_GROUP" ROOT /begin FUNCTION_LIST HARD /end FUNCTION_LIST /end GROUP
/begin GROUP MAIN "MAIN_GROUP" ROOT /begin FUNCTION_LIST MAIN /end FUNCTION_LIST /end GROUP
/begin GROUP Main "Main_GROUP" ROOT /begin FUNCTION_LIST MAIN SPY /end FUNCTION_LIST /end GROUP
/begin GROUP Miscellaneous "Miscellaneous_GROUP" ROOT /end GROUP
/begin GROUP Noyau "Noyau_GROUP" ROOT /end GROUP
/begin GROUP NvM "NvM_GROUP" ROOT /end GROUP
/begin GROUP OBD "OBD_GROUP" ROOT /begin FUNCTION_LIST OBD /end FUNCTION_LIST /end GROUP
/begin GROUP OC "OC_GROUP" ROOT /begin FUNCTION_LIST MAIN /end FUNCTION_LIST /end GROUP
/begin GROUP OMAIN "OMAIN_GROUP" ROOT /begin FUNCTION_LIST OMAIN /end FUNCTION_LIST /end GROUP
/begin GROUP Physical "Physical_GROUP" ROOT /begin SUB_GROUP DCU_1 /end SUB_GROUP /end GROUP
/begin GROUP PortMux "PortMux_GROUP" ROOT /begin FUNCTION_LIST PortMux /end FUNCTION_LIST /end GROUP
/begin GROUP PreDrv "PreDrv_GROUP" ROOT /begin FUNCTION_LIST PreDrv /end FUNCTION_LIST /end GROUP
/begin GROUP RSTSRV "RSTSRV_GROUP" ROOT /end GROUP
/begin GROUP RTE "RTE_GROUP" ROOT /begin FUNCTION_LIST RTE /end FUNCTION_LIST /end GROUP
/begin GROUP Raw "Raw_GROUP" ROOT /begin SUB_GROUP Calibration /end SUB_GROUP /end GROUP
/begin GROUP RunTime "RunTime_GROUP" ROOT /begin FUNCTION_LIST MAIN /end FUNCTION_LIST /end GROUP
/begin GROUP RxChecksum "RxChecksum_GROUP" ROOT /end GROUP
/begin GROUP SBC "SBC_GROUP" ROOT /begin FUNCTION_LIST SBC /end FUNCTION_LIST /end GROUP
/begin GROUP TJA1145 "TJA1145_GROUP" ROOT /end GROUP
/begin GROUP TLE9180 "TLE9180_GROUP" ROOT /begin FUNCTION_LIST TLE9180 /end FUNCTION_LIST /end GROUP
/begin GROUP TOutFlag_Can01 "TOutFlag_Can01_GROUP" ROOT /begin FUNCTION_LIST BSW /end FUNCTION_LIST /end GROUP
/begin GROUP TOutFlag_Can02 "TOutFlag_Can02_GROUP" ROOT /begin FUNCTION_LIST BSW /end FUNCTION_LIST /end GROUP
/begin GROUP TOutFlag_Can03 "TOutFlag_Can03_GROUP" ROOT /begin FUNCTION_LIST BSW /end FUNCTION_LIST /end GROUP
/begin GROUP TPPC "TPPC_GROUP" ROOT /begin FUNCTION_LIST TPPC /end FUNCTION_LIST /end GROUP
/begin GROUP TST "TST_GROUP" ROOT /begin FUNCTION_LIST HARD /end FUNCTION_LIST /end GROUP
/begin GROUP UDS "UDS_GROUP" ROOT /begin FUNCTION_LIST UDS /end FUNCTION_LIST /end GROUP
/begin GROUP miscellaneous "miscellaneous_GROUP" ROOT /end GROUP
/begin GROUP miscellenious "miscellenious_GROUP" ROOT /end GROUP
/begin COMPU_METHOD ESM_EsmMode_conv "" TAB_VERB "%8.4" "." COMPU_TAB_REF ESM_EsmMode_table /end COMPU_METHOD
/begin COMPU_VTAB ESM_EsmMode_table "" TAB_VERB 2 1 "ESM_ESM_MODE_NF" 4 "ESM_ESM_MODE_FT" /end COMPU_VTAB
/begin COMPU_METHOD GESM_EsmMode_conv "" TAB_VERB "%8.4" "." COMPU_TAB_REF GESM_EsmMode_table /end COMPU_METHOD
/begin COMPU_VTAB GESM_EsmMode_table "" TAB_VERB 2 1 "GESM_ESM_MODE_NF" 4 "GESM_ESM_MODE_FT" /end COMPU_VTAB
/end MODULE
/end PROJECT
