ASAP2_VERSION 1 3
/begin PROJECT P_TC387_PLATFORM_0_0 "P_TC387_PLATFORM_0_0"
/begin HEADER "" VERSION "5210.00" PROJECT_NO D0 /end HEADER
/begin MODULE P_TC387_PLATFORM_0_0 "Invt"
/begin MOD_COMMON "" DEPOSIT ABSOLUTE ALIGNMENT_BYTE 1 ALIGNMENT_WORD 2 ALIGNMENT_LONG 4 ALIGNMENT_FLOAT32_IEEE 4 ALIGNMENT_FLOAT64_IEEE 8 BYTE_ORDER MSB_LAST /end MOD_COMMON
/begin RECORD_LAYOUT DATA_RECORD_UBYTE FNC_VALUES 1 UBYTE ROW_DIR DIRECT /end RECORD_LAYOUT
/begin RECORD_LAYOUT DATA_RECORD_UWORD FNC_VALUES 1 UWORD ROW_DIR DIRECT /end RECORD_LAYOUT
/begin RECORD_LAYOUT DATA_RECORD_SWORD FNC_VALUES 1 SWORD ROW_DIR DIRECT /end RECORD_LAYOUT
/begin RECORD_LAYOUT DATA_RECORD_ULONG FNC_VALUES 1 ULONG ROW_DIR DIRECT /end RECORD_LAYOUT
/begin RECORD_LAYOUT DATA_RECORD_FLOAT32_IEEE FNC_VALUES 1 FLOAT32_IEEE ROW_DIR DIRECT /end RECORD_LAYOUT
/begin RECORD_LAYOUT DATA_RECORD_FLOAT64_IEEE FNC_VALUES 1 FLOAT64_IEEE ROW_DIR DIRECT /end RECORD_LAYOUT
/begin CHARACTERISTIC FaultBSW_COM_BusOff_CAN1Dec "FaultBSW_COM_BusOff_CAN1Dec" VALUE 0x8009A9DC DATA_RECORD_UBYTE 255 I_1 0 255 /end CHARACTERISTIC
/begin CHARACTERISTIC FaultBSW_COM_BusOff_CAN1FailMod "FaultBSW_COM_BusOff_CAN1FailMod" VALUE 0x8009AC20 DATA_RECORD_UBYTE 255 I_1 0 255 /end CHARACTERISTIC
/begin CHARACTERISTIC FaultBSW_COM_BusOff_CAN1Inc "FaultBSW_COM_BusOff_CAN1Inc" VALUE 0x8009AAFE DATA_RECORD_UBYTE 255 I_1 0 255 /end CHARACTERISTIC
/begin CHARACTERISTIC FaultBSW_COM_ChecksumErrVCUDec "FaultBSW_COM_ChecksumErrVCUDec" VALUE 0x8009A9DD DATA_RECORD_UBYTE 255 I_1 0 255 /end CHARACTERISTIC
/begin CHARACTERISTIC FaultBSW_COM_ChecksumErrVCUFailMod "FaultBSW_COM_ChecksumErrVCUFailMod" VALUE 0x8009AC21 DATA_RECORD_UBYTE 255 I_1 0 255 /end CHARACTERISTIC
/begin CHARACTERISTIC FaultBSW_COM_ChecksumErrVCUInc "FaultBSW_COM_ChecksumErrVCUInc" VALUE 0x8009AAFF DATA_RECORD_UBYTE 255 I_1 0 255 /end CHARACTERISTIC
/begin CHARACTERISTIC FaultBSW_COM_InterFaultVCUDec "FaultBSW_COM_InterFaultVCUDec" VALUE 0x8009A9DE DATA_RECORD_UBYTE 255 I_1 0 255 /end CHARACTERISTIC
/begin CHARACTERISTIC FaultBSW_COM_InterFaultVCUFailMod "FaultBSW_COM_InterFaultVCUFailMod" VALUE 0x8009AC22 DATA_RECORD_UBYTE 255 I_1 0 255 /end CHARACTERISTIC
/begin CHARACTERISTIC FaultBSW_COM_InterFaultVCUInc "FaultBSW_COM_InterFaultVCUInc" VALUE 0x8009AB00 DATA_RECORD_UBYTE 255 I_1 0 255 /end CHARACTERISTIC
/begin CHARACTERISTIC FaultBSW_COM_RollCntErrVCUDec "FaultBSW_COM_RollCntErrVCUDec" VALUE 0x8009A9DF DATA_RECORD_UBYTE 255 I_1 0 255 /end CHARACTERISTIC
/begin CHARACTERISTIC FaultBSW_COM_RollCntErrVCUFailMod "FaultBSW_COM_RollCntErrVCUFailMod" VALUE 0x8009AC23 DATA_RECORD_UBYTE 255 I_1 0 255 /end CHARACTERISTIC
/begin CHARACTERISTIC FaultBSW_COM_RollCntErrVCUInc "FaultBSW_COM_RollCntErrVCUInc" VALUE 0x8009AB01 DATA_RECORD_UBYTE 255 I_1 0 255 /end CHARACTERISTIC
/begin CHARACTERISTIC FaultBSW_COM_TimoutRxBCMDec "FaultBSW_COM_TimoutRxBCMDec" VALUE 0x8009A9E0 DATA_RECORD_UBYTE 255 I_1 0 255 /end CHARACTERISTIC
/begin CHARACTERISTIC FaultBSW_COM_TimoutRxBCMFailMod "FaultBSW_COM_TimoutRxBCMFailMod" VALUE 0x8009AC24 DATA_RECORD_UBYTE 255 I_1 0 255 /end CHARACTERISTIC
/begin CHARACTERISTIC FaultBSW_COM_TimoutRxBCMInc "FaultBSW_COM_TimoutRxBCMInc" VALUE 0x8009AB02 DATA_RECORD_UBYTE 255 I_1 0 255 /end CHARACTERISTIC
/begin CHARACTERISTIC FaultBSW_COM_TimoutRxBMSHDec "FaultBSW_COM_TimoutRxBMSHDec" VALUE 0x8009A9E1 DATA_RECORD_UBYTE 255 I_1 0 255 /end CHARACTERISTIC
/begin CHARACTERISTIC FaultBSW_COM_TimoutRxBMSHFailMod "FaultBSW_COM_TimoutRxBMSHFailMod" VALUE 0x8009AC25 DATA_RECORD_UBYTE 255 I_1 0 255 /end CHARACTERISTIC
/begin CHARACTERISTIC FaultBSW_COM_TimoutRxBMSHInc "FaultBSW_COM_TimoutRxBMSHInc" VALUE 0x8009AB03 DATA_RECORD_UBYTE 255 I_1 0 255 /end CHARACTERISTIC
/begin CHARACTERISTIC FaultBSW_COM_TimoutRxEMSDec "FaultBSW_COM_TimoutRxEMSDec" VALUE 0x8009A9E2 DATA_RECORD_UBYTE 255 I_1 0 255 /end CHARACTERISTIC
/begin CHARACTERISTIC FaultBSW_COM_TimoutRxEMSFailMod "FaultBSW_COM_TimoutRxEMSFailMod" VALUE 0x8009AC26 DATA_RECORD_UBYTE 255 I_1 0 255 /end CHARACTERISTIC
/begin CHARACTERISTIC FaultBSW_COM_TimoutRxEMSInc "FaultBSW_COM_TimoutRxEMSInc" VALUE 0x8009AB04 DATA_RECORD_UBYTE 255 I_1 0 255 /end CHARACTERISTIC
/begin CHARACTERISTIC FaultBSW_COM_TimoutRxGCUDec "FaultBSW_COM_TimoutRxGCUDec" VALUE 0x8009A9E3 DATA_RECORD_UBYTE 255 I_1 0 255 /end CHARACTERISTIC
/begin CHARACTERISTIC FaultBSW_COM_TimoutRxGCUFailMod "FaultBSW_COM_TimoutRxGCUFailMod" VALUE 0x8009AC27 DATA_RECORD_UBYTE 255 I_1 0 255 /end CHARACTERISTIC
/begin CHARACTERISTIC FaultBSW_COM_TimoutRxGCUInc "FaultBSW_COM_TimoutRxGCUInc" VALUE 0x8009AB05 DATA_RECORD_UBYTE 255 I_1 0 255 /end CHARACTERISTIC
/begin CHARACTERISTIC FaultBSW_COM_TimoutRxIPCDec "FaultBSW_COM_TimoutRxIPCDec" VALUE 0x8009A9E4 DATA_RECORD_UBYTE 255 I_1 0 255 /end CHARACTERISTIC
/begin CHARACTERISTIC FaultBSW_COM_TimoutRxIPCFailMod "FaultBSW_COM_TimoutRxIPCFailMod" VALUE 0x8009AC28 DATA_RECORD_UBYTE 255 I_1 0 255 /end CHARACTERISTIC
/begin CHARACTERISTIC FaultBSW_COM_TimoutRxIPCInc "FaultBSW_COM_TimoutRxIPCInc" VALUE 0x8009AB06 DATA_RECORD_UBYTE 255 I_1 0 255 /end CHARACTERISTIC
/begin CHARACTERISTIC FaultBSW_COM_TimoutRxTBOXDec "FaultBSW_COM_TimoutRxTBOXDec" VALUE 0x8009A9E5 DATA_RECORD_UBYTE 255 I_1 0 255 /end CHARACTERISTIC
/begin CHARACTERISTIC FaultBSW_COM_TimoutRxTBOXFailMod "FaultBSW_COM_TimoutRxTBOXFailMod" VALUE 0x8009AC29 DATA_RECORD_UBYTE 255 I_1 0 255 /end CHARACTERISTIC
/begin CHARACTERISTIC FaultBSW_COM_TimoutRxTBOXInc "FaultBSW_COM_TimoutRxTBOXInc" VALUE 0x8009AB07 DATA_RECORD_UBYTE 255 I_1 0 255 /end CHARACTERISTIC
/begin CHARACTERISTIC FaultBSW_COM_TimoutRxVCUDec "FaultBSW_COM_TimoutRxVCUDec" VALUE 0x8009A9E6 DATA_RECORD_UBYTE 255 I_1 0 255 /end CHARACTERISTIC
/begin CHARACTERISTIC FaultBSW_COM_TimoutRxVCUFailMod "FaultBSW_COM_TimoutRxVCUFailMod" VALUE 0x8009AC2A DATA_RECORD_UBYTE 255 I_1 0 255 /end CHARACTERISTIC
/begin CHARACTERISTIC FaultBSW_COM_TimoutRxVCUInc "FaultBSW_COM_TimoutRxVCUInc" VALUE 0x8009AB08 DATA_RECORD_UBYTE 255 I_1 0 255 /end CHARACTERISTIC
/begin CHARACTERISTIC FaultBSW_HW2_FPGA_OverVoltVBatDec "FaultBSW_HW2_FPGA_OverVoltVBatDec" VALUE 0x8009A9E7 DATA_RECORD_UBYTE 255 I_1 0 255 /end CHARACTERISTIC
/begin CHARACTERISTIC FaultBSW_HW2_FPGA_OverVoltVBatFailMod "FaultBSW_HW2_FPGA_OverVoltVBatFailMod" VALUE 0x8009AC2B DATA_RECORD_UBYTE 255 I_1 0 255 /end CHARACTERISTIC
/begin CHARACTERISTIC FaultBSW_HW2_FPGA_OverVoltVBatInc "FaultBSW_HW2_FPGA_OverVoltVBatInc" VALUE 0x8009AB09 DATA_RECORD_UBYTE 255 I_1 0 255 /end CHARACTERISTIC
/begin CHARACTERISTIC FaultBSW_HW2_SafeTlib_PreRunDec "FaultBSW_HW2_SafeTlib_PreRunDec" VALUE 0x8009A9E8 DATA_RECORD_UBYTE 255 I_1 0 255 /end CHARACTERISTIC
/begin CHARACTERISTIC FaultBSW_HW2_SafeTlib_PreRunFailMod "FaultBSW_HW2_SafeTlib_PreRunFailMod" VALUE 0x8009AC2C DATA_RECORD_UBYTE 255 I_1 0 255 /end CHARACTERISTIC
/begin CHARACTERISTIC FaultBSW_HW2_SafeTlib_PreRunInc "FaultBSW_HW2_SafeTlib_PreRunInc" VALUE 0x8009AB0A DATA_RECORD_UBYTE 255 I_1 0 255 /end CHARACTERISTIC
/begin CHARACTERISTIC FaultBSW_HW_EasAckFailDec "FaultBSW_HW_EasAckFailDec" VALUE 0x8009A9E9 DATA_RECORD_UBYTE 255 I_1 0 255 /end CHARACTERISTIC
/begin CHARACTERISTIC FaultBSW_HW_EasAckFailFailMod "FaultBSW_HW_EasAckFailFailMod" VALUE 0x8009AC2D DATA_RECORD_UBYTE 255 I_1 0 255 /end CHARACTERISTIC
/begin CHARACTERISTIC FaultBSW_HW_EasAckFailInc "FaultBSW_HW_EasAckFailInc" VALUE 0x8009AB0B DATA_RECORD_UBYTE 255 I_1 0 255 /end CHARACTERISTIC
/begin CHARACTERISTIC FaultBSW_HW_FPGA_IGBT_HDec "FaultBSW_HW_FPGA_IGBT_HDec" VALUE 0x8009A9EA DATA_RECORD_UBYTE 255 I_1 0 255 /end CHARACTERISTIC
/begin CHARACTERISTIC FaultBSW_HW_FPGA_IGBT_HFailMod "FaultBSW_HW_FPGA_IGBT_HFailMod" VALUE 0x8009AC2E DATA_RECORD_UBYTE 255 I_1 0 255 /end CHARACTERISTIC
/begin CHARACTERISTIC FaultBSW_HW_FPGA_IGBT_HInc "FaultBSW_HW_FPGA_IGBT_HInc" VALUE 0x8009AB0C DATA_RECORD_UBYTE 255 I_1 0 255 /end CHARACTERISTIC
/begin CHARACTERISTIC FaultBSW_HW_FPGA_IGBT_LDec "FaultBSW_HW_FPGA_IGBT_LDec" VALUE 0x8009A9EB DATA_RECORD_UBYTE 255 I_1 0 255 /end CHARACTERISTIC
/begin CHARACTERISTIC FaultBSW_HW_FPGA_IGBT_LFailMod "FaultBSW_HW_FPGA_IGBT_LFailMod" VALUE 0x8009AC2F DATA_RECORD_UBYTE 255 I_1 0 255 /end CHARACTERISTIC
/begin CHARACTERISTIC FaultBSW_HW_FPGA_IGBT_LInc "FaultBSW_HW_FPGA_IGBT_LInc" VALUE 0x8009AB0D DATA_RECORD_UBYTE 255 I_1 0 255 /end CHARACTERISTIC
/begin CHARACTERISTIC FaultBSW_HW_FPGA_OverUnderCurUIDec "FaultBSW_HW_FPGA_OverUnderCurUIDec" VALUE 0x8009A9EC DATA_RECORD_UBYTE 255 I_1 0 255 /end CHARACTERISTIC
/begin CHARACTERISTIC FaultBSW_HW_FPGA_OverUnderCurUIFailMod "FaultBSW_HW_FPGA_OverUnderCurUIFailMod" VALUE 0x8009AC30 DATA_RECORD_UBYTE 255 I_1 0 255 /end CHARACTERISTIC
/begin CHARACTERISTIC FaultBSW_HW_FPGA_OverUnderCurUIInc "FaultBSW_HW_FPGA_OverUnderCurUIInc" VALUE 0x8009AB0E DATA_RECORD_UBYTE 255 I_1 0 255 /end CHARACTERISTIC
/begin CHARACTERISTIC FaultBSW_HW_FPGA_OverUnderCurVIDec "FaultBSW_HW_FPGA_OverUnderCurVIDec" VALUE 0x8009A9ED DATA_RECORD_UBYTE 255 I_1 0 255 /end CHARACTERISTIC
/begin CHARACTERISTIC FaultBSW_HW_FPGA_OverUnderCurVIFailMod "FaultBSW_HW_FPGA_OverUnderCurVIFailMod" VALUE 0x8009AC31 DATA_RECORD_UBYTE 255 I_1 0 255 /end CHARACTERISTIC
/begin CHARACTERISTIC FaultBSW_HW_FPGA_OverUnderCurVIInc "FaultBSW_HW_FPGA_OverUnderCurVIInc" VALUE 0x8009AB0F DATA_RECORD_UBYTE 255 I_1 0 255 /end CHARACTERISTIC
/begin CHARACTERISTIC FaultBSW_HW_FPGA_OverUnderCurWIDec "FaultBSW_HW_FPGA_OverUnderCurWIDec" VALUE 0x8009A9EE DATA_RECORD_UBYTE 255 I_1 0 255 /end CHARACTERISTIC
/begin CHARACTERISTIC FaultBSW_HW_FPGA_OverUnderCurWIFailMod "FaultBSW_HW_FPGA_OverUnderCurWIFailMod" VALUE 0x8009AC32 DATA_RECORD_UBYTE 255 I_1 0 255 /end CHARACTERISTIC
/begin CHARACTERISTIC FaultBSW_HW_FPGA_OverUnderCurWIInc "FaultBSW_HW_FPGA_OverUnderCurWIInc" VALUE 0x8009AB10 DATA_RECORD_UBYTE 255 I_1 0 255 /end CHARACTERISTIC
/begin CHARACTERISTIC FaultBSW_HW_OCDataNotRationalDec "FaultBSW_HW_OCDataNotRationalDec" VALUE 0x8009A9EF DATA_RECORD_UBYTE 255 I_1 0 255 /end CHARACTERISTIC
/begin CHARACTERISTIC FaultBSW_HW_OCDataNotRationalFailMod "FaultBSW_HW_OCDataNotRationalFailMod" VALUE 0x8009AC33 DATA_RECORD_UBYTE 255 I_1 0 255 /end CHARACTERISTIC
/begin CHARACTERISTIC FaultBSW_HW_OCDataNotRationalInc "FaultBSW_HW_OCDataNotRationalInc" VALUE 0x8009AB11 DATA_RECORD_UBYTE 255 I_1 0 255 /end CHARACTERISTIC
/begin CHARACTERISTIC FaultBSW_SYS_RstHotDec "FaultBSW_SYS_RstHotDec" VALUE 0x8009A9F0 DATA_RECORD_UBYTE 255 I_1 0 255 /end CHARACTERISTIC
/begin CHARACTERISTIC FaultBSW_SYS_RstHotFailMod "FaultBSW_SYS_RstHotFailMod" VALUE 0x8009AC34 DATA_RECORD_UBYTE 255 I_1 0 255 /end CHARACTERISTIC
/begin CHARACTERISTIC FaultBSW_SYS_RstHotInc "FaultBSW_SYS_RstHotInc" VALUE 0x8009AB12 DATA_RECORD_UBYTE 255 I_1 0 255 /end CHARACTERISTIC
/begin CHARACTERISTIC FaultBSW_SYS_StackOverflowDec "FaultBSW_SYS_StackOverflowDec" VALUE 0x8009A9F1 DATA_RECORD_UBYTE 255 I_1 0 255 /end CHARACTERISTIC
/begin CHARACTERISTIC FaultBSW_SYS_StackOverflowFailMod "FaultBSW_SYS_StackOverflowFailMod" VALUE 0x8009AC35 DATA_RECORD_UBYTE 255 I_1 0 255 /end CHARACTERISTIC
/begin CHARACTERISTIC FaultBSW_SYS_StackOverflowInc "FaultBSW_SYS_StackOverflowInc" VALUE 0x8009AB13 DATA_RECORD_UBYTE 255 I_1 0 255 /end CHARACTERISTIC
/begin CHARACTERISTIC FaultBSW_VSI_TimeoutTCalcDec "FaultBSW_VSI_TimeoutTCalcDec" VALUE 0x8009A9F2 DATA_RECORD_UBYTE 255 I_1 0 255 /end CHARACTERISTIC
/begin CHARACTERISTIC FaultBSW_VSI_TimeoutTCalcFailMod "FaultBSW_VSI_TimeoutTCalcFailMod" VALUE 0x8009AC36 DATA_RECORD_UBYTE 255 I_1 0 255 /end CHARACTERISTIC
/begin CHARACTERISTIC FaultBSW_VSI_TimeoutTCalcInc "FaultBSW_VSI_TimeoutTCalcInc" VALUE 0x8009AB14 DATA_RECORD_UBYTE 255 I_1 0 255 /end CHARACTERISTIC
/begin CHARACTERISTIC FaultFSEVBHV_OverVoltageDec "FaultFSEVBHV_OverVoltageDec" VALUE 0x8009A9F3 DATA_RECORD_UBYTE 255 I_1 0 255 /end CHARACTERISTIC
/begin CHARACTERISTIC FaultFSEVBHV_OverVoltageFailMod "FaultFSEVBHV_OverVoltageFailMod" VALUE 0x8009AC37 DATA_RECORD_UBYTE 255 I_1 0 255 /end CHARACTERISTIC
/begin CHARACTERISTIC FaultFSEVBHV_OverVoltageInc "FaultFSEVBHV_OverVoltageInc" VALUE 0x8009AB15 DATA_RECORD_UBYTE 255 I_1 0 255 /end CHARACTERISTIC
/begin CHARACTERISTIC FaultFSEVBHV_SampleVolOutRngHDec "FaultFSEVBHV_SampleVolOutRngHDec" VALUE 0x8009A9F4 DATA_RECORD_UBYTE 255 I_1 0 255 /end CHARACTERISTIC
/begin CHARACTERISTIC FaultFSEVBHV_SampleVolOutRngHFailMod "FaultFSEVBHV_SampleVolOutRngHFailMod" VALUE 0x8009AC38 DATA_RECORD_UBYTE 255 I_1 0 255 /end CHARACTERISTIC
/begin CHARACTERISTIC FaultFSEVBHV_SampleVolOutRngHInc "FaultFSEVBHV_SampleVolOutRngHInc" VALUE 0x8009AB16 DATA_RECORD_UBYTE 255 I_1 0 255 /end CHARACTERISTIC
/begin CHARACTERISTIC FaultFSEVBHV_SampleVolOutRngLDec "FaultFSEVBHV_SampleVolOutRngLDec" VALUE 0x8009A9F5 DATA_RECORD_UBYTE 255 I_1 0 255 /end CHARACTERISTIC
/begin CHARACTERISTIC FaultFSEVBHV_SampleVolOutRngLFailMod "FaultFSEVBHV_SampleVolOutRngLFailMod" VALUE 0x8009AC39 DATA_RECORD_UBYTE 255 I_1 0 255 /end CHARACTERISTIC
/begin CHARACTERISTIC FaultFSEVBHV_SampleVolOutRngLInc "FaultFSEVBHV_SampleVolOutRngLInc" VALUE 0x8009AB17 DATA_RECORD_UBYTE 255 I_1 0 255 /end CHARACTERISTIC
/begin CHARACTERISTIC FaultFSEVBHV_UnderVoltageDec "FaultFSEVBHV_UnderVoltageDec" VALUE 0x8009A9F6 DATA_RECORD_UBYTE 255 I_1 0 255 /end CHARACTERISTIC
/begin CHARACTERISTIC FaultFSEVBHV_UnderVoltageFailMod "FaultFSEVBHV_UnderVoltageFailMod" VALUE 0x8009AC3A DATA_RECORD_UBYTE 255 I_1 0 255 /end CHARACTERISTIC
/begin CHARACTERISTIC FaultFSEVBHV_UnderVoltageInc "FaultFSEVBHV_UnderVoltageInc" VALUE 0x8009AB18 DATA_RECORD_UBYTE 255 I_1 0 255 /end CHARACTERISTIC
/begin CHARACTERISTIC FaultFSEVBHV_UnderVoltageWarnDec "FaultFSEVBHV_UnderVoltageWarnDec" VALUE 0x8009A9FA DATA_RECORD_UBYTE 255 I_1 0 255 /end CHARACTERISTIC
/begin CHARACTERISTIC FaultFSEVBHV_UnderVoltageWarnFailMod "FaultFSEVBHV_UnderVoltageWarnFailMod" VALUE 0x8009AC3E DATA_RECORD_UBYTE 255 I_1 0 255 /end CHARACTERISTIC
/begin CHARACTERISTIC FaultFSEVBHV_UnderVoltageWarnInc "FaultFSEVBHV_UnderVoltageWarnInc" VALUE 0x8009AB1C DATA_RECORD_UBYTE 255 I_1 0 255 /end CHARACTERISTIC
/begin CHARACTERISTIC FaultFSEVBHV_VolNotRationalDec "FaultFSEVBHV_VolNotRationalDec" VALUE 0x8009A9F7 DATA_RECORD_UBYTE 255 I_1 0 255 /end CHARACTERISTIC
/begin CHARACTERISTIC FaultFSEVBHV_VolNotRationalFailMod "FaultFSEVBHV_VolNotRationalFailMod" VALUE 0x8009AC3B DATA_RECORD_UBYTE 255 I_1 0 255 /end CHARACTERISTIC
/begin CHARACTERISTIC FaultFSEVBHV_VolNotRationalInc "FaultFSEVBHV_VolNotRationalInc" VALUE 0x8009AB19 DATA_RECORD_UBYTE 255 I_1 0 255 /end CHARACTERISTIC
/begin CHARACTERISTIC FaultFSEVBHV_VoltageGndDec "FaultFSEVBHV_VoltageGndDec" VALUE 0x8009A9F8 DATA_RECORD_UBYTE 255 I_1 0 255 /end CHARACTERISTIC
/begin CHARACTERISTIC FaultFSEVBHV_VoltageGndFailMod "FaultFSEVBHV_VoltageGndFailMod" VALUE 0x8009AC3C DATA_RECORD_UBYTE 255 I_1 0 255 /end CHARACTERISTIC
/begin CHARACTERISTIC FaultFSEVBHV_VoltageGndInc "FaultFSEVBHV_VoltageGndInc" VALUE 0x8009AB1A DATA_RECORD_UBYTE 255 I_1 0 255 /end CHARACTERISTIC
/begin CHARACTERISTIC FaultFSEVBHV_VoltageVccDec "FaultFSEVBHV_VoltageVccDec" VALUE 0x8009A9F9 DATA_RECORD_UBYTE 255 I_1 0 255 /end CHARACTERISTIC
/begin CHARACTERISTIC FaultFSEVBHV_VoltageVccFailMod "FaultFSEVBHV_VoltageVccFailMod" VALUE 0x8009AC3D DATA_RECORD_UBYTE 255 I_1 0 255 /end CHARACTERISTIC
/begin CHARACTERISTIC FaultFSEVBHV_VoltageVccInc "FaultFSEVBHV_VoltageVccInc" VALUE 0x8009AB1B DATA_RECORD_UBYTE 255 I_1 0 255 /end CHARACTERISTIC
/begin CHARACTERISTIC FaultFSEVBLV_OverVoltageDec "FaultFSEVBLV_OverVoltageDec" VALUE 0x8009A9FB DATA_RECORD_UBYTE 255 I_1 0 255 /end CHARACTERISTIC
/begin CHARACTERISTIC FaultFSEVBLV_OverVoltageFailMod "FaultFSEVBLV_OverVoltageFailMod" VALUE 0x8009AC3F DATA_RECORD_UBYTE 255 I_1 0 255 /end CHARACTERISTIC
/begin CHARACTERISTIC FaultFSEVBLV_OverVoltageInc "FaultFSEVBLV_OverVoltageInc" VALUE 0x8009AB1D DATA_RECORD_UBYTE 255 I_1 0 255 /end CHARACTERISTIC
/begin CHARACTERISTIC FaultFSEVBLV_P5VRefADCFltDec "FaultFSEVBLV_P5VRefADCFltDec" VALUE 0x8009A9FC DATA_RECORD_UBYTE 255 I_1 0 255 /end CHARACTERISTIC
/begin CHARACTERISTIC FaultFSEVBLV_P5VRefADCFltFailMod "FaultFSEVBLV_P5VRefADCFltFailMod" VALUE 0x8009AC40 DATA_RECORD_UBYTE 255 I_1 0 255 /end CHARACTERISTIC
/begin CHARACTERISTIC FaultFSEVBLV_P5VRefADCFltInc "FaultFSEVBLV_P5VRefADCFltInc" VALUE 0x8009AB1E DATA_RECORD_UBYTE 255 I_1 0 255 /end CHARACTERISTIC
/begin CHARACTERISTIC FaultFSEVBLV_UnderVoltageDec "FaultFSEVBLV_UnderVoltageDec" VALUE 0x8009A9FD DATA_RECORD_UBYTE 255 I_1 0 255 /end CHARACTERISTIC
/begin CHARACTERISTIC FaultFSEVBLV_UnderVoltageFailMod "FaultFSEVBLV_UnderVoltageFailMod" VALUE 0x8009AC41 DATA_RECORD_UBYTE 255 I_1 0 255 /end CHARACTERISTIC
/begin CHARACTERISTIC FaultFSEVBLV_UnderVoltageInc "FaultFSEVBLV_UnderVoltageInc" VALUE 0x8009AB1F DATA_RECORD_UBYTE 255 I_1 0 255 /end CHARACTERISTIC
/begin CHARACTERISTIC FaultFSEVBLV_UnderVoltageWarnDec "FaultFSEVBLV_UnderVoltageWarnDec" VALUE 0x8009AA00 DATA_RECORD_UBYTE 255 I_1 0 255 /end CHARACTERISTIC
/begin CHARACTERISTIC FaultFSEVBLV_UnderVoltageWarnFailMod "FaultFSEVBLV_UnderVoltageWarnFailMod" VALUE 0x8009AC44 DATA_RECORD_UBYTE 255 I_1 0 255 /end CHARACTERISTIC
/begin CHARACTERISTIC FaultFSEVBLV_UnderVoltageWarnInc "FaultFSEVBLV_UnderVoltageWarnInc" VALUE 0x8009AB22 DATA_RECORD_UBYTE 255 I_1 0 255 /end CHARACTERISTIC
/begin CHARACTERISTIC FaultFSEVBLV_VoltageGndDec "FaultFSEVBLV_VoltageGndDec" VALUE 0x8009A9FE DATA_RECORD_UBYTE 255 I_1 0 255 /end CHARACTERISTIC
/begin CHARACTERISTIC FaultFSEVBLV_VoltageGndFailMod "FaultFSEVBLV_VoltageGndFailMod" VALUE 0x8009AC42 DATA_RECORD_UBYTE 255 I_1 0 255 /end CHARACTERISTIC
/begin CHARACTERISTIC FaultFSEVBLV_VoltageGndInc "FaultFSEVBLV_VoltageGndInc" VALUE 0x8009AB20 DATA_RECORD_UBYTE 255 I_1 0 255 /end CHARACTERISTIC
/begin CHARACTERISTIC FaultFSEVBLV_VoltageVccDec "FaultFSEVBLV_VoltageVccDec" VALUE 0x8009A9FF DATA_RECORD_UBYTE 255 I_1 0 255 /end CHARACTERISTIC
/begin CHARACTERISTIC FaultFSEVBLV_VoltageVccFailMod "FaultFSEVBLV_VoltageVccFailMod" VALUE 0x8009AC43 DATA_RECORD_UBYTE 255 I_1 0 255 /end CHARACTERISTIC
/begin CHARACTERISTIC FaultFSEVBLV_VoltageVccInc "FaultFSEVBLV_VoltageVccInc" VALUE 0x8009AB21 DATA_RECORD_UBYTE 255 I_1 0 255 /end CHARACTERISTIC
/begin CHARACTERISTIC FaultFSEVETA_DrvTempRationDec "FaultFSEVETA_DrvTempRationDec" VALUE 0x8009AA01 DATA_RECORD_UBYTE 255 I_1 0 255 /end CHARACTERISTIC
/begin CHARACTERISTIC FaultFSEVETA_DrvTempRationFailMod "FaultFSEVETA_DrvTempRationFailMod" VALUE 0x8009AC45 DATA_RECORD_UBYTE 255 I_1 0 255 /end CHARACTERISTIC
/begin CHARACTERISTIC FaultFSEVETA_DrvTempRationInc "FaultFSEVETA_DrvTempRationInc" VALUE 0x8009AB23 DATA_RECORD_UBYTE 255 I_1 0 255 /end CHARACTERISTIC
/begin CHARACTERISTIC FaultFSEVETA_IgbtTempRationalDec "FaultFSEVETA_IgbtTempRationalDec" VALUE 0x8009AA02 DATA_RECORD_UBYTE 255 I_1 0 255 /end CHARACTERISTIC
/begin CHARACTERISTIC FaultFSEVETA_IgbtTempRationalFailMod "FaultFSEVETA_IgbtTempRationalFailMod" VALUE 0x8009AC46 DATA_RECORD_UBYTE 255 I_1 0 255 /end CHARACTERISTIC
/begin CHARACTERISTIC FaultFSEVETA_IgbtTempRationalInc "FaultFSEVETA_IgbtTempRationalInc" VALUE 0x8009AB24 DATA_RECORD_UBYTE 255 I_1 0 255 /end CHARACTERISTIC
/begin CHARACTERISTIC FaultFSEVETA_OverTempDrvLeftDec "FaultFSEVETA_OverTempDrvLeftDec" VALUE 0x8009AA05 DATA_RECORD_UBYTE 255 I_1 0 255 /end CHARACTERISTIC
/begin CHARACTERISTIC FaultFSEVETA_OverTempDrvLeftFailMod "FaultFSEVETA_OverTempDrvLeftFailMod" VALUE 0x8009AC49 DATA_RECORD_UBYTE 255 I_1 0 255 /end CHARACTERISTIC
/begin CHARACTERISTIC FaultFSEVETA_OverTempDrvLeftInc "FaultFSEVETA_OverTempDrvLeftInc" VALUE 0x8009AB27 DATA_RECORD_UBYTE 255 I_1 0 255 /end CHARACTERISTIC
/begin CHARACTERISTIC FaultFSEVETA_OverTempIgbtLeftDec "FaultFSEVETA_OverTempIgbtLeftDec" VALUE 0x8009AA06 DATA_RECORD_UBYTE 255 I_1 0 255 /end CHARACTERISTIC
/begin CHARACTERISTIC FaultFSEVETA_OverTempIgbtLeftFailMod "FaultFSEVETA_OverTempIgbtLeftFailMod" VALUE 0x8009AC4A DATA_RECORD_UBYTE 255 I_1 0 255 /end CHARACTERISTIC
/begin CHARACTERISTIC FaultFSEVETA_OverTempIgbtLeftInc "FaultFSEVETA_OverTempIgbtLeftInc" VALUE 0x8009AB28 DATA_RECORD_UBYTE 255 I_1 0 255 /end CHARACTERISTIC
/begin CHARACTERISTIC FaultFSEVETA_OverTempNTC1CmdBoardDec "FaultFSEVETA_OverTempNTC1CmdBoardDec" VALUE 0x8009AA07 DATA_RECORD_UBYTE 255 I_1 0 255 /end CHARACTERISTIC
/begin CHARACTERISTIC FaultFSEVETA_OverTempNTC1CmdBoardFailMod "FaultFSEVETA_OverTempNTC1CmdBoardFailMod" VALUE 0x8009AC4B DATA_RECORD_UBYTE 255 I_1 0 255 /end CHARACTERISTIC
/begin CHARACTERISTIC FaultFSEVETA_OverTempNTC1CmdBoardInc "FaultFSEVETA_OverTempNTC1CmdBoardInc" VALUE 0x8009AB29 DATA_RECORD_UBYTE 255 I_1 0 255 /end CHARACTERISTIC
/begin CHARACTERISTIC FaultFSEVETA_SampleIgbtTempOutRngHDec "FaultFSEVETA_SampleIgbtTempOutRngHDec" VALUE 0x8009AA03 DATA_RECORD_UBYTE 255 I_1 0 255 /end CHARACTERISTIC
/begin CHARACTERISTIC FaultFSEVETA_SampleIgbtTempOutRngHFailMod "FaultFSEVETA_SampleIgbtTempOutRngHFailMod" VALUE 0x8009AC47 DATA_RECORD_UBYTE 255 I_1 0 255 /end CHARACTERISTIC
/begin CHARACTERISTIC FaultFSEVETA_SampleIgbtTempOutRngHInc "FaultFSEVETA_SampleIgbtTempOutRngHInc" VALUE 0x8009AB25 DATA_RECORD_UBYTE 255 I_1 0 255 /end CHARACTERISTIC
/begin CHARACTERISTIC FaultFSEVETA_SampleIgbtTempOutRngLDec "FaultFSEVETA_SampleIgbtTempOutRngLDec" VALUE 0x8009AA04 DATA_RECORD_UBYTE 255 I_1 0 255 /end CHARACTERISTIC
/begin CHARACTERISTIC FaultFSEVETA_SampleIgbtTempOutRngLFailMod "FaultFSEVETA_SampleIgbtTempOutRngLFailMod" VALUE 0x8009AC48 DATA_RECORD_UBYTE 255 I_1 0 255 /end CHARACTERISTIC
/begin CHARACTERISTIC FaultFSEVETA_SampleIgbtTempOutRngLInc "FaultFSEVETA_SampleIgbtTempOutRngLInc" VALUE 0x8009AB26 DATA_RECORD_UBYTE 255 I_1 0 255 /end CHARACTERISTIC
/begin CHARACTERISTIC FaultFSEVETA_TempDrvBoardLeftGndDec "FaultFSEVETA_TempDrvBoardLeftGndDec" VALUE 0x8009AA08 DATA_RECORD_UBYTE 255 I_1 0 255 /end CHARACTERISTIC
/begin CHARACTERISTIC FaultFSEVETA_TempDrvBoardLeftGndFailMod "FaultFSEVETA_TempDrvBoardLeftGndFailMod" VALUE 0x8009AC4C DATA_RECORD_UBYTE 255 I_1 0 255 /end CHARACTERISTIC
/begin CHARACTERISTIC FaultFSEVETA_TempDrvBoardLeftGndInc "FaultFSEVETA_TempDrvBoardLeftGndInc" VALUE 0x8009AB2A DATA_RECORD_UBYTE 255 I_1 0 255 /end CHARACTERISTIC
/begin CHARACTERISTIC FaultFSEVETA_TempDrvBoardLeftVccDec "FaultFSEVETA_TempDrvBoardLeftVccDec" VALUE 0x8009AA09 DATA_RECORD_UBYTE 255 I_1 0 255 /end CHARACTERISTIC
/begin CHARACTERISTIC FaultFSEVETA_TempDrvBoardLeftVccFailMod "FaultFSEVETA_TempDrvBoardLeftVccFailMod" VALUE 0x8009AC4D DATA_RECORD_UBYTE 255 I_1 0 255 /end CHARACTERISTIC
/begin CHARACTERISTIC FaultFSEVETA_TempDrvBoardLeftVccInc "FaultFSEVETA_TempDrvBoardLeftVccInc" VALUE 0x8009AB2B DATA_RECORD_UBYTE 255 I_1 0 255 /end CHARACTERISTIC
/begin CHARACTERISTIC FaultFSEVETA_TempIgbtLeftGndDec "FaultFSEVETA_TempIgbtLeftGndDec" VALUE 0x8009AA0A DATA_RECORD_UBYTE 255 I_1 0 255 /end CHARACTERISTIC
/begin CHARACTERISTIC FaultFSEVETA_TempIgbtLeftGndFailMod "FaultFSEVETA_TempIgbtLeftGndFailMod" VALUE 0x8009AC4E DATA_RECORD_UBYTE 255 I_1 0 255 /end CHARACTERISTIC
/begin CHARACTERISTIC FaultFSEVETA_TempIgbtLeftGndInc "FaultFSEVETA_TempIgbtLeftGndInc" VALUE 0x8009AB2C DATA_RECORD_UBYTE 255 I_1 0 255 /end CHARACTERISTIC
/begin CHARACTERISTIC FaultFSEVETA_TempIgbtLeftVccDec "FaultFSEVETA_TempIgbtLeftVccDec" VALUE 0x8009AA0B DATA_RECORD_UBYTE 255 I_1 0 255 /end CHARACTERISTIC
/begin CHARACTERISTIC FaultFSEVETA_TempIgbtLeftVccFailMod "FaultFSEVETA_TempIgbtLeftVccFailMod" VALUE 0x8009AC4F DATA_RECORD_UBYTE 255 I_1 0 255 /end CHARACTERISTIC
/begin CHARACTERISTIC FaultFSEVETA_TempIgbtLeftVccInc "FaultFSEVETA_TempIgbtLeftVccInc" VALUE 0x8009AB2D DATA_RECORD_UBYTE 255 I_1 0 255 /end CHARACTERISTIC
/begin CHARACTERISTIC FaultFSEVETA_TempNTC1CmdBoardGndDec "FaultFSEVETA_TempNTC1CmdBoardGndDec" VALUE 0x8009AA0C DATA_RECORD_UBYTE 255 I_1 0 255 /end CHARACTERISTIC
/begin CHARACTERISTIC FaultFSEVETA_TempNTC1CmdBoardGndFailMod "FaultFSEVETA_TempNTC1CmdBoardGndFailMod" VALUE 0x8009AC50 DATA_RECORD_UBYTE 255 I_1 0 255 /end CHARACTERISTIC
/begin CHARACTERISTIC FaultFSEVETA_TempNTC1CmdBoardGndInc "FaultFSEVETA_TempNTC1CmdBoardGndInc" VALUE 0x8009AB2E DATA_RECORD_UBYTE 255 I_1 0 255 /end CHARACTERISTIC
/begin CHARACTERISTIC FaultFSEVETA_TempNTC1CmdBoardVccDec "FaultFSEVETA_TempNTC1CmdBoardVccDec" VALUE 0x8009AA0D DATA_RECORD_UBYTE 255 I_1 0 255 /end CHARACTERISTIC
/begin CHARACTERISTIC FaultFSEVETA_TempNTC1CmdBoardVccFailMod "FaultFSEVETA_TempNTC1CmdBoardVccFailMod" VALUE 0x8009AC51 DATA_RECORD_UBYTE 255 I_1 0 255 /end CHARACTERISTIC
/begin CHARACTERISTIC FaultFSEVETA_TempNTC1CmdBoardVccInc "FaultFSEVETA_TempNTC1CmdBoardVccInc" VALUE 0x8009AB2F DATA_RECORD_UBYTE 255 I_1 0 255 /end CHARACTERISTIC
/begin CHARACTERISTIC FaultFSEVETA_UnderTempDrvLeftDec "FaultFSEVETA_UnderTempDrvLeftDec" VALUE 0x8009AA0E DATA_RECORD_UBYTE 255 I_1 0 255 /end CHARACTERISTIC
/begin CHARACTERISTIC FaultFSEVETA_UnderTempDrvLeftFailMod "FaultFSEVETA_UnderTempDrvLeftFailMod" VALUE 0x8009AC52 DATA_RECORD_UBYTE 255 I_1 0 255 /end CHARACTERISTIC
/begin CHARACTERISTIC FaultFSEVETA_UnderTempDrvLeftInc "FaultFSEVETA_UnderTempDrvLeftInc" VALUE 0x8009AB30 DATA_RECORD_UBYTE 255 I_1 0 255 /end CHARACTERISTIC
/begin CHARACTERISTIC FaultFSEVETA_UnderTempIgbtLeftDec "FaultFSEVETA_UnderTempIgbtLeftDec" VALUE 0x8009AA0F DATA_RECORD_UBYTE 255 I_1 0 255 /end CHARACTERISTIC
/begin CHARACTERISTIC FaultFSEVETA_UnderTempIgbtLeftFailMod "FaultFSEVETA_UnderTempIgbtLeftFailMod" VALUE 0x8009AC53 DATA_RECORD_UBYTE 255 I_1 0 255 /end CHARACTERISTIC
/begin CHARACTERISTIC FaultFSEVETA_UnderTempIgbtLeftInc "FaultFSEVETA_UnderTempIgbtLeftInc" VALUE 0x8009AB31 DATA_RECORD_UBYTE 255 I_1 0 255 /end CHARACTERISTIC
/begin CHARACTERISTIC FaultFSEVETA_UnderTempNTC1CmdBoardDec "FaultFSEVETA_UnderTempNTC1CmdBoardDec" VALUE 0x8009AA10 DATA_RECORD_UBYTE 255 I_1 0 255 /end CHARACTERISTIC
/begin CHARACTERISTIC FaultFSEVETA_UnderTempNTC1CmdBoardFailMod "FaultFSEVETA_UnderTempNTC1CmdBoardFailMod" VALUE 0x8009AC54 DATA_RECORD_UBYTE 255 I_1 0 255 /end CHARACTERISTIC
/begin CHARACTERISTIC FaultFSEVETA_UnderTempNTC1CmdBoardInc "FaultFSEVETA_UnderTempNTC1CmdBoardInc" VALUE 0x8009AB32 DATA_RECORD_UBYTE 255 I_1 0 255 /end CHARACTERISTIC
/begin CHARACTERISTIC FaultFSMTMTA_OverTempWdgHead1Dec "FaultFSMTMTA_OverTempWdgHead1Dec" VALUE 0x8009AA11 DATA_RECORD_UBYTE 255 I_1 0 255 /end CHARACTERISTIC
/begin CHARACTERISTIC FaultFSMTMTA_OverTempWdgHead1FailMod "FaultFSMTMTA_OverTempWdgHead1FailMod" VALUE 0x8009AC55 DATA_RECORD_UBYTE 255 I_1 0 255 /end CHARACTERISTIC
/begin CHARACTERISTIC FaultFSMTMTA_OverTempWdgHead1Inc "FaultFSMTMTA_OverTempWdgHead1Inc" VALUE 0x8009AB33 DATA_RECORD_UBYTE 255 I_1 0 255 /end CHARACTERISTIC
/begin CHARACTERISTIC FaultFSMTMTA_TempWindHead1OutRngHDec "FaultFSMTMTA_TempWindHead1OutRngHDec" VALUE 0x8009AA12 DATA_RECORD_UBYTE 255 I_1 0 255 /end CHARACTERISTIC
/begin CHARACTERISTIC FaultFSMTMTA_TempWindHead1OutRngHFailMod "FaultFSMTMTA_TempWindHead1OutRngHFailMod" VALUE 0x8009AC56 DATA_RECORD_UBYTE 255 I_1 0 255 /end CHARACTERISTIC
/begin CHARACTERISTIC FaultFSMTMTA_TempWindHead1OutRngHInc "FaultFSMTMTA_TempWindHead1OutRngHInc" VALUE 0x8009AB34 DATA_RECORD_UBYTE 255 I_1 0 255 /end CHARACTERISTIC
/begin CHARACTERISTIC FaultFSMTMTA_TempWindHead1OutRngLDec "FaultFSMTMTA_TempWindHead1OutRngLDec" VALUE 0x8009AA13 DATA_RECORD_UBYTE 255 I_1 0 255 /end CHARACTERISTIC
/begin CHARACTERISTIC FaultFSMTMTA_TempWindHead1OutRngLFailMod "FaultFSMTMTA_TempWindHead1OutRngLFailMod" VALUE 0x8009AC57 DATA_RECORD_UBYTE 255 I_1 0 255 /end CHARACTERISTIC
/begin CHARACTERISTIC FaultFSMTMTA_TempWindHead1OutRngLInc "FaultFSMTMTA_TempWindHead1OutRngLInc" VALUE 0x8009AB35 DATA_RECORD_UBYTE 255 I_1 0 255 /end CHARACTERISTIC
/begin CHARACTERISTIC FaultFSMTMTA_TempWindingHead1GndDec "FaultFSMTMTA_TempWindingHead1GndDec" VALUE 0x8009AA14 DATA_RECORD_UBYTE 255 I_1 0 255 /end CHARACTERISTIC
/begin CHARACTERISTIC FaultFSMTMTA_TempWindingHead1GndFailMod "FaultFSMTMTA_TempWindingHead1GndFailMod" VALUE 0x8009AC58 DATA_RECORD_UBYTE 255 I_1 0 255 /end CHARACTERISTIC
/begin CHARACTERISTIC FaultFSMTMTA_TempWindingHead1GndInc "FaultFSMTMTA_TempWindingHead1GndInc" VALUE 0x8009AB36 DATA_RECORD_UBYTE 255 I_1 0 255 /end CHARACTERISTIC
/begin CHARACTERISTIC FaultFSMTMTA_TempWindingHead1VccDec "FaultFSMTMTA_TempWindingHead1VccDec" VALUE 0x8009AA15 DATA_RECORD_UBYTE 255 I_1 0 255 /end CHARACTERISTIC
/begin CHARACTERISTIC FaultFSMTMTA_TempWindingHead1VccFailMod "FaultFSMTMTA_TempWindingHead1VccFailMod" VALUE 0x8009AC59 DATA_RECORD_UBYTE 255 I_1 0 255 /end CHARACTERISTIC
/begin CHARACTERISTIC FaultFSMTMTA_TempWindingHead1VccInc "FaultFSMTMTA_TempWindingHead1VccInc" VALUE 0x8009AB37 DATA_RECORD_UBYTE 255 I_1 0 255 /end CHARACTERISTIC
/begin CHARACTERISTIC FaultFSMTMTA_UnderTempWdgHead1Dec "FaultFSMTMTA_UnderTempWdgHead1Dec" VALUE 0x8009AA16 DATA_RECORD_UBYTE 255 I_1 0 255 /end CHARACTERISTIC
/begin CHARACTERISTIC FaultFSMTMTA_UnderTempWdgHead1FailMod "FaultFSMTMTA_UnderTempWdgHead1FailMod" VALUE 0x8009AC5A DATA_RECORD_UBYTE 255 I_1 0 255 /end CHARACTERISTIC
/begin CHARACTERISTIC FaultFSMTMTA_UnderTempWdgHead1Inc "FaultFSMTMTA_UnderTempWdgHead1Inc" VALUE 0x8009AB38 DATA_RECORD_UBYTE 255 I_1 0 255 /end CHARACTERISTIC
/begin CHARACTERISTIC FaultFSMTRDG_ExcGenerationDec "FaultFSMTRDG_ExcGenerationDec" VALUE 0x8009AA17 DATA_RECORD_UBYTE 255 I_1 0 255 /end CHARACTERISTIC
/begin CHARACTERISTIC FaultFSMTRDG_ExcGenerationFailMod "FaultFSMTRDG_ExcGenerationFailMod" VALUE 0x8009AC5B DATA_RECORD_UBYTE 255 I_1 0 255 /end CHARACTERISTIC
/begin CHARACTERISTIC FaultFSMTRDG_ExcGenerationInc "FaultFSMTRDG_ExcGenerationInc" VALUE 0x8009AB39 DATA_RECORD_UBYTE 255 I_1 0 255 /end CHARACTERISTIC
/begin CHARACTERISTIC FaultFSMTRDG_ExcSignalGNDDec "FaultFSMTRDG_ExcSignalGNDDec" VALUE 0x8009AA18 DATA_RECORD_UBYTE 255 I_1 0 255 /end CHARACTERISTIC
/begin CHARACTERISTIC FaultFSMTRDG_ExcSignalGNDFailMod "FaultFSMTRDG_ExcSignalGNDFailMod" VALUE 0x8009AC5C DATA_RECORD_UBYTE 255 I_1 0 255 /end CHARACTERISTIC
/begin CHARACTERISTIC FaultFSMTRDG_ExcSignalGNDInc "FaultFSMTRDG_ExcSignalGNDInc" VALUE 0x8009AB3A DATA_RECORD_UBYTE 255 I_1 0 255 /end CHARACTERISTIC
/begin CHARACTERISTIC FaultFSMTRDG_ExcSignalVCCDec "FaultFSMTRDG_ExcSignalVCCDec" VALUE 0x8009AA19 DATA_RECORD_UBYTE 255 I_1 0 255 /end CHARACTERISTIC
/begin CHARACTERISTIC FaultFSMTRDG_ExcSignalVCCFailMod "FaultFSMTRDG_ExcSignalVCCFailMod" VALUE 0x8009AC5D DATA_RECORD_UBYTE 255 I_1 0 255 /end CHARACTERISTIC
/begin CHARACTERISTIC FaultFSMTRDG_ExcSignalVCCInc "FaultFSMTRDG_ExcSignalVCCInc" VALUE 0x8009AB3B DATA_RECORD_UBYTE 255 I_1 0 255 /end CHARACTERISTIC
/begin CHARACTERISTIC FaultFSMTRDG_SinCosHLGndDec "FaultFSMTRDG_SinCosHLGndDec" VALUE 0x8009AA1A DATA_RECORD_UBYTE 255 I_1 0 255 /end CHARACTERISTIC
/begin CHARACTERISTIC FaultFSMTRDG_SinCosHLGndFailMod "FaultFSMTRDG_SinCosHLGndFailMod" VALUE 0x8009AC5E DATA_RECORD_UBYTE 255 I_1 0 255 /end CHARACTERISTIC
/begin CHARACTERISTIC FaultFSMTRDG_SinCosHLGndInc "FaultFSMTRDG_SinCosHLGndInc" VALUE 0x8009AB3C DATA_RECORD_UBYTE 255 I_1 0 255 /end CHARACTERISTIC
/begin CHARACTERISTIC FaultFSMTRDG_SinCosHLOpenDec "FaultFSMTRDG_SinCosHLOpenDec" VALUE 0x8009AA1B DATA_RECORD_UBYTE 255 I_1 0 255 /end CHARACTERISTIC
/begin CHARACTERISTIC FaultFSMTRDG_SinCosHLOpenFailMod "FaultFSMTRDG_SinCosHLOpenFailMod" VALUE 0x8009AC5F DATA_RECORD_UBYTE 255 I_1 0 255 /end CHARACTERISTIC
/begin CHARACTERISTIC FaultFSMTRDG_SinCosHLOpenInc "FaultFSMTRDG_SinCosHLOpenInc" VALUE 0x8009AB3D DATA_RECORD_UBYTE 255 I_1 0 255 /end CHARACTERISTIC
/begin CHARACTERISTIC FaultFSMTRDG_SinCosHLVccDec "FaultFSMTRDG_SinCosHLVccDec" VALUE 0x8009AA1C DATA_RECORD_UBYTE 255 I_1 0 255 /end CHARACTERISTIC
/begin CHARACTERISTIC FaultFSMTRDG_SinCosHLVccFailMod "FaultFSMTRDG_SinCosHLVccFailMod" VALUE 0x8009AC60 DATA_RECORD_UBYTE 255 I_1 0 255 /end CHARACTERISTIC
/begin CHARACTERISTIC FaultFSMTRDG_SinCosHLVccInc "FaultFSMTRDG_SinCosHLVccInc" VALUE 0x8009AB3E DATA_RECORD_UBYTE 255 I_1 0 255 /end CHARACTERISTIC
/begin CHARACTERISTIC FaultFSSMACS_AkdFailFlagDec "FaultFSSMACS_AkdFailFlagDec" VALUE 0x8009AA1D DATA_RECORD_UBYTE 255 I_1 0 255 /end CHARACTERISTIC
/begin CHARACTERISTIC FaultFSSMACS_AkdFailFlagFailMod "FaultFSSMACS_AkdFailFlagFailMod" VALUE 0x8009AC61 DATA_RECORD_UBYTE 255 I_1 0 255 /end CHARACTERISTIC
/begin CHARACTERISTIC FaultFSSMACS_AkdFailFlagInc "FaultFSSMACS_AkdFailFlagInc" VALUE 0x8009AB3F DATA_RECORD_UBYTE 255 I_1 0 255 /end CHARACTERISTIC
/begin CHARACTERISTIC FaultFTASBDS_BattVoltDeratingActDec "FaultFTASBDS_BattVoltDeratingActDec" VALUE 0x8009AA1E DATA_RECORD_UBYTE 255 I_1 0 255 /end CHARACTERISTIC
/begin CHARACTERISTIC FaultFTASBDS_BattVoltDeratingActFailMod "FaultFTASBDS_BattVoltDeratingActFailMod" VALUE 0x8009AC62 DATA_RECORD_UBYTE 255 I_1 0 255 /end CHARACTERISTIC
/begin CHARACTERISTIC FaultFTASBDS_BattVoltDeratingActInc "FaultFTASBDS_BattVoltDeratingActInc" VALUE 0x8009AB40 DATA_RECORD_UBYTE 255 I_1 0 255 /end CHARACTERISTIC
/begin CHARACTERISTIC FaultFTASETP_EstPmDeratingActDec "FaultFTASETP_EstPmDeratingActDec" VALUE 0x8009AA1F DATA_RECORD_UBYTE 255 I_1 0 255 /end CHARACTERISTIC
/begin CHARACTERISTIC FaultFTASETP_EstPmDeratingActFailMod "FaultFTASETP_EstPmDeratingActFailMod" VALUE 0x8009AC63 DATA_RECORD_UBYTE 255 I_1 0 255 /end CHARACTERISTIC
/begin CHARACTERISTIC FaultFTASETP_EstPmDeratingActInc "FaultFTASETP_EstPmDeratingActInc" VALUE 0x8009AB41 DATA_RECORD_UBYTE 255 I_1 0 255 /end CHARACTERISTIC
/begin CHARACTERISTIC FaultFTASETP_PmDeratingActDec "FaultFTASETP_PmDeratingActDec" VALUE 0x8009AA20 DATA_RECORD_UBYTE 255 I_1 0 255 /end CHARACTERISTIC
/begin CHARACTERISTIC FaultFTASETP_PmDeratingActFailMod "FaultFTASETP_PmDeratingActFailMod" VALUE 0x8009AC64 DATA_RECORD_UBYTE 255 I_1 0 255 /end CHARACTERISTIC
/begin CHARACTERISTIC FaultFTASETP_PmDeratingActInc "FaultFTASETP_PmDeratingActInc" VALUE 0x8009AB42 DATA_RECORD_UBYTE 255 I_1 0 255 /end CHARACTERISTIC
/begin CHARACTERISTIC FaultFTASMTP_Wndg1DeratingActDec "FaultFTASMTP_Wndg1DeratingActDec" VALUE 0x8009AA21 DATA_RECORD_UBYTE 255 I_1 0 255 /end CHARACTERISTIC
/begin CHARACTERISTIC FaultFTASMTP_Wndg1DeratingActFailMod "FaultFTASMTP_Wndg1DeratingActFailMod" VALUE 0x8009AC65 DATA_RECORD_UBYTE 255 I_1 0 255 /end CHARACTERISTIC
/begin CHARACTERISTIC FaultFTASMTP_Wndg1DeratingActInc "FaultFTASMTP_Wndg1DeratingActInc" VALUE 0x8009AB43 DATA_RECORD_UBYTE 255 I_1 0 255 /end CHARACTERISTIC
/begin CHARACTERISTIC FaultFTASOSP_MotorSpdDeratingActDec "FaultFTASOSP_MotorSpdDeratingActDec" VALUE 0x8009AA22 DATA_RECORD_UBYTE 255 I_1 0 255 /end CHARACTERISTIC
/begin CHARACTERISTIC FaultFTASOSP_MotorSpdDeratingActFailMod "FaultFTASOSP_MotorSpdDeratingActFailMod" VALUE 0x8009AC66 DATA_RECORD_UBYTE 255 I_1 0 255 /end CHARACTERISTIC
/begin CHARACTERISTIC FaultFTASOSP_MotorSpdDeratingActInc "FaultFTASOSP_MotorSpdDeratingActInc" VALUE 0x8009AB44 DATA_RECORD_UBYTE 255 I_1 0 255 /end CHARACTERISTIC
/begin CHARACTERISTIC FaultFTCMSCS_CtrlSatTimoutDec "FaultFTCMSCS_CtrlSatTimoutDec" VALUE 0x8009AA23 DATA_RECORD_UBYTE 255 I_1 0 255 /end CHARACTERISTIC
/begin CHARACTERISTIC FaultFTCMSCS_CtrlSatTimoutFailMod "FaultFTCMSCS_CtrlSatTimoutFailMod" VALUE 0x8009AC67 DATA_RECORD_UBYTE 255 I_1 0 255 /end CHARACTERISTIC
/begin CHARACTERISTIC FaultFTCMSCS_CtrlSatTimoutInc "FaultFTCMSCS_CtrlSatTimoutInc" VALUE 0x8009AB45 DATA_RECORD_UBYTE 255 I_1 0 255 /end CHARACTERISTIC
/begin CHARACTERISTIC FaultFTCMSCS_SpdOvershootDec "FaultFTCMSCS_SpdOvershootDec" VALUE 0x8009AA24 DATA_RECORD_UBYTE 255 I_1 0 255 /end CHARACTERISTIC
/begin CHARACTERISTIC FaultFTCMSCS_SpdOvershootFailMod "FaultFTCMSCS_SpdOvershootFailMod" VALUE 0x8009AC68 DATA_RECORD_UBYTE 255 I_1 0 255 /end CHARACTERISTIC
/begin CHARACTERISTIC FaultFTCMSCS_SpdOvershootInc "FaultFTCMSCS_SpdOvershootInc" VALUE 0x8009AB46 DATA_RECORD_UBYTE 255 I_1 0 255 /end CHARACTERISTIC
/begin CHARACTERISTIC FaultFTCMSCS_ZeroSpeedTimoutDec "FaultFTCMSCS_ZeroSpeedTimoutDec" VALUE 0x8009AA25 DATA_RECORD_UBYTE 255 I_1 0 255 /end CHARACTERISTIC
/begin CHARACTERISTIC FaultFTCMSCS_ZeroSpeedTimoutFailMod "FaultFTCMSCS_ZeroSpeedTimoutFailMod" VALUE 0x8009AC69 DATA_RECORD_UBYTE 255 I_1 0 255 /end CHARACTERISTIC
/begin CHARACTERISTIC FaultFTCMSCS_ZeroSpeedTimoutInc "FaultFTCMSCS_ZeroSpeedTimoutInc" VALUE 0x8009AB47 DATA_RECORD_UBYTE 255 I_1 0 255 /end CHARACTERISTIC
/begin CHARACTERISTIC FaultFTCMTCS_VoltageMarginLowDec "FaultFTCMTCS_VoltageMarginLowDec" VALUE 0x8009AA26 DATA_RECORD_UBYTE 255 I_1 0 255 /end CHARACTERISTIC
/begin CHARACTERISTIC FaultFTCMTCS_VoltageMarginLowFailMod "FaultFTCMTCS_VoltageMarginLowFailMod" VALUE 0x8009AC6A DATA_RECORD_UBYTE 255 I_1 0 255 /end CHARACTERISTIC
/begin CHARACTERISTIC FaultFTCMTCS_VoltageMarginLowInc "FaultFTCMTCS_VoltageMarginLowInc" VALUE 0x8009AB48 DATA_RECORD_UBYTE 255 I_1 0 255 /end CHARACTERISTIC
/begin CHARACTERISTIC FaultFTEVEIT_EstOverTempDec "FaultFTEVEIT_EstOverTempDec" VALUE 0x8009AA27 DATA_RECORD_UBYTE 255 I_1 0 255 /end CHARACTERISTIC
/begin CHARACTERISTIC FaultFTEVEIT_EstOverTempFailMod "FaultFTEVEIT_EstOverTempFailMod" VALUE 0x8009AC6B DATA_RECORD_UBYTE 255 I_1 0 255 /end CHARACTERISTIC
/begin CHARACTERISTIC FaultFTEVEIT_EstOverTempInc "FaultFTEVEIT_EstOverTempInc" VALUE 0x8009AB49 DATA_RECORD_UBYTE 255 I_1 0 255 /end CHARACTERISTIC
/begin CHARACTERISTIC FaultFTMTLCS_CurSenrPhaU_GNDDec "FaultFTMTLCS_CurSenrPhaU_GNDDec" VALUE 0x8009AA29 DATA_RECORD_UBYTE 255 I_1 0 255 /end CHARACTERISTIC
/begin CHARACTERISTIC FaultFTMTLCS_CurSenrPhaU_GNDFailMod "FaultFTMTLCS_CurSenrPhaU_GNDFailMod" VALUE 0x8009AC6D DATA_RECORD_UBYTE 255 I_1 0 255 /end CHARACTERISTIC
/begin CHARACTERISTIC FaultFTMTLCS_CurSenrPhaU_GNDInc "FaultFTMTLCS_CurSenrPhaU_GNDInc" VALUE 0x8009AB4B DATA_RECORD_UBYTE 255 I_1 0 255 /end CHARACTERISTIC
/begin CHARACTERISTIC FaultFTMTLCS_CurSenrPhaU_OutRngHDec "FaultFTMTLCS_CurSenrPhaU_OutRngHDec" VALUE 0x8009AA2A DATA_RECORD_UBYTE 255 I_1 0 255 /end CHARACTERISTIC
/begin CHARACTERISTIC FaultFTMTLCS_CurSenrPhaU_OutRngHFailMod "FaultFTMTLCS_CurSenrPhaU_OutRngHFailMod" VALUE 0x8009AC6E DATA_RECORD_UBYTE 255 I_1 0 255 /end CHARACTERISTIC
/begin CHARACTERISTIC FaultFTMTLCS_CurSenrPhaU_OutRngHInc "FaultFTMTLCS_CurSenrPhaU_OutRngHInc" VALUE 0x8009AB4C DATA_RECORD_UBYTE 255 I_1 0 255 /end CHARACTERISTIC
/begin CHARACTERISTIC FaultFTMTLCS_CurSenrPhaU_OutRngLDec "FaultFTMTLCS_CurSenrPhaU_OutRngLDec" VALUE 0x8009AA2B DATA_RECORD_UBYTE 255 I_1 0 255 /end CHARACTERISTIC
/begin CHARACTERISTIC FaultFTMTLCS_CurSenrPhaU_OutRngLFailMod "FaultFTMTLCS_CurSenrPhaU_OutRngLFailMod" VALUE 0x8009AC6F DATA_RECORD_UBYTE 255 I_1 0 255 /end CHARACTERISTIC
/begin CHARACTERISTIC FaultFTMTLCS_CurSenrPhaU_OutRngLInc "FaultFTMTLCS_CurSenrPhaU_OutRngLInc" VALUE 0x8009AB4D DATA_RECORD_UBYTE 255 I_1 0 255 /end CHARACTERISTIC
/begin CHARACTERISTIC FaultFTMTLCS_CurSenrPhaU_VCCDec "FaultFTMTLCS_CurSenrPhaU_VCCDec" VALUE 0x8009AA2C DATA_RECORD_UBYTE 255 I_1 0 255 /end CHARACTERISTIC
/begin CHARACTERISTIC FaultFTMTLCS_CurSenrPhaU_VCCFailMod "FaultFTMTLCS_CurSenrPhaU_VCCFailMod" VALUE 0x8009AC70 DATA_RECORD_UBYTE 255 I_1 0 255 /end CHARACTERISTIC
/begin CHARACTERISTIC FaultFTMTLCS_CurSenrPhaU_VCCInc "FaultFTMTLCS_CurSenrPhaU_VCCInc" VALUE 0x8009AB4E DATA_RECORD_UBYTE 255 I_1 0 255 /end CHARACTERISTIC
/begin CHARACTERISTIC FaultFTMTLCS_CurSenrPhaV_GNDDec "FaultFTMTLCS_CurSenrPhaV_GNDDec" VALUE 0x8009AA2D DATA_RECORD_UBYTE 255 I_1 0 255 /end CHARACTERISTIC
/begin CHARACTERISTIC FaultFTMTLCS_CurSenrPhaV_GNDFailMod "FaultFTMTLCS_CurSenrPhaV_GNDFailMod" VALUE 0x8009AC71 DATA_RECORD_UBYTE 255 I_1 0 255 /end CHARACTERISTIC
/begin CHARACTERISTIC FaultFTMTLCS_CurSenrPhaV_GNDInc "FaultFTMTLCS_CurSenrPhaV_GNDInc" VALUE 0x8009AB4F DATA_RECORD_UBYTE 255 I_1 0 255 /end CHARACTERISTIC
/begin CHARACTERISTIC FaultFTMTLCS_CurSenrPhaV_OutRngHDec "FaultFTMTLCS_CurSenrPhaV_OutRngHDec" VALUE 0x8009AA2E DATA_RECORD_UBYTE 255 I_1 0 255 /end CHARACTERISTIC
/begin CHARACTERISTIC FaultFTMTLCS_CurSenrPhaV_OutRngHFailMod "FaultFTMTLCS_CurSenrPhaV_OutRngHFailMod" VALUE 0x8009AC72 DATA_RECORD_UBYTE 255 I_1 0 255 /end CHARACTERISTIC
/begin CHARACTERISTIC FaultFTMTLCS_CurSenrPhaV_OutRngHInc "FaultFTMTLCS_CurSenrPhaV_OutRngHInc" VALUE 0x8009AB50 DATA_RECORD_UBYTE 255 I_1 0 255 /end CHARACTERISTIC
/begin CHARACTERISTIC FaultFTMTLCS_CurSenrPhaV_OutRngLDec "FaultFTMTLCS_CurSenrPhaV_OutRngLDec" VALUE 0x8009AA2F DATA_RECORD_UBYTE 255 I_1 0 255 /end CHARACTERISTIC
/begin CHARACTERISTIC FaultFTMTLCS_CurSenrPhaV_OutRngLFailMod "FaultFTMTLCS_CurSenrPhaV_OutRngLFailMod" VALUE 0x8009AC73 DATA_RECORD_UBYTE 255 I_1 0 255 /end CHARACTERISTIC
/begin CHARACTERISTIC FaultFTMTLCS_CurSenrPhaV_OutRngLInc "FaultFTMTLCS_CurSenrPhaV_OutRngLInc" VALUE 0x8009AB51 DATA_RECORD_UBYTE 255 I_1 0 255 /end CHARACTERISTIC
/begin CHARACTERISTIC FaultFTMTLCS_CurSenrPhaV_VCCDec "FaultFTMTLCS_CurSenrPhaV_VCCDec" VALUE 0x8009AA30 DATA_RECORD_UBYTE 255 I_1 0 255 /end CHARACTERISTIC
/begin CHARACTERISTIC FaultFTMTLCS_CurSenrPhaV_VCCFailMod "FaultFTMTLCS_CurSenrPhaV_VCCFailMod" VALUE 0x8009AC74 DATA_RECORD_UBYTE 255 I_1 0 255 /end CHARACTERISTIC
/begin CHARACTERISTIC FaultFTMTLCS_CurSenrPhaV_VCCInc "FaultFTMTLCS_CurSenrPhaV_VCCInc" VALUE 0x8009AB52 DATA_RECORD_UBYTE 255 I_1 0 255 /end CHARACTERISTIC
/begin CHARACTERISTIC FaultFTMTLCS_CurSenrPhaW_GNDDec "FaultFTMTLCS_CurSenrPhaW_GNDDec" VALUE 0x8009AA31 DATA_RECORD_UBYTE 255 I_1 0 255 /end CHARACTERISTIC
/begin CHARACTERISTIC FaultFTMTLCS_CurSenrPhaW_GNDFailMod "FaultFTMTLCS_CurSenrPhaW_GNDFailMod" VALUE 0x8009AC75 DATA_RECORD_UBYTE 255 I_1 0 255 /end CHARACTERISTIC
/begin CHARACTERISTIC FaultFTMTLCS_CurSenrPhaW_GNDInc "FaultFTMTLCS_CurSenrPhaW_GNDInc" VALUE 0x8009AB53 DATA_RECORD_UBYTE 255 I_1 0 255 /end CHARACTERISTIC
/begin CHARACTERISTIC FaultFTMTLCS_CurSenrPhaW_OutRngHDec "FaultFTMTLCS_CurSenrPhaW_OutRngHDec" VALUE 0x8009AA32 DATA_RECORD_UBYTE 255 I_1 0 255 /end CHARACTERISTIC
/begin CHARACTERISTIC FaultFTMTLCS_CurSenrPhaW_OutRngHFailMod "FaultFTMTLCS_CurSenrPhaW_OutRngHFailMod" VALUE 0x8009AC76 DATA_RECORD_UBYTE 255 I_1 0 255 /end CHARACTERISTIC
/begin CHARACTERISTIC FaultFTMTLCS_CurSenrPhaW_OutRngHInc "FaultFTMTLCS_CurSenrPhaW_OutRngHInc" VALUE 0x8009AB54 DATA_RECORD_UBYTE 255 I_1 0 255 /end CHARACTERISTIC
/begin CHARACTERISTIC FaultFTMTLCS_CurSenrPhaW_OutRngLDec "FaultFTMTLCS_CurSenrPhaW_OutRngLDec" VALUE 0x8009AA33 DATA_RECORD_UBYTE 255 I_1 0 255 /end CHARACTERISTIC
/begin CHARACTERISTIC FaultFTMTLCS_CurSenrPhaW_OutRngLFailMod "FaultFTMTLCS_CurSenrPhaW_OutRngLFailMod" VALUE 0x8009AC77 DATA_RECORD_UBYTE 255 I_1 0 255 /end CHARACTERISTIC
/begin CHARACTERISTIC FaultFTMTLCS_CurSenrPhaW_OutRngLInc "FaultFTMTLCS_CurSenrPhaW_OutRngLInc" VALUE 0x8009AB55 DATA_RECORD_UBYTE 255 I_1 0 255 /end CHARACTERISTIC
/begin CHARACTERISTIC FaultFTMTLCS_CurSenrPhaW_VCCDec "FaultFTMTLCS_CurSenrPhaW_VCCDec" VALUE 0x8009AA34 DATA_RECORD_UBYTE 255 I_1 0 255 /end CHARACTERISTIC
/begin CHARACTERISTIC FaultFTMTLCS_CurSenrPhaW_VCCFailMod "FaultFTMTLCS_CurSenrPhaW_VCCFailMod" VALUE 0x8009AC78 DATA_RECORD_UBYTE 255 I_1 0 255 /end CHARACTERISTIC
/begin CHARACTERISTIC FaultFTMTLCS_CurSenrPhaW_VCCInc "FaultFTMTLCS_CurSenrPhaW_VCCInc" VALUE 0x8009AB56 DATA_RECORD_UBYTE 255 I_1 0 255 /end CHARACTERISTIC
/begin CHARACTERISTIC FaultFTMTLCS_CurrentSumErrorDec "FaultFTMTLCS_CurrentSumErrorDec" VALUE 0x8009AA28 DATA_RECORD_UBYTE 255 I_1 0 255 /end CHARACTERISTIC
/begin CHARACTERISTIC FaultFTMTLCS_CurrentSumErrorFailMod "FaultFTMTLCS_CurrentSumErrorFailMod" VALUE 0x8009AC6C DATA_RECORD_UBYTE 255 I_1 0 255 /end CHARACTERISTIC
/begin CHARACTERISTIC FaultFTMTLCS_CurrentSumErrorInc "FaultFTMTLCS_CurrentSumErrorInc" VALUE 0x8009AB4A DATA_RECORD_UBYTE 255 I_1 0 255 /end CHARACTERISTIC
/begin CHARACTERISTIC FaultSDMTMEP_CosGndDec "FaultSDMTMEP_CosGndDec" VALUE 0x8009AA35 DATA_RECORD_UBYTE 255 I_1 0 255 /end CHARACTERISTIC
/begin CHARACTERISTIC FaultSDMTMEP_CosGndFailMod "FaultSDMTMEP_CosGndFailMod" VALUE 0x8009AC79 DATA_RECORD_UBYTE 255 I_1 0 255 /end CHARACTERISTIC
/begin CHARACTERISTIC FaultSDMTMEP_CosGndInc "FaultSDMTMEP_CosGndInc" VALUE 0x8009AB57 DATA_RECORD_UBYTE 255 I_1 0 255 /end CHARACTERISTIC
/begin CHARACTERISTIC FaultSDMTMEP_CosOutRangeHighDec "FaultSDMTMEP_CosOutRangeHighDec" VALUE 0x8009AA36 DATA_RECORD_UBYTE 255 I_1 0 255 /end CHARACTERISTIC
/begin CHARACTERISTIC FaultSDMTMEP_CosOutRangeHighFailMod "FaultSDMTMEP_CosOutRangeHighFailMod" VALUE 0x8009AC7A DATA_RECORD_UBYTE 255 I_1 0 255 /end CHARACTERISTIC
/begin CHARACTERISTIC FaultSDMTMEP_CosOutRangeHighInc "FaultSDMTMEP_CosOutRangeHighInc" VALUE 0x8009AB58 DATA_RECORD_UBYTE 255 I_1 0 255 /end CHARACTERISTIC
/begin CHARACTERISTIC FaultSDMTMEP_CosOutRangeLowDec "FaultSDMTMEP_CosOutRangeLowDec" VALUE 0x8009AA37 DATA_RECORD_UBYTE 255 I_1 0 255 /end CHARACTERISTIC
/begin CHARACTERISTIC FaultSDMTMEP_CosOutRangeLowFailMod "FaultSDMTMEP_CosOutRangeLowFailMod" VALUE 0x8009AC7B DATA_RECORD_UBYTE 255 I_1 0 255 /end CHARACTERISTIC
/begin CHARACTERISTIC FaultSDMTMEP_CosOutRangeLowInc "FaultSDMTMEP_CosOutRangeLowInc" VALUE 0x8009AB59 DATA_RECORD_UBYTE 255 I_1 0 255 /end CHARACTERISTIC
/begin CHARACTERISTIC FaultSDMTMEP_CosVccDec "FaultSDMTMEP_CosVccDec" VALUE 0x8009AA38 DATA_RECORD_UBYTE 255 I_1 0 255 /end CHARACTERISTIC
/begin CHARACTERISTIC FaultSDMTMEP_CosVccFailMod "FaultSDMTMEP_CosVccFailMod" VALUE 0x8009AC7C DATA_RECORD_UBYTE 255 I_1 0 255 /end CHARACTERISTIC
/begin CHARACTERISTIC FaultSDMTMEP_CosVccInc "FaultSDMTMEP_CosVccInc" VALUE 0x8009AB5A DATA_RECORD_UBYTE 255 I_1 0 255 /end CHARACTERISTIC
/begin CHARACTERISTIC FaultSDMTMEP_OverSpeedDec "FaultSDMTMEP_OverSpeedDec" VALUE 0x8009AA39 DATA_RECORD_UBYTE 255 I_1 0 255 /end CHARACTERISTIC
/begin CHARACTERISTIC FaultSDMTMEP_OverSpeedFailMod "FaultSDMTMEP_OverSpeedFailMod" VALUE 0x8009AC7D DATA_RECORD_UBYTE 255 I_1 0 255 /end CHARACTERISTIC
/begin CHARACTERISTIC FaultSDMTMEP_OverSpeedInc "FaultSDMTMEP_OverSpeedInc" VALUE 0x8009AB5B DATA_RECORD_UBYTE 255 I_1 0 255 /end CHARACTERISTIC
/begin CHARACTERISTIC FaultSDMTMEP_ResSquaSumErrByFTDec "FaultSDMTMEP_ResSquaSumErrByFTDec" VALUE 0x8009AA3A DATA_RECORD_UBYTE 255 I_1 0 255 /end CHARACTERISTIC
/begin CHARACTERISTIC FaultSDMTMEP_ResSquaSumErrByFTFailMod "FaultSDMTMEP_ResSquaSumErrByFTFailMod" VALUE 0x8009AC7E DATA_RECORD_UBYTE 255 I_1 0 255 /end CHARACTERISTIC
/begin CHARACTERISTIC FaultSDMTMEP_ResSquaSumErrByFTInc "FaultSDMTMEP_ResSquaSumErrByFTInc" VALUE 0x8009AB5C DATA_RECORD_UBYTE 255 I_1 0 255 /end CHARACTERISTIC
/begin CHARACTERISTIC FaultSDMTMEP_SinGndDec "FaultSDMTMEP_SinGndDec" VALUE 0x8009AA3B DATA_RECORD_UBYTE 255 I_1 0 255 /end CHARACTERISTIC
/begin CHARACTERISTIC FaultSDMTMEP_SinGndFailMod "FaultSDMTMEP_SinGndFailMod" VALUE 0x8009AC7F DATA_RECORD_UBYTE 255 I_1 0 255 /end CHARACTERISTIC
/begin CHARACTERISTIC FaultSDMTMEP_SinGndInc "FaultSDMTMEP_SinGndInc" VALUE 0x8009AB5D DATA_RECORD_UBYTE 255 I_1 0 255 /end CHARACTERISTIC
/begin CHARACTERISTIC FaultSDMTMEP_SinOutRangeHighDec "FaultSDMTMEP_SinOutRangeHighDec" VALUE 0x8009AA3C DATA_RECORD_UBYTE 255 I_1 0 255 /end CHARACTERISTIC
/begin CHARACTERISTIC FaultSDMTMEP_SinOutRangeHighFailMod "FaultSDMTMEP_SinOutRangeHighFailMod" VALUE 0x8009AC80 DATA_RECORD_UBYTE 255 I_1 0 255 /end CHARACTERISTIC
/begin CHARACTERISTIC FaultSDMTMEP_SinOutRangeHighInc "FaultSDMTMEP_SinOutRangeHighInc" VALUE 0x8009AB5E DATA_RECORD_UBYTE 255 I_1 0 255 /end CHARACTERISTIC
/begin CHARACTERISTIC FaultSDMTMEP_SinOutRangeLowDec "FaultSDMTMEP_SinOutRangeLowDec" VALUE 0x8009AA3D DATA_RECORD_UBYTE 255 I_1 0 255 /end CHARACTERISTIC
/begin CHARACTERISTIC FaultSDMTMEP_SinOutRangeLowFailMod "FaultSDMTMEP_SinOutRangeLowFailMod" VALUE 0x8009AC81 DATA_RECORD_UBYTE 255 I_1 0 255 /end CHARACTERISTIC
/begin CHARACTERISTIC FaultSDMTMEP_SinOutRangeLowInc "FaultSDMTMEP_SinOutRangeLowInc" VALUE 0x8009AB5F DATA_RECORD_UBYTE 255 I_1 0 255 /end CHARACTERISTIC
/begin CHARACTERISTIC FaultSDMTMEP_SinVccDec "FaultSDMTMEP_SinVccDec" VALUE 0x8009AA3E DATA_RECORD_UBYTE 255 I_1 0 255 /end CHARACTERISTIC
/begin CHARACTERISTIC FaultSDMTMEP_SinVccFailMod "FaultSDMTMEP_SinVccFailMod" VALUE 0x8009AC82 DATA_RECORD_UBYTE 255 I_1 0 255 /end CHARACTERISTIC
/begin CHARACTERISTIC FaultSDMTMEP_SinVccInc "FaultSDMTMEP_SinVccInc" VALUE 0x8009AB60 DATA_RECORD_UBYTE 255 I_1 0 255 /end CHARACTERISTIC
/begin CHARACTERISTIC FaultSDMTMEP_UnderSpeedDec "FaultSDMTMEP_UnderSpeedDec" VALUE 0x8009AA3F DATA_RECORD_UBYTE 255 I_1 0 255 /end CHARACTERISTIC
/begin CHARACTERISTIC FaultSDMTMEP_UnderSpeedFailMod "FaultSDMTMEP_UnderSpeedFailMod" VALUE 0x8009AC83 DATA_RECORD_UBYTE 255 I_1 0 255 /end CHARACTERISTIC
/begin CHARACTERISTIC FaultSDMTMEP_UnderSpeedInc "FaultSDMTMEP_UnderSpeedInc" VALUE 0x8009AB61 DATA_RECORD_UBYTE 255 I_1 0 255 /end CHARACTERISTIC
/begin CHARACTERISTIC FaultTCUCAP0_CAPPressureHDec "FaultTCUCAP0_CAPPressureHDec" VALUE 0x8009AA40 DATA_RECORD_UBYTE 255 I_1 0 255 /end CHARACTERISTIC
/begin CHARACTERISTIC FaultTCUCAP0_CAPPressureHFailMod "FaultTCUCAP0_CAPPressureHFailMod" VALUE 0x8009AC84 DATA_RECORD_UBYTE 255 I_1 0 255 /end CHARACTERISTIC
/begin CHARACTERISTIC FaultTCUCAP0_CAPPressureHInc "FaultTCUCAP0_CAPPressureHInc" VALUE 0x8009AB62 DATA_RECORD_UBYTE 255 I_1 0 255 /end CHARACTERISTIC
/begin CHARACTERISTIC FaultTCUCAP0_CAPPressureLDec "FaultTCUCAP0_CAPPressureLDec" VALUE 0x8009AA41 DATA_RECORD_UBYTE 255 I_1 0 255 /end CHARACTERISTIC
/begin CHARACTERISTIC FaultTCUCAP0_CAPPressureLFailMod "FaultTCUCAP0_CAPPressureLFailMod" VALUE 0x8009AC85 DATA_RECORD_UBYTE 255 I_1 0 255 /end CHARACTERISTIC
/begin CHARACTERISTIC FaultTCUCAP0_CAPPressureLInc "FaultTCUCAP0_CAPPressureLInc" VALUE 0x8009AB63 DATA_RECORD_UBYTE 255 I_1 0 255 /end CHARACTERISTIC
/begin CHARACTERISTIC FaultTCUCAP0_CAPPressureOverHDec "FaultTCUCAP0_CAPPressureOverHDec" VALUE 0x8009AA42 DATA_RECORD_UBYTE 255 I_1 0 255 /end CHARACTERISTIC
/begin CHARACTERISTIC FaultTCUCAP0_CAPPressureOverHFailMod "FaultTCUCAP0_CAPPressureOverHFailMod" VALUE 0x8009AC86 DATA_RECORD_UBYTE 255 I_1 0 255 /end CHARACTERISTIC
/begin CHARACTERISTIC FaultTCUCAP0_CAPPressureOverHInc "FaultTCUCAP0_CAPPressureOverHInc" VALUE 0x8009AB64 DATA_RECORD_UBYTE 255 I_1 0 255 /end CHARACTERISTIC
/begin CHARACTERISTIC FaultTCUCAP0_CAPSlipDec "FaultTCUCAP0_CAPSlipDec" VALUE 0x8009AA43 DATA_RECORD_UBYTE 255 I_1 0 255 /end CHARACTERISTIC
/begin CHARACTERISTIC FaultTCUCAP0_CAPSlipFailMod "FaultTCUCAP0_CAPSlipFailMod" VALUE 0x8009AC87 DATA_RECORD_UBYTE 255 I_1 0 255 /end CHARACTERISTIC
/begin CHARACTERISTIC FaultTCUCAP0_CAPSlipInc "FaultTCUCAP0_CAPSlipInc" VALUE 0x8009AB65 DATA_RECORD_UBYTE 255 I_1 0 255 /end CHARACTERISTIC
/begin CHARACTERISTIC FaultTCUCAP0_DragMomentHDec "FaultTCUCAP0_DragMomentHDec" VALUE 0x8009AA44 DATA_RECORD_UBYTE 255 I_1 0 255 /end CHARACTERISTIC
/begin CHARACTERISTIC FaultTCUCAP0_DragMomentHFailMod "FaultTCUCAP0_DragMomentHFailMod" VALUE 0x8009AC88 DATA_RECORD_UBYTE 255 I_1 0 255 /end CHARACTERISTIC
/begin CHARACTERISTIC FaultTCUCAP0_DragMomentHInc "FaultTCUCAP0_DragMomentHInc" VALUE 0x8009AB66 DATA_RECORD_UBYTE 255 I_1 0 255 /end CHARACTERISTIC
/begin CHARACTERISTIC FaultTCUCAP0_HLSinInvalidDec "FaultTCUCAP0_HLSinInvalidDec" VALUE 0x8009AA45 DATA_RECORD_UBYTE 255 I_1 0 255 /end CHARACTERISTIC
/begin CHARACTERISTIC FaultTCUCAP0_HLSinInvalidFailMod "FaultTCUCAP0_HLSinInvalidFailMod" VALUE 0x8009AC89 DATA_RECORD_UBYTE 255 I_1 0 255 /end CHARACTERISTIC
/begin CHARACTERISTIC FaultTCUCAP0_HLSinInvalidInc "FaultTCUCAP0_HLSinInvalidInc" VALUE 0x8009AB67 DATA_RECORD_UBYTE 255 I_1 0 255 /end CHARACTERISTIC
/begin CHARACTERISTIC FaultTCUCAP0_HLSinUndefineDec "FaultTCUCAP0_HLSinUndefineDec" VALUE 0x8009AA46 DATA_RECORD_UBYTE 255 I_1 0 255 /end CHARACTERISTIC
/begin CHARACTERISTIC FaultTCUCAP0_HLSinUndefineFailMod "FaultTCUCAP0_HLSinUndefineFailMod" VALUE 0x8009AC8A DATA_RECORD_UBYTE 255 I_1 0 255 /end CHARACTERISTIC
/begin CHARACTERISTIC FaultTCUCAP0_HLSinUndefineInc "FaultTCUCAP0_HLSinUndefineInc" VALUE 0x8009AB68 DATA_RECORD_UBYTE 255 I_1 0 255 /end CHARACTERISTIC
/begin CHARACTERISTIC FaultTCUCAP0_HLSupplyHDec "FaultTCUCAP0_HLSupplyHDec" VALUE 0x8009AA47 DATA_RECORD_UBYTE 255 I_1 0 255 /end CHARACTERISTIC
/begin CHARACTERISTIC FaultTCUCAP0_HLSupplyHFailMod "FaultTCUCAP0_HLSupplyHFailMod" VALUE 0x8009AC8B DATA_RECORD_UBYTE 255 I_1 0 255 /end CHARACTERISTIC
/begin CHARACTERISTIC FaultTCUCAP0_HLSupplyHInc "FaultTCUCAP0_HLSupplyHInc" VALUE 0x8009AB69 DATA_RECORD_UBYTE 255 I_1 0 255 /end CHARACTERISTIC
/begin CHARACTERISTIC FaultTCUCAP0_HLSupplyLDec "FaultTCUCAP0_HLSupplyLDec" VALUE 0x8009AA48 DATA_RECORD_UBYTE 255 I_1 0 255 /end CHARACTERISTIC
/begin CHARACTERISTIC FaultTCUCAP0_HLSupplyLFailMod "FaultTCUCAP0_HLSupplyLFailMod" VALUE 0x8009AC8C DATA_RECORD_UBYTE 255 I_1 0 255 /end CHARACTERISTIC
/begin CHARACTERISTIC FaultTCUCAP0_HLSupplyLInc "FaultTCUCAP0_HLSupplyLInc" VALUE 0x8009AB6A DATA_RECORD_UBYTE 255 I_1 0 255 /end CHARACTERISTIC
/begin CHARACTERISTIC FaultTCUCAP0_MotorPhaseVolHDec "FaultTCUCAP0_MotorPhaseVolHDec" VALUE 0x8009AA49 DATA_RECORD_UBYTE 255 I_1 0 255 /end CHARACTERISTIC
/begin CHARACTERISTIC FaultTCUCAP0_MotorPhaseVolHFailMod "FaultTCUCAP0_MotorPhaseVolHFailMod" VALUE 0x8009AC8D DATA_RECORD_UBYTE 255 I_1 0 255 /end CHARACTERISTIC
/begin CHARACTERISTIC FaultTCUCAP0_MotorPhaseVolHInc "FaultTCUCAP0_MotorPhaseVolHInc" VALUE 0x8009AB6B DATA_RECORD_UBYTE 255 I_1 0 255 /end CHARACTERISTIC
/begin CHARACTERISTIC FaultTCUCAP0_PressureRationalDec "FaultTCUCAP0_PressureRationalDec" VALUE 0x8009AA4A DATA_RECORD_UBYTE 255 I_1 0 255 /end CHARACTERISTIC
/begin CHARACTERISTIC FaultTCUCAP0_PressureRationalFailMod "FaultTCUCAP0_PressureRationalFailMod" VALUE 0x8009AC8E DATA_RECORD_UBYTE 255 I_1 0 255 /end CHARACTERISTIC
/begin CHARACTERISTIC FaultTCUCAP0_PressureRationalInc "FaultTCUCAP0_PressureRationalInc" VALUE 0x8009AB6C DATA_RECORD_UBYTE 255 I_1 0 255 /end CHARACTERISTIC
/begin CHARACTERISTIC FaultTCUCAP0_SenSigOpenOrGNDDec "FaultTCUCAP0_SenSigOpenOrGNDDec" VALUE 0x8009AA4B DATA_RECORD_UBYTE 255 I_1 0 255 /end CHARACTERISTIC
/begin CHARACTERISTIC FaultTCUCAP0_SenSigOpenOrGNDFailMod "FaultTCUCAP0_SenSigOpenOrGNDFailMod" VALUE 0x8009AC8F DATA_RECORD_UBYTE 255 I_1 0 255 /end CHARACTERISTIC
/begin CHARACTERISTIC FaultTCUCAP0_SenSigOpenOrGNDInc "FaultTCUCAP0_SenSigOpenOrGNDInc" VALUE 0x8009AB6D DATA_RECORD_UBYTE 255 I_1 0 255 /end CHARACTERISTIC
/begin CHARACTERISTIC FaultTCUCAP0_SenSigVCCDec "FaultTCUCAP0_SenSigVCCDec" VALUE 0x8009AA4C DATA_RECORD_UBYTE 255 I_1 0 255 /end CHARACTERISTIC
/begin CHARACTERISTIC FaultTCUCAP0_SenSigVCCFailMod "FaultTCUCAP0_SenSigVCCFailMod" VALUE 0x8009AC90 DATA_RECORD_UBYTE 255 I_1 0 255 /end CHARACTERISTIC
/begin CHARACTERISTIC FaultTCUCAP0_SenSigVCCInc "FaultTCUCAP0_SenSigVCCInc" VALUE 0x8009AB6E DATA_RECORD_UBYTE 255 I_1 0 255 /end CHARACTERISTIC
/begin CHARACTERISTIC FaultTCUCAP0_SensorPerforErrDec "FaultTCUCAP0_SensorPerforErrDec" VALUE 0x8009AA4D DATA_RECORD_UBYTE 255 I_1 0 255 /end CHARACTERISTIC
/begin CHARACTERISTIC FaultTCUCAP0_SensorPerforErrFailMod "FaultTCUCAP0_SensorPerforErrFailMod" VALUE 0x8009AC91 DATA_RECORD_UBYTE 255 I_1 0 255 /end CHARACTERISTIC
/begin CHARACTERISTIC FaultTCUCAP0_SensorPerforErrInc "FaultTCUCAP0_SensorPerforErrInc" VALUE 0x8009AB6F DATA_RECORD_UBYTE 255 I_1 0 255 /end CHARACTERISTIC
/begin CHARACTERISTIC FaultTCUCAP1_COM_GCUDec "FaultTCUCAP1_COM_GCUDec" VALUE 0x8009AA4E DATA_RECORD_UBYTE 255 I_1 0 255 /end CHARACTERISTIC
/begin CHARACTERISTIC FaultTCUCAP1_COM_GCUFailMod "FaultTCUCAP1_COM_GCUFailMod" VALUE 0x8009AC92 DATA_RECORD_UBYTE 255 I_1 0 255 /end CHARACTERISTIC
/begin CHARACTERISTIC FaultTCUCAP1_COM_GCUInc "FaultTCUCAP1_COM_GCUInc" VALUE 0x8009AB70 DATA_RECORD_UBYTE 255 I_1 0 255 /end CHARACTERISTIC
/begin CHARACTERISTIC FaultTCUCAP1_DriverTempHDec "FaultTCUCAP1_DriverTempHDec" VALUE 0x8009AA4F DATA_RECORD_UBYTE 255 I_1 0 255 /end CHARACTERISTIC
/begin CHARACTERISTIC FaultTCUCAP1_DriverTempHFailMod "FaultTCUCAP1_DriverTempHFailMod" VALUE 0x8009AC93 DATA_RECORD_UBYTE 255 I_1 0 255 /end CHARACTERISTIC
/begin CHARACTERISTIC FaultTCUCAP1_DriverTempHInc "FaultTCUCAP1_DriverTempHInc" VALUE 0x8009AB71 DATA_RECORD_UBYTE 255 I_1 0 255 /end CHARACTERISTIC
/begin CHARACTERISTIC FaultTCUCAP1_FETShortDec "FaultTCUCAP1_FETShortDec" VALUE 0x8009AA50 DATA_RECORD_UBYTE 255 I_1 0 255 /end CHARACTERISTIC
/begin CHARACTERISTIC FaultTCUCAP1_FETShortFailMod "FaultTCUCAP1_FETShortFailMod" VALUE 0x8009AC94 DATA_RECORD_UBYTE 255 I_1 0 255 /end CHARACTERISTIC
/begin CHARACTERISTIC FaultTCUCAP1_FETShortInc "FaultTCUCAP1_FETShortInc" VALUE 0x8009AB72 DATA_RECORD_UBYTE 255 I_1 0 255 /end CHARACTERISTIC
/begin CHARACTERISTIC FaultTCUCAP1_HWOverCurDec "FaultTCUCAP1_HWOverCurDec" VALUE 0x8009AA51 DATA_RECORD_UBYTE 255 I_1 0 255 /end CHARACTERISTIC
/begin CHARACTERISTIC FaultTCUCAP1_HWOverCurFailMod "FaultTCUCAP1_HWOverCurFailMod" VALUE 0x8009AC95 DATA_RECORD_UBYTE 255 I_1 0 255 /end CHARACTERISTIC
/begin CHARACTERISTIC FaultTCUCAP1_HWOverCurInc "FaultTCUCAP1_HWOverCurInc" VALUE 0x8009AB73 DATA_RECORD_UBYTE 255 I_1 0 255 /end CHARACTERISTIC
/begin CHARACTERISTIC FaultTCUCAP1_MotorPhaseDriveErrDec "FaultTCUCAP1_MotorPhaseDriveErrDec" VALUE 0x8009AA52 DATA_RECORD_UBYTE 255 I_1 0 255 /end CHARACTERISTIC
/begin CHARACTERISTIC FaultTCUCAP1_MotorPhaseDriveErrFailMod "FaultTCUCAP1_MotorPhaseDriveErrFailMod" VALUE 0x8009AC96 DATA_RECORD_UBYTE 255 I_1 0 255 /end CHARACTERISTIC
/begin CHARACTERISTIC FaultTCUCAP1_MotorPhaseDriveErrInc "FaultTCUCAP1_MotorPhaseDriveErrInc" VALUE 0x8009AB74 DATA_RECORD_UBYTE 255 I_1 0 255 /end CHARACTERISTIC
/begin CHARACTERISTIC FaultTCUCAP1_MotorStallDec "FaultTCUCAP1_MotorStallDec" VALUE 0x8009AA53 DATA_RECORD_UBYTE 255 I_1 0 255 /end CHARACTERISTIC
/begin CHARACTERISTIC FaultTCUCAP1_MotorStallFailMod "FaultTCUCAP1_MotorStallFailMod" VALUE 0x8009AC97 DATA_RECORD_UBYTE 255 I_1 0 255 /end CHARACTERISTIC
/begin CHARACTERISTIC FaultTCUCAP1_MotorStallInc "FaultTCUCAP1_MotorStallInc" VALUE 0x8009AB75 DATA_RECORD_UBYTE 255 I_1 0 255 /end CHARACTERISTIC
/begin CHARACTERISTIC FaultTCUCAP1_OverVoltageDec "FaultTCUCAP1_OverVoltageDec" VALUE 0x8009AA54 DATA_RECORD_UBYTE 255 I_1 0 255 /end CHARACTERISTIC
/begin CHARACTERISTIC FaultTCUCAP1_OverVoltageFailMod "FaultTCUCAP1_OverVoltageFailMod" VALUE 0x8009AC98 DATA_RECORD_UBYTE 255 I_1 0 255 /end CHARACTERISTIC
/begin CHARACTERISTIC FaultTCUCAP1_OverVoltageInc "FaultTCUCAP1_OverVoltageInc" VALUE 0x8009AB76 DATA_RECORD_UBYTE 255 I_1 0 255 /end CHARACTERISTIC
/begin CHARACTERISTIC FaultTCUCAP1_PhaseDetectGNDDec "FaultTCUCAP1_PhaseDetectGNDDec" VALUE 0x8009AA55 DATA_RECORD_UBYTE 255 I_1 0 255 /end CHARACTERISTIC
/begin CHARACTERISTIC FaultTCUCAP1_PhaseDetectGNDFailMod "FaultTCUCAP1_PhaseDetectGNDFailMod" VALUE 0x8009AC99 DATA_RECORD_UBYTE 255 I_1 0 255 /end CHARACTERISTIC
/begin CHARACTERISTIC FaultTCUCAP1_PhaseDetectGNDInc "FaultTCUCAP1_PhaseDetectGNDInc" VALUE 0x8009AB77 DATA_RECORD_UBYTE 255 I_1 0 255 /end CHARACTERISTIC
/begin CHARACTERISTIC FaultTCUCAP1_PhaseDetectVCCDec "FaultTCUCAP1_PhaseDetectVCCDec" VALUE 0x8009AA56 DATA_RECORD_UBYTE 255 I_1 0 255 /end CHARACTERISTIC
/begin CHARACTERISTIC FaultTCUCAP1_PhaseDetectVCCFailMod "FaultTCUCAP1_PhaseDetectVCCFailMod" VALUE 0x8009AC9A DATA_RECORD_UBYTE 255 I_1 0 255 /end CHARACTERISTIC
/begin CHARACTERISTIC FaultTCUCAP1_PhaseDetectVCCInc "FaultTCUCAP1_PhaseDetectVCCInc" VALUE 0x8009AB78 DATA_RECORD_UBYTE 255 I_1 0 255 /end CHARACTERISTIC
/begin CHARACTERISTIC FaultTCUCAP1_SWOverCurDec "FaultTCUCAP1_SWOverCurDec" VALUE 0x8009AA57 DATA_RECORD_UBYTE 255 I_1 0 255 /end CHARACTERISTIC
/begin CHARACTERISTIC FaultTCUCAP1_SWOverCurFailMod "FaultTCUCAP1_SWOverCurFailMod" VALUE 0x8009AC9B DATA_RECORD_UBYTE 255 I_1 0 255 /end CHARACTERISTIC
/begin CHARACTERISTIC FaultTCUCAP1_SWOverCurInc "FaultTCUCAP1_SWOverCurInc" VALUE 0x8009AB79 DATA_RECORD_UBYTE 255 I_1 0 255 /end CHARACTERISTIC
/begin CHARACTERISTIC FaultTCUCAP1_ThermalShutDownDec "FaultTCUCAP1_ThermalShutDownDec" VALUE 0x8009AA58 DATA_RECORD_UBYTE 255 I_1 0 255 /end CHARACTERISTIC
/begin CHARACTERISTIC FaultTCUCAP1_ThermalShutDownFailMod "FaultTCUCAP1_ThermalShutDownFailMod" VALUE 0x8009AC9C DATA_RECORD_UBYTE 255 I_1 0 255 /end CHARACTERISTIC
/begin CHARACTERISTIC FaultTCUCAP1_ThermalShutDownInc "FaultTCUCAP1_ThermalShutDownInc" VALUE 0x8009AB7A DATA_RECORD_UBYTE 255 I_1 0 255 /end CHARACTERISTIC
/begin CHARACTERISTIC FaultTCUCAP1_ThermalWarningDec "FaultTCUCAP1_ThermalWarningDec" VALUE 0x8009AA59 DATA_RECORD_UBYTE 255 I_1 0 255 /end CHARACTERISTIC
/begin CHARACTERISTIC FaultTCUCAP1_ThermalWarningFailMod "FaultTCUCAP1_ThermalWarningFailMod" VALUE 0x8009AC9D DATA_RECORD_UBYTE 255 I_1 0 255 /end CHARACTERISTIC
/begin CHARACTERISTIC FaultTCUCAP1_ThermalWarningInc "FaultTCUCAP1_ThermalWarningInc" VALUE 0x8009AB7B DATA_RECORD_UBYTE 255 I_1 0 255 /end CHARACTERISTIC
/begin CHARACTERISTIC FaultTCUCAP1_UnderVoltageDec "FaultTCUCAP1_UnderVoltageDec" VALUE 0x8009AA5A DATA_RECORD_UBYTE 255 I_1 0 255 /end CHARACTERISTIC
/begin CHARACTERISTIC FaultTCUCAP1_UnderVoltageFailMod "FaultTCUCAP1_UnderVoltageFailMod" VALUE 0x8009AC9E DATA_RECORD_UBYTE 255 I_1 0 255 /end CHARACTERISTIC
/begin CHARACTERISTIC FaultTCUCAP1_UnderVoltageInc "FaultTCUCAP1_UnderVoltageInc" VALUE 0x8009AB7C DATA_RECORD_UBYTE 255 I_1 0 255 /end CHARACTERISTIC
/begin CHARACTERISTIC FaultTCUCCP_OilMotorRationalDec "FaultTCUCCP_OilMotorRationalDec" VALUE 0x8009AA5B DATA_RECORD_UBYTE 255 I_1 0 255 /end CHARACTERISTIC
/begin CHARACTERISTIC FaultTCUCCP_OilMotorRationalFailMod "FaultTCUCCP_OilMotorRationalFailMod" VALUE 0x8009AC9F DATA_RECORD_UBYTE 255 I_1 0 255 /end CHARACTERISTIC
/begin CHARACTERISTIC FaultTCUCCP_OilMotorRationalInc "FaultTCUCCP_OilMotorRationalInc" VALUE 0x8009AB7D DATA_RECORD_UBYTE 255 I_1 0 255 /end CHARACTERISTIC
/begin CHARACTERISTIC FaultTCUCCP_OilMotorStallDec "FaultTCUCCP_OilMotorStallDec" VALUE 0x8009AA5C DATA_RECORD_UBYTE 255 I_1 0 255 /end CHARACTERISTIC
/begin CHARACTERISTIC FaultTCUCCP_OilMotorStallFailMod "FaultTCUCCP_OilMotorStallFailMod" VALUE 0x8009ACA0 DATA_RECORD_UBYTE 255 I_1 0 255 /end CHARACTERISTIC
/begin CHARACTERISTIC FaultTCUCCP_OilMotorStallInc "FaultTCUCCP_OilMotorStallInc" VALUE 0x8009AB7E DATA_RECORD_UBYTE 255 I_1 0 255 /end CHARACTERISTIC
/begin CHARACTERISTIC FaultTCUCCP_OilSenRationalL1Dec "FaultTCUCCP_OilSenRationalL1Dec" VALUE 0x8009AA5D DATA_RECORD_UBYTE 255 I_1 0 255 /end CHARACTERISTIC
/begin CHARACTERISTIC FaultTCUCCP_OilSenRationalL1FailMod "FaultTCUCCP_OilSenRationalL1FailMod" VALUE 0x8009ACA1 DATA_RECORD_UBYTE 255 I_1 0 255 /end CHARACTERISTIC
/begin CHARACTERISTIC FaultTCUCCP_OilSenRationalL1Inc "FaultTCUCCP_OilSenRationalL1Inc" VALUE 0x8009AB7F DATA_RECORD_UBYTE 255 I_1 0 255 /end CHARACTERISTIC
/begin CHARACTERISTIC FaultTCUCCP_OilSenRationalL2Dec "FaultTCUCCP_OilSenRationalL2Dec" VALUE 0x8009AA5E DATA_RECORD_UBYTE 255 I_1 0 255 /end CHARACTERISTIC
/begin CHARACTERISTIC FaultTCUCCP_OilSenRationalL2FailMod "FaultTCUCCP_OilSenRationalL2FailMod" VALUE 0x8009ACA2 DATA_RECORD_UBYTE 255 I_1 0 255 /end CHARACTERISTIC
/begin CHARACTERISTIC FaultTCUCCP_OilSenRationalL2Inc "FaultTCUCCP_OilSenRationalL2Inc" VALUE 0x8009AB80 DATA_RECORD_UBYTE 255 I_1 0 255 /end CHARACTERISTIC
/begin CHARACTERISTIC FaultTCUCCP_OilTempRationalHDec "FaultTCUCCP_OilTempRationalHDec" VALUE 0x8009AA5F DATA_RECORD_UBYTE 255 I_1 0 255 /end CHARACTERISTIC
/begin CHARACTERISTIC FaultTCUCCP_OilTempRationalHFailMod "FaultTCUCCP_OilTempRationalHFailMod" VALUE 0x8009ACA3 DATA_RECORD_UBYTE 255 I_1 0 255 /end CHARACTERISTIC
/begin CHARACTERISTIC FaultTCUCCP_OilTempRationalHInc "FaultTCUCCP_OilTempRationalHInc" VALUE 0x8009AB81 DATA_RECORD_UBYTE 255 I_1 0 255 /end CHARACTERISTIC
/begin CHARACTERISTIC FaultTCUCCP_OilTempRationalLDec "FaultTCUCCP_OilTempRationalLDec" VALUE 0x8009AA60 DATA_RECORD_UBYTE 255 I_1 0 255 /end CHARACTERISTIC
/begin CHARACTERISTIC FaultTCUCCP_OilTempRationalLFailMod "FaultTCUCCP_OilTempRationalLFailMod" VALUE 0x8009ACA4 DATA_RECORD_UBYTE 255 I_1 0 255 /end CHARACTERISTIC
/begin CHARACTERISTIC FaultTCUCCP_OilTempRationalLInc "FaultTCUCCP_OilTempRationalLInc" VALUE 0x8009AB82 DATA_RECORD_UBYTE 255 I_1 0 255 /end CHARACTERISTIC
/begin CHARACTERISTIC GCCU6_bAlimFreqChgEnaC "..." VALUE 0x8005803F DATA_RECORD_UBYTE 1 Bool_ON_OFF 0 1 BIT_MASK 0x01 /end CHARACTERISTIC
/begin CHARACTERISTIC GCCU6_bDualSmpEnaC "..." VALUE 0x8005803E DATA_RECORD_UBYTE 1 Bool_ON_OFF 0 1 BIT_MASK 0x01 /end CHARACTERISTIC
/begin CHARACTERISTIC GCCU6_bHwOvcFltDetEnaC "..." VALUE 0x8005803D DATA_RECORD_UBYTE 1 Bool_ON_OFF 0 1 BIT_MASK 0x01 /end CHARACTERISTIC
/begin CHARACTERISTIC GCCU6_bHwPinAscEnaC "..." VALUE 0x8005803C DATA_RECORD_UBYTE 1 Bool_ON_OFF 0 1 BIT_MASK 0x01 /end CHARACTERISTIC
/begin CHARACTERISTIC GCCU6_f32DrvClkDutyThdHighC "..." VALUE 0x80058038 DATA_RECORD_FLOAT32_IEEE 3.402823466E+038 F_1_p0_2 -3.402823466E+038 3.402823466E+038 /end CHARACTERISTIC
/begin CHARACTERISTIC GCCU6_f32DrvClkDutyThdLowC "..." VALUE 0x80058034 DATA_RECORD_FLOAT32_IEEE 3.402823466E+038 F_1_p0_2 -3.402823466E+038 3.402823466E+038 /end CHARACTERISTIC
/begin CHARACTERISTIC GCCU6_kbDrvBdClkEnaC "..." VALUE 0x80058024 DATA_RECORD_UBYTE 1 Bool_ON_OFF 0 1 BIT_MASK 0x01 /end CHARACTERISTIC
/begin CHARACTERISTIC GCCU6_kf32MidPointDutyHC "..." VALUE 0x80058030 DATA_RECORD_FLOAT32_IEEE 3.402823466E+038 F_1_p0_2 -3.402823466E+038 3.402823466E+038 /end CHARACTERISTIC
/begin CHARACTERISTIC GCCU6_kf32MidPointDutyLC "..." VALUE 0x8005802C DATA_RECORD_FLOAT32_IEEE 3.402823466E+038 F_1_p0_2 -3.402823466E+038 3.402823466E+038 /end CHARACTERISTIC
/begin CHARACTERISTIC GCCU6_ku16AlimDutyCycRawC "..." VALUE 0x80058096 DATA_RECORD_UWORD 65535 F_1_p0_2 0 65535 /end CHARACTERISTIC
/begin CHARACTERISTIC GCCU6_ku32AlimFreqRawC "..." VALUE 0x80058AE8 DATA_RECORD_ULONG 4294967295 F_1_p0_2 0 4294967295 /end CHARACTERISTIC
/begin CHARACTERISTIC GCCU6_ku8AscRecoverCntMaxC "..." VALUE 0x80058028 DATA_RECORD_UBYTE 255 F_1_p0_2 0 255 /end CHARACTERISTIC
/begin CHARACTERISTIC GCCU6_ku8PwmMidPointFaultC "..." VALUE 0x80058026 DATA_RECORD_UBYTE 255 F_1_p0_2 0 255 /end CHARACTERISTIC
/begin CHARACTERISTIC HARDPTG_s16AmplitudeC "HARDPTG_s16AmplitudeC" VALUE 0x800580A6 DATA_RECORD_SWORD 200 F_0v0030518044_p0_19 -100.0015259 99.9984741 /end CHARACTERISTIC
/begin CHARACTERISTIC HARDPTG_s16ContinuousRequestC "HARDPTG_s16ContinuousRequestC" VALUE 0x800580A4 DATA_RECORD_SWORD 100 F_0v0015259022_p0_20 -50.00076295 49.99923705 /end CHARACTERISTIC
/begin CHARACTERISTIC HARDPTG_s16OffsetC "HARDPTG_s16OffsetC" VALUE 0x800580A2 DATA_RECORD_SWORD 200 F_0v0030518044_p0_19 -100.0015259 99.9984741 /end CHARACTERISTIC
/begin CHARACTERISTIC HARDPTG_s16SlewRateC "HARDPTG_s16SlewRateC" VALUE 0x800580A0 DATA_RECORD_SWORD 200 F_0v0030518044_p0_19 -100.0015259 99.9984741 /end CHARACTERISTIC
/begin CHARACTERISTIC HARDPTG_u16PulseDutyCycleC "HARDPTG_u16PulseDutyCycleC" VALUE 0x80058098 DATA_RECORD_UWORD 99.9984741 D_2_0v01_p0_21 0.00152590219 100 /end CHARACTERISTIC
/begin CHARACTERISTIC HARDPTG_u32FrequenceC "Sous-multiple de la pï¿½riode SPI VSI" VALUE 0x80058AEC DATA_RECORD_ULONG 4294967295 F_1_p0_2 0 4294967295 /end CHARACTERISTIC
/begin CHARACTERISTIC HARD_bPtgEnablePhaseShiftingC "HARD_bPtgEnablePhaseShiftingC" VALUE 0x80058041 DATA_RECORD_UBYTE 1 Bool_ON_OFF 0 1 BIT_MASK 0x01 /end CHARACTERISTIC
/begin CHARACTERISTIC HARD_u16PtgUSignalShiftC "HARD_u16PtgUSignalShiftC" VALUE 0x8005809E DATA_RECORD_UWORD 1.999969482 F_0v0000305176_p0_23 0 1.999969482 /end CHARACTERISTIC
/begin CHARACTERISTIC HARD_u16PtgVSignalShiftC "HARD_u16PtgVSignalShiftC" VALUE 0x8005809C DATA_RECORD_UWORD 1.999969482 F_0v0000305176_p0_23 0 1.999969482 /end CHARACTERISTIC
/begin CHARACTERISTIC HARD_u16PtgWSignalShiftC "HARD_u16PtgWSignalShiftC" VALUE 0x8005809A DATA_RECORD_UWORD 1.999969482 F_0v0000305176_p0_23 0 1.999969482 /end CHARACTERISTIC
/begin MEASUREMENT Core1_PositionStartTime "..." ULONG I_1 1 2 0 4294967295 ECU_ADDRESS 0x7001FEF4 /end MEASUREMENT
/begin MEASUREMENT Core1_PositionStopTime "..." ULONG I_1 1 2 0 4294967295 ECU_ADDRESS 0x7001FEF0 /end MEASUREMENT
/begin MEASUREMENT Core1_PositionTotalTime "..." ULONG I_1 1 2 0 4294967295 ECU_ADDRESS 0x7001FEEC /end MEASUREMENT
/begin MEASUREMENT FAULT_FF_bFrameLock_FF1 "FAULT_FF_bFrameLock_FF1" UBYTE Bool_ON_OFF 1 2 0 1 BIT_MASK 0x01 ECU_ADDRESS 0x70013182 /end MEASUREMENT
/begin MEASUREMENT FF_FF1_Item_0x0D01 "FF_FF1_Item_0x0D01" UBYTE F_1_p0_2 1 2 0 255 ECU_ADDRESS 0x7001318D /end MEASUREMENT
/begin MEASUREMENT FF_FF1_Item_0x0D02 "FF_FF1_Item_0x0D02" UWORD F_1_p0_2 1 2 0 65535 ECU_ADDRESS 0x7001318E /end MEASUREMENT
/begin MEASUREMENT FF_FF1_Item_0x0D03 "FF_FF1_Item_0x0D03" UWORD F_1_p0_2 1 2 0 65535 ECU_ADDRESS 0x70013190 /end MEASUREMENT
/begin MEASUREMENT FF_FF1_Item_0x0D04 "FF_FF1_Item_0x0D04" UWORD F_1_p0_2 1 2 0 65535 ECU_ADDRESS 0x70013192 /end MEASUREMENT
/begin MEASUREMENT FF_FF1_Item_0x0D05 "FF_FF1_Item_0x0D05" UBYTE F_1_p0_2 1 2 0 255 ECU_ADDRESS 0x70013194 /end MEASUREMENT
/begin MEASUREMENT FF_FF1_Item_0x0D06 "FF_FF1_Item_0x0D06" UWORD F_1_p0_2 1 2 0 65535 ECU_ADDRESS 0x70013196 /end MEASUREMENT
/begin MEASUREMENT FF_FF1_Item_0x0D07 "FF_FF1_Item_0x0D07" UBYTE F_1_p0_2 1 2 0 255 ECU_ADDRESS 0x70013198 /end MEASUREMENT
/begin MEASUREMENT FF_FF1_Item_0x0D08 "FF_FF1_Item_0x0D08" UWORD F_1_p0_2 1 2 0 65535 ECU_ADDRESS 0x7001319A /end MEASUREMENT
/begin MEASUREMENT FF_FF1_Item_0x0D09 "FF_FF1_Item_0x0D09" UBYTE F_1_p0_2 1 2 0 255 ECU_ADDRESS 0x7001319C /end MEASUREMENT
/begin MEASUREMENT FF_FF1_Item_0x0D0A "FF_FF1_Item_0x0D0A" UBYTE F_1_p0_2 1 2 0 255 ECU_ADDRESS 0x7001319D /end MEASUREMENT
/begin MEASUREMENT FF_FF1_Item_0x0D0B "FF_FF1_Item_0x0D0B" UBYTE F_1_p0_2 1 2 0 255 ECU_ADDRESS 0x7001319E /end MEASUREMENT
/begin MEASUREMENT FF_FF1_Item_0x0D0C "FF_FF1_Item_0x0D0C" UWORD F_1_p0_2 1 2 0 65535 ECU_ADDRESS 0x700131A0 /end MEASUREMENT
/begin MEASUREMENT FF_FF1_Item_0x0D0C_1 "FF_FF1_Item_0x0D0C_1" UWORD F_1_p0_2 1 2 0 65535 ECU_ADDRESS 0x700131A2 /end MEASUREMENT
/begin MEASUREMENT FF_FF1_Item_0x0D0C_2 "FF_FF1_Item_0x0D0C_2" UWORD F_1_p0_2 1 2 0 65535 ECU_ADDRESS 0x700131A4 /end MEASUREMENT
/begin MEASUREMENT FF_FF1_Item_0x0D0D "FF_FF1_Item_0x0D0D" UWORD F_1_p0_2 1 2 0 65535 ECU_ADDRESS 0x700131A6 /end MEASUREMENT
/begin MEASUREMENT FF_FF1_Item_0x0D0E "FF_FF1_Item_0x0D0E" UWORD F_1_p0_2 1 2 0 65535 ECU_ADDRESS 0x700131A8 /end MEASUREMENT
/begin MEASUREMENT FF_FF1_Item_0x0D0F "FF_FF1_Item_0x0D0F" UWORD F_1_p0_2 1 2 0 65535 ECU_ADDRESS 0x700131AA /end MEASUREMENT
/begin MEASUREMENT FF_FF1_Item_0x0D13 "FF_FF1_Item_0x0D13" UWORD F_1_p0_2 1 2 0 65535 ECU_ADDRESS 0x700131AC /end MEASUREMENT
/begin MEASUREMENT FF_FF1_Item_0x0D14 "FF_FF1_Item_0x0D14" UWORD F_1_p0_2 1 2 0 65535 ECU_ADDRESS 0x700131AE /end MEASUREMENT
/begin MEASUREMENT FF_FF1_Item_0x0D15 "FF_FF1_Item_0x0D15" UWORD F_1_p0_2 1 2 0 65535 ECU_ADDRESS 0x700131B0 /end MEASUREMENT
/begin MEASUREMENT FF_FF1_Item_0x0D16 "FF_FF1_Item_0x0D16" UWORD F_1_p0_2 1 2 0 65535 ECU_ADDRESS 0x700131B2 /end MEASUREMENT
/begin MEASUREMENT FF_FF1_Item_0x0D17 "FF_FF1_Item_0x0D17" UWORD F_1_p0_2 1 2 0 65535 ECU_ADDRESS 0x700131B4 /end MEASUREMENT
/begin MEASUREMENT FF_FF1_Item_0x0D18 "FF_FF1_Item_0x0D18" UWORD F_1_p0_2 1 2 0 65535 ECU_ADDRESS 0x700131B6 /end MEASUREMENT
/begin MEASUREMENT FF_FF1_Item_0x0D19 "FF_FF1_Item_0x0D19" UWORD F_1_p0_2 1 2 0 65535 ECU_ADDRESS 0x700131B8 /end MEASUREMENT
/begin MEASUREMENT FF_FF1_Item_0x0D1A "FF_FF1_Item_0x0D1A" UWORD F_1_p0_2 1 2 0 65535 ECU_ADDRESS 0x700131BA /end MEASUREMENT
/begin MEASUREMENT FF_FF1_Item_0x0D1B "FF_FF1_Item_0x0D1B" UWORD F_1_p0_2 1 2 0 65535 ECU_ADDRESS 0x700131BC /end MEASUREMENT
/begin MEASUREMENT FF_FF1_Item_0x0D1C "FF_FF1_Item_0x0D1C" UWORD F_1_p0_2 1 2 0 65535 ECU_ADDRESS 0x700131BE /end MEASUREMENT
/begin MEASUREMENT FF_FF1_Item_0x0D1D "FF_FF1_Item_0x0D1D" UWORD F_1_p0_2 1 2 0 65535 ECU_ADDRESS 0x700131C0 /end MEASUREMENT
/begin MEASUREMENT FF_FF1_Item_0x0D1E "FF_FF1_Item_0x0D1E" UWORD F_1_p0_2 1 2 0 65535 ECU_ADDRESS 0x700131C2 /end MEASUREMENT
/begin MEASUREMENT FF_FF1_Item_0x0D1F "FF_FF1_Item_0x0D1F" UWORD F_1_p0_2 1 2 0 65535 ECU_ADDRESS 0x700131C4 /end MEASUREMENT
/begin MEASUREMENT FF_FF1_Item_0x0D20 "FF_FF1_Item_0x0D20" UWORD F_1_p0_2 1 2 0 65535 ECU_ADDRESS 0x700131C6 /end MEASUREMENT
/begin MEASUREMENT FF_FF1_Item_0x0D21 "FF_FF1_Item_0x0D21" UWORD F_1_p0_2 1 2 0 65535 ECU_ADDRESS 0x700131C8 /end MEASUREMENT
/begin MEASUREMENT FF_FF1_Item_0x0D22 "FF_FF1_Item_0x0D22" UWORD F_1_p0_2 1 2 0 65535 ECU_ADDRESS 0x700131CA /end MEASUREMENT
/begin MEASUREMENT FF_FF1_Item_0x0D23 "FF_FF1_Item_0x0D23" UWORD F_1_p0_2 1 2 0 65535 ECU_ADDRESS 0x700131CC /end MEASUREMENT
/begin MEASUREMENT FF_FF1_Item_0x0D24 "FF_FF1_Item_0x0D24" UWORD F_1_p0_2 1 2 0 65535 ECU_ADDRESS 0x700131CE /end MEASUREMENT
/begin MEASUREMENT FF_FF1_Item_0x0D25 "FF_FF1_Item_0x0D25" UWORD F_1_p0_2 1 2 0 65535 ECU_ADDRESS 0x700131D0 /end MEASUREMENT
/begin MEASUREMENT FF_FF1_Item_0x0D26 "FF_FF1_Item_0x0D26" UWORD F_1_p0_2 1 2 0 65535 ECU_ADDRESS 0x700131D2 /end MEASUREMENT
/begin MEASUREMENT FF_FF1_Item_0x0D27 "FF_FF1_Item_0x0D27" UWORD F_1_p0_2 1 2 0 65535 ECU_ADDRESS 0x700131D4 /end MEASUREMENT
/begin MEASUREMENT FF_FF1_Item_0x0D28 "FF_FF1_Item_0x0D28" UWORD F_1_p0_2 1 2 0 65535 ECU_ADDRESS 0x700131D6 /end MEASUREMENT
/begin MEASUREMENT FF_FF1_Item_0x0D29 "FF_FF1_Item_0x0D29" UWORD F_1_p0_2 1 2 0 65535 ECU_ADDRESS 0x700131D8 /end MEASUREMENT
/begin MEASUREMENT FF_FF1_Item_0x1D01 "FF_FF1_Item_0x1D01" UBYTE F_1_p0_2 1 2 0 255 ECU_ADDRESS 0x700131DA /end MEASUREMENT
/begin MEASUREMENT FF_FF1_Item_0x1D02 "FF_FF1_Item_0x1D02" UWORD F_1_p0_2 1 2 0 65535 ECU_ADDRESS 0x700131DC /end MEASUREMENT
/begin MEASUREMENT FF_FF1_Item_0x1D03 "FF_FF1_Item_0x1D03" UWORD F_1_p0_2 1 2 0 65535 ECU_ADDRESS 0x700131DE /end MEASUREMENT
/begin MEASUREMENT FF_FF1_Item_0x1D04 "FF_FF1_Item_0x1D04" UWORD F_1_p0_2 1 2 0 65535 ECU_ADDRESS 0x700131E0 /end MEASUREMENT
/begin MEASUREMENT FF_FF1_Item_0x1D05 "FF_FF1_Item_0x1D05" UBYTE F_1_p0_2 1 2 0 255 ECU_ADDRESS 0x700131E2 /end MEASUREMENT
/begin MEASUREMENT FF_FF1_Item_0x1D06 "FF_FF1_Item_0x1D06" UWORD F_1_p0_2 1 2 0 65535 ECU_ADDRESS 0x700131E4 /end MEASUREMENT
/begin MEASUREMENT FF_FF1_Item_0x1D07 "FF_FF1_Item_0x1D07" UBYTE F_1_p0_2 1 2 0 255 ECU_ADDRESS 0x700131E6 /end MEASUREMENT
/begin MEASUREMENT FF_FF1_Item_0x1D08 "FF_FF1_Item_0x1D08" UWORD F_1_p0_2 1 2 0 65535 ECU_ADDRESS 0x700131E8 /end MEASUREMENT
/begin MEASUREMENT FF_FF1_Item_0x1D09 "FF_FF1_Item_0x1D09" UBYTE F_1_p0_2 1 2 0 255 ECU_ADDRESS 0x700131EA /end MEASUREMENT
/begin MEASUREMENT FF_FF1_Item_0x1D0A "FF_FF1_Item_0x1D0A" UBYTE F_1_p0_2 1 2 0 255 ECU_ADDRESS 0x700131EB /end MEASUREMENT
/begin MEASUREMENT FF_FF1_Item_0x1D0B "FF_FF1_Item_0x1D0B" UBYTE F_1_p0_2 1 2 0 255 ECU_ADDRESS 0x700131EC /end MEASUREMENT
/begin MEASUREMENT FF_FF1_Item_0x1D0C "FF_FF1_Item_0x1D0C" UWORD F_1_p0_2 1 2 0 65535 ECU_ADDRESS 0x700131EE /end MEASUREMENT
/begin MEASUREMENT FF_FF1_Item_0x1D0C_1 "FF_FF1_Item_0x1D0C_1" UWORD F_1_p0_2 1 2 0 65535 ECU_ADDRESS 0x700131F0 /end MEASUREMENT
/begin MEASUREMENT FF_FF1_Item_0x1D0C_2 "FF_FF1_Item_0x1D0C_2" UWORD F_1_p0_2 1 2 0 65535 ECU_ADDRESS 0x700131F2 /end MEASUREMENT
/begin MEASUREMENT FF_FF1_Item_0x1D0D "FF_FF1_Item_0x1D0D" UWORD F_1_p0_2 1 2 0 65535 ECU_ADDRESS 0x700131F4 /end MEASUREMENT
/begin MEASUREMENT FF_FF1_Item_0x1D0E "FF_FF1_Item_0x1D0E" UWORD F_1_p0_2 1 2 0 65535 ECU_ADDRESS 0x700131F6 /end MEASUREMENT
/begin MEASUREMENT FF_FF1_Item_0x1D0F "FF_FF1_Item_0x1D0F" UWORD F_1_p0_2 1 2 0 65535 ECU_ADDRESS 0x700131F8 /end MEASUREMENT
/begin MEASUREMENT FF_FF1_Item_0x1D13 "FF_FF1_Item_0x1D13" UWORD F_1_p0_2 1 2 0 65535 ECU_ADDRESS 0x700131FA /end MEASUREMENT
/begin MEASUREMENT FF_FF1_Item_0x1D14 "FF_FF1_Item_0x1D14" UWORD F_1_p0_2 1 2 0 65535 ECU_ADDRESS 0x700131FC /end MEASUREMENT
/begin MEASUREMENT FF_FF1_Item_0x1D15 "FF_FF1_Item_0x1D15" UWORD F_1_p0_2 1 2 0 65535 ECU_ADDRESS 0x700131FE /end MEASUREMENT
/begin MEASUREMENT FF_FF1_Item_0x1D16 "FF_FF1_Item_0x1D16" UWORD F_1_p0_2 1 2 0 65535 ECU_ADDRESS 0x70013200 /end MEASUREMENT
/begin MEASUREMENT FF_FF1_Item_0x1D17 "FF_FF1_Item_0x1D17" UWORD F_1_p0_2 1 2 0 65535 ECU_ADDRESS 0x70013202 /end MEASUREMENT
/begin MEASUREMENT FF_FF1_Item_0x1D18 "FF_FF1_Item_0x1D18" UWORD F_1_p0_2 1 2 0 65535 ECU_ADDRESS 0x70013204 /end MEASUREMENT
/begin MEASUREMENT FF_FF1_Item_0x1D19 "FF_FF1_Item_0x1D19" UWORD F_1_p0_2 1 2 0 65535 ECU_ADDRESS 0x70013206 /end MEASUREMENT
/begin MEASUREMENT FF_FF1_Item_0x1D1A "FF_FF1_Item_0x1D1A" UWORD F_1_p0_2 1 2 0 65535 ECU_ADDRESS 0x70013208 /end MEASUREMENT
/begin MEASUREMENT FF_FF1_Item_0x1D1B "FF_FF1_Item_0x1D1B" UWORD F_1_p0_2 1 2 0 65535 ECU_ADDRESS 0x7001320A /end MEASUREMENT
/begin MEASUREMENT FF_FF1_Item_0x1D1C "FF_FF1_Item_0x1D1C" UWORD F_1_p0_2 1 2 0 65535 ECU_ADDRESS 0x7001320C /end MEASUREMENT
/begin MEASUREMENT FF_FF1_Item_0x1D1D "FF_FF1_Item_0x1D1D" UWORD F_1_p0_2 1 2 0 65535 ECU_ADDRESS 0x7001320E /end MEASUREMENT
/begin MEASUREMENT FF_FF1_Item_0x1D1E "FF_FF1_Item_0x1D1E" UWORD F_1_p0_2 1 2 0 65535 ECU_ADDRESS 0x70013210 /end MEASUREMENT
/begin MEASUREMENT FF_FF1_Item_0x1D1F "FF_FF1_Item_0x1D1F" UWORD F_1_p0_2 1 2 0 65535 ECU_ADDRESS 0x70013212 /end MEASUREMENT
/begin MEASUREMENT FF_FF1_Item_0x1D20 "FF_FF1_Item_0x1D20" UWORD F_1_p0_2 1 2 0 65535 ECU_ADDRESS 0x70013214 /end MEASUREMENT
/begin MEASUREMENT FF_FF1_Item_0x1D21 "FF_FF1_Item_0x1D21" UWORD F_1_p0_2 1 2 0 65535 ECU_ADDRESS 0x70013216 /end MEASUREMENT
/begin MEASUREMENT FF_FF1_Item_0x1D22 "FF_FF1_Item_0x1D22" UWORD F_1_p0_2 1 2 0 65535 ECU_ADDRESS 0x70013218 /end MEASUREMENT
/begin MEASUREMENT FF_FF1_Item_0x1D23 "FF_FF1_Item_0x1D23" UWORD F_1_p0_2 1 2 0 65535 ECU_ADDRESS 0x7001321A /end MEASUREMENT
/begin MEASUREMENT FF_FF1_Item_0x1D24 "FF_FF1_Item_0x1D24" UWORD F_1_p0_2 1 2 0 65535 ECU_ADDRESS 0x7001321C /end MEASUREMENT
/begin MEASUREMENT FF_FF1_Item_0x1D25 "FF_FF1_Item_0x1D25" UWORD F_1_p0_2 1 2 0 65535 ECU_ADDRESS 0x7001321E /end MEASUREMENT
/begin MEASUREMENT FF_FF1_Item_0x1D26 "FF_FF1_Item_0x1D26" UWORD F_1_p0_2 1 2 0 65535 ECU_ADDRESS 0x70013220 /end MEASUREMENT
/begin MEASUREMENT FF_FF1_Item_0x1D27 "FF_FF1_Item_0x1D27" UWORD F_1_p0_2 1 2 0 65535 ECU_ADDRESS 0x70013222 /end MEASUREMENT
/begin MEASUREMENT FF_FF1_Item_0x1D28 "FF_FF1_Item_0x1D28" UWORD F_1_p0_2 1 2 0 65535 ECU_ADDRESS 0x70013224 /end MEASUREMENT
/begin MEASUREMENT FF_FF1_Item_0x1D29 "FF_FF1_Item_0x1D29" UWORD F_1_p0_2 1 2 0 65535 ECU_ADDRESS 0x70013226 /end MEASUREMENT
/begin MEASUREMENT FF_FF1_Item_0x2D02 "FF_FF1_Item_0x2D02" UWORD F_1_p0_2 1 2 0 65535 ECU_ADDRESS 0x70013228 /end MEASUREMENT
/begin MEASUREMENT FF_FF1_Item_0x2D03 "FF_FF1_Item_0x2D03" UWORD F_1_p0_2 1 2 0 65535 ECU_ADDRESS 0x7001322A /end MEASUREMENT
/begin MEASUREMENT FF_FF1_Item_0x2D04 "FF_FF1_Item_0x2D04" UWORD F_1_p0_2 1 2 0 65535 ECU_ADDRESS 0x7001322C /end MEASUREMENT
/begin MEASUREMENT FF_FF1_Item_0x2D05 "FF_FF1_Item_0x2D05" UBYTE F_1_p0_2 1 2 0 255 ECU_ADDRESS 0x7001322E /end MEASUREMENT
/begin MEASUREMENT FF_FF1_Item_0x2D06 "FF_FF1_Item_0x2D06" UWORD F_1_p0_2 1 2 0 65535 ECU_ADDRESS 0x70013230 /end MEASUREMENT
/begin MEASUREMENT FF_FF1_Item_0x2D07 "FF_FF1_Item_0x2D07" UBYTE F_1_p0_2 1 2 0 255 ECU_ADDRESS 0x70013232 /end MEASUREMENT
/begin MEASUREMENT FF_FF1_Item_0x2D08 "FF_FF1_Item_0x2D08" UWORD F_1_p0_2 1 2 0 65535 ECU_ADDRESS 0x70013234 /end MEASUREMENT
/begin MEASUREMENT FF_FF1_Item_0x2D0E "FF_FF1_Item_0x2D0E" UWORD F_1_p0_2 1 2 0 65535 ECU_ADDRESS 0x70013236 /end MEASUREMENT
/begin MEASUREMENT FF_FF1_Item_0x2D13 "FF_FF1_Item_0x2D13" UWORD F_1_p0_2 1 2 0 65535 ECU_ADDRESS 0x70013238 /end MEASUREMENT
/begin MEASUREMENT FF_FF1_Item_0x2D14 "FF_FF1_Item_0x2D14" UWORD F_1_p0_2 1 2 0 65535 ECU_ADDRESS 0x7001323A /end MEASUREMENT
/begin MEASUREMENT FF_FF1_Item_0x2D15 "FF_FF1_Item_0x2D15" UWORD F_1_p0_2 1 2 0 65535 ECU_ADDRESS 0x7001323C /end MEASUREMENT
/begin MEASUREMENT FF_FF1_Item_0x2D1C "FF_FF1_Item_0x2D1C" UWORD F_1_p0_2 1 2 0 65535 ECU_ADDRESS 0x7001323E /end MEASUREMENT
/begin MEASUREMENT FF_FF1_Item_0x2D1D "FF_FF1_Item_0x2D1D" UWORD F_1_p0_2 1 2 0 65535 ECU_ADDRESS 0x70013240 /end MEASUREMENT
/begin MEASUREMENT FF_FF1_Item_0x2D1E "FF_FF1_Item_0x2D1E" UWORD F_1_p0_2 1 2 0 65535 ECU_ADDRESS 0x70013242 /end MEASUREMENT
/begin MEASUREMENT FF_FF1_Item_0x2D1F "FF_FF1_Item_0x2D1F" UWORD F_1_p0_2 1 2 0 65535 ECU_ADDRESS 0x70013244 /end MEASUREMENT
/begin MEASUREMENT FF_FF1_Item_0x2D20 "FF_FF1_Item_0x2D20" UWORD F_1_p0_2 1 2 0 65535 ECU_ADDRESS 0x70013246 /end MEASUREMENT
/begin MEASUREMENT FF_FF1_Item_0x2D21 "FF_FF1_Item_0x2D21" UWORD F_1_p0_2 1 2 0 65535 ECU_ADDRESS 0x70013248 /end MEASUREMENT
/begin MEASUREMENT FF_FF1_Item_0x2D22 "FF_FF1_Item_0x2D22" UWORD F_1_p0_2 1 2 0 65535 ECU_ADDRESS 0x7001324A /end MEASUREMENT
/begin MEASUREMENT FF_FF1_Item_0x2D25 "FF_FF1_Item_0x2D25" UWORD F_1_p0_2 1 2 0 65535 ECU_ADDRESS 0x7001324C /end MEASUREMENT
/begin MEASUREMENT FF_FF1_Item_0x2D26 "FF_FF1_Item_0x2D26" UWORD F_1_p0_2 1 2 0 65535 ECU_ADDRESS 0x7001324E /end MEASUREMENT
/begin MEASUREMENT FF_FF1_Item_0x3D02 "FF_FF1_Item_0x3D02" UWORD F_1_p0_2 1 2 0 65535 ECU_ADDRESS 0x70013250 /end MEASUREMENT
/begin MEASUREMENT FF_FF1_Item_0x3D03 "FF_FF1_Item_0x3D03" UWORD F_1_p0_2 1 2 0 65535 ECU_ADDRESS 0x70013252 /end MEASUREMENT
/begin MEASUREMENT FF_FF1_Item_0x3D04 "FF_FF1_Item_0x3D04" UWORD F_1_p0_2 1 2 0 65535 ECU_ADDRESS 0x70013254 /end MEASUREMENT
/begin MEASUREMENT FF_FF1_Item_0x3D05 "FF_FF1_Item_0x3D05" UBYTE F_1_p0_2 1 2 0 255 ECU_ADDRESS 0x70013256 /end MEASUREMENT
/begin MEASUREMENT FF_FF1_Item_0x3D06 "FF_FF1_Item_0x3D06" UWORD F_1_p0_2 1 2 0 65535 ECU_ADDRESS 0x70013258 /end MEASUREMENT
/begin MEASUREMENT FF_FF1_Item_0x3D07 "FF_FF1_Item_0x3D07" UBYTE F_1_p0_2 1 2 0 255 ECU_ADDRESS 0x7001325A /end MEASUREMENT
/begin MEASUREMENT FF_FF1_Item_0x3D08 "FF_FF1_Item_0x3D08" UWORD F_1_p0_2 1 2 0 65535 ECU_ADDRESS 0x7001325C /end MEASUREMENT
/begin MEASUREMENT FF_FF1_Item_0x3D0E "FF_FF1_Item_0x3D0E" UWORD F_1_p0_2 1 2 0 65535 ECU_ADDRESS 0x7001325E /end MEASUREMENT
/begin MEASUREMENT FF_FF1_Item_0x3D13 "FF_FF1_Item_0x3D13" UWORD F_1_p0_2 1 2 0 65535 ECU_ADDRESS 0x70013260 /end MEASUREMENT
/begin MEASUREMENT FF_FF1_Item_0x3D14 "FF_FF1_Item_0x3D14" UWORD F_1_p0_2 1 2 0 65535 ECU_ADDRESS 0x70013262 /end MEASUREMENT
/begin MEASUREMENT FF_FF1_Item_0x3D15 "FF_FF1_Item_0x3D15" UWORD F_1_p0_2 1 2 0 65535 ECU_ADDRESS 0x70013264 /end MEASUREMENT
/begin MEASUREMENT FF_FF1_Item_0x3D1C "FF_FF1_Item_0x3D1C" UWORD F_1_p0_2 1 2 0 65535 ECU_ADDRESS 0x70013266 /end MEASUREMENT
/begin MEASUREMENT FF_FF1_Item_0x3D1D "FF_FF1_Item_0x3D1D" UWORD F_1_p0_2 1 2 0 65535 ECU_ADDRESS 0x70013268 /end MEASUREMENT
/begin MEASUREMENT FF_FF1_Item_0x3D1E "FF_FF1_Item_0x3D1E" UWORD F_1_p0_2 1 2 0 65535 ECU_ADDRESS 0x7001326A /end MEASUREMENT
/begin MEASUREMENT FF_FF1_Item_0x3D1F "FF_FF1_Item_0x3D1F" UWORD F_1_p0_2 1 2 0 65535 ECU_ADDRESS 0x7001326C /end MEASUREMENT
/begin MEASUREMENT FF_FF1_Item_0x3D20 "FF_FF1_Item_0x3D20" UWORD F_1_p0_2 1 2 0 65535 ECU_ADDRESS 0x7001326E /end MEASUREMENT
/begin MEASUREMENT FF_FF1_Item_0x3D21 "FF_FF1_Item_0x3D21" UWORD F_1_p0_2 1 2 0 65535 ECU_ADDRESS 0x70013270 /end MEASUREMENT
/begin MEASUREMENT FF_FF1_Item_0x3D22 "FF_FF1_Item_0x3D22" UWORD F_1_p0_2 1 2 0 65535 ECU_ADDRESS 0x70013272 /end MEASUREMENT
/begin MEASUREMENT FF_FF1_Item_0x3D25 "FF_FF1_Item_0x3D25" UWORD F_1_p0_2 1 2 0 65535 ECU_ADDRESS 0x70013274 /end MEASUREMENT
/begin MEASUREMENT FF_FF1_Item_0x3D26 "FF_FF1_Item_0x3D26" UWORD F_1_p0_2 1 2 0 65535 ECU_ADDRESS 0x70013276 /end MEASUREMENT
/begin MEASUREMENT FF_FF1_Item_0x4D27 "FF_FF1_Item_0x4D27" UWORD F_1_p0_2 1 2 0 65535 ECU_ADDRESS 0x70013278 /end MEASUREMENT
/begin MEASUREMENT FF_FF1_Item_0x4D28 "FF_FF1_Item_0x4D28" UWORD F_1_p0_2 1 2 0 65535 ECU_ADDRESS 0x7001327A /end MEASUREMENT
/begin MEASUREMENT FF_FF1_Item_0x4D29 "FF_FF1_Item_0x4D29" UWORD F_1_p0_2 1 2 0 65535 ECU_ADDRESS 0x7001327C /end MEASUREMENT
/begin MEASUREMENT FF_FF1_Item_0x4D2A "FF_FF1_Item_0x4D2A" UWORD F_1_p0_2 1 2 0 65535 ECU_ADDRESS 0x7001327E /end MEASUREMENT
/begin MEASUREMENT FF_FF1_Item_0x4D2B "FF_FF1_Item_0x4D2B" UWORD F_1_p0_2 1 2 0 65535 ECU_ADDRESS 0x70013280 /end MEASUREMENT
/begin MEASUREMENT FF_FF1_Item_0x4D2C "FF_FF1_Item_0x4D2C" UWORD F_1_p0_2 1 2 0 65535 ECU_ADDRESS 0x70013282 /end MEASUREMENT
/begin MEASUREMENT FF_FF1_Item_0x4D2D "FF_FF1_Item_0x4D2D" UWORD F_1_p0_2 1 2 0 65535 ECU_ADDRESS 0x70013284 /end MEASUREMENT
/begin MEASUREMENT FF_FF1_Item_0x4D2E "FF_FF1_Item_0x4D2E" UWORD F_1_p0_2 1 2 0 65535 ECU_ADDRESS 0x70013286 /end MEASUREMENT
/begin MEASUREMENT FF_FF1_Item_0x4D2F "FF_FF1_Item_0x4D2F" UWORD F_1_p0_2 1 2 0 65535 ECU_ADDRESS 0x70013288 /end MEASUREMENT
/begin MEASUREMENT FF_FF1_Item_0x4D30 "FF_FF1_Item_0x4D30" UWORD F_1_p0_2 1 2 0 65535 ECU_ADDRESS 0x7001328A /end MEASUREMENT
/begin MEASUREMENT FF_FF1_Item_0x4D31 "FF_FF1_Item_0x4D31" UWORD F_1_p0_2 1 2 0 65535 ECU_ADDRESS 0x7001328C /end MEASUREMENT
/begin MEASUREMENT FF_FF1_Item_0x4D32 "FF_FF1_Item_0x4D32" UWORD F_1_p0_2 1 2 0 65535 ECU_ADDRESS 0x7001328E /end MEASUREMENT
/begin MEASUREMENT FF_FF1_Item_0x4D33 "FF_FF1_Item_0x4D33" UBYTE F_1_p0_2 1 2 0 255 ECU_ADDRESS 0x70013290 /end MEASUREMENT
/begin MEASUREMENT FF_FF1_Item_0x4D34 "FF_FF1_Item_0x4D34" UWORD F_1_p0_2 1 2 0 65535 ECU_ADDRESS 0x70013292 /end MEASUREMENT
/begin MEASUREMENT FF_FF1_Item_0x4D35 "FF_FF1_Item_0x4D35" UBYTE F_1_p0_2 1 2 0 255 ECU_ADDRESS 0x70013294 /end MEASUREMENT
/begin MEASUREMENT FF_FF1_Item_0x4D36 "FF_FF1_Item_0x4D36" UWORD F_1_p0_2 1 2 0 65535 ECU_ADDRESS 0x70013296 /end MEASUREMENT
/begin MEASUREMENT FF_FF1_Item_0x4D37 "FF_FF1_Item_0x4D37" UBYTE F_1_p0_2 1 2 0 255 ECU_ADDRESS 0x70013298 /end MEASUREMENT
/begin MEASUREMENT FF_FF1_Item_0x4D38 "FF_FF1_Item_0x4D38" UWORD F_1_p0_2 1 2 0 65535 ECU_ADDRESS 0x7001329A /end MEASUREMENT
/begin MEASUREMENT FF_FF1_Item_0x4D39 "FF_FF1_Item_0x4D39" UBYTE F_1_p0_2 1 2 0 255 ECU_ADDRESS 0x7001329C /end MEASUREMENT
/begin MEASUREMENT FF_FF1_Item_0x4D3A "FF_FF1_Item_0x4D3A" UWORD F_1_p0_2 1 2 0 65535 ECU_ADDRESS 0x7001329E /end MEASUREMENT
/begin MEASUREMENT FF_FF1_Item_0x4D3B "FF_FF1_Item_0x4D3B" UBYTE F_1_p0_2 1 2 0 255 ECU_ADDRESS 0x700132A0 /end MEASUREMENT
/begin MEASUREMENT FF_FF1_Item_0x4D3C "FF_FF1_Item_0x4D3C" UWORD F_1_p0_2 1 2 0 65535 ECU_ADDRESS 0x700132A2 /end MEASUREMENT
/begin MEASUREMENT FF_FF1_Item_0x4D3D "FF_FF1_Item_0x4D3D" UBYTE F_1_p0_2 1 2 0 255 ECU_ADDRESS 0x700132A4 /end MEASUREMENT
/begin MEASUREMENT FF_FF1_Item_0xDF20 "FF_FF1_Item_0xDF20" UWORD F_1_p0_2 1 2 0 65535 ECU_ADDRESS 0x70013184 /end MEASUREMENT
/begin MEASUREMENT FF_FF1_Item_0xDF21 "FF_FF1_Item_0xDF21" UWORD F_1_p0_2 1 2 0 65535 ECU_ADDRESS 0x70013186 /end MEASUREMENT
/begin MEASUREMENT FF_FF1_Item_0xDF23 "FF_FF1_Item_0xDF23" UWORD F_1_p0_2 1 2 0 65535 ECU_ADDRESS 0x70013188 /end MEASUREMENT
/begin MEASUREMENT FF_FF1_Item_0xDF29 "FF_FF1_Item_0xDF29" UBYTE F_1_p0_2 1 2 0 255 ECU_ADDRESS 0x7001318A /end MEASUREMENT
/begin MEASUREMENT FF_FF1_Item_0xDF2A "FF_FF1_Item_0xDF2A" UBYTE F_1_p0_2 1 2 0 255 ECU_ADDRESS 0x7001318B /end MEASUREMENT
/begin MEASUREMENT FF_FF1_Item_0xDF2C "FF_FF1_Item_0xDF2C" UBYTE F_1_p0_2 1 2 0 255 ECU_ADDRESS 0x7001318C /end MEASUREMENT
/begin MEASUREMENT FaultTCUCAP0_CAPPressureHAut "FaultTCUCAP0_CAPPressureHAut" UBYTE Bool_ON_OFF 1 2 0 1 BIT_MASK 0x01 ECU_ADDRESS 0x70012E80 /end MEASUREMENT
/begin MEASUREMENT FaultTCUCAP0_CAPPressureHDetected "FaultTCUCAP0_CAPPressureHDetected" UBYTE Bool_ON_OFF 1 2 0 1 BIT_MASK 0x01 ECU_ADDRESS 0x70012FE4 /end MEASUREMENT
/begin MEASUREMENT FaultTCUCAP0_CAPPressureHLogged "FaultTCUCAP0_CAPPressureHLogged" UBYTE Bool_ON_OFF 1 2 0 1 BIT_MASK 0x01 ECU_ADDRESS 0x70012F32 /end MEASUREMENT
/begin MEASUREMENT FaultTCUCAP0_CAPPressureLAut "FaultTCUCAP0_CAPPressureLAut" UBYTE Bool_ON_OFF 1 2 0 1 BIT_MASK 0x02 ECU_ADDRESS 0x70012E80 /end MEASUREMENT
/begin MEASUREMENT FaultTCUCAP0_CAPPressureLDetected "FaultTCUCAP0_CAPPressureLDetected" UBYTE Bool_ON_OFF 1 2 0 1 BIT_MASK 0x02 ECU_ADDRESS 0x70012FE4 /end MEASUREMENT
/begin MEASUREMENT FaultTCUCAP0_CAPPressureLLogged "FaultTCUCAP0_CAPPressureLLogged" UBYTE Bool_ON_OFF 1 2 0 1 BIT_MASK 0x02 ECU_ADDRESS 0x70012F32 /end MEASUREMENT
/begin MEASUREMENT FaultTCUCAP0_CAPPressureOverHAut "FaultTCUCAP0_CAPPressureOverHAut" UBYTE Bool_ON_OFF 1 2 0 1 BIT_MASK 0x04 ECU_ADDRESS 0x70012E80 /end MEASUREMENT
/begin MEASUREMENT FaultTCUCAP0_CAPPressureOverHDetected "FaultTCUCAP0_CAPPressureOverHDetected" UBYTE Bool_ON_OFF 1 2 0 1 BIT_MASK 0x04 ECU_ADDRESS 0x70012FE4 /end MEASUREMENT
/begin MEASUREMENT FaultTCUCAP0_CAPPressureOverHLogged "FaultTCUCAP0_CAPPressureOverHLogged" UBYTE Bool_ON_OFF 1 2 0 1 BIT_MASK 0x04 ECU_ADDRESS 0x70012F32 /end MEASUREMENT
/begin MEASUREMENT FaultTCUCAP0_CAPSlipAut "FaultTCUCAP0_CAPSlipAut" UBYTE Bool_ON_OFF 1 2 0 1 BIT_MASK 0x08 ECU_ADDRESS 0x70012E80 /end MEASUREMENT
/begin MEASUREMENT FaultTCUCAP0_CAPSlipDetected "FaultTCUCAP0_CAPSlipDetected" UBYTE Bool_ON_OFF 1 2 0 1 BIT_MASK 0x08 ECU_ADDRESS 0x70012FE4 /end MEASUREMENT
/begin MEASUREMENT FaultTCUCAP0_CAPSlipLogged "FaultTCUCAP0_CAPSlipLogged" UBYTE Bool_ON_OFF 1 2 0 1 BIT_MASK 0x08 ECU_ADDRESS 0x70012F32 /end MEASUREMENT
/begin MEASUREMENT FaultTCUCAP0_Detected "FaultTCUCAP0_Detected" UWORD I_1 1 2 0 65535 ECU_ADDRESS 0x70012FE4 /end MEASUREMENT
/begin MEASUREMENT FaultTCUCAP0_DragMomentHAut "FaultTCUCAP0_DragMomentHAut" UBYTE Bool_ON_OFF 1 2 0 1 BIT_MASK 0x10 ECU_ADDRESS 0x70012E80 /end MEASUREMENT
/begin MEASUREMENT FaultTCUCAP0_DragMomentHDetected "FaultTCUCAP0_DragMomentHDetected" UBYTE Bool_ON_OFF 1 2 0 1 BIT_MASK 0x10 ECU_ADDRESS 0x70012FE4 /end MEASUREMENT
/begin MEASUREMENT FaultTCUCAP0_DragMomentHLogged "FaultTCUCAP0_DragMomentHLogged" UBYTE Bool_ON_OFF 1 2 0 1 BIT_MASK 0x10 ECU_ADDRESS 0x70012F32 /end MEASUREMENT
/begin MEASUREMENT FaultTCUCAP0_HLSinInvalidAut "FaultTCUCAP0_HLSinInvalidAut" UBYTE Bool_ON_OFF 1 2 0 1 BIT_MASK 0x20 ECU_ADDRESS 0x70012E80 /end MEASUREMENT
/begin MEASUREMENT FaultTCUCAP0_HLSinInvalidDetected "FaultTCUCAP0_HLSinInvalidDetected" UBYTE Bool_ON_OFF 1 2 0 1 BIT_MASK 0x20 ECU_ADDRESS 0x70012FE4 /end MEASUREMENT
/begin MEASUREMENT FaultTCUCAP0_HLSinInvalidLogged "FaultTCUCAP0_HLSinInvalidLogged" UBYTE Bool_ON_OFF 1 2 0 1 BIT_MASK 0x20 ECU_ADDRESS 0x70012F32 /end MEASUREMENT
/begin MEASUREMENT FaultTCUCAP0_HLSinUndefineAut "FaultTCUCAP0_HLSinUndefineAut" UBYTE Bool_ON_OFF 1 2 0 1 BIT_MASK 0x40 ECU_ADDRESS 0x70012E80 /end MEASUREMENT
/begin MEASUREMENT FaultTCUCAP0_HLSinUndefineDetected "FaultTCUCAP0_HLSinUndefineDetected" UBYTE Bool_ON_OFF 1 2 0 1 BIT_MASK 0x40 ECU_ADDRESS 0x70012FE4 /end MEASUREMENT
/begin MEASUREMENT FaultTCUCAP0_HLSinUndefineLogged "FaultTCUCAP0_HLSinUndefineLogged" UBYTE Bool_ON_OFF 1 2 0 1 BIT_MASK 0x40 ECU_ADDRESS 0x70012F32 /end MEASUREMENT
/begin MEASUREMENT FaultTCUCAP0_HLSupplyHAut "FaultTCUCAP0_HLSupplyHAut" UBYTE Bool_ON_OFF 1 2 0 1 BIT_MASK 0x80 ECU_ADDRESS 0x70012E80 /end MEASUREMENT
/begin MEASUREMENT FaultTCUCAP0_HLSupplyHDetected "FaultTCUCAP0_HLSupplyHDetected" UBYTE Bool_ON_OFF 1 2 0 1 BIT_MASK 0x80 ECU_ADDRESS 0x70012FE4 /end MEASUREMENT
/begin MEASUREMENT FaultTCUCAP0_HLSupplyHLogged "FaultTCUCAP0_HLSupplyHLogged" UBYTE Bool_ON_OFF 1 2 0 1 BIT_MASK 0x80 ECU_ADDRESS 0x70012F32 /end MEASUREMENT
/begin MEASUREMENT FaultTCUCAP0_HLSupplyLAut "FaultTCUCAP0_HLSupplyLAut" UBYTE Bool_ON_OFF 1 2 0 1 BIT_MASK 0x01 ECU_ADDRESS 0x70012E81 /end MEASUREMENT
/begin MEASUREMENT FaultTCUCAP0_HLSupplyLDetected "FaultTCUCAP0_HLSupplyLDetected" UBYTE Bool_ON_OFF 1 2 0 1 BIT_MASK 0x01 ECU_ADDRESS 0x70012FE5 /end MEASUREMENT
/begin MEASUREMENT FaultTCUCAP0_HLSupplyLLogged "FaultTCUCAP0_HLSupplyLLogged" UBYTE Bool_ON_OFF 1 2 0 1 BIT_MASK 0x01 ECU_ADDRESS 0x70012F33 /end MEASUREMENT
/begin MEASUREMENT FaultTCUCAP0_Logged "FaultTCUCAP0_Logged" UWORD I_1 1 2 0 65535 ECU_ADDRESS 0x70012F32 /end MEASUREMENT
/begin MEASUREMENT FaultTCUCAP0_MotorPhaseVolHAut "FaultTCUCAP0_MotorPhaseVolHAut" UBYTE Bool_ON_OFF 1 2 0 1 BIT_MASK 0x02 ECU_ADDRESS 0x70012E81 /end MEASUREMENT
/begin MEASUREMENT FaultTCUCAP0_MotorPhaseVolHDetected "FaultTCUCAP0_MotorPhaseVolHDetected" UBYTE Bool_ON_OFF 1 2 0 1 BIT_MASK 0x02 ECU_ADDRESS 0x70012FE5 /end MEASUREMENT
/begin MEASUREMENT FaultTCUCAP0_MotorPhaseVolHLogged "FaultTCUCAP0_MotorPhaseVolHLogged" UBYTE Bool_ON_OFF 1 2 0 1 BIT_MASK 0x02 ECU_ADDRESS 0x70012F33 /end MEASUREMENT
/begin MEASUREMENT FaultTCUCAP0_PressureRationalAut "FaultTCUCAP0_PressureRationalAut" UBYTE Bool_ON_OFF 1 2 0 1 BIT_MASK 0x04 ECU_ADDRESS 0x70012E81 /end MEASUREMENT
/begin MEASUREMENT FaultTCUCAP0_PressureRationalDetected "FaultTCUCAP0_PressureRationalDetected" UBYTE Bool_ON_OFF 1 2 0 1 BIT_MASK 0x04 ECU_ADDRESS 0x70012FE5 /end MEASUREMENT
/begin MEASUREMENT FaultTCUCAP0_PressureRationalLogged "FaultTCUCAP0_PressureRationalLogged" UBYTE Bool_ON_OFF 1 2 0 1 BIT_MASK 0x04 ECU_ADDRESS 0x70012F33 /end MEASUREMENT
/begin MEASUREMENT FaultTCUCAP0_SenSigOpenOrGNDAut "FaultTCUCAP0_SenSigOpenOrGNDAut" UBYTE Bool_ON_OFF 1 2 0 1 BIT_MASK 0x08 ECU_ADDRESS 0x70012E81 /end MEASUREMENT
/begin MEASUREMENT FaultTCUCAP0_SenSigOpenOrGNDDetected "FaultTCUCAP0_SenSigOpenOrGNDDetected" UBYTE Bool_ON_OFF 1 2 0 1 BIT_MASK 0x08 ECU_ADDRESS 0x70012FE5 /end MEASUREMENT
/begin MEASUREMENT FaultTCUCAP0_SenSigOpenOrGNDLogged "FaultTCUCAP0_SenSigOpenOrGNDLogged" UBYTE Bool_ON_OFF 1 2 0 1 BIT_MASK 0x08 ECU_ADDRESS 0x70012F33 /end MEASUREMENT
/begin MEASUREMENT FaultTCUCAP0_SenSigVCCAut "FaultTCUCAP0_SenSigVCCAut" UBYTE Bool_ON_OFF 1 2 0 1 BIT_MASK 0x10 ECU_ADDRESS 0x70012E81 /end MEASUREMENT
/begin MEASUREMENT FaultTCUCAP0_SenSigVCCDetected "FaultTCUCAP0_SenSigVCCDetected" UBYTE Bool_ON_OFF 1 2 0 1 BIT_MASK 0x10 ECU_ADDRESS 0x70012FE5 /end MEASUREMENT
/begin MEASUREMENT FaultTCUCAP0_SenSigVCCLogged "FaultTCUCAP0_SenSigVCCLogged" UBYTE Bool_ON_OFF 1 2 0 1 BIT_MASK 0x10 ECU_ADDRESS 0x70012F33 /end MEASUREMENT
/begin MEASUREMENT FaultTCUCAP0_SensorPerforErrAut "FaultTCUCAP0_SensorPerforErrAut" UBYTE Bool_ON_OFF 1 2 0 1 BIT_MASK 0x20 ECU_ADDRESS 0x70012E81 /end MEASUREMENT
/begin MEASUREMENT FaultTCUCAP0_SensorPerforErrDetected "FaultTCUCAP0_SensorPerforErrDetected" UBYTE Bool_ON_OFF 1 2 0 1 BIT_MASK 0x20 ECU_ADDRESS 0x70012FE5 /end MEASUREMENT
/begin MEASUREMENT FaultTCUCAP0_SensorPerforErrLogged "FaultTCUCAP0_SensorPerforErrLogged" UBYTE Bool_ON_OFF 1 2 0 1 BIT_MASK 0x20 ECU_ADDRESS 0x70012F33 /end MEASUREMENT
/begin MEASUREMENT FaultTCUCAP1_COM_GCUAut "FaultTCUCAP1_COM_GCUAut" UBYTE Bool_ON_OFF 1 2 0 1 BIT_MASK 0x01 ECU_ADDRESS 0x70012E82 /end MEASUREMENT
/begin MEASUREMENT FaultTCUCAP1_COM_GCUDetected "FaultTCUCAP1_COM_GCUDetected" UBYTE Bool_ON_OFF 1 2 0 1 BIT_MASK 0x01 ECU_ADDRESS 0x70012FE6 /end MEASUREMENT
/begin MEASUREMENT FaultTCUCAP1_COM_GCULogged "FaultTCUCAP1_COM_GCULogged" UBYTE Bool_ON_OFF 1 2 0 1 BIT_MASK 0x01 ECU_ADDRESS 0x70012F34 /end MEASUREMENT
/begin MEASUREMENT FaultTCUCAP1_Detected "FaultTCUCAP1_Detected" UWORD I_1 1 2 0 65535 ECU_ADDRESS 0x70012FE6 /end MEASUREMENT
/begin MEASUREMENT FaultTCUCAP1_DriverTempHAut "FaultTCUCAP1_DriverTempHAut" UBYTE Bool_ON_OFF 1 2 0 1 BIT_MASK 0x02 ECU_ADDRESS 0x70012E82 /end MEASUREMENT
/begin MEASUREMENT FaultTCUCAP1_DriverTempHDetected "FaultTCUCAP1_DriverTempHDetected" UBYTE Bool_ON_OFF 1 2 0 1 BIT_MASK 0x02 ECU_ADDRESS 0x70012FE6 /end MEASUREMENT
/begin MEASUREMENT FaultTCUCAP1_DriverTempHLogged "FaultTCUCAP1_DriverTempHLogged" UBYTE Bool_ON_OFF 1 2 0 1 BIT_MASK 0x02 ECU_ADDRESS 0x70012F34 /end MEASUREMENT
/begin MEASUREMENT FaultTCUCAP1_FETShortAut "FaultTCUCAP1_FETShortAut" UBYTE Bool_ON_OFF 1 2 0 1 BIT_MASK 0x04 ECU_ADDRESS 0x70012E82 /end MEASUREMENT
/begin MEASUREMENT FaultTCUCAP1_FETShortDetected "FaultTCUCAP1_FETShortDetected" UBYTE Bool_ON_OFF 1 2 0 1 BIT_MASK 0x04 ECU_ADDRESS 0x70012FE6 /end MEASUREMENT
/begin MEASUREMENT FaultTCUCAP1_FETShortLogged "FaultTCUCAP1_FETShortLogged" UBYTE Bool_ON_OFF 1 2 0 1 BIT_MASK 0x04 ECU_ADDRESS 0x70012F34 /end MEASUREMENT
/begin MEASUREMENT FaultTCUCAP1_HWOverCurAut "FaultTCUCAP1_HWOverCurAut" UBYTE Bool_ON_OFF 1 2 0 1 BIT_MASK 0x08 ECU_ADDRESS 0x70012E82 /end MEASUREMENT
/begin MEASUREMENT FaultTCUCAP1_HWOverCurDetected "FaultTCUCAP1_HWOverCurDetected" UBYTE Bool_ON_OFF 1 2 0 1 BIT_MASK 0x08 ECU_ADDRESS 0x70012FE6 /end MEASUREMENT
/begin MEASUREMENT FaultTCUCAP1_HWOverCurLogged "FaultTCUCAP1_HWOverCurLogged" UBYTE Bool_ON_OFF 1 2 0 1 BIT_MASK 0x08 ECU_ADDRESS 0x70012F34 /end MEASUREMENT
/begin MEASUREMENT FaultTCUCAP1_Logged "FaultTCUCAP1_Logged" UWORD I_1 1 2 0 65535 ECU_ADDRESS 0x70012F34 /end MEASUREMENT
/begin MEASUREMENT FaultTCUCAP1_MotorPhaseDriveErrAut "FaultTCUCAP1_MotorPhaseDriveErrAut" UBYTE Bool_ON_OFF 1 2 0 1 BIT_MASK 0x10 ECU_ADDRESS 0x70012E82 /end MEASUREMENT
/begin MEASUREMENT FaultTCUCAP1_MotorPhaseDriveErrDetected "FaultTCUCAP1_MotorPhaseDriveErrDetected" UBYTE Bool_ON_OFF 1 2 0 1 BIT_MASK 0x10 ECU_ADDRESS 0x70012FE6 /end MEASUREMENT
/begin MEASUREMENT FaultTCUCAP1_MotorPhaseDriveErrLogged "FaultTCUCAP1_MotorPhaseDriveErrLogged" UBYTE Bool_ON_OFF 1 2 0 1 BIT_MASK 0x10 ECU_ADDRESS 0x70012F34 /end MEASUREMENT
/begin MEASUREMENT FaultTCUCAP1_MotorStallAut "FaultTCUCAP1_MotorStallAut" UBYTE Bool_ON_OFF 1 2 0 1 BIT_MASK 0x20 ECU_ADDRESS 0x70012E82 /end MEASUREMENT
/begin MEASUREMENT FaultTCUCAP1_MotorStallDetected "FaultTCUCAP1_MotorStallDetected" UBYTE Bool_ON_OFF 1 2 0 1 BIT_MASK 0x20 ECU_ADDRESS 0x70012FE6 /end MEASUREMENT
/begin MEASUREMENT FaultTCUCAP1_MotorStallLogged "FaultTCUCAP1_MotorStallLogged" UBYTE Bool_ON_OFF 1 2 0 1 BIT_MASK 0x20 ECU_ADDRESS 0x70012F34 /end MEASUREMENT
/begin MEASUREMENT FaultTCUCAP1_OverVoltageAut "FaultTCUCAP1_OverVoltageAut" UBYTE Bool_ON_OFF 1 2 0 1 BIT_MASK 0x40 ECU_ADDRESS 0x70012E82 /end MEASUREMENT
/begin MEASUREMENT FaultTCUCAP1_OverVoltageDetected "FaultTCUCAP1_OverVoltageDetected" UBYTE Bool_ON_OFF 1 2 0 1 BIT_MASK 0x40 ECU_ADDRESS 0x70012FE6 /end MEASUREMENT
/begin MEASUREMENT FaultTCUCAP1_OverVoltageLogged "FaultTCUCAP1_OverVoltageLogged" UBYTE Bool_ON_OFF 1 2 0 1 BIT_MASK 0x40 ECU_ADDRESS 0x70012F34 /end MEASUREMENT
/begin MEASUREMENT FaultTCUCAP1_PhaseDetectGNDAut "FaultTCUCAP1_PhaseDetectGNDAut" UBYTE Bool_ON_OFF 1 2 0 1 BIT_MASK 0x80 ECU_ADDRESS 0x70012E82 /end MEASUREMENT
/begin MEASUREMENT FaultTCUCAP1_PhaseDetectGNDDetected "FaultTCUCAP1_PhaseDetectGNDDetected" UBYTE Bool_ON_OFF 1 2 0 1 BIT_MASK 0x80 ECU_ADDRESS 0x70012FE6 /end MEASUREMENT
/begin MEASUREMENT FaultTCUCAP1_PhaseDetectGNDLogged "FaultTCUCAP1_PhaseDetectGNDLogged" UBYTE Bool_ON_OFF 1 2 0 1 BIT_MASK 0x80 ECU_ADDRESS 0x70012F34 /end MEASUREMENT
/begin MEASUREMENT FaultTCUCAP1_PhaseDetectVCCAut "FaultTCUCAP1_PhaseDetectVCCAut" UBYTE Bool_ON_OFF 1 2 0 1 BIT_MASK 0x01 ECU_ADDRESS 0x70012E83 /end MEASUREMENT
/begin MEASUREMENT FaultTCUCAP1_PhaseDetectVCCDetected "FaultTCUCAP1_PhaseDetectVCCDetected" UBYTE Bool_ON_OFF 1 2 0 1 BIT_MASK 0x01 ECU_ADDRESS 0x70012FE7 /end MEASUREMENT
/begin MEASUREMENT FaultTCUCAP1_PhaseDetectVCCLogged "FaultTCUCAP1_PhaseDetectVCCLogged" UBYTE Bool_ON_OFF 1 2 0 1 BIT_MASK 0x01 ECU_ADDRESS 0x70012F35 /end MEASUREMENT
/begin MEASUREMENT FaultTCUCAP1_SWOverCurAut "FaultTCUCAP1_SWOverCurAut" UBYTE Bool_ON_OFF 1 2 0 1 BIT_MASK 0x02 ECU_ADDRESS 0x70012E83 /end MEASUREMENT
/begin MEASUREMENT FaultTCUCAP1_SWOverCurDetected "FaultTCUCAP1_SWOverCurDetected" UBYTE Bool_ON_OFF 1 2 0 1 BIT_MASK 0x02 ECU_ADDRESS 0x70012FE7 /end MEASUREMENT
/begin MEASUREMENT FaultTCUCAP1_SWOverCurLogged "FaultTCUCAP1_SWOverCurLogged" UBYTE Bool_ON_OFF 1 2 0 1 BIT_MASK 0x02 ECU_ADDRESS 0x70012F35 /end MEASUREMENT
/begin MEASUREMENT FaultTCUCAP1_ThermalShutDownAut "FaultTCUCAP1_ThermalShutDownAut" UBYTE Bool_ON_OFF 1 2 0 1 BIT_MASK 0x04 ECU_ADDRESS 0x70012E83 /end MEASUREMENT
/begin MEASUREMENT FaultTCUCAP1_ThermalShutDownDetected "FaultTCUCAP1_ThermalShutDownDetected" UBYTE Bool_ON_OFF 1 2 0 1 BIT_MASK 0x04 ECU_ADDRESS 0x70012FE7 /end MEASUREMENT
/begin MEASUREMENT FaultTCUCAP1_ThermalShutDownLogged "FaultTCUCAP1_ThermalShutDownLogged" UBYTE Bool_ON_OFF 1 2 0 1 BIT_MASK 0x04 ECU_ADDRESS 0x70012F35 /end MEASUREMENT
/begin MEASUREMENT FaultTCUCAP1_ThermalWarningAut "FaultTCUCAP1_ThermalWarningAut" UBYTE Bool_ON_OFF 1 2 0 1 BIT_MASK 0x08 ECU_ADDRESS 0x70012E83 /end MEASUREMENT
/begin MEASUREMENT FaultTCUCAP1_ThermalWarningDetected "FaultTCUCAP1_ThermalWarningDetected" UBYTE Bool_ON_OFF 1 2 0 1 BIT_MASK 0x08 ECU_ADDRESS 0x70012FE7 /end MEASUREMENT
/begin MEASUREMENT FaultTCUCAP1_ThermalWarningLogged "FaultTCUCAP1_ThermalWarningLogged" UBYTE Bool_ON_OFF 1 2 0 1 BIT_MASK 0x08 ECU_ADDRESS 0x70012F35 /end MEASUREMENT
/begin MEASUREMENT FaultTCUCAP1_UnderVoltageAut "FaultTCUCAP1_UnderVoltageAut" UBYTE Bool_ON_OFF 1 2 0 1 BIT_MASK 0x10 ECU_ADDRESS 0x70012E83 /end MEASUREMENT
/begin MEASUREMENT FaultTCUCAP1_UnderVoltageDetected "FaultTCUCAP1_UnderVoltageDetected" UBYTE Bool_ON_OFF 1 2 0 1 BIT_MASK 0x10 ECU_ADDRESS 0x70012FE7 /end MEASUREMENT
/begin MEASUREMENT FaultTCUCAP1_UnderVoltageLogged "FaultTCUCAP1_UnderVoltageLogged" UBYTE Bool_ON_OFF 1 2 0 1 BIT_MASK 0x10 ECU_ADDRESS 0x70012F35 /end MEASUREMENT
/begin MEASUREMENT FaultTCUCCP_Detected "FaultTCUCCP_Detected" UWORD I_1 1 2 0 65535 ECU_ADDRESS 0x70012FE8 /end MEASUREMENT
/begin MEASUREMENT FaultTCUCCP_Logged "FaultTCUCCP_Logged" UWORD I_1 1 2 0 65535 ECU_ADDRESS 0x70012F36 /end MEASUREMENT
/begin MEASUREMENT FaultTCUCCP_OilMotorRationalAut "FaultTCUCCP_OilMotorRationalAut" UBYTE Bool_ON_OFF 1 2 0 1 BIT_MASK 0x01 ECU_ADDRESS 0x70012E84 /end MEASUREMENT
/begin MEASUREMENT FaultTCUCCP_OilMotorRationalDetected "FaultTCUCCP_OilMotorRationalDetected" UBYTE Bool_ON_OFF 1 2 0 1 BIT_MASK 0x01 ECU_ADDRESS 0x70012FE8 /end MEASUREMENT
/begin MEASUREMENT FaultTCUCCP_OilMotorRationalLogged "FaultTCUCCP_OilMotorRationalLogged" UBYTE Bool_ON_OFF 1 2 0 1 BIT_MASK 0x01 ECU_ADDRESS 0x70012F36 /end MEASUREMENT
/begin MEASUREMENT FaultTCUCCP_OilMotorStallAut "FaultTCUCCP_OilMotorStallAut" UBYTE Bool_ON_OFF 1 2 0 1 BIT_MASK 0x02 ECU_ADDRESS 0x70012E84 /end MEASUREMENT
/begin MEASUREMENT FaultTCUCCP_OilMotorStallDetected "FaultTCUCCP_OilMotorStallDetected" UBYTE Bool_ON_OFF 1 2 0 1 BIT_MASK 0x02 ECU_ADDRESS 0x70012FE8 /end MEASUREMENT
/begin MEASUREMENT FaultTCUCCP_OilMotorStallLogged "FaultTCUCCP_OilMotorStallLogged" UBYTE Bool_ON_OFF 1 2 0 1 BIT_MASK 0x02 ECU_ADDRESS 0x70012F36 /end MEASUREMENT
/begin MEASUREMENT FaultTCUCCP_OilSenRationalL1Aut "FaultTCUCCP_OilSenRationalL1Aut" UBYTE Bool_ON_OFF 1 2 0 1 BIT_MASK 0x04 ECU_ADDRESS 0x70012E84 /end MEASUREMENT
/begin MEASUREMENT FaultTCUCCP_OilSenRationalL1Detected "FaultTCUCCP_OilSenRationalL1Detected" UBYTE Bool_ON_OFF 1 2 0 1 BIT_MASK 0x04 ECU_ADDRESS 0x70012FE8 /end MEASUREMENT
/begin MEASUREMENT FaultTCUCCP_OilSenRationalL1Logged "FaultTCUCCP_OilSenRationalL1Logged" UBYTE Bool_ON_OFF 1 2 0 1 BIT_MASK 0x04 ECU_ADDRESS 0x70012F36 /end MEASUREMENT
/begin MEASUREMENT FaultTCUCCP_OilSenRationalL2Aut "FaultTCUCCP_OilSenRationalL2Aut" UBYTE Bool_ON_OFF 1 2 0 1 BIT_MASK 0x08 ECU_ADDRESS 0x70012E84 /end MEASUREMENT
/begin MEASUREMENT FaultTCUCCP_OilSenRationalL2Detected "FaultTCUCCP_OilSenRationalL2Detected" UBYTE Bool_ON_OFF 1 2 0 1 BIT_MASK 0x08 ECU_ADDRESS 0x70012FE8 /end MEASUREMENT
/begin MEASUREMENT FaultTCUCCP_OilSenRationalL2Logged "FaultTCUCCP_OilSenRationalL2Logged" UBYTE Bool_ON_OFF 1 2 0 1 BIT_MASK 0x08 ECU_ADDRESS 0x70012F36 /end MEASUREMENT
/begin MEASUREMENT FaultTCUCCP_OilTempRationalHAut "FaultTCUCCP_OilTempRationalHAut" UBYTE Bool_ON_OFF 1 2 0 1 BIT_MASK 0x10 ECU_ADDRESS 0x70012E84 /end MEASUREMENT
/begin MEASUREMENT FaultTCUCCP_OilTempRationalHDetected "FaultTCUCCP_OilTempRationalHDetected" UBYTE Bool_ON_OFF 1 2 0 1 BIT_MASK 0x10 ECU_ADDRESS 0x70012FE8 /end MEASUREMENT
/begin MEASUREMENT FaultTCUCCP_OilTempRationalHLogged "FaultTCUCCP_OilTempRationalHLogged" UBYTE Bool_ON_OFF 1 2 0 1 BIT_MASK 0x10 ECU_ADDRESS 0x70012F36 /end MEASUREMENT
/begin MEASUREMENT FaultTCUCCP_OilTempRationalLAut "FaultTCUCCP_OilTempRationalLAut" UBYTE Bool_ON_OFF 1 2 0 1 BIT_MASK 0x20 ECU_ADDRESS 0x70012E84 /end MEASUREMENT
/begin MEASUREMENT FaultTCUCCP_OilTempRationalLDetected "FaultTCUCCP_OilTempRationalLDetected" UBYTE Bool_ON_OFF 1 2 0 1 BIT_MASK 0x20 ECU_ADDRESS 0x70012FE8 /end MEASUREMENT
/begin MEASUREMENT FaultTCUCCP_OilTempRationalLLogged "FaultTCUCCP_OilTempRationalLLogged" UBYTE Bool_ON_OFF 1 2 0 1 BIT_MASK 0x20 ECU_ADDRESS 0x70012F36 /end MEASUREMENT
/begin MEASUREMENT FaultTableFuncTypeCounter1[54] "FaultTableFuncTypeCounter1[54]" UBYTE I_1 1 2 0 255 ECU_ADDRESS 0x70013096 /end MEASUREMENT
/begin MEASUREMENT FaultTableFuncTypeCounter1[55] "FaultTableFuncTypeCounter1[55]" UBYTE I_1 1 2 0 255 ECU_ADDRESS 0x70013097 /end MEASUREMENT
/begin MEASUREMENT FaultTableFuncTypeCounter1[56] "FaultTableFuncTypeCounter1[56]" UBYTE I_1 1 2 0 255 ECU_ADDRESS 0x70013098 /end MEASUREMENT
/begin MEASUREMENT FaultTableFuncTypeCounter1[57] "FaultTableFuncTypeCounter1[57]" UBYTE I_1 1 2 0 255 ECU_ADDRESS 0x70013099 /end MEASUREMENT
/begin MEASUREMENT FaultTableFuncTypeCounter1[58] "FaultTableFuncTypeCounter1[58]" UBYTE I_1 1 2 0 255 ECU_ADDRESS 0x7001309A /end MEASUREMENT
/begin MEASUREMENT FaultTableFuncTypeCounter1[59] "FaultTableFuncTypeCounter1[59]" UBYTE I_1 1 2 0 255 ECU_ADDRESS 0x7001309B /end MEASUREMENT
/begin MEASUREMENT FaultTableFuncTypeCounter1[5] "FaultTableFuncTypeCounter1[5]" UBYTE I_1 1 2 0 255 ECU_ADDRESS 0x70013065 /end MEASUREMENT
/begin MEASUREMENT FaultTableFuncTypeCounter1[60] "FaultTableFuncTypeCounter1[60]" UBYTE I_1 1 2 0 255 ECU_ADDRESS 0x7001309C /end MEASUREMENT
/begin MEASUREMENT FaultTableFuncTypeCounter1[61] "FaultTableFuncTypeCounter1[61]" UBYTE I_1 1 2 0 255 ECU_ADDRESS 0x7001309D /end MEASUREMENT
/begin MEASUREMENT FaultTableFuncTypeCounter1[62] "FaultTableFuncTypeCounter1[62]" UBYTE I_1 1 2 0 255 ECU_ADDRESS 0x7001309E /end MEASUREMENT
/begin MEASUREMENT FaultTableFuncTypeCounter1[63] "FaultTableFuncTypeCounter1[63]" UBYTE I_1 1 2 0 255 ECU_ADDRESS 0x7001309F /end MEASUREMENT
/begin MEASUREMENT FaultTableFuncTypeCounter1[64] "FaultTableFuncTypeCounter1[64]" UBYTE I_1 1 2 0 255 ECU_ADDRESS 0x700130A0 /end MEASUREMENT
/begin MEASUREMENT FaultTableFuncTypeCounter1[65] "FaultTableFuncTypeCounter1[65]" UBYTE I_1 1 2 0 255 ECU_ADDRESS 0x700130A1 /end MEASUREMENT
/begin MEASUREMENT FaultTableFuncTypeCounter1[66] "FaultTableFuncTypeCounter1[66]" UBYTE I_1 1 2 0 255 ECU_ADDRESS 0x700130A2 /end MEASUREMENT
/begin MEASUREMENT FaultTableFuncTypeCounter1[67] "FaultTableFuncTypeCounter1[67]" UBYTE I_1 1 2 0 255 ECU_ADDRESS 0x700130A3 /end MEASUREMENT
/begin MEASUREMENT FaultTableFuncTypeCounter1[68] "FaultTableFuncTypeCounter1[68]" UBYTE I_1 1 2 0 255 ECU_ADDRESS 0x700130A4 /end MEASUREMENT
/begin MEASUREMENT FaultTableFuncTypeCounter1[69] "FaultTableFuncTypeCounter1[69]" UBYTE I_1 1 2 0 255 ECU_ADDRESS 0x700130A5 /end MEASUREMENT
/begin MEASUREMENT FaultTableFuncTypeCounter1[6] "FaultTableFuncTypeCounter1[6]" UBYTE I_1 1 2 0 255 ECU_ADDRESS 0x70013066 /end MEASUREMENT
/begin MEASUREMENT FaultTableFuncTypeCounter1[70] "FaultTableFuncTypeCounter1[70]" UBYTE I_1 1 2 0 255 ECU_ADDRESS 0x700130A6 /end MEASUREMENT
/begin MEASUREMENT FaultTableFuncTypeCounter1[71] "FaultTableFuncTypeCounter1[71]" UBYTE I_1 1 2 0 255 ECU_ADDRESS 0x700130A7 /end MEASUREMENT
/begin MEASUREMENT FaultTableFuncTypeCounter1[72] "FaultTableFuncTypeCounter1[72]" UBYTE I_1 1 2 0 255 ECU_ADDRESS 0x700130A8 /end MEASUREMENT
/begin MEASUREMENT FaultTableFuncTypeCounter1[73] "FaultTableFuncTypeCounter1[73]" UBYTE I_1 1 2 0 255 ECU_ADDRESS 0x700130A9 /end MEASUREMENT
/begin MEASUREMENT FaultTableFuncTypeCounter1[74] "FaultTableFuncTypeCounter1[74]" UBYTE I_1 1 2 0 255 ECU_ADDRESS 0x700130AA /end MEASUREMENT
/begin MEASUREMENT FaultTableFuncTypeCounter1[75] "FaultTableFuncTypeCounter1[75]" UBYTE I_1 1 2 0 255 ECU_ADDRESS 0x700130AB /end MEASUREMENT
/begin MEASUREMENT FaultTableFuncTypeCounter1[76] "FaultTableFuncTypeCounter1[76]" UBYTE I_1 1 2 0 255 ECU_ADDRESS 0x700130AC /end MEASUREMENT
/begin MEASUREMENT FaultTableFuncTypeCounter1[77] "FaultTableFuncTypeCounter1[77]" UBYTE I_1 1 2 0 255 ECU_ADDRESS 0x700130AD /end MEASUREMENT
/begin MEASUREMENT FaultTableFuncTypeCounter1[78] "FaultTableFuncTypeCounter1[78]" UBYTE I_1 1 2 0 255 ECU_ADDRESS 0x700130AE /end MEASUREMENT
/begin MEASUREMENT FaultTableFuncTypeCounter1[79] "FaultTableFuncTypeCounter1[79]" UBYTE I_1 1 2 0 255 ECU_ADDRESS 0x700130AF /end MEASUREMENT
/begin MEASUREMENT FaultTableFuncTypeCounter1[7] "FaultTableFuncTypeCounter1[7]" UBYTE I_1 1 2 0 255 ECU_ADDRESS 0x70013067 /end MEASUREMENT
/begin MEASUREMENT FaultTableFuncTypeCounter1[80] "FaultTableFuncTypeCounter1[80]" UBYTE I_1 1 2 0 255 ECU_ADDRESS 0x700130B0 /end MEASUREMENT
/begin MEASUREMENT FaultTableFuncTypeCounter1[81] "FaultTableFuncTypeCounter1[81]" UBYTE I_1 1 2 0 255 ECU_ADDRESS 0x700130B1 /end MEASUREMENT
/begin MEASUREMENT FaultTableFuncTypeCounter1[82] "FaultTableFuncTypeCounter1[82]" UBYTE I_1 1 2 0 255 ECU_ADDRESS 0x700130B2 /end MEASUREMENT
/begin MEASUREMENT FaultTableFuncTypeCounter1[83] "FaultTableFuncTypeCounter1[83]" UBYTE I_1 1 2 0 255 ECU_ADDRESS 0x700130B3 /end MEASUREMENT
/begin MEASUREMENT FaultTableFuncTypeCounter1[84] "FaultTableFuncTypeCounter1[84]" UBYTE I_1 1 2 0 255 ECU_ADDRESS 0x700130B4 /end MEASUREMENT
/begin MEASUREMENT FaultTableFuncTypeCounter1[85] "FaultTableFuncTypeCounter1[85]" UBYTE I_1 1 2 0 255 ECU_ADDRESS 0x700130B5 /end MEASUREMENT
/begin MEASUREMENT FaultTableFuncTypeCounter1[86] "FaultTableFuncTypeCounter1[86]" UBYTE I_1 1 2 0 255 ECU_ADDRESS 0x700130B6 /end MEASUREMENT
/begin MEASUREMENT FaultTableFuncTypeCounter1[87] "FaultTableFuncTypeCounter1[87]" UBYTE I_1 1 2 0 255 ECU_ADDRESS 0x700130B7 /end MEASUREMENT
/begin MEASUREMENT FaultTableFuncTypeCounter1[88] "FaultTableFuncTypeCounter1[88]" UBYTE I_1 1 2 0 255 ECU_ADDRESS 0x700130B8 /end MEASUREMENT
/begin MEASUREMENT FaultTableFuncTypeCounter1[89] "FaultTableFuncTypeCounter1[89]" UBYTE I_1 1 2 0 255 ECU_ADDRESS 0x700130B9 /end MEASUREMENT
/begin MEASUREMENT FaultTableFuncTypeCounter1[8] "FaultTableFuncTypeCounter1[8]" UBYTE I_1 1 2 0 255 ECU_ADDRESS 0x70013068 /end MEASUREMENT
/begin MEASUREMENT FaultTableFuncTypeCounter1[90] "FaultTableFuncTypeCounter1[90]" UBYTE I_1 1 2 0 255 ECU_ADDRESS 0x700130BA /end MEASUREMENT
/begin MEASUREMENT FaultTableFuncTypeCounter1[91] "FaultTableFuncTypeCounter1[91]" UBYTE I_1 1 2 0 255 ECU_ADDRESS 0x700130BB /end MEASUREMENT
/begin MEASUREMENT FaultTableFuncTypeCounter1[92] "FaultTableFuncTypeCounter1[92]" UBYTE I_1 1 2 0 255 ECU_ADDRESS 0x700130BC /end MEASUREMENT
/begin MEASUREMENT FaultTableFuncTypeCounter1[93] "FaultTableFuncTypeCounter1[93]" UBYTE I_1 1 2 0 255 ECU_ADDRESS 0x700130BD /end MEASUREMENT
/begin MEASUREMENT FaultTableFuncTypeCounter1[94] "FaultTableFuncTypeCounter1[94]" UBYTE I_1 1 2 0 255 ECU_ADDRESS 0x700130BE /end MEASUREMENT
/begin MEASUREMENT FaultTableFuncTypeCounter1[95] "FaultTableFuncTypeCounter1[95]" UBYTE I_1 1 2 0 255 ECU_ADDRESS 0x700130BF /end MEASUREMENT
/begin MEASUREMENT FaultTableFuncTypeCounter1[96] "FaultTableFuncTypeCounter1[96]" UBYTE I_1 1 2 0 255 ECU_ADDRESS 0x700130C0 /end MEASUREMENT
/begin MEASUREMENT FaultTableFuncTypeCounter1[97] "FaultTableFuncTypeCounter1[97]" UBYTE I_1 1 2 0 255 ECU_ADDRESS 0x700130C1 /end MEASUREMENT
/begin MEASUREMENT FaultTableFuncTypeCounter1[98] "FaultTableFuncTypeCounter1[98]" UBYTE I_1 1 2 0 255 ECU_ADDRESS 0x700130C2 /end MEASUREMENT
/begin MEASUREMENT FaultTableFuncTypeCounter1[99] "FaultTableFuncTypeCounter1[99]" UBYTE I_1 1 2 0 255 ECU_ADDRESS 0x700130C3 /end MEASUREMENT
/begin MEASUREMENT FaultTableFuncTypeCounter1[9] "FaultTableFuncTypeCounter1[9]" UBYTE I_1 1 2 0 255 ECU_ADDRESS 0x70013069 /end MEASUREMENT
/begin MEASUREMENT GCCU6_au32PWMOnTime "." ULONG F_1_p0_2 1 2 0 4294967295 MATRIX_DIM 3 1 1 ECU_ADDRESS 0x70013CF8 /end MEASUREMENT
/begin MEASUREMENT GCCU6_au32PWMOnTime[0] "GCCU6_au32PWMOnTime[0]" ULONG F_1_p0_2 1 2 0 4294967295 ECU_ADDRESS 0x70013CF8 /end MEASUREMENT
/begin MEASUREMENT GCCU6_au32PWMOnTime[1] "GCCU6_au32PWMOnTime[1]" ULONG F_1_p0_2 1 2 0 4294967295 ECU_ADDRESS 0x70013CFC /end MEASUREMENT
/begin MEASUREMENT GCCU6_au32PWMOnTime[2] "GCCU6_au32PWMOnTime[2]" ULONG F_1_p0_2 1 2 0 4294967295 ECU_ADDRESS 0x70013D00 /end MEASUREMENT
/begin MEASUREMENT GCCU6_bAkdAfterAscReq "..." UBYTE Bool_ON_OFF 1 2 0 1 BIT_MASK 0x01 ECU_ADDRESS 0x70013D31 /end MEASUREMENT
/begin MEASUREMENT GCCU6_bClrTrapReq "..." UBYTE Bool_ON_OFF 1 2 0 1 BIT_MASK 0x01 ECU_ADDRESS 0x70013D30 /end MEASUREMENT
/begin MEASUREMENT GCCU6_bHwFaultDcOvVolt "..." UBYTE Bool_ON_OFF 1 2 0 1 BIT_MASK 0x01 ECU_ADDRESS 0x70013D2F /end MEASUREMENT
/begin MEASUREMENT GCCU6_bHwFaultIgbtH "..." UBYTE Bool_ON_OFF 1 2 0 1 BIT_MASK 0x01 ECU_ADDRESS 0x70013D2E /end MEASUREMENT
/begin MEASUREMENT GCCU6_bHwFaultIgbtL "..." UBYTE Bool_ON_OFF 1 2 0 1 BIT_MASK 0x01 ECU_ADDRESS 0x70013D2D /end MEASUREMENT
/begin MEASUREMENT GCCU6_bHwFaultOvcU "..." UBYTE Bool_ON_OFF 1 2 0 1 BIT_MASK 0x01 ECU_ADDRESS 0x70013D2C /end MEASUREMENT
/begin MEASUREMENT GCCU6_bHwFaultOvcV "..." UBYTE Bool_ON_OFF 1 2 0 1 BIT_MASK 0x01 ECU_ADDRESS 0x70013D2B /end MEASUREMENT
/begin MEASUREMENT GCCU6_bHwFaultOvcW "..." UBYTE Bool_ON_OFF 1 2 0 1 BIT_MASK 0x01 ECU_ADDRESS 0x70013D2A /end MEASUREMENT
/begin MEASUREMENT GCCU6_bIgbtHighSideShort "..." UBYTE Bool_ON_OFF 1 2 0 1 BIT_MASK 0x01 ECU_ADDRESS 0x70013D29 /end MEASUREMENT
/begin MEASUREMENT GCCU6_bIgbtLowSideShort "..." UBYTE Bool_ON_OFF 1 2 0 1 BIT_MASK 0x01 ECU_ADDRESS 0x70013D28 /end MEASUREMENT
/begin MEASUREMENT GCCU6_bIuvwCompReq "..." UBYTE Bool_ON_OFF 1 2 0 1 BIT_MASK 0x01 ECU_ADDRESS 0x70013D26 /end MEASUREMENT
/begin MEASUREMENT GCCU6_bMotorSpdRdy "..." UBYTE Bool_ON_OFF 1 2 0 1 BIT_MASK 0x01 ECU_ADDRESS 0x70013D25 /end MEASUREMENT
/begin MEASUREMENT GCCU6_bP5VDiagReinitCmd "..." UBYTE Bool_ON_OFF 1 2 0 1 BIT_MASK 0x01 ECU_ADDRESS 0x70013D24 /end MEASUREMENT
/begin MEASUREMENT GCCU6_bP5VHSFltFlg "..." UBYTE Bool_ON_OFF 1 2 0 1 BIT_MASK 0x01 ECU_ADDRESS 0x70013D23 /end MEASUREMENT
/begin MEASUREMENT GCCU6_bP5VLSFltFlg "..." UBYTE Bool_ON_OFF 1 2 0 1 BIT_MASK 0x01 ECU_ADDRESS 0x70013D22 /end MEASUREMENT
/begin MEASUREMENT GCCU6_bPwmMidPointU "..." UBYTE Bool_ON_OFF 1 2 0 1 BIT_MASK 0x01 ECU_ADDRESS 0x70013D21 /end MEASUREMENT
/begin MEASUREMENT GCCU6_bPwmMidPointV "..." UBYTE Bool_ON_OFF 1 2 0 1 BIT_MASK 0x01 ECU_ADDRESS 0x70013D20 /end MEASUREMENT
/begin MEASUREMENT GCCU6_bPwmMidPointW "..." UBYTE Bool_ON_OFF 1 2 0 1 BIT_MASK 0x01 ECU_ADDRESS 0x70013D1F /end MEASUREMENT
/begin MEASUREMENT GCCU6_bPwmOnGoingFlg "..." UBYTE Bool_ON_OFF 1 2 0 1 BIT_MASK 0x01 ECU_ADDRESS 0x70013D1E /end MEASUREMENT
/begin MEASUREMENT GCCU6_bT12ZeroMatchFlg "..." UBYTE Bool_ON_OFF 1 2 0 1 BIT_MASK 0x01 ECU_ADDRESS 0x70013D1D /end MEASUREMENT
/begin MEASUREMENT GCCU6_bTrapTrigger "..." UBYTE Bool_ON_OFF 1 2 0 1 BIT_MASK 0x01 ECU_ADDRESS 0x70013D1C /end MEASUREMENT
/begin MEASUREMENT GCCU6_f32DrvClkHsDuty "..." FLOAT32_IEEE I_1 1 2 -3.402823466E+038 3.402823466E+038 ECU_ADDRESS 0x70013D18 /end MEASUREMENT
/begin MEASUREMENT GCCU6_f32DrvClkLsDuty "..." FLOAT32_IEEE I_1 1 2 -3.402823466E+038 3.402823466E+038 ECU_ADDRESS 0x70013D14 /end MEASUREMENT
/begin MEASUREMENT GCCU6_f32HighVolPhys "..." FLOAT32_IEEE I_1 1 2 -3.402823466E+038 3.402823466E+038 ECU_ADDRESS 0x70013D10 /end MEASUREMENT
/begin MEASUREMENT GCCU6_f32PwmDutyPhysUZ "..." FLOAT32_IEEE I_1 1 2 -3.402823466E+038 3.402823466E+038 ECU_ADDRESS 0x70013D0C /end MEASUREMENT
/begin MEASUREMENT GCCU6_f32PwmDutyPhysVZ "..." FLOAT32_IEEE I_1 1 2 -3.402823466E+038 3.402823466E+038 ECU_ADDRESS 0x70013D08 /end MEASUREMENT
/begin MEASUREMENT GCCU6_f32PwmDutyPhysWZ "..." FLOAT32_IEEE I_1 1 2 -3.402823466E+038 3.402823466E+038 ECU_ADDRESS 0x70013D04 /end MEASUREMENT
/begin MEASUREMENT GCCU6_u16AlimPowerOnDelay "..." UWORD I_1 1 2 0 65535 ECU_ADDRESS 0x70013CD4 /end MEASUREMENT
/begin MEASUREMENT GCCU6_u16HighVolAdc "..." UWORD I_1 1 2 0 65535 ECU_ADDRESS 0x70013CD2 /end MEASUREMENT
/begin MEASUREMENT GCCU6_u16McuAscSttDelay "..." UWORD I_1 1 2 0 65535 ECU_ADDRESS 0x70013CD0 /end MEASUREMENT
/begin MEASUREMENT GCCU6_u16P5VHSAdc "..." UWORD I_7 1 2 0 65535 ECU_ADDRESS 0x70013CCE /end MEASUREMENT
/begin MEASUREMENT GCCU6_u16PowerOnDelay "..." UWORD I_1 1 2 0 65535 ECU_ADDRESS 0x70013CCC /end MEASUREMENT
/begin MEASUREMENT GCCU6_u16PwmMaxDutyCyc "..." UWORD I_1 1 2 0 65535 ECU_ADDRESS 0x70013CCA /end MEASUREMENT
/begin MEASUREMENT GCCU6_u16PwmMidPointErrCnt "..." UWORD I_1 1 2 0 65535 ECU_ADDRESS 0x70013CC8 /end MEASUREMENT
/begin MEASUREMENT GCCU6_u16PwmMinDutyCyc "..." UWORD I_1 1 2 0 65535 ECU_ADDRESS 0x70013CC6 /end MEASUREMENT
/begin MEASUREMENT GCCU6_u16PwmModReq "..." UWORD I_1 1 2 0 65535 ECU_ADDRESS 0x70013CC4 /end MEASUREMENT
/begin MEASUREMENT GCCU6_u16T12CntVal "..." UWORD I_1 1 2 0 65535 ECU_ADDRESS 0x70013CC2 /end MEASUREMENT
/begin MEASUREMENT GCCU6_u16T12PeriodVal "..." UWORD I_1 1 2 0 65535 ECU_ADDRESS 0x70001A24 /end MEASUREMENT
/begin MEASUREMENT GCCU6_u16T13PeriodVal "..." UWORD I_1 1 2 0 65535 ECU_ADDRESS 0x70013CC0 /end MEASUREMENT
/begin MEASUREMENT GCCU6_u32DrvClkHsDutyRaw "..." ULONG I_1 1 2 0 4294967295 ECU_ADDRESS 0x70013CF4 /end MEASUREMENT
/begin MEASUREMENT GCCU6_u32DrvClkHsPerdRaw "..." ULONG I_1 1 2 0 4294967295 ECU_ADDRESS 0x70013CF0 /end MEASUREMENT
/begin MEASUREMENT GCCU6_u32DrvClkLsDutyRaw "..." ULONG I_1 1 2 0 4294967295 ECU_ADDRESS 0x70013CEC /end MEASUREMENT
/begin MEASUREMENT GCCU6_u32DrvClkLsPerdRaw "..." ULONG I_1 1 2 0 4294967295 ECU_ADDRESS 0x70013CE8 /end MEASUREMENT
/begin MEASUREMENT GCCU6_u32TrapCreq "..." ULONG I_1 1 2 0 4294967295 ECU_ADDRESS 0x70013CE4 /end MEASUREMENT
/begin MEASUREMENT GCCU6_u8AscRecoverCnt "GCCU6 State" UBYTE I_1 1 2 0 255 ECU_ADDRESS 0x70013CE0 /end MEASUREMENT
/begin MEASUREMENT GCCU6_u8McuAscSttStep "GCCU6 State" UBYTE I_1 1 2 0 255 ECU_ADDRESS 0x70013CDE /end MEASUREMENT
/begin MEASUREMENT GCCU6_u8McuAscType "GCCU6 ASC Type" UBYTE I_1 1 2 0 255 ECU_ADDRESS 0x70013CDD /end MEASUREMENT
/begin MEASUREMENT GCCU6_u8P5VHSFltCnt "..." UBYTE I_1 1 2 0 255 ECU_ADDRESS 0x70013CDC /end MEASUREMENT
/begin MEASUREMENT GCCU6_u8P5VLSFltCnt "..." UBYTE I_1 1 2 0 255 ECU_ADDRESS 0x70013CDB /end MEASUREMENT
/begin MEASUREMENT GCCU6_u8P5VPowerMngStt "..." UBYTE I_1 1 2 0 255 ECU_ADDRESS 0x70013CDA /end MEASUREMENT
/begin MEASUREMENT GCCU6_u8P5VSelfTstTimCnt "..." UBYTE I_1 1 2 0 255 ECU_ADDRESS 0x70013CD9 /end MEASUREMENT
/begin MEASUREMENT GCCU6_u8PreTestStep "..." UBYTE I_1 1 2 0 255 ECU_ADDRESS 0x70013CD7 /end MEASUREMENT
/begin MEASUREMENT GCCU6_u8PwmState "GCCU6 State" UBYTE I_1 1 2 0 255 ECU_ADDRESS 0x70013CD6 /end MEASUREMENT
/begin MEASUREMENT GMAIN_ku16SpdReadyEstConfirmC "..." UWORD I_1 1 2 0 65535 ECU_ADDRESS 0x80058AD6 /end MEASUREMENT
/begin MEASUREMENT GMAIN_u16Core0Cnt5 "..." UWORD I_1 1 2 0 65535 ECU_ADDRESS 0x7001FE14 /end MEASUREMENT
/begin MEASUREMENT GMAIN_u16Core2Cnt10 "..." UWORD I_1 1 2 0 65535 ECU_ADDRESS 0x7001FE0E /end MEASUREMENT
/begin MEASUREMENT GMAIN_u8IgbtFltConfirmCntC "..." UBYTE I_1 1 2 0 255 ECU_ADDRESS 0x80058074 /end MEASUREMENT
/begin MEASUREMENT GMAIN_u8IgbtHighFltCnt "..." UBYTE I_1 1 2 0 255 ECU_ADDRESS 0x7001FE18 /end MEASUREMENT
/begin MEASUREMENT GMAIN_u8IgbtLowFltCnt "..." UBYTE I_1 1 2 0 255 ECU_ADDRESS 0x7001FE17 /end MEASUREMENT
/begin MEASUREMENT GMAIN_u8StopCacheFreezeFrameCnt "..." UBYTE I_1 1 2 0 255 ECU_ADDRESS 0x7001FE16 /end MEASUREMENT
/begin MEASUREMENT HARD_CH_DIO_IN_M_HW_OCP_U_2 "HARD_CH_DIO_IN_M_HW_OCP_U_2" UWORD I_1 1 2 0 65535 ECU_ADDRESS 0x70013DF2 /end MEASUREMENT
/begin MEASUREMENT HARD_CH_DIO_IN_M_HW_OCP_V_2 "HARD_CH_DIO_IN_M_HW_OCP_V_2" UWORD I_1 1 2 0 65535 ECU_ADDRESS 0x70013DF4 /end MEASUREMENT
/begin MEASUREMENT HARD_CH_DIO_IN_M_HW_OCP_W_2 "HARD_CH_DIO_IN_M_HW_OCP_W_2" UWORD I_1 1 2 0 65535 ECU_ADDRESS 0x70013DF6 /end MEASUREMENT
/begin MEASUREMENT HARD_ESM_FT_STATE_FT_SHUTDOWN "HARD_ESM_FT_STATE_FT_SHUTDOWN" UBYTE Bool_ON_OFF 1 2 0 1 BIT_MASK 0x08 ECU_ADDRESS 0x70013E52 /end MEASUREMENT
/begin MEASUREMENT HARD_ESM_FT_STATE_IDLE "HARD_ESM_FT_STATE_IDLE" UBYTE Bool_ON_OFF 1 2 0 1 BIT_MASK 0x40 ECU_ADDRESS 0x70013E52 /end MEASUREMENT
/begin MEASUREMENT HARD_ESM_FT_STATE_PWM_DIRECT "HARD_ESM_FT_STATE_PWM_DIRECT" UBYTE Bool_ON_OFF 1 2 0 1 BIT_MASK 0x01 ECU_ADDRESS 0x70013E52 /end MEASUREMENT
/begin MEASUREMENT HARD_ESM_FT_STATE_PWM_HARD "HARD_ESM_FT_STATE_PWM_HARD" UBYTE Bool_ON_OFF 1 2 0 1 BIT_MASK 0x02 ECU_ADDRESS 0x70013E52 /end MEASUREMENT
/begin MEASUREMENT HARD_ESM_FT_STATE_PWM_OFF "HARD_ESM_FT_STATE_PWM_OFF" UBYTE Bool_ON_OFF 1 2 0 1 BIT_MASK 0x04 ECU_ADDRESS 0x70013E52 /end MEASUREMENT
/begin MEASUREMENT HARD_ESM_NF_STATE_FT_START "HARD_ESM_NF_STATE_FT_START" UBYTE Bool_ON_OFF 1 2 0 1 BIT_MASK 0x01 ECU_ADDRESS 0x70013E50 /end MEASUREMENT
/begin MEASUREMENT HARD_ESM_NF_STATE_IDLE "HARD_ESM_NF_STATE_IDLE" UBYTE Bool_ON_OFF 1 2 0 1 BIT_MASK 0x40 ECU_ADDRESS 0x70013E50 /end MEASUREMENT
/begin MEASUREMENT HARD_ESM_NF_STATE_PWM_HARD "HARD_ESM_NF_STATE_PWM_HARD" UBYTE Bool_ON_OFF 1 2 0 1 BIT_MASK 0x08 ECU_ADDRESS 0x70013E50 /end MEASUREMENT
/begin MEASUREMENT HARD_ESM_NF_STATE_PWM_OFF "HARD_ESM_NF_STATE_PWM_OFF" UBYTE Bool_ON_OFF 1 2 0 1 BIT_MASK 0x10 ECU_ADDRESS 0x70013E50 /end MEASUREMENT
/begin MEASUREMENT HARD_ESM_NF_STATE_SW_SHUTDOWN "HARD_ESM_NF_STATE_SW_SHUTDOWN" UBYTE Bool_ON_OFF 1 2 0 1 BIT_MASK 0x04 ECU_ADDRESS 0x70013E50 /end MEASUREMENT
/begin MEASUREMENT HARD_EsmFtState "HARD_EsmFtState" UWORD HARD_EsmFtState_conv 1 2 1 64 ECU_ADDRESS 0x70013E52 /end MEASUREMENT
/begin MEASUREMENT HARD_EsmFtStateAut "HARD_EsmFtStateAut" UBYTE Bool_ON_OFF 1 2 0 1 BIT_MASK 0x01 ECU_ADDRESS 0x70013D56 /end MEASUREMENT
/begin MEASUREMENT HARD_EsmNfState "HARD_EsmNfState" UWORD HARD_EsmNfState_conv 1 2 1 64 ECU_ADDRESS 0x70013E50 /end MEASUREMENT
/begin MEASUREMENT HARD_EsmNfStateAut "HARD_EsmNfStateAut" UBYTE Bool_ON_OFF 1 2 0 1 BIT_MASK 0x01 ECU_ADDRESS 0x70013D55 /end MEASUREMENT
/begin MEASUREMENT HARD_PTG_CONTINUOUS_MODE "HARD_PTG_CONTINUOUS_MODE" UBYTE Bool_ON_OFF 1 2 0 1 BIT_MASK 0x10 ECU_ADDRESS 0x70013E4E /end MEASUREMENT
/begin MEASUREMENT HARD_PTG_DISJUNCTION_MODE "HARD_PTG_DISJUNCTION_MODE" UBYTE Bool_ON_OFF 1 2 0 1 BIT_MASK 0x40 ECU_ADDRESS 0x70013E4E /end MEASUREMENT
/begin MEASUREMENT HARD_PTG_LOOP_NB_MODE "HARD_PTG_LOOP_NB_MODE" UBYTE Bool_ON_OFF 1 2 0 1 BIT_MASK 0x80 ECU_ADDRESS 0x70013E4E /end MEASUREMENT
/begin MEASUREMENT HARD_PTG_PROFIL_MODE "HARD_PTG_PROFIL_MODE" UBYTE Bool_ON_OFF 1 2 0 1 BIT_MASK 0x20 ECU_ADDRESS 0x70013E4E /end MEASUREMENT
/begin MEASUREMENT HARD_PTG_PULSE_MODE "HARD_PTG_PULSE_MODE" UBYTE Bool_ON_OFF 1 2 0 1 BIT_MASK 0x01 ECU_ADDRESS 0x70013E4E /end MEASUREMENT
/begin MEASUREMENT HARD_PTG_SINUS_MODE "HARD_PTG_SINUS_MODE" UBYTE Bool_ON_OFF 1 2 0 1 BIT_MASK 0x02 ECU_ADDRESS 0x70013E4E /end MEASUREMENT
/begin MEASUREMENT HARD_PTG_SQUARE_MODE "HARD_PTG_SQUARE_MODE" UBYTE Bool_ON_OFF 1 2 0 1 BIT_MASK 0x08 ECU_ADDRESS 0x70013E4E /end MEASUREMENT
/begin MEASUREMENT HARD_PTG_TRIANGLE_MODE "HARD_PTG_TRIANGLE_MODE" UBYTE Bool_ON_OFF 1 2 0 1 BIT_MASK 0x04 ECU_ADDRESS 0x70013E4E /end MEASUREMENT
/begin MEASUREMENT HARD_PtgModeTest "HARD_PtgModeTest" UWORD HARD_PtgModeTest_conv 1 2 1 128 ECU_ADDRESS 0x70013E4E /end MEASUREMENT
/begin MEASUREMENT HARD_bDio_MCU_ASC_STATE "HARD_bDio_MCU_ASC_STATE" UBYTE Bool_ON_OFF 1 2 0 1 BIT_MASK 0x01 ECU_ADDRESS 0x70013E1C /end MEASUREMENT
/begin MEASUREMENT HARD_bDio_MCU_STATE_LED "HARD_bDio_MCU_STATE_LED" UBYTE Bool_ON_OFF 1 2 0 1 BIT_MASK 0x01 ECU_ADDRESS 0x70013DFF /end MEASUREMENT
/begin MEASUREMENT HARD_bDio_M_ACM_ENA_PWM "HARD_bDio_M_ACM_ENA_PWM" UBYTE Bool_ON_OFF 1 2 0 1 BIT_MASK 0x01 ECU_ADDRESS 0x70013E0F /end MEASUREMENT
/begin MEASUREMENT HARD_bDio_M_AN_ENABLE_ASC1 "HARD_bDio_M_AN_ENABLE_ASC1" UBYTE Bool_ON_OFF 1 2 0 1 BIT_MASK 0x01 ECU_ADDRESS 0x70013E47 /end MEASUREMENT
/begin MEASUREMENT HARD_bDio_M_AN_ENABLE_ASC2 "HARD_bDio_M_AN_ENABLE_ASC2" UBYTE Bool_ON_OFF 1 2 0 1 BIT_MASK 0x01 ECU_ADDRESS 0x70013E49 /end MEASUREMENT
/begin MEASUREMENT HARD_bDio_M_BACKUP_EN "HARD_bDio_M_BACKUP_EN" UBYTE Bool_ON_OFF 1 2 0 1 BIT_MASK 0x01 ECU_ADDRESS 0x70013E4C /end MEASUREMENT
/begin MEASUREMENT HARD_bDio_M_CHG_ON "HARD_bDio_M_CHG_ON" UBYTE Bool_ON_OFF 1 2 0 1 BIT_MASK 0x01 ECU_ADDRESS 0x70013DF9 /end MEASUREMENT
/begin MEASUREMENT HARD_bDio_M_DI2 "HARD_bDio_M_DI2" UBYTE Bool_ON_OFF 1 2 0 1 BIT_MASK 0x01 ECU_ADDRESS 0x70013E06 /end MEASUREMENT
/begin MEASUREMENT HARD_bDio_M_DI3_KM_EN "HARD_bDio_M_DI3_KM_EN" UBYTE Bool_ON_OFF 1 2 0 1 BIT_MASK 0x01 ECU_ADDRESS 0x70013E48 /end MEASUREMENT
/begin MEASUREMENT HARD_bDio_M_DO1 "HARD_bDio_M_DO1" UBYTE Bool_ON_OFF 1 2 0 1 BIT_MASK 0x01 ECU_ADDRESS 0x70013DFC /end MEASUREMENT
/begin MEASUREMENT HARD_bDio_M_DX1_A "HARD_bDio_M_DX1_A" UBYTE Bool_ON_OFF 1 2 0 1 BIT_MASK 0x01 ECU_ADDRESS 0x70013E09 /end MEASUREMENT
/begin MEASUREMENT HARD_bDio_M_DX1_B "HARD_bDio_M_DX1_B" UBYTE Bool_ON_OFF 1 2 0 1 BIT_MASK 0x01 ECU_ADDRESS 0x70013E08 /end MEASUREMENT
/begin MEASUREMENT HARD_bDio_M_DX1_C "HARD_bDio_M_DX1_C" UBYTE Bool_ON_OFF 1 2 0 1 BIT_MASK 0x01 ECU_ADDRESS 0x70013DFE /end MEASUREMENT
/begin MEASUREMENT HARD_bDio_M_DX2_A "HARD_bDio_M_DX2_A" UBYTE Bool_ON_OFF 1 2 0 1 BIT_MASK 0x01 ECU_ADDRESS 0x70013E05 /end MEASUREMENT
/begin MEASUREMENT HARD_bDio_M_DX2_B "HARD_bDio_M_DX2_B" UBYTE Bool_ON_OFF 1 2 0 1 BIT_MASK 0x01 ECU_ADDRESS 0x70013E04 /end MEASUREMENT
/begin MEASUREMENT HARD_bDio_M_DX2_C "HARD_bDio_M_DX2_C" UBYTE Bool_ON_OFF 1 2 0 1 BIT_MASK 0x01 ECU_ADDRESS 0x70013E03 /end MEASUREMENT
/begin MEASUREMENT HARD_bDio_M_DX3_A "HARD_bDio_M_DX3_A" UBYTE Bool_ON_OFF 1 2 0 1 BIT_MASK 0x01 ECU_ADDRESS 0x70013E45 /end MEASUREMENT
/begin MEASUREMENT HARD_bDio_M_DX3_B "HARD_bDio_M_DX3_B" UBYTE Bool_ON_OFF 1 2 0 1 BIT_MASK 0x01 ECU_ADDRESS 0x70013E44 /end MEASUREMENT
/begin MEASUREMENT HARD_bDio_M_DX3_C "HARD_bDio_M_DX3_C" UBYTE Bool_ON_OFF 1 2 0 1 BIT_MASK 0x01 ECU_ADDRESS 0x70013E43 /end MEASUREMENT
/begin MEASUREMENT HARD_bDio_M_ENA_KM "HARD_bDio_M_ENA_KM" UBYTE Bool_ON_OFF 1 2 0 1 BIT_MASK 0x01 ECU_ADDRESS 0x70013E12 /end MEASUREMENT
/begin MEASUREMENT HARD_bDio_M_EPS_ENA_PWM "HARD_bDio_M_EPS_ENA_PWM" UBYTE Bool_ON_OFF 1 2 0 1 BIT_MASK 0x01 ECU_ADDRESS 0x70013E07 /end MEASUREMENT
/begin MEASUREMENT HARD_bDio_M_FAULT_ACM_HS_N "HARD_bDio_M_FAULT_ACM_HS_N" UBYTE Bool_ON_OFF 1 2 0 1 BIT_MASK 0x01 ECU_ADDRESS 0x70013E1A /end MEASUREMENT
/begin MEASUREMENT HARD_bDio_M_FAULT_DRV_HS_N_1 "HARD_bDio_M_FAULT_DRV_HS_N_1" UBYTE Bool_ON_OFF 1 2 0 1 BIT_MASK 0x01 ECU_ADDRESS 0x70013E11 /end MEASUREMENT
/begin MEASUREMENT HARD_bDio_M_FAULT_DRV_HS_N_2 "HARD_bDio_M_FAULT_DRV_HS_N_2" UBYTE Bool_ON_OFF 1 2 0 1 BIT_MASK 0x01 ECU_ADDRESS 0x70013E0C /end MEASUREMENT
/begin MEASUREMENT HARD_bDio_M_FAULT_DRV_LS_N_1 "HARD_bDio_M_FAULT_DRV_LS_N_1" UBYTE Bool_ON_OFF 1 2 0 1 BIT_MASK 0x01 ECU_ADDRESS 0x70013E0E /end MEASUREMENT
/begin MEASUREMENT HARD_bDio_M_FAULT_DRV_LS_N_2 "HARD_bDio_M_FAULT_DRV_LS_N_2" UBYTE Bool_ON_OFF 1 2 0 1 BIT_MASK 0x01 ECU_ADDRESS 0x70013E0D /end MEASUREMENT
/begin MEASUREMENT HARD_bDio_M_FAULT_EPS_HS_N "HARD_bDio_M_FAULT_EPS_HS_N" UBYTE Bool_ON_OFF 1 2 0 1 BIT_MASK 0x01 ECU_ADDRESS 0x70013E19 /end MEASUREMENT
/begin MEASUREMENT HARD_bDio_M_FLT_EXCITATION_1 "HARD_bDio_M_FLT_EXCITATION_1" UBYTE Bool_ON_OFF 1 2 0 1 BIT_MASK 0x01 ECU_ADDRESS 0x70013E2E /end MEASUREMENT
/begin MEASUREMENT HARD_bDio_M_FLT_EXCITATION_2 "HARD_bDio_M_FLT_EXCITATION_2" UBYTE Bool_ON_OFF 1 2 0 1 BIT_MASK 0x01 ECU_ADDRESS 0x70013E2F /end MEASUREMENT
/begin MEASUREMENT HARD_bDio_M_HWCFG1 "HARD_bDio_M_HWCFG1" UBYTE Bool_ON_OFF 1 2 0 1 BIT_MASK 0x01 ECU_ADDRESS 0x70013E21 /end MEASUREMENT
/begin MEASUREMENT HARD_bDio_M_HWCFG2 "HARD_bDio_M_HWCFG2" UBYTE Bool_ON_OFF 1 2 0 1 BIT_MASK 0x01 ECU_ADDRESS 0x70013E24 /end MEASUREMENT
/begin MEASUREMENT HARD_bDio_M_HWCFG3 "HARD_bDio_M_HWCFG3" UBYTE Bool_ON_OFF 1 2 0 1 BIT_MASK 0x01 ECU_ADDRESS 0x70013E23 /end MEASUREMENT
/begin MEASUREMENT HARD_bDio_M_HWCFG4 "HARD_bDio_M_HWCFG4" UBYTE Bool_ON_OFF 1 2 0 1 BIT_MASK 0x01 ECU_ADDRESS 0x70013E38 /end MEASUREMENT
/begin MEASUREMENT HARD_bDio_M_HWCFG5 "HARD_bDio_M_HWCFG5" UBYTE Bool_ON_OFF 1 2 0 1 BIT_MASK 0x01 ECU_ADDRESS 0x70013E37 /end MEASUREMENT
/begin MEASUREMENT HARD_bDio_M_HWCFG6 "HARD_bDio_M_HWCFG6" UBYTE Bool_ON_OFF 1 2 0 1 BIT_MASK 0x01 ECU_ADDRESS 0x70013E22 /end MEASUREMENT
/begin MEASUREMENT HARD_bDio_M_IO_MUX1 "HARD_bDio_M_IO_MUX1" UBYTE Bool_ON_OFF 1 2 0 1 BIT_MASK 0x01 ECU_ADDRESS 0x70013DF8 /end MEASUREMENT
/begin MEASUREMENT HARD_bDio_M_ISO_EN1 "HARD_bDio_M_ISO_EN1" UBYTE Bool_ON_OFF 1 2 0 1 BIT_MASK 0x01 ECU_ADDRESS 0x70013E32 /end MEASUREMENT
/begin MEASUREMENT HARD_bDio_M_ISO_EN2 "HARD_bDio_M_ISO_EN2" UBYTE Bool_ON_OFF 1 2 0 1 BIT_MASK 0x01 ECU_ADDRESS 0x70013E31 /end MEASUREMENT
/begin MEASUREMENT HARD_bDio_M_ISO_EN3 "HARD_bDio_M_ISO_EN3" UBYTE Bool_ON_OFF 1 2 0 1 BIT_MASK 0x01 ECU_ADDRESS 0x70013E30 /end MEASUREMENT
/begin MEASUREMENT HARD_bDio_M_K1_KCF_XJCQ1 "HARD_bDio_M_K1_KCF_XJCQ1" UBYTE Bool_ON_OFF 1 2 0 1 BIT_MASK 0x01 ECU_ADDRESS 0x70013E46 /end MEASUREMENT
/begin MEASUREMENT HARD_bDio_M_K2_KCF_XJCQ2 "HARD_bDio_M_K2_KCF_XJCQ2" UBYTE Bool_ON_OFF 1 2 0 1 BIT_MASK 0x01 ECU_ADDRESS 0x70013E2C /end MEASUREMENT
/begin MEASUREMENT HARD_bDio_M_K3_KCF_XJCQ3 "HARD_bDio_M_K3_KCF_XJCQ3" UBYTE Bool_ON_OFF 1 2 0 1 BIT_MASK 0x01 ECU_ADDRESS 0x70013E25 /end MEASUREMENT
/begin MEASUREMENT HARD_bDio_M_K4_KCF_XJCQ4 "HARD_bDio_M_K4_KCF_XJCQ4" UBYTE Bool_ON_OFF 1 2 0 1 BIT_MASK 0x01 ECU_ADDRESS 0x70013DFA /end MEASUREMENT
/begin MEASUREMENT HARD_bDio_M_KEY_ON "HARD_bDio_M_KEY_ON" UBYTE Bool_ON_OFF 1 2 0 1 BIT_MASK 0x01 ECU_ADDRESS 0x70013E00 /end MEASUREMENT
/begin MEASUREMENT HARD_bDio_M_KM10_KC3F "HARD_bDio_M_KM10_KC3F" UBYTE Bool_ON_OFF 1 2 0 1 BIT_MASK 0x01 ECU_ADDRESS 0x70013E34 /end MEASUREMENT
/begin MEASUREMENT HARD_bDio_M_KM11_KC2Z "HARD_bDio_M_KM11_KC2Z" UBYTE Bool_ON_OFF 1 2 0 1 BIT_MASK 0x01 ECU_ADDRESS 0x70013DFB /end MEASUREMENT
/begin MEASUREMENT HARD_bDio_M_KM12_KC4F "HARD_bDio_M_KM12_KC4F" UBYTE Bool_ON_OFF 1 2 0 1 BIT_MASK 0x01 ECU_ADDRESS 0x70013E1D /end MEASUREMENT
/begin MEASUREMENT HARD_bDio_M_KM13_KC3Z "HARD_bDio_M_KM13_KC3Z" UBYTE Bool_ON_OFF 1 2 0 1 BIT_MASK 0x01 ECU_ADDRESS 0x70013E39 /end MEASUREMENT
/begin MEASUREMENT HARD_bDio_M_KM15_KC4Z "HARD_bDio_M_KM15_KC4Z" UBYTE Bool_ON_OFF 1 2 0 1 BIT_MASK 0x01 ECU_ADDRESS 0x70013E1E /end MEASUREMENT
/begin MEASUREMENT HARD_bDio_M_KM17_SZ1 "HARD_bDio_M_KM17_SZ1" UBYTE Bool_ON_OFF 1 2 0 1 BIT_MASK 0x01 ECU_ADDRESS 0x70013E02 /end MEASUREMENT
/begin MEASUREMENT HARD_bDio_M_KM18_SZ2 "HARD_bDio_M_KM18_SZ2" UBYTE Bool_ON_OFF 1 2 0 1 BIT_MASK 0x01 ECU_ADDRESS 0x70013E42 /end MEASUREMENT
/begin MEASUREMENT HARD_bDio_M_KM19_XGLFZ "HARD_bDio_M_KM19_XGLFZ" UBYTE Bool_ON_OFF 1 2 0 1 BIT_MASK 0x01 ECU_ADDRESS 0x70013E0B /end MEASUREMENT
/begin MEASUREMENT HARD_bDio_M_KM1_ZQ1 "HARD_bDio_M_KM1_ZQ1" UBYTE Bool_ON_OFF 1 2 0 1 BIT_MASK 0x01 ECU_ADDRESS 0x70013E3E /end MEASUREMENT
/begin MEASUREMENT HARD_bDio_M_KM20_DCJY1 "HARD_bDio_M_KM20_DCJY1" UBYTE Bool_ON_OFF 1 2 0 1 BIT_MASK 0x01 ECU_ADDRESS 0x70013E2B /end MEASUREMENT
/begin MEASUREMENT HARD_bDio_M_KM21_DCJY2 "HARD_bDio_M_KM21_DCJY2" UBYTE Bool_ON_OFF 1 2 0 1 BIT_MASK 0x01 ECU_ADDRESS 0x70013E2A /end MEASUREMENT
/begin MEASUREMENT HARD_bDio_M_KM22_DCJY3 "HARD_bDio_M_KM22_DCJY3" UBYTE Bool_ON_OFF 1 2 0 1 BIT_MASK 0x01 ECU_ADDRESS 0x70013E29 /end MEASUREMENT
/begin MEASUREMENT HARD_bDio_M_KM23_DCJY4 "HARD_bDio_M_KM23_DCJY4" UBYTE Bool_ON_OFF 1 2 0 1 BIT_MASK 0x01 ECU_ADDRESS 0x70013E28 /end MEASUREMENT
/begin MEASUREMENT HARD_bDio_M_KM24_ZXFZ "HARD_bDio_M_KM24_ZXFZ" UBYTE Bool_ON_OFF 1 2 0 1 BIT_MASK 0x01 ECU_ADDRESS 0x70013E26 /end MEASUREMENT
/begin MEASUREMENT HARD_bDio_M_KM2_ZQ2 "HARD_bDio_M_KM2_ZQ2" UBYTE Bool_ON_OFF 1 2 0 1 BIT_MASK 0x01 ECU_ADDRESS 0x70013E3D /end MEASUREMENT
/begin MEASUREMENT HARD_bDio_M_KM3_ZQ3 "HARD_bDio_M_KM3_ZQ3" UBYTE Bool_ON_OFF 1 2 0 1 BIT_MASK 0x01 ECU_ADDRESS 0x70013E3C /end MEASUREMENT
/begin MEASUREMENT HARD_bDio_M_KM4_ZQ4 "HARD_bDio_M_KM4_ZQ4" UBYTE Bool_ON_OFF 1 2 0 1 BIT_MASK 0x01 ECU_ADDRESS 0x70013E3B /end MEASUREMENT
/begin MEASUREMENT HARD_bDio_M_KM5_KC1Z "HARD_bDio_M_KM5_KC1Z" UBYTE Bool_ON_OFF 1 2 0 1 BIT_MASK 0x01 ECU_ADDRESS 0x70013E41 /end MEASUREMENT
/begin MEASUREMENT HARD_bDio_M_KM6_KC1F "HARD_bDio_M_KM6_KC1F" UBYTE Bool_ON_OFF 1 2 0 1 BIT_MASK 0x01 ECU_ADDRESS 0x70013E40 /end MEASUREMENT
/begin MEASUREMENT HARD_bDio_M_KM7_KC1Z "HARD_bDio_M_KM7_KC1Z" UBYTE Bool_ON_OFF 1 2 0 1 BIT_MASK 0x01 ECU_ADDRESS 0x70013E4B /end MEASUREMENT
/begin MEASUREMENT HARD_bDio_M_KM8_KC2F "HARD_bDio_M_KM8_KC2F" UBYTE Bool_ON_OFF 1 2 0 1 BIT_MASK 0x01 ECU_ADDRESS 0x70013E35 /end MEASUREMENT
/begin MEASUREMENT HARD_bDio_M_KM9_KC2Z "HARD_bDio_M_KM9_KC2Z" UBYTE Bool_ON_OFF 1 2 0 1 BIT_MASK 0x01 ECU_ADDRESS 0x70013E36 /end MEASUREMENT
/begin MEASUREMENT HARD_bDio_M_PW_DOWN "HARD_bDio_M_PW_DOWN" UBYTE Bool_ON_OFF 1 2 0 1 BIT_MASK 0x01 ECU_ADDRESS 0x70013E3F /end MEASUREMENT
/begin MEASUREMENT HARD_bDio_M_Q1_DCJR1 "HARD_bDio_M_Q1_DCJR1" UBYTE Bool_ON_OFF 1 2 0 1 BIT_MASK 0x01 ECU_ADDRESS 0x70013E16 /end MEASUREMENT
/begin MEASUREMENT HARD_bDio_M_Q2_DCJR2 "HARD_bDio_M_Q2_DCJR2" UBYTE Bool_ON_OFF 1 2 0 1 BIT_MASK 0x01 ECU_ADDRESS 0x70013E15 /end MEASUREMENT
/begin MEASUREMENT HARD_bDio_M_Q3_DCJR3 "HARD_bDio_M_Q3_DCJR3" UBYTE Bool_ON_OFF 1 2 0 1 BIT_MASK 0x01 ECU_ADDRESS 0x70013E14 /end MEASUREMENT
/begin MEASUREMENT HARD_bDio_M_Q4_DCJR4 "HARD_bDio_M_Q4_DCJR4" UBYTE Bool_ON_OFF 1 2 0 1 BIT_MASK 0x01 ECU_ADDRESS 0x70013E13 /end MEASUREMENT
/begin MEASUREMENT HARD_bDio_M_Q5_PTC1 "HARD_bDio_M_Q5_PTC1" UBYTE Bool_ON_OFF 1 2 0 1 BIT_MASK 0x01 ECU_ADDRESS 0x70013E10 /end MEASUREMENT
/begin MEASUREMENT HARD_bDio_M_Q6_PTC2 "HARD_bDio_M_Q6_PTC2" UBYTE Bool_ON_OFF 1 2 0 1 BIT_MASK 0x01 ECU_ADDRESS 0x70013E4A /end MEASUREMENT
/begin MEASUREMENT HARD_bDio_M_SER "HARD_bDio_M_SER" UBYTE Bool_ON_OFF 1 2 0 1 BIT_MASK 0x01 ECU_ADDRESS 0x70013DFD /end MEASUREMENT
/begin MEASUREMENT HARD_bDio_M_SUPPLY_WDI "HARD_bDio_M_SUPPLY_WDI" UBYTE Bool_ON_OFF 1 2 0 1 BIT_MASK 0x01 ECU_ADDRESS 0x70013E20 /end MEASUREMENT
/begin MEASUREMENT HARD_bDio_M_YC1_ZQ_YC "HARD_bDio_M_YC1_ZQ_YC" UBYTE Bool_ON_OFF 1 2 0 1 BIT_MASK 0x01 ECU_ADDRESS 0x70013E17 /end MEASUREMENT
/begin MEASUREMENT HARD_bDio_M_YC2_KC3Z_YC "HARD_bDio_M_YC2_KC3Z_YC" UBYTE Bool_ON_OFF 1 2 0 1 BIT_MASK 0x01 ECU_ADDRESS 0x70013E33 /end MEASUREMENT
/begin MEASUREMENT HARD_bDio_M_YC3_KC4Z_YC "HARD_bDio_M_YC3_KC4Z_YC" UBYTE Bool_ON_OFF 1 2 0 1 BIT_MASK 0x01 ECU_ADDRESS 0x70013E1B /end MEASUREMENT
/begin MEASUREMENT HARD_bDio_M_YC4_SZ1_YC "HARD_bDio_M_YC4_SZ1_YC" UBYTE Bool_ON_OFF 1 2 0 1 BIT_MASK 0x01 ECU_ADDRESS 0x70013E01 /end MEASUREMENT
/begin MEASUREMENT HARD_bDio_M_YC5_SZ2_YC "HARD_bDio_M_YC5_SZ2_YC" UBYTE Bool_ON_OFF 1 2 0 1 BIT_MASK 0x01 ECU_ADDRESS 0x70013E27 /end MEASUREMENT
/begin MEASUREMENT HARD_bDio_M_YC6_XGLFZ_YC "HARD_bDio_M_YC6_XGLFZ_YC" UBYTE Bool_ON_OFF 1 2 0 1 BIT_MASK 0x01 ECU_ADDRESS 0x70013E0A /end MEASUREMENT
/begin MEASUREMENT HARD_bDio_M_YC7_ZXFZ_YC "HARD_bDio_M_YC7_ZXFZ_YC" UBYTE Bool_ON_OFF 1 2 0 1 BIT_MASK 0x01 ECU_ADDRESS 0x70013E18 /end MEASUREMENT
/begin MEASUREMENT HARD_bDio_PORT_11_PIN_2 "HARD_bDio_PORT_11_PIN_2" UBYTE Bool_ON_OFF 1 2 0 1 BIT_MASK 0x01 ECU_ADDRESS 0x70013E2D /end MEASUREMENT
/begin MEASUREMENT HARD_bDio_PORT_14_PIN_8 "HARD_bDio_PORT_14_PIN_8" UBYTE Bool_ON_OFF 1 2 0 1 BIT_MASK 0x01 ECU_ADDRESS 0x70013E1F /end MEASUREMENT
/begin MEASUREMENT HARD_bDio_Port_2_Pin_6 "HARD_bDio_Port_2_Pin_6" UBYTE Bool_ON_OFF 1 2 0 1 BIT_MASK 0x01 ECU_ADDRESS 0x70013E3A /end MEASUREMENT
/begin MEASUREMENT HARD_bESMCmdFtShutdownReq "HARD_bESMCmdFtShutdownReq" UBYTE Bool_ON_OFF 1 2 0 1 BIT_MASK 0x01 ECU_ADDRESS 0x70013D70 /end MEASUREMENT
/begin MEASUREMENT HARD_bESMCmdFtShutdownRes "HARD_bESMCmdFtShutdownRes" UBYTE Bool_ON_OFF 1 2 0 1 BIT_MASK 0x01 ECU_ADDRESS 0x70013D6F /end MEASUREMENT
/begin MEASUREMENT HARD_bESMCmdFtStartReq "HARD_bESMCmdFtStartReq" UBYTE Bool_ON_OFF 1 2 0 1 BIT_MASK 0x01 ECU_ADDRESS 0x70013D6E /end MEASUREMENT
/begin MEASUREMENT HARD_bESMCmdFtStartRes "HARD_bESMCmdFtStartRes" UBYTE Bool_ON_OFF 1 2 0 1 BIT_MASK 0x01 ECU_ADDRESS 0x70013D6D /end MEASUREMENT
/begin MEASUREMENT HARD_bESMCmdPwmDirectReq "HARD_bESMCmdPwmDirectReq" UBYTE Bool_ON_OFF 1 2 0 1 BIT_MASK 0x01 ECU_ADDRESS 0x70013D6C /end MEASUREMENT
/begin MEASUREMENT HARD_bESMCmdPwmDirectRes "HARD_bESMCmdPwmDirectRes" UBYTE Bool_ON_OFF 1 2 0 1 BIT_MASK 0x01 ECU_ADDRESS 0x70013D6B /end MEASUREMENT
/begin MEASUREMENT HARD_bESMCmdPwmHardReq "HARD_bESMCmdPwmHardReq" UBYTE Bool_ON_OFF 1 2 0 1 BIT_MASK 0x01 ECU_ADDRESS 0x70013D6A /end MEASUREMENT
/begin MEASUREMENT HARD_bESMCmdPwmHardRes "HARD_bESMCmdPwmHardRes" UBYTE Bool_ON_OFF 1 2 0 1 BIT_MASK 0x01 ECU_ADDRESS 0x70013D69 /end MEASUREMENT
/begin MEASUREMENT HARD_bESMCmdPwmOffReq "HARD_bESMCmdPwmOffReq" UBYTE Bool_ON_OFF 1 2 0 1 BIT_MASK 0x01 ECU_ADDRESS 0x70013D68 /end MEASUREMENT
/begin MEASUREMENT HARD_bESMCmdPwmOffRes "HARD_bESMCmdPwmOffRes" UBYTE Bool_ON_OFF 1 2 0 1 BIT_MASK 0x01 ECU_ADDRESS 0x70013D67 /end MEASUREMENT
/begin MEASUREMENT HARD_bESMCmdSwShutdownReq "HARD_bESMCmdSwShutdownReq" UBYTE Bool_ON_OFF 1 2 0 1 BIT_MASK 0x01 ECU_ADDRESS 0x70013D66 /end MEASUREMENT
/begin MEASUREMENT HARD_bESMCmdSwShutdownRes "HARD_bESMCmdSwShutdownRes" UBYTE Bool_ON_OFF 1 2 0 1 BIT_MASK 0x01 ECU_ADDRESS 0x70013D65 /end MEASUREMENT
/begin MEASUREMENT HARD_bESMCmdSwStartReq "HARD_bESMCmdSwStartReq" UBYTE Bool_ON_OFF 1 2 0 1 BIT_MASK 0x01 ECU_ADDRESS 0x70013D64 /end MEASUREMENT
/begin MEASUREMENT HARD_bESMCmdSwStartRes "HARD_bESMCmdSwStartRes" UBYTE Bool_ON_OFF 1 2 0 1 BIT_MASK 0x01 ECU_ADDRESS 0x70013D63 /end MEASUREMENT
/begin MEASUREMENT HARD_bModSeq1FuncOn "Mode fonctionnel Hard mode #1: Functional stage: Test CEM traction (20/10/2015)" UBYTE Bool_ON_OFF 1 2 0 1 BIT_MASK 0x01 ECU_ADDRESS 0x70013D62 /end MEASUREMENT
/begin MEASUREMENT HARD_bModSeq1InitOn "Mode fonctionnel Hard mode #1: Initialization stage : Test CEM traction (20/10/2015)" UBYTE Bool_ON_OFF 1 2 0 1 BIT_MASK 0x01 ECU_ADDRESS 0x70013D61 /end MEASUREMENT
/begin MEASUREMENT HARD_bModSeq2FuncOn "Mode fonctionnel Hard mode #2: Functional stage: Test xx (xx/xx/xxxx)" UBYTE Bool_ON_OFF 1 2 0 1 BIT_MASK 0x01 ECU_ADDRESS 0x70013D60 /end MEASUREMENT
/begin MEASUREMENT HARD_bModSeq2InitOn "Mode fonctionnel Hard mode #2: Initialization stage : Test xx (xx/xx/xxxx)" UBYTE Bool_ON_OFF 1 2 0 1 BIT_MASK 0x01 ECU_ADDRESS 0x70013D5F /end MEASUREMENT
/begin MEASUREMENT HARD_bNMTestOn "Nm Test on" UBYTE Bool_ON_OFF 1 2 0 1 BIT_MASK 0x01 ECU_ADDRESS 0x70013D5D /end MEASUREMENT
/begin MEASUREMENT HARD_bPtgEnable "HARD_bPtgEnable" UBYTE Bool_ON_OFF 1 2 0 1 BIT_MASK 0x01 ECU_ADDRESS 0x70013D5B /end MEASUREMENT
/begin MEASUREMENT HARD_bPtgSignalsShiftControl "HARD_bPtgSignalsShiftControl" UBYTE Bool_ON_OFF 1 2 0 1 BIT_MASK 0x01 ECU_ADDRESS 0x70013D5A /end MEASUREMENT
/begin MEASUREMENT HARD_bPtgUSignalEnable "HARD_bPtgUSignalEnable" UBYTE Bool_ON_OFF 1 2 0 1 BIT_MASK 0x01 ECU_ADDRESS 0x70013D59 /end MEASUREMENT
/begin MEASUREMENT HARD_bPtgVSignalEnable "HARD_bPtgVSignalEnable" UBYTE Bool_ON_OFF 1 2 0 1 BIT_MASK 0x01 ECU_ADDRESS 0x70013D58 /end MEASUREMENT
/begin MEASUREMENT HARD_bPtgWSignalEnable "HARD_bPtgWSignalEnable" UBYTE Bool_ON_OFF 1 2 0 1 BIT_MASK 0x01 ECU_ADDRESS 0x70013D57 /end MEASUREMENT
/begin MEASUREMENT HARD_s16PtgRefSignalValue "HARD_s16PtgRefSignalValue" SWORD I_1 1 2 -32768 32767 ECU_ADDRESS 0x70013D4E /end MEASUREMENT
/begin MEASUREMENT HARD_s16PtgUSignalValue "HARD_s16PtgUSignalValue" SWORD I_1 1 2 -32768 32767 ECU_ADDRESS 0x70013D4C /end MEASUREMENT
/begin MEASUREMENT HARD_s16PtgVSignalValue "HARD_s16PtgVSignalValue" SWORD I_1 1 2 -32768 32767 ECU_ADDRESS 0x70013D4A /end MEASUREMENT
/begin MEASUREMENT HARD_s16PtgWSignalValue "HARD_s16PtgWSignalValue" SWORD I_1 1 2 -32768 32767 ECU_ADDRESS 0x70013D48 /end MEASUREMENT
/begin MEASUREMENT HARD_u16Adc0An10_CTN_BOARD2Phys "HARD_u16Adc0An10_CTN_BOARD2Phys" UBYTE F_1_m40_22 1 2 -40 215 ECU_ADDRESS 0x70013D53 /end MEASUREMENT
/begin MEASUREMENT HARD_u16Adc_AN_15V_RDC "HARD_u16Adc_AN_15V_RDC" UWORD I_1 1 2 0 65535 ECU_ADDRESS 0x70013DDC /end MEASUREMENT
/begin MEASUREMENT HARD_u16Adc_AN_P5V_AD2S "HARD_u16Adc_AN_P5V_AD2S" UWORD I_1 1 2 0 65535 ECU_ADDRESS 0x70013DD2 /end MEASUREMENT
/begin MEASUREMENT HARD_u16Adc_AN_P5V_REF "HARD_u16Adc_AN_P5V_REF" UWORD I_1 1 2 0 65535 ECU_ADDRESS 0x70013DC4 /end MEASUREMENT
/begin MEASUREMENT HARD_u16Adc_AN_VOL_DCLINK_DRV "HARD_u16Adc_AN_VOL_DCLINK_DRV" UWORD I_1 1 2 0 65535 ECU_ADDRESS 0x70013DEE /end MEASUREMENT
/begin MEASUREMENT HARD_u16Adc_M_ACM_AN_CURRENT_U "HARD_u16Adc_M_ACM_AN_CURRENT_U" UWORD I_1 1 2 0 65535 ECU_ADDRESS 0x70013DDE /end MEASUREMENT
/begin MEASUREMENT HARD_u16Adc_M_ACM_AN_CURRENT_V "HARD_u16Adc_M_ACM_AN_CURRENT_V" UWORD I_1 1 2 0 65535 ECU_ADDRESS 0x70013DE0 /end MEASUREMENT
/begin MEASUREMENT HARD_u16Adc_M_ACM_AN_CURRENT_W "HARD_u16Adc_M_ACM_AN_CURRENT_W" UWORD I_1 1 2 0 65535 ECU_ADDRESS 0x70013DE6 /end MEASUREMENT
/begin MEASUREMENT HARD_u16Adc_M_ACM_TEMP_MEAS_MOD_V "HARD_u16Adc_M_ACM_TEMP_MEAS_MOD_V" UWORD I_1 1 2 0 65535 ECU_ADDRESS 0x70013DB0 /end MEASUREMENT
/begin MEASUREMENT HARD_u16Adc_M_ACM_TEMP_MEAS_MOD_W "HARD_u16Adc_M_ACM_TEMP_MEAS_MOD_W" UWORD I_1 1 2 0 65535 ECU_ADDRESS 0x70013DAE /end MEASUREMENT
/begin MEASUREMENT HARD_u16Adc_M_AN_CURRENT_U_1 "HARD_u16Adc_M_AN_CURRENT_U_1" UWORD I_1 1 2 0 65535 ECU_ADDRESS 0x70013DA4 /end MEASUREMENT
/begin MEASUREMENT HARD_u16Adc_M_AN_CURRENT_U_2 "HARD_u16Adc_M_AN_CURRENT_U_2" UWORD I_1 1 2 0 65535 ECU_ADDRESS 0x70013DBE /end MEASUREMENT
/begin MEASUREMENT HARD_u16Adc_M_AN_CURRENT_V_1 "HARD_u16Adc_M_AN_CURRENT_V_1" UWORD I_1 1 2 0 65535 ECU_ADDRESS 0x70013DA8 /end MEASUREMENT
/begin MEASUREMENT HARD_u16Adc_M_AN_CURRENT_V_2 "HARD_u16Adc_M_AN_CURRENT_V_2" UWORD I_1 1 2 0 65535 ECU_ADDRESS 0x70013DC0 /end MEASUREMENT
/begin MEASUREMENT HARD_u16Adc_M_AN_CURRENT_W_1 "HARD_u16Adc_M_AN_CURRENT_W_1" UWORD I_1 1 2 0 65535 ECU_ADDRESS 0x70013DAA /end MEASUREMENT
/begin MEASUREMENT HARD_u16Adc_M_AN_CURRENT_W_2 "HARD_u16Adc_M_AN_CURRENT_W_2" UWORD I_1 1 2 0 65535 ECU_ADDRESS 0x70013DC2 /end MEASUREMENT
/begin MEASUREMENT HARD_u16Adc_M_AN_DC_LINK_PACK1 "HARD_u16Adc_M_AN_DC_LINK_PACK1" UWORD I_1 1 2 0 65535 ECU_ADDRESS 0x70013DA0 /end MEASUREMENT
/begin MEASUREMENT HARD_u16Adc_M_AN_DC_LINK_PACK2 "HARD_u16Adc_M_AN_DC_LINK_PACK2" UWORD I_1 1 2 0 65535 ECU_ADDRESS 0x70013DA2 /end MEASUREMENT
/begin MEASUREMENT HARD_u16Adc_M_AN_DC_LINK_PACK3 "HARD_u16Adc_M_AN_DC_LINK_PACK3" UWORD I_1 1 2 0 65535 ECU_ADDRESS 0x70013DA6 /end MEASUREMENT
/begin MEASUREMENT HARD_u16Adc_M_AN_DC_LINK_PACK4 "HARD_u16Adc_M_AN_DC_LINK_PACK4" UWORD I_1 1 2 0 65535 ECU_ADDRESS 0x70013DAC /end MEASUREMENT
/begin MEASUREMENT HARD_u16Adc_M_AN_DIAG_COS_H_1 "HARD_u16Adc_M_AN_DIAG_COS_H_1" UWORD I_1 1 2 0 65535 ECU_ADDRESS 0x70013DCE /end MEASUREMENT
/begin MEASUREMENT HARD_u16Adc_M_AN_DIAG_COS_H_2 "HARD_u16Adc_M_AN_DIAG_COS_H_2" UWORD I_1 1 2 0 65535 ECU_ADDRESS 0x70013DBC /end MEASUREMENT
/begin MEASUREMENT HARD_u16Adc_M_AN_DIAG_COS_L_1 "HARD_u16Adc_M_AN_DIAG_COS_L_1" UWORD I_1 1 2 0 65535 ECU_ADDRESS 0x70013DD0 /end MEASUREMENT
/begin MEASUREMENT HARD_u16Adc_M_AN_DIAG_COS_L_2 "HARD_u16Adc_M_AN_DIAG_COS_L_2" UWORD I_1 1 2 0 65535 ECU_ADDRESS 0x70013DBA /end MEASUREMENT
/begin MEASUREMENT HARD_u16Adc_M_AN_DIAG_SIN_H_1 "HARD_u16Adc_M_AN_DIAG_SIN_H_1" UWORD I_1 1 2 0 65535 ECU_ADDRESS 0x70013DD4 /end MEASUREMENT
/begin MEASUREMENT HARD_u16Adc_M_AN_DIAG_SIN_H_2 "HARD_u16Adc_M_AN_DIAG_SIN_H_2" UWORD I_1 1 2 0 65535 ECU_ADDRESS 0x70013DD6 /end MEASUREMENT
/begin MEASUREMENT HARD_u16Adc_M_AN_DIAG_SIN_L_1 "HARD_u16Adc_M_AN_DIAG_SIN_L_1" UWORD I_1 1 2 0 65535 ECU_ADDRESS 0x70013DDA /end MEASUREMENT
/begin MEASUREMENT HARD_u16Adc_M_AN_DIAG_SIN_L_2 "HARD_u16Adc_M_AN_DIAG_SIN_L_2" UWORD I_1 1 2 0 65535 ECU_ADDRESS 0x70013DD8 /end MEASUREMENT
/begin MEASUREMENT HARD_u16Adc_M_AN_KM10_FB_KC3F "HARD_u16Adc_M_AN_KM10_FB_KC3F" UWORD I_1 1 2 0 65535 ECU_ADDRESS 0x70013D9C /end MEASUREMENT
/begin MEASUREMENT HARD_u16Adc_M_AN_KM12_FB_KC4F "HARD_u16Adc_M_AN_KM12_FB_KC4F" UWORD I_1 1 2 0 65535 ECU_ADDRESS 0x70013D9E /end MEASUREMENT
/begin MEASUREMENT HARD_u16Adc_M_AN_KM6_FB_KC1F "HARD_u16Adc_M_AN_KM6_FB_KC1F" UWORD I_1 1 2 0 65535 ECU_ADDRESS 0x70013D98 /end MEASUREMENT
/begin MEASUREMENT HARD_u16Adc_M_AN_KM8_FB_KC2F "HARD_u16Adc_M_AN_KM8_FB_KC2F" UWORD I_1 1 2 0 65535 ECU_ADDRESS 0x70013D9A /end MEASUREMENT
/begin MEASUREMENT HARD_u16Adc_M_AN_MOT_COS_1 "HARD_u16Adc_M_AN_MOT_COS_1" UWORD I_1 1 2 0 65535 ECU_ADDRESS 0x70013D94 /end MEASUREMENT
/begin MEASUREMENT HARD_u16Adc_M_AN_MOT_COS_2 "HARD_u16Adc_M_AN_MOT_COS_2" UWORD I_1 1 2 0 65535 ECU_ADDRESS 0x70013DB2 /end MEASUREMENT
/begin MEASUREMENT HARD_u16Adc_M_AN_MOT_SIN_1 "HARD_u16Adc_M_AN_MOT_SIN_1" UWORD I_1 1 2 0 65535 ECU_ADDRESS 0x70013D96 /end MEASUREMENT
/begin MEASUREMENT HARD_u16Adc_M_AN_MOT_SIN_2 "HARD_u16Adc_M_AN_MOT_SIN_2" UWORD I_1 1 2 0 65535 ECU_ADDRESS 0x70013DB4 /end MEASUREMENT
/begin MEASUREMENT HARD_u16Adc_M_AN_MUX1 "HARD_u16Adc_M_AN_MUX1" UWORD I_1 1 2 0 65535 ECU_ADDRESS 0x70013DC6 /end MEASUREMENT
/begin MEASUREMENT HARD_u16Adc_M_AN_MUX2 "HARD_u16Adc_M_AN_MUX2" UWORD I_1 1 2 0 65535 ECU_ADDRESS 0x70013DC8 /end MEASUREMENT
/begin MEASUREMENT HARD_u16Adc_M_AN_MUX3 "HARD_u16Adc_M_AN_MUX3" UWORD I_1 1 2 0 65535 ECU_ADDRESS 0x70013DCC /end MEASUREMENT
/begin MEASUREMENT HARD_u16Adc_M_AN_MUX4 "HARD_u16Adc_M_AN_MUX4" UWORD I_1 1 2 0 65535 ECU_ADDRESS 0x70013DCA /end MEASUREMENT
/begin MEASUREMENT HARD_u16Adc_M_AN_MUX6 "HARD_u16Adc_M_AN_MUX6" UWORD I_1 1 2 0 65535 ECU_ADDRESS 0x70013DEA /end MEASUREMENT
/begin MEASUREMENT HARD_u16Adc_M_AN_MUX7 "HARD_u16Adc_M_AN_MUX7" UWORD I_1 1 2 0 65535 ECU_ADDRESS 0x70013DEC /end MEASUREMENT
/begin MEASUREMENT HARD_u16Adc_M_EPS_AN_CURRENT_U "HARD_u16Adc_M_EPS_AN_CURRENT_U" UWORD I_1 1 2 0 65535 ECU_ADDRESS 0x70013DE2 /end MEASUREMENT
/begin MEASUREMENT HARD_u16Adc_M_EPS_AN_CURRENT_V "HARD_u16Adc_M_EPS_AN_CURRENT_V" UWORD I_1 1 2 0 65535 ECU_ADDRESS 0x70013DE4 /end MEASUREMENT
/begin MEASUREMENT HARD_u16Adc_M_EPS_AN_CURRENT_W "HARD_u16Adc_M_EPS_AN_CURRENT_W" UWORD I_1 1 2 0 65535 ECU_ADDRESS 0x70013DE8 /end MEASUREMENT
/begin MEASUREMENT HARD_u16Adc_M_EPS_TEMP_MEAS_MOD_V "HARD_u16Adc_M_EPS_TEMP_MEAS_MOD_V" UWORD I_1 1 2 0 65535 ECU_ADDRESS 0x70013DB8 /end MEASUREMENT
/begin MEASUREMENT HARD_u16Adc_M_EPS_TEMP_MEAS_MOD_W "HARD_u16Adc_M_EPS_TEMP_MEAS_MOD_W" UWORD I_1 1 2 0 65535 ECU_ADDRESS 0x70013DB6 /end MEASUREMENT
/begin MEASUREMENT HARD_u16Adc_M_TEMP_MEAS_MOD_W_2 "HARD_u16Adc_M_TEMP_MEAS_MOD_W_2" UWORD I_1 1 2 0 65535 ECU_ADDRESS 0x70013DF0 /end MEASUREMENT
/begin MEASUREMENT HARD_u16PtgRefSignalNbPeriode "HARD_u16PtgRefSignalNbPeriode" UWORD I_1 1 2 0 65535 ECU_ADDRESS 0x70013D46 /end MEASUREMENT
/begin MEASUREMENT HARD_u16PtgRefSignalTime "HARD_u16PtgRefSignalTime" UWORD I_1 1 2 0 65535 ECU_ADDRESS 0x70013D44 /end MEASUREMENT
/begin MEASUREMENT HARD_u16PtgUSignalNbPeriode "HARD_u16PtgUSignalNbPeriode" UWORD I_1 1 2 0 65535 ECU_ADDRESS 0x70013D42 /end MEASUREMENT
/begin MEASUREMENT HARD_u16PtgUSignalTime "HARD_u16PtgUSignalTime" UWORD I_1 1 2 0 65535 ECU_ADDRESS 0x70013D40 /end MEASUREMENT
/begin MEASUREMENT HARD_u16PtgVSignalNbPeriode "HARD_u16PtgVSignalNbPeriode" UWORD I_1 1 2 0 65535 ECU_ADDRESS 0x70013D3E /end MEASUREMENT
/begin MEASUREMENT HARD_u16PtgVSignalTime "HARD_u16PtgVSignalTime" UWORD I_1 1 2 0 65535 ECU_ADDRESS 0x70013D3C /end MEASUREMENT
/begin MEASUREMENT HARD_u16PtgWSignalNbPeriode "HARD_u16PtgWSignalNbPeriode" UWORD I_1 1 2 0 65535 ECU_ADDRESS 0x70013D3A /end MEASUREMENT
/begin MEASUREMENT HARD_u16PtgWSignalTime "HARD_u16PtgWSignalTime" UWORD I_1 1 2 0 65535 ECU_ADDRESS 0x70013D38 /end MEASUREMENT
/begin MEASUREMENT HARD_u8VSIRxaTempCtrlBdPhys "Physical value of MAIN_VSIRxaTempCtrlBd" UBYTE F_1_m40_22 1 2 -40 215 ECU_ADDRESS 0x70013D52 /end MEASUREMENT
/begin MEASUREMENT HARD_u8VSIRxaTempDrvBdPhys "Physical value of MAIN_VSIRxaTempDrvBd (MAJ OC140)" UBYTE F_1_m40_22 1 2 -40 215 ECU_ADDRESS 0x70013D51 /end MEASUREMENT
/begin MEASUREMENT HARD_u8VSIRxaTempIgbtPhys "Physical value of MAIN_VSIRxaTempIgbt (MAJ OC140)" UBYTE F_1_m40_22 1 2 -40 215 ECU_ADDRESS 0x70013D50 /end MEASUREMENT
/begin COMPU_METHOD I_1 "" RAT_FUNC "%9.2" "-" COEFFS 0 1 0 0 0 1 /end COMPU_METHOD
/begin COMPU_METHOD F_1_p0_2 "" RAT_FUNC "%9.2" "-" COEFFS 0 1 0 0 0 1 /end COMPU_METHOD
/begin COMPU_METHOD I_7 "" RAT_FUNC "%9.2" "V" COEFFS 0 1 0 0 0 1 /end COMPU_METHOD
/begin COMPU_METHOD F_0v0030518044_p0_19 "" RAT_FUNC "%9.3" "%" COEFFS 0 1 0 0 0 0.0030518 /end COMPU_METHOD
/begin COMPU_METHOD F_0v0015259022_p0_20 "" RAT_FUNC "%9.3" "%" COEFFS 0 1 0 0 0 0.0015259 /end COMPU_METHOD
/begin COMPU_METHOD D_2_0v01_p0_21 "" RAT_FUNC "%9.2" "%" COEFFS 0 0 1 0 0.01 0 /end COMPU_METHOD
/begin COMPU_METHOD F_1_m40_22 "" RAT_FUNC "%9.2" "ï¿½C" COEFFS 0 1 40 0 0 1 /end COMPU_METHOD
/begin COMPU_METHOD F_0v0000305176_p0_23 "" RAT_FUNC "%9.5" "PI/RAD" COEFFS 0 1 0 0 0 3.05176e-005 /end COMPU_METHOD
/begin COMPU_METHOD Bool_ON_OFF "" TAB_VERB "%8.4" "." COMPU_TAB_REF Bool_ON_OFF_table /end COMPU_METHOD
/begin COMPU_VTAB Bool_ON_OFF_table "" TAB_VERB 2 0 "OFF" 1 "ON" /end COMPU_VTAB
/begin FUNCTION FAULT ""
 /begin DEF_CHARACTERISTIC FaultBSW_COM_BusOff_CAN1Dec FaultBSW_COM_BusOff_CAN1FailMod FaultBSW_COM_BusOff_CAN1Inc FaultBSW_COM_ChecksumErrVCUDec FaultBSW_COM_ChecksumErrVCUFailMod FaultBSW_COM_ChecksumErrVCUInc FaultBSW_COM_InterFaultVCUDec FaultBSW_COM_InterFaultVCUFailMod FaultBSW_COM_InterFaultVCUInc FaultBSW_COM_RollCntErrVCUDec FaultBSW_COM_RollCntErrVCUFailMod FaultBSW_COM_RollCntErrVCUInc FaultBSW_COM_TimoutRxBCMDec FaultBSW_COM_TimoutRxBCMFailMod FaultBSW_COM_TimoutRxBCMInc FaultBSW_COM_TimoutRxBMSHDec FaultBSW_COM_TimoutRxBMSHFailMod FaultBSW_COM_TimoutRxBMSHInc FaultBSW_COM_TimoutRxEMSDec FaultBSW_COM_TimoutRxEMSFailMod FaultBSW_COM_TimoutRxEMSInc FaultBSW_COM_TimoutRxGCUDec FaultBSW_COM_TimoutRxGCUFailMod FaultBSW_COM_TimoutRxGCUInc FaultBSW_COM_TimoutRxIPCDec FaultBSW_COM_TimoutRxIPCFailMod FaultBSW_COM_TimoutRxIPCInc FaultBSW_COM_TimoutRxTBOXDec FaultBSW_COM_TimoutRxTBOXFailMod FaultBSW_COM_TimoutRxTBOXInc FaultBSW_COM_TimoutRxVCUDec FaultBSW_COM_TimoutRxVCUFailMod FaultBSW_COM_TimoutRxVCUInc FaultBSW_HW2_FPGA_OverVoltVBatDec FaultBSW_HW2_FPGA_OverVoltVBatFailMod FaultBSW_HW2_FPGA_OverVoltVBatInc FaultBSW_HW2_SafeTlib_PreRunDec FaultBSW_HW2_SafeTlib_PreRunFailMod FaultBSW_HW2_SafeTlib_PreRunInc FaultBSW_HW_EasAckFailDec FaultBSW_HW_EasAckFailFailMod FaultBSW_HW_EasAckFailInc FaultBSW_HW_FPGA_IGBT_HDec FaultBSW_HW_FPGA_IGBT_HFailMod FaultBSW_HW_FPGA_IGBT_HInc FaultBSW_HW_FPGA_IGBT_LDec FaultBSW_HW_FPGA_IGBT_LFailMod FaultBSW_HW_FPGA_IGBT_LInc FaultBSW_HW_FPGA_OverUnderCurUIDec FaultBSW_HW_FPGA_OverUnderCurUIFailMod FaultBSW_HW_FPGA_OverUnderCurUIInc FaultBSW_HW_FPGA_OverUnderCurVIDec FaultBSW_HW_FPGA_OverUnderCurVIFailMod FaultBSW_HW_FPGA_OverUnderCurVIInc FaultBSW_HW_FPGA_OverUnderCurWIDec FaultBSW_HW_FPGA_OverUnderCurWIFailMod FaultBSW_HW_FPGA_OverUnderCurWIInc FaultBSW_HW_OCDataNotRationalDec FaultBSW_HW_OCDataNotRationalFailMod FaultBSW_HW_OCDataNotRationalInc FaultBSW_SYS_RstHotDec FaultBSW_SYS_RstHotFailMod FaultBSW_SYS_RstHotInc FaultBSW_SYS_StackOverflowDec FaultBSW_SYS_StackOverflowFailMod FaultBSW_SYS_StackOverflowInc FaultBSW_VSI_TimeoutTCalcDec FaultBSW_VSI_TimeoutTCalcFailMod FaultBSW_VSI_TimeoutTCalcInc FaultFSEVBHV_OverVoltageDec FaultFSEVBHV_OverVoltageFailMod FaultFSEVBHV_OverVoltageInc FaultFSEVBHV_SampleVolOutRngHDec FaultFSEVBHV_SampleVolOutRngHFailMod FaultFSEVBHV_SampleVolOutRngHInc FaultFSEVBHV_SampleVolOutRngLDec FaultFSEVBHV_SampleVolOutRngLFailMod FaultFSEVBHV_SampleVolOutRngLInc FaultFSEVBHV_UnderVoltageDec FaultFSEVBHV_UnderVoltageFailMod FaultFSEVBHV_UnderVoltageInc FaultFSEVBHV_UnderVoltageWarnDec FaultFSEVBHV_UnderVoltageWarnFailMod FaultFSEVBHV_UnderVoltageWarnInc FaultFSEVBHV_VolNotRationalDec FaultFSEVBHV_VolNotRationalFailMod FaultFSEVBHV_VolNotRationalInc FaultFSEVBHV_VoltageGndDec FaultFSEVBHV_VoltageGndFailMod FaultFSEVBHV_VoltageGndInc FaultFSEVBHV_VoltageVccDec FaultFSEVBHV_VoltageVccFailMod FaultFSEVBHV_VoltageVccInc FaultFSEVBLV_OverVoltageDec FaultFSEVBLV_OverVoltageFailMod FaultFSEVBLV_OverVoltageInc FaultFSEVBLV_P5VRefADCFltDec FaultFSEVBLV_P5VRefADCFltFailMod FaultFSEVBLV_P5VRefADCFltInc FaultFSEVBLV_UnderVoltageDec FaultFSEVBLV_UnderVoltageFailMod FaultFSEVBLV_UnderVoltageInc FaultFSEVBLV_UnderVoltageWarnDec FaultFSEVBLV_UnderVoltageWarnFailMod FaultFSEVBLV_UnderVoltageWarnInc FaultFSEVBLV_VoltageGndDec FaultFSEVBLV_VoltageGndFailMod FaultFSEVBLV_VoltageGndInc FaultFSEVBLV_VoltageVccDec FaultFSEVBLV_VoltageVccFailMod FaultFSEVBLV_VoltageVccInc FaultFSEVETA_DrvTempRationDec FaultFSEVETA_DrvTempRationFailMod FaultFSEVETA_DrvTempRationInc FaultFSEVETA_IgbtTempRationalDec FaultFSEVETA_IgbtTempRationalFailMod FaultFSEVETA_IgbtTempRationalInc FaultFSEVETA_OverTempDrvLeftDec FaultFSEVETA_OverTempDrvLeftFailMod FaultFSEVETA_OverTempDrvLeftInc FaultFSEVETA_OverTempIgbtLeftDec FaultFSEVETA_OverTempIgbtLeftFailMod FaultFSEVETA_OverTempIgbtLeftInc FaultFSEVETA_OverTempNTC1CmdBoardDec FaultFSEVETA_OverTempNTC1CmdBoardFailMod FaultFSEVETA_OverTempNTC1CmdBoardInc FaultFSEVETA_SampleIgbtTempOutRngHDec FaultFSEVETA_SampleIgbtTempOutRngHFailMod FaultFSEVETA_SampleIgbtTempOutRngHInc FaultFSEVETA_SampleIgbtTempOutRngLDec FaultFSEVETA_SampleIgbtTempOutRngLFailMod FaultFSEVETA_SampleIgbtTempOutRngLInc FaultFSEVETA_TempDrvBoardLeftGndDec FaultFSEVETA_TempDrvBoardLeftGndFailMod FaultFSEVETA_TempDrvBoardLeftGndInc FaultFSEVETA_TempDrvBoardLeftVccDec FaultFSEVETA_TempDrvBoardLeftVccFailMod FaultFSEVETA_TempDrvBoardLeftVccInc FaultFSEVETA_TempIgbtLeftGndDec FaultFSEVETA_TempIgbtLeftGndFailMod FaultFSEVETA_TempIgbtLeftGndInc FaultFSEVETA_TempIgbtLeftVccDec FaultFSEVETA_TempIgbtLeftVccFailMod FaultFSEVETA_TempIgbtLeftVccInc FaultFSEVETA_TempNTC1CmdBoardGndDec FaultFSEVETA_TempNTC1CmdBoardGndFailMod FaultFSEVETA_TempNTC1CmdBoardGndInc FaultFSEVETA_TempNTC1CmdBoardVccDec FaultFSEVETA_TempNTC1CmdBoardVccFailMod FaultFSEVETA_TempNTC1CmdBoardVccInc FaultFSEVETA_UnderTempDrvLeftDec FaultFSEVETA_UnderTempDrvLeftFailMod FaultFSEVETA_UnderTempDrvLeftInc FaultFSEVETA_UnderTempIgbtLeftDec FaultFSEVETA_UnderTempIgbtLeftFailMod FaultFSEVETA_UnderTempIgbtLeftInc FaultFSEVETA_UnderTempNTC1CmdBoardDec FaultFSEVETA_UnderTempNTC1CmdBoardFailMod FaultFSEVETA_UnderTempNTC1CmdBoardInc FaultFSMTMTA_OverTempWdgHead1Dec FaultFSMTMTA_OverTempWdgHead1FailMod FaultFSMTMTA_OverTempWdgHead1Inc FaultFSMTMTA_TempWindHead1OutRngHDec FaultFSMTMTA_TempWindHead1OutRngHFailMod FaultFSMTMTA_TempWindHead1OutRngHInc FaultFSMTMTA_TempWindHead1OutRngLDec FaultFSMTMTA_TempWindHead1OutRngLFailMod FaultFSMTMTA_TempWindHead1OutRngLInc FaultFSMTMTA_TempWindingHead1GndDec FaultFSMTMTA_TempWindingHead1GndFailMod FaultFSMTMTA_TempWindingHead1GndInc FaultFSMTMTA_TempWindingHead1VccDec FaultFSMTMTA_TempWindingHead1VccFailMod FaultFSMTMTA_TempWindingHead1VccInc FaultFSMTMTA_UnderTempWdgHead1Dec FaultFSMTMTA_UnderTempWdgHead1FailMod FaultFSMTMTA_UnderTempWdgHead1Inc FaultFSMTRDG_ExcGenerationDec FaultFSMTRDG_ExcGenerationFailMod FaultFSMTRDG_ExcGenerationInc FaultFSMTRDG_ExcSignalGNDDec FaultFSMTRDG_ExcSignalGNDFailMod FaultFSMTRDG_ExcSignalGNDInc FaultFSMTRDG_ExcSignalVCCDec FaultFSMTRDG_ExcSignalVCCFailMod FaultFSMTRDG_ExcSignalVCCInc FaultFSMTRDG_SinCosHLGndDec FaultFSMTRDG_SinCosHLGndFailMod FaultFSMTRDG_SinCosHLGndInc FaultFSMTRDG_SinCosHLOpenDec FaultFSMTRDG_SinCosHLOpenFailMod FaultFSMTRDG_SinCosHLOpenInc FaultFSMTRDG_SinCosHLVccDec FaultFSMTRDG_SinCosHLVccFailMod FaultFSMTRDG_SinCosHLVccInc FaultFSSMACS_AkdFailFlagDec FaultFSSMACS_AkdFailFlagFailMod FaultFSSMACS_AkdFailFlagInc FaultFTASBDS_BattVoltDeratingActDec FaultFTASBDS_BattVoltDeratingActFailMod FaultFTASBDS_BattVoltDeratingActInc FaultFTASETP_EstPmDeratingActDec FaultFTASETP_EstPmDeratingActFailMod FaultFTASETP_EstPmDeratingActInc FaultFTASETP_PmDeratingActDec FaultFTASETP_PmDeratingActFailMod FaultFTASETP_PmDeratingActInc FaultFTASMTP_Wndg1DeratingActDec FaultFTASMTP_Wndg1DeratingActFailMod FaultFTASMTP_Wndg1DeratingActInc FaultFTASOSP_MotorSpdDeratingActDec FaultFTASOSP_MotorSpdDeratingActFailMod FaultFTASOSP_MotorSpdDeratingActInc FaultFTCMSCS_CtrlSatTimoutDec FaultFTCMSCS_CtrlSatTimoutFailMod FaultFTCMSCS_CtrlSatTimoutInc FaultFTCMSCS_SpdOvershootDec FaultFTCMSCS_SpdOvershootFailMod FaultFTCMSCS_SpdOvershootInc FaultFTCMSCS_ZeroSpeedTimoutDec FaultFTCMSCS_ZeroSpeedTimoutFailMod FaultFTCMSCS_ZeroSpeedTimoutInc FaultFTCMTCS_VoltageMarginLowDec FaultFTCMTCS_VoltageMarginLowFailMod FaultFTCMTCS_VoltageMarginLowInc FaultFTEVEIT_EstOverTempDec FaultFTEVEIT_EstOverTempFailMod FaultFTEVEIT_EstOverTempInc FaultFTMTLCS_CurrentSumErrorDec FaultFTMTLCS_CurrentSumErrorFailMod FaultFTMTLCS_CurrentSumErrorInc FaultFTMTLCS_CurSenrPhaU_GNDDec FaultFTMTLCS_CurSenrPhaU_GNDFailMod FaultFTMTLCS_CurSenrPhaU_GNDInc FaultFTMTLCS_CurSenrPhaU_OutRngHDec FaultFTMTLCS_CurSenrPhaU_OutRngHFailMod FaultFTMTLCS_CurSenrPhaU_OutRngHInc FaultFTMTLCS_CurSenrPhaU_OutRngLDec FaultFTMTLCS_CurSenrPhaU_OutRngLFailMod FaultFTMTLCS_CurSenrPhaU_OutRngLInc FaultFTMTLCS_CurSenrPhaU_VCCDec FaultFTMTLCS_CurSenrPhaU_VCCFailMod FaultFTMTLCS_CurSenrPhaU_VCCInc FaultFTMTLCS_CurSenrPhaV_GNDDec FaultFTMTLCS_CurSenrPhaV_GNDFailMod FaultFTMTLCS_CurSenrPhaV_GNDInc FaultFTMTLCS_CurSenrPhaV_OutRngHDec FaultFTMTLCS_CurSenrPhaV_OutRngHFailMod FaultFTMTLCS_CurSenrPhaV_OutRngHInc FaultFTMTLCS_CurSenrPhaV_OutRngLDec FaultFTMTLCS_CurSenrPhaV_OutRngLFailMod FaultFTMTLCS_CurSenrPhaV_OutRngLInc FaultFTMTLCS_CurSenrPhaV_VCCDec FaultFTMTLCS_CurSenrPhaV_VCCFailMod FaultFTMTLCS_CurSenrPhaV_VCCInc FaultFTMTLCS_CurSenrPhaW_GNDDec FaultFTMTLCS_CurSenrPhaW_GNDFailMod FaultFTMTLCS_CurSenrPhaW_GNDInc FaultFTMTLCS_CurSenrPhaW_OutRngHDec FaultFTMTLCS_CurSenrPhaW_OutRngHFailMod FaultFTMTLCS_CurSenrPhaW_OutRngHInc FaultFTMTLCS_CurSenrPhaW_OutRngLDec FaultFTMTLCS_CurSenrPhaW_OutRngLFailMod FaultFTMTLCS_CurSenrPhaW_OutRngLInc FaultFTMTLCS_CurSenrPhaW_VCCDec FaultFTMTLCS_CurSenrPhaW_VCCFailMod FaultFTMTLCS_CurSenrPhaW_VCCInc FaultSDMTMEP_CosGndDec FaultSDMTMEP_CosGndFailMod FaultSDMTMEP_CosGndInc FaultSDMTMEP_CosOutRangeHighDec FaultSDMTMEP_CosOutRangeHighFailMod FaultSDMTMEP_CosOutRangeHighInc FaultSDMTMEP_CosOutRangeLowDec FaultSDMTMEP_CosOutRangeLowFailMod FaultSDMTMEP_CosOutRangeLowInc FaultSDMTMEP_CosVccDec FaultSDMTMEP_CosVccFailMod FaultSDMTMEP_CosVccInc FaultSDMTMEP_OverSpeedDec FaultSDMTMEP_OverSpeedFailMod FaultSDMTMEP_OverSpeedInc FaultSDMTMEP_ResSquaSumErrByFTDec FaultSDMTMEP_ResSquaSumErrByFTFailMod FaultSDMTMEP_ResSquaSumErrByFTInc FaultSDMTMEP_SinGndDec FaultSDMTMEP_SinGndFailMod FaultSDMTMEP_SinGndInc FaultSDMTMEP_SinOutRangeHighDec FaultSDMTMEP_SinOutRangeHighFailMod FaultSDMTMEP_SinOutRangeHighInc FaultSDMTMEP_SinOutRangeLowDec FaultSDMTMEP_SinOutRangeLowFailMod FaultSDMTMEP_SinOutRangeLowInc FaultSDMTMEP_SinVccDec FaultSDMTMEP_SinVccFailMod FaultSDMTMEP_SinVccInc FaultSDMTMEP_UnderSpeedDec FaultSDMTMEP_UnderSpeedFailMod FaultSDMTMEP_UnderSpeedInc FaultTCUCAP0_CAPPressureHDec FaultTCUCAP0_CAPPressureHFailMod FaultTCUCAP0_CAPPressureHInc FaultTCUCAP0_CAPPressureLDec FaultTCUCAP0_CAPPressureLFailMod FaultTCUCAP0_CAPPressureLInc FaultTCUCAP0_CAPPressureOverHDec FaultTCUCAP0_CAPPressureOverHFailMod FaultTCUCAP0_CAPPressureOverHInc FaultTCUCAP0_CAPSlipDec FaultTCUCAP0_CAPSlipFailMod FaultTCUCAP0_CAPSlipInc FaultTCUCAP0_DragMomentHDec FaultTCUCAP0_DragMomentHFailMod FaultTCUCAP0_DragMomentHInc FaultTCUCAP0_HLSinInvalidDec FaultTCUCAP0_HLSinInvalidFailMod FaultTCUCAP0_HLSinInvalidInc FaultTCUCAP0_HLSinUndefineDec FaultTCUCAP0_HLSinUndefineFailMod FaultTCUCAP0_HLSinUndefineInc FaultTCUCAP0_HLSupplyHDec FaultTCUCAP0_HLSupplyHFailMod FaultTCUCAP0_HLSupplyHInc FaultTCUCAP0_HLSupplyLDec FaultTCUCAP0_HLSupplyLFailMod FaultTCUCAP0_HLSupplyLInc FaultTCUCAP0_MotorPhaseVolHDec FaultTCUCAP0_MotorPhaseVolHFailMod FaultTCUCAP0_MotorPhaseVolHInc FaultTCUCAP0_PressureRationalDec FaultTCUCAP0_PressureRationalFailMod FaultTCUCAP0_PressureRationalInc FaultTCUCAP0_SenSigOpenOrGNDDec FaultTCUCAP0_SenSigOpenOrGNDFailMod FaultTCUCAP0_SenSigOpenOrGNDInc FaultTCUCAP0_SenSigVCCDec FaultTCUCAP0_SenSigVCCFailMod FaultTCUCAP0_SenSigVCCInc FaultTCUCAP0_SensorPerforErrDec FaultTCUCAP0_SensorPerforErrFailMod FaultTCUCAP0_SensorPerforErrInc FaultTCUCAP1_COM_GCUDec FaultTCUCAP1_COM_GCUFailMod FaultTCUCAP1_COM_GCUInc FaultTCUCAP1_DriverTempHDec FaultTCUCAP1_DriverTempHFailMod FaultTCUCAP1_DriverTempHInc FaultTCUCAP1_FETShortDec FaultTCUCAP1_FETShortFailMod FaultTCUCAP1_FETShortInc FaultTCUCAP1_HWOverCurDec FaultTCUCAP1_HWOverCurFailMod FaultTCUCAP1_HWOverCurInc FaultTCUCAP1_MotorPhaseDriveErrDec FaultTCUCAP1_MotorPhaseDriveErrFailMod FaultTCUCAP1_MotorPhaseDriveErrInc FaultTCUCAP1_MotorStallDec FaultTCUCAP1_MotorStallFailMod FaultTCUCAP1_MotorStallInc FaultTCUCAP1_OverVoltageDec FaultTCUCAP1_OverVoltageFailMod FaultTCUCAP1_OverVoltageInc FaultTCUCAP1_PhaseDetectGNDDec FaultTCUCAP1_PhaseDetectGNDFailMod FaultTCUCAP1_PhaseDetectGNDInc FaultTCUCAP1_PhaseDetectVCCDec FaultTCUCAP1_PhaseDetectVCCFailMod FaultTCUCAP1_PhaseDetectVCCInc FaultTCUCAP1_SWOverCurDec FaultTCUCAP1_SWOverCurFailMod FaultTCUCAP1_SWOverCurInc FaultTCUCAP1_ThermalShutDownDec FaultTCUCAP1_ThermalShutDownFailMod FaultTCUCAP1_ThermalShutDownInc FaultTCUCAP1_ThermalWarningDec FaultTCUCAP1_ThermalWarningFailMod FaultTCUCAP1_ThermalWarningInc FaultTCUCAP1_UnderVoltageDec FaultTCUCAP1_UnderVoltageFailMod FaultTCUCAP1_UnderVoltageInc FaultTCUCCP_OilMotorRationalDec FaultTCUCCP_OilMotorRationalFailMod FaultTCUCCP_OilMotorRationalInc FaultTCUCCP_OilMotorStallDec FaultTCUCCP_OilMotorStallFailMod FaultTCUCCP_OilMotorStallInc FaultTCUCCP_OilSenRationalL1Dec FaultTCUCCP_OilSenRationalL1FailMod FaultTCUCCP_OilSenRationalL1Inc FaultTCUCCP_OilSenRationalL2Dec FaultTCUCCP_OilSenRationalL2FailMod FaultTCUCCP_OilSenRationalL2Inc FaultTCUCCP_OilTempRationalHDec FaultTCUCCP_OilTempRationalHFailMod FaultTCUCCP_OilTempRationalHInc FaultTCUCCP_OilTempRationalLDec FaultTCUCCP_OilTempRationalLFailMod FaultTCUCCP_OilTempRationalLInc /end DEF_CHARACTERISTIC
 /begin OUT_MEASUREMENT FaultTableFuncTypeCounter1[54] FaultTableFuncTypeCounter1[55] FaultTableFuncTypeCounter1[56] FaultTableFuncTypeCounter1[57] FaultTableFuncTypeCounter1[58] FaultTableFuncTypeCounter1[59] FaultTableFuncTypeCounter1[5] FaultTableFuncTypeCounter1[60] FaultTableFuncTypeCounter1[61] FaultTableFuncTypeCounter1[62] FaultTableFuncTypeCounter1[63] FaultTableFuncTypeCounter1[64] FaultTableFuncTypeCounter1[65] FaultTableFuncTypeCounter1[66] FaultTableFuncTypeCounter1[67] FaultTableFuncTypeCounter1[68] FaultTableFuncTypeCounter1[69] FaultTableFuncTypeCounter1[6] FaultTableFuncTypeCounter1[70] FaultTableFuncTypeCounter1[71] FaultTableFuncTypeCounter1[72] FaultTableFuncTypeCounter1[73] FaultTableFuncTypeCounter1[74] FaultTableFuncTypeCounter1[75] FaultTableFuncTypeCounter1[76] FaultTableFuncTypeCounter1[77] FaultTableFuncTypeCounter1[78] FaultTableFuncTypeCounter1[79] FaultTableFuncTypeCounter1[7] FaultTableFuncTypeCounter1[80] FaultTableFuncTypeCounter1[81] FaultTableFuncTypeCounter1[82] FaultTableFuncTypeCounter1[83] FaultTableFuncTypeCounter1[84] FaultTableFuncTypeCounter1[85] FaultTableFuncTypeCounter1[86] FaultTableFuncTypeCounter1[87] FaultTableFuncTypeCounter1[88] FaultTableFuncTypeCounter1[89] FaultTableFuncTypeCounter1[8] FaultTableFuncTypeCounter1[90] FaultTableFuncTypeCounter1[91] FaultTableFuncTypeCounter1[92] FaultTableFuncTypeCounter1[93] FaultTableFuncTypeCounter1[94] FaultTableFuncTypeCounter1[95] FaultTableFuncTypeCounter1[96] FaultTableFuncTypeCounter1[97] FaultTableFuncTypeCounter1[98] FaultTableFuncTypeCounter1[99] FaultTableFuncTypeCounter1[9] FaultTCUCAP0_CAPPressureHAut FaultTCUCAP0_CAPPressureHDetected FaultTCUCAP0_CAPPressureHLogged FaultTCUCAP0_CAPPressureLAut FaultTCUCAP0_CAPPressureLDetected FaultTCUCAP0_CAPPressureLLogged FaultTCUCAP0_CAPPressureOverHAut FaultTCUCAP0_CAPPressureOverHDetected FaultTCUCAP0_CAPPressureOverHLogged FaultTCUCAP0_CAPSlipAut FaultTCUCAP0_CAPSlipDetected FaultTCUCAP0_CAPSlipLogged FaultTCUCAP0_Detected FaultTCUCAP0_DragMomentHAut FaultTCUCAP0_DragMomentHDetected FaultTCUCAP0_DragMomentHLogged FaultTCUCAP0_HLSinInvalidAut FaultTCUCAP0_HLSinInvalidDetected FaultTCUCAP0_HLSinInvalidLogged FaultTCUCAP0_HLSinUndefineAut FaultTCUCAP0_HLSinUndefineDetected FaultTCUCAP0_HLSinUndefineLogged FaultTCUCAP0_HLSupplyHAut FaultTCUCAP0_HLSupplyHDetected FaultTCUCAP0_HLSupplyHLogged FaultTCUCAP0_HLSupplyLAut FaultTCUCAP0_HLSupplyLDetected FaultTCUCAP0_HLSupplyLLogged FaultTCUCAP0_Logged FaultTCUCAP0_MotorPhaseVolHAut FaultTCUCAP0_MotorPhaseVolHDetected FaultTCUCAP0_MotorPhaseVolHLogged FaultTCUCAP0_PressureRationalAut FaultTCUCAP0_PressureRationalDetected FaultTCUCAP0_PressureRationalLogged FaultTCUCAP0_SenSigOpenOrGNDAut FaultTCUCAP0_SenSigOpenOrGNDDetected FaultTCUCAP0_SenSigOpenOrGNDLogged FaultTCUCAP0_SenSigVCCAut FaultTCUCAP0_SenSigVCCDetected FaultTCUCAP0_SenSigVCCLogged FaultTCUCAP0_SensorPerforErrAut FaultTCUCAP0_SensorPerforErrDetected FaultTCUCAP0_SensorPerforErrLogged FaultTCUCAP1_COM_GCUAut FaultTCUCAP1_COM_GCUDetected FaultTCUCAP1_COM_GCULogged FaultTCUCAP1_Detected FaultTCUCAP1_DriverTempHAut FaultTCUCAP1_DriverTempHDetected FaultTCUCAP1_DriverTempHLogged FaultTCUCAP1_FETShortAut FaultTCUCAP1_FETShortDetected FaultTCUCAP1_FETShortLogged FaultTCUCAP1_HWOverCurAut FaultTCUCAP1_HWOverCurDetected FaultTCUCAP1_HWOverCurLogged FaultTCUCAP1_Logged FaultTCUCAP1_MotorPhaseDriveErrAut FaultTCUCAP1_MotorPhaseDriveErrDetected FaultTCUCAP1_MotorPhaseDriveErrLogged FaultTCUCAP1_MotorStallAut FaultTCUCAP1_MotorStallDetected FaultTCUCAP1_MotorStallLogged FaultTCUCAP1_OverVoltageAut FaultTCUCAP1_OverVoltageDetected FaultTCUCAP1_OverVoltageLogged FaultTCUCAP1_PhaseDetectGNDAut FaultTCUCAP1_PhaseDetectGNDDetected FaultTCUCAP1_PhaseDetectGNDLogged FaultTCUCAP1_PhaseDetectVCCAut FaultTCUCAP1_PhaseDetectVCCDetected FaultTCUCAP1_PhaseDetectVCCLogged FaultTCUCAP1_SWOverCurAut FaultTCUCAP1_SWOverCurDetected FaultTCUCAP1_SWOverCurLogged FaultTCUCAP1_ThermalShutDownAut FaultTCUCAP1_ThermalShutDownDetected FaultTCUCAP1_ThermalShutDownLogged FaultTCUCAP1_ThermalWarningAut FaultTCUCAP1_ThermalWarningDetected FaultTCUCAP1_ThermalWarningLogged FaultTCUCAP1_UnderVoltageAut FaultTCUCAP1_UnderVoltageDetected FaultTCUCAP1_UnderVoltageLogged FaultTCUCCP_Detected FaultTCUCCP_Logged FaultTCUCCP_OilMotorRationalAut FaultTCUCCP_OilMotorRationalDetected FaultTCUCCP_OilMotorRationalLogged FaultTCUCCP_OilMotorStallAut FaultTCUCCP_OilMotorStallDetected FaultTCUCCP_OilMotorStallLogged FaultTCUCCP_OilSenRationalL1Aut FaultTCUCCP_OilSenRationalL1Detected FaultTCUCCP_OilSenRationalL1Logged FaultTCUCCP_OilSenRationalL2Aut FaultTCUCCP_OilSenRationalL2Detected FaultTCUCCP_OilSenRationalL2Logged FaultTCUCCP_OilTempRationalHAut FaultTCUCCP_OilTempRationalHDetected FaultTCUCCP_OilTempRationalHLogged FaultTCUCCP_OilTempRationalLAut FaultTCUCCP_OilTempRationalLDetected FaultTCUCCP_OilTempRationalLLogged /end OUT_MEASUREMENT
/end FUNCTION
/begin FUNCTION FAULT_FF ""
 /begin OUT_MEASUREMENT FAULT_FF_bFrameLock_FF1 FF_FF1_Item_0x0D01 FF_FF1_Item_0x0D02 FF_FF1_Item_0x0D03 FF_FF1_Item_0x0D04 FF_FF1_Item_0x0D05 FF_FF1_Item_0x0D06 FF_FF1_Item_0x0D07 FF_FF1_Item_0x0D08 FF_FF1_Item_0x0D09 FF_FF1_Item_0x0D0A FF_FF1_Item_0x0D0B FF_FF1_Item_0x0D0C FF_FF1_Item_0x0D0C_1 FF_FF1_Item_0x0D0C_2 FF_FF1_Item_0x0D0D FF_FF1_Item_0x0D0E FF_FF1_Item_0x0D0F FF_FF1_Item_0x0D13 FF_FF1_Item_0x0D14 FF_FF1_Item_0x0D15 FF_FF1_Item_0x0D16 FF_FF1_Item_0x0D17 FF_FF1_Item_0x0D18 FF_FF1_Item_0x0D19 FF_FF1_Item_0x0D1A FF_FF1_Item_0x0D1B FF_FF1_Item_0x0D1C FF_FF1_Item_0x0D1D FF_FF1_Item_0x0D1E FF_FF1_Item_0x0D1F FF_FF1_Item_0x0D20 FF_FF1_Item_0x0D21 FF_FF1_Item_0x0D22 FF_FF1_Item_0x0D23 FF_FF1_Item_0x0D24 FF_FF1_Item_0x0D25 FF_FF1_Item_0x0D26 FF_FF1_Item_0x0D27 FF_FF1_Item_0x0D28 FF_FF1_Item_0x0D29 FF_FF1_Item_0x1D01 FF_FF1_Item_0x1D02 FF_FF1_Item_0x1D03 FF_FF1_Item_0x1D04 FF_FF1_Item_0x1D05 FF_FF1_Item_0x1D06 FF_FF1_Item_0x1D07 FF_FF1_Item_0x1D08 FF_FF1_Item_0x1D09 FF_FF1_Item_0x1D0A FF_FF1_Item_0x1D0B FF_FF1_Item_0x1D0C FF_FF1_Item_0x1D0C_1 FF_FF1_Item_0x1D0C_2 FF_FF1_Item_0x1D0D FF_FF1_Item_0x1D0E FF_FF1_Item_0x1D0F FF_FF1_Item_0x1D13 FF_FF1_Item_0x1D14 FF_FF1_Item_0x1D15 FF_FF1_Item_0x1D16 FF_FF1_Item_0x1D17 FF_FF1_Item_0x1D18 FF_FF1_Item_0x1D19 FF_FF1_Item_0x1D1A FF_FF1_Item_0x1D1B FF_FF1_Item_0x1D1C FF_FF1_Item_0x1D1D FF_FF1_Item_0x1D1E FF_FF1_Item_0x1D1F FF_FF1_Item_0x1D20 FF_FF1_Item_0x1D21 FF_FF1_Item_0x1D22 FF_FF1_Item_0x1D23 FF_FF1_Item_0x1D24 FF_FF1_Item_0x1D25 FF_FF1_Item_0x1D26 FF_FF1_Item_0x1D27 FF_FF1_Item_0x1D28 FF_FF1_Item_0x1D29 FF_FF1_Item_0x2D02 FF_FF1_Item_0x2D03 FF_FF1_Item_0x2D04 FF_FF1_Item_0x2D05 FF_FF1_Item_0x2D06 FF_FF1_Item_0x2D07 FF_FF1_Item_0x2D08 FF_FF1_Item_0x2D0E FF_FF1_Item_0x2D13 FF_FF1_Item_0x2D14 FF_FF1_Item_0x2D15 FF_FF1_Item_0x2D1C FF_FF1_Item_0x2D1D FF_FF1_Item_0x2D1E FF_FF1_Item_0x2D1F FF_FF1_Item_0x2D20 FF_FF1_Item_0x2D21 FF_FF1_Item_0x2D22 FF_FF1_Item_0x2D25 FF_FF1_Item_0x2D26 FF_FF1_Item_0x3D02 FF_FF1_Item_0x3D03 FF_FF1_Item_0x3D04 FF_FF1_Item_0x3D05 FF_FF1_Item_0x3D06 FF_FF1_Item_0x3D07 FF_FF1_Item_0x3D08 FF_FF1_Item_0x3D0E FF_FF1_Item_0x3D13 FF_FF1_Item_0x3D14 FF_FF1_Item_0x3D15 FF_FF1_Item_0x3D1C FF_FF1_Item_0x3D1D FF_FF1_Item_0x3D1E FF_FF1_Item_0x3D1F FF_FF1_Item_0x3D20 FF_FF1_Item_0x3D21 FF_FF1_Item_0x3D22 FF_FF1_Item_0x3D25 FF_FF1_Item_0x3D26 FF_FF1_Item_0x4D27 FF_FF1_Item_0x4D28 FF_FF1_Item_0x4D29 FF_FF1_Item_0x4D2A FF_FF1_Item_0x4D2B FF_FF1_Item_0x4D2C FF_FF1_Item_0x4D2D FF_FF1_Item_0x4D2E FF_FF1_Item_0x4D2F FF_FF1_Item_0x4D30 FF_FF1_Item_0x4D31 FF_FF1_Item_0x4D32 FF_FF1_Item_0x4D33 FF_FF1_Item_0x4D34 FF_FF1_Item_0x4D35 FF_FF1_Item_0x4D36 FF_FF1_Item_0x4D37 FF_FF1_Item_0x4D38 FF_FF1_Item_0x4D39 FF_FF1_Item_0x4D3A FF_FF1_Item_0x4D3B FF_FF1_Item_0x4D3C FF_FF1_Item_0x4D3D FF_FF1_Item_0xDF20 FF_FF1_Item_0xDF21 FF_FF1_Item_0xDF23 FF_FF1_Item_0xDF29 FF_FF1_Item_0xDF2A FF_FF1_Item_0xDF2C /end OUT_MEASUREMENT
/end FUNCTION
/begin FUNCTION GCCU6 ""
 /begin DEF_CHARACTERISTIC GCCU6_bAlimFreqChgEnaC GCCU6_bDualSmpEnaC GCCU6_bHwOvcFltDetEnaC GCCU6_bHwPinAscEnaC GCCU6_f32DrvClkDutyThdHighC GCCU6_f32DrvClkDutyThdLowC GCCU6_kbDrvBdClkEnaC GCCU6_kf32MidPointDutyHC GCCU6_kf32MidPointDutyLC GCCU6_ku16AlimDutyCycRawC GCCU6_ku32AlimFreqRawC GCCU6_ku8AscRecoverCntMaxC GCCU6_ku8PwmMidPointFaultC /end DEF_CHARACTERISTIC
 /begin OUT_MEASUREMENT GCCU6_au32PWMOnTime GCCU6_au32PWMOnTime[0] GCCU6_au32PWMOnTime[1] GCCU6_au32PWMOnTime[2] GCCU6_bAkdAfterAscReq GCCU6_bClrTrapReq GCCU6_bHwFaultDcOvVolt GCCU6_bHwFaultIgbtH GCCU6_bHwFaultIgbtL GCCU6_bHwFaultOvcU GCCU6_bHwFaultOvcV GCCU6_bHwFaultOvcW GCCU6_bIgbtHighSideShort GCCU6_bIgbtLowSideShort GCCU6_bIuvwCompReq GCCU6_bMotorSpdRdy GCCU6_bP5VDiagReinitCmd GCCU6_bP5VHSFltFlg GCCU6_bP5VLSFltFlg GCCU6_bPwmMidPointU GCCU6_bPwmMidPointV GCCU6_bPwmMidPointW GCCU6_bPwmOnGoingFlg GCCU6_bT12ZeroMatchFlg GCCU6_bTrapTrigger GCCU6_f32DrvClkHsDuty GCCU6_f32DrvClkLsDuty GCCU6_f32HighVolPhys GCCU6_f32PwmDutyPhysUZ GCCU6_f32PwmDutyPhysVZ GCCU6_f32PwmDutyPhysWZ GCCU6_u16AlimPowerOnDelay GCCU6_u16HighVolAdc GCCU6_u16McuAscSttDelay GCCU6_u16P5VHSAdc GCCU6_u16PowerOnDelay GCCU6_u16PwmMaxDutyCyc GCCU6_u16PwmMidPointErrCnt GCCU6_u16PwmMinDutyCyc GCCU6_u16PwmModReq GCCU6_u16T12CntVal GCCU6_u16T12PeriodVal GCCU6_u16T13PeriodVal GCCU6_u32DrvClkHsDutyRaw GCCU6_u32DrvClkHsPerdRaw GCCU6_u32DrvClkLsDutyRaw GCCU6_u32DrvClkLsPerdRaw GCCU6_u32TrapCreq GCCU6_u8AscRecoverCnt GCCU6_u8McuAscSttStep GCCU6_u8McuAscType GCCU6_u8P5VHSFltCnt GCCU6_u8P5VLSFltCnt GCCU6_u8P5VPowerMngStt GCCU6_u8P5VSelfTstTimCnt GCCU6_u8PreTestStep GCCU6_u8PwmState /end OUT_MEASUREMENT
/end FUNCTION
/begin FUNCTION GMAIN ""
 /begin OUT_MEASUREMENT Core1_PositionStartTime Core1_PositionStopTime Core1_PositionTotalTime GMAIN_ku16SpdReadyEstConfirmC GMAIN_u16Core0Cnt5 GMAIN_u16Core2Cnt10 GMAIN_u8IgbtFltConfirmCntC GMAIN_u8IgbtHighFltCnt GMAIN_u8IgbtLowFltCnt GMAIN_u8StopCacheFreezeFrameCnt /end OUT_MEASUREMENT
/end FUNCTION
/begin FUNCTION HARD ""
 /begin DEF_CHARACTERISTIC HARD_bPtgEnablePhaseShiftingC HARD_u16PtgUSignalShiftC HARD_u16PtgVSignalShiftC HARD_u16PtgWSignalShiftC HARDPTG_s16AmplitudeC HARDPTG_s16ContinuousRequestC HARDPTG_s16OffsetC HARDPTG_s16SlewRateC HARDPTG_u16PulseDutyCycleC HARDPTG_u32FrequenceC /end DEF_CHARACTERISTIC
 /begin OUT_MEASUREMENT HARD_bDio_M_ACM_ENA_PWM HARD_bDio_M_AN_ENABLE_ASC1 HARD_bDio_M_AN_ENABLE_ASC2 HARD_bDio_M_BACKUP_EN HARD_bDio_M_CHG_ON HARD_bDio_M_DI2 HARD_bDio_M_DI3_KM_EN HARD_bDio_M_DO1 HARD_bDio_M_DX1_A HARD_bDio_M_DX1_B HARD_bDio_M_DX1_C HARD_bDio_M_DX2_A HARD_bDio_M_DX2_B HARD_bDio_M_DX2_C HARD_bDio_M_DX3_A HARD_bDio_M_DX3_B HARD_bDio_M_DX3_C HARD_bDio_M_ENA_KM HARD_bDio_M_EPS_ENA_PWM HARD_bDio_M_FAULT_ACM_HS_N HARD_bDio_M_FAULT_DRV_HS_N_1 HARD_bDio_M_FAULT_DRV_HS_N_2 HARD_bDio_M_FAULT_DRV_LS_N_1 HARD_bDio_M_FAULT_DRV_LS_N_2 HARD_bDio_M_FAULT_EPS_HS_N HARD_bDio_M_FLT_EXCITATION_1 HARD_bDio_M_FLT_EXCITATION_2 HARD_bDio_M_HWCFG1 HARD_bDio_M_HWCFG2 HARD_bDio_M_HWCFG3 HARD_bDio_M_HWCFG4 HARD_bDio_M_HWCFG5 HARD_bDio_M_HWCFG6 HARD_bDio_M_IO_MUX1 HARD_bDio_M_ISO_EN1 HARD_bDio_M_ISO_EN2 HARD_bDio_M_ISO_EN3 HARD_bDio_M_K1_KCF_XJCQ1 HARD_bDio_M_K2_KCF_XJCQ2 HARD_bDio_M_K3_KCF_XJCQ3 HARD_bDio_M_K4_KCF_XJCQ4 HARD_bDio_M_KEY_ON HARD_bDio_M_KM10_KC3F HARD_bDio_M_KM11_KC2Z HARD_bDio_M_KM12_KC4F HARD_bDio_M_KM13_KC3Z HARD_bDio_M_KM15_KC4Z HARD_bDio_M_KM17_SZ1 HARD_bDio_M_KM18_SZ2 HARD_bDio_M_KM19_XGLFZ HARD_bDio_M_KM1_ZQ1 HARD_bDio_M_KM20_DCJY1 HARD_bDio_M_KM21_DCJY2 HARD_bDio_M_KM22_DCJY3 HARD_bDio_M_KM23_DCJY4 HARD_bDio_M_KM24_ZXFZ HARD_bDio_M_KM2_ZQ2 HARD_bDio_M_KM3_ZQ3 HARD_bDio_M_KM4_ZQ4 HARD_bDio_M_KM5_KC1Z HARD_bDio_M_KM6_KC1F HARD_bDio_M_KM7_KC1Z HARD_bDio_M_KM8_KC2F HARD_bDio_M_KM9_KC2Z HARD_bDio_M_PW_DOWN HARD_bDio_M_Q1_DCJR1 HARD_bDio_M_Q2_DCJR2 HARD_bDio_M_Q3_DCJR3 HARD_bDio_M_Q4_DCJR4 HARD_bDio_M_Q5_PTC1 HARD_bDio_M_Q6_PTC2 HARD_bDio_M_SER HARD_bDio_M_SUPPLY_WDI HARD_bDio_M_YC1_ZQ_YC HARD_bDio_M_YC2_KC3Z_YC HARD_bDio_M_YC3_KC4Z_YC HARD_bDio_M_YC4_SZ1_YC HARD_bDio_M_YC5_SZ2_YC HARD_bDio_M_YC6_XGLFZ_YC HARD_bDio_M_YC7_ZXFZ_YC HARD_bDio_MCU_ASC_STATE HARD_bDio_MCU_STATE_LED HARD_bDio_PORT_11_PIN_2 HARD_bDio_PORT_14_PIN_8 HARD_bDio_Port_2_Pin_6 HARD_bESMCmdFtShutdownReq HARD_bESMCmdFtShutdownRes HARD_bESMCmdFtStartReq HARD_bESMCmdFtStartRes HARD_bESMCmdPwmDirectReq HARD_bESMCmdPwmDirectRes HARD_bESMCmdPwmHardReq HARD_bESMCmdPwmHardRes HARD_bESMCmdPwmOffReq HARD_bESMCmdPwmOffRes HARD_bESMCmdSwShutdownReq HARD_bESMCmdSwShutdownRes HARD_bESMCmdSwStartReq HARD_bESMCmdSwStartRes HARD_bModSeq1FuncOn HARD_bModSeq1InitOn HARD_bModSeq2FuncOn HARD_bModSeq2InitOn HARD_bNMTestOn HARD_bPtgEnable HARD_bPtgSignalsShiftControl HARD_bPtgUSignalEnable HARD_bPtgVSignalEnable HARD_bPtgWSignalEnable HARD_CH_DIO_IN_M_HW_OCP_U_2 HARD_CH_DIO_IN_M_HW_OCP_V_2 HARD_CH_DIO_IN_M_HW_OCP_W_2 HARD_ESM_FT_STATE_FT_SHUTDOWN HARD_ESM_FT_STATE_IDLE HARD_ESM_FT_STATE_PWM_DIRECT HARD_ESM_FT_STATE_PWM_HARD HARD_ESM_FT_STATE_PWM_OFF HARD_ESM_NF_STATE_FT_START HARD_ESM_NF_STATE_IDLE HARD_ESM_NF_STATE_PWM_HARD HARD_ESM_NF_STATE_PWM_OFF HARD_ESM_NF_STATE_SW_SHUTDOWN HARD_EsmFtState HARD_EsmFtStateAut HARD_EsmNfState HARD_EsmNfStateAut HARD_PTG_CONTINUOUS_MODE HARD_PTG_DISJUNCTION_MODE HARD_PTG_LOOP_NB_MODE HARD_PTG_PROFIL_MODE HARD_PTG_PULSE_MODE HARD_PTG_SINUS_MODE HARD_PTG_SQUARE_MODE HARD_PTG_TRIANGLE_MODE HARD_PtgModeTest HARD_s16PtgRefSignalValue HARD_s16PtgUSignalValue HARD_s16PtgVSignalValue HARD_s16PtgWSignalValue HARD_u16Adc0An10_CTN_BOARD2Phys HARD_u16Adc_AN_15V_RDC HARD_u16Adc_AN_P5V_AD2S HARD_u16Adc_AN_P5V_REF HARD_u16Adc_AN_VOL_DCLINK_DRV HARD_u16Adc_M_ACM_AN_CURRENT_U HARD_u16Adc_M_ACM_AN_CURRENT_V HARD_u16Adc_M_ACM_AN_CURRENT_W HARD_u16Adc_M_ACM_TEMP_MEAS_MOD_V HARD_u16Adc_M_ACM_TEMP_MEAS_MOD_W HARD_u16Adc_M_AN_CURRENT_U_1 HARD_u16Adc_M_AN_CURRENT_U_2 HARD_u16Adc_M_AN_CURRENT_V_1 HARD_u16Adc_M_AN_CURRENT_V_2 HARD_u16Adc_M_AN_CURRENT_W_1 HARD_u16Adc_M_AN_CURRENT_W_2 HARD_u16Adc_M_AN_DC_LINK_PACK1 HARD_u16Adc_M_AN_DC_LINK_PACK2 HARD_u16Adc_M_AN_DC_LINK_PACK3 HARD_u16Adc_M_AN_DC_LINK_PACK4 HARD_u16Adc_M_AN_DIAG_COS_H_1 HARD_u16Adc_M_AN_DIAG_COS_H_2 HARD_u16Adc_M_AN_DIAG_COS_L_1 HARD_u16Adc_M_AN_DIAG_COS_L_2 HARD_u16Adc_M_AN_DIAG_SIN_H_1 HARD_u16Adc_M_AN_DIAG_SIN_H_2 HARD_u16Adc_M_AN_DIAG_SIN_L_1 HARD_u16Adc_M_AN_DIAG_SIN_L_2 HARD_u16Adc_M_AN_KM10_FB_KC3F HARD_u16Adc_M_AN_KM12_FB_KC4F HARD_u16Adc_M_AN_KM6_FB_KC1F HARD_u16Adc_M_AN_KM8_FB_KC2F HARD_u16Adc_M_AN_MOT_COS_1 HARD_u16Adc_M_AN_MOT_COS_2 HARD_u16Adc_M_AN_MOT_SIN_1 HARD_u16Adc_M_AN_MOT_SIN_2 HARD_u16Adc_M_AN_MUX1 HARD_u16Adc_M_AN_MUX2 HARD_u16Adc_M_AN_MUX3 HARD_u16Adc_M_AN_MUX4 HARD_u16Adc_M_AN_MUX6 HARD_u16Adc_M_AN_MUX7 HARD_u16Adc_M_EPS_AN_CURRENT_U HARD_u16Adc_M_EPS_AN_CURRENT_V HARD_u16Adc_M_EPS_AN_CURRENT_W HARD_u16Adc_M_EPS_TEMP_MEAS_MOD_V HARD_u16Adc_M_EPS_TEMP_MEAS_MOD_W HARD_u16Adc_M_TEMP_MEAS_MOD_W_2 HARD_u16PtgRefSignalNbPeriode HARD_u16PtgRefSignalTime HARD_u16PtgUSignalNbPeriode HARD_u16PtgUSignalTime HARD_u16PtgVSignalNbPeriode HARD_u16PtgVSignalTime HARD_u16PtgWSignalNbPeriode HARD_u16PtgWSignalTime HARD_u8VSIRxaTempCtrlBdPhys HARD_u8VSIRxaTempDrvBdPhys HARD_u8VSIRxaTempIgbtPhys /end OUT_MEASUREMENT
/end FUNCTION
/begin COMPU_METHOD HARD_EsmFtState_conv "" TAB_VERB "%8.4" "." COMPU_TAB_REF HARD_EsmFtState_table /end COMPU_METHOD
/begin COMPU_VTAB HARD_EsmFtState_table "" TAB_VERB 5 1 "HARD_ESM_FT_STATE_PWM_DIRECT" 2 "HARD_ESM_FT_STATE_PWM_HARD" 4 "HARD_ESM_FT_STATE_PWM_OFF" 8 "HARD_ESM_FT_STATE_FT_SHUTDOWN" 64 "HARD_ESM_FT_STATE_IDLE" /end COMPU_VTAB
/begin COMPU_METHOD HARD_EsmNfState_conv "" TAB_VERB "%8.4" "." COMPU_TAB_REF HARD_EsmNfState_table /end COMPU_METHOD
/begin COMPU_VTAB HARD_EsmNfState_table "" TAB_VERB 5 1 "HARD_ESM_NF_STATE_FT_START" 4 "HARD_ESM_NF_STATE_SW_SHUTDOWN" 8 "HARD_ESM_NF_STATE_PWM_HARD" 16 "HARD_ESM_NF_STATE_PWM_OFF" 64 "HARD_ESM_NF_STATE_IDLE" /end COMPU_VTAB
/begin COMPU_METHOD HARD_PtgModeTest_conv "" TAB_VERB "%8.4" "." COMPU_TAB_REF HARD_PtgModeTest_table /end COMPU_METHOD
/begin COMPU_VTAB HARD_PtgModeTest_table "" TAB_VERB 8 1 "HARD_PTG_PULSE_MODE" 2 "HARD_PTG_SINUS_MODE" 4 "HARD_PTG_TRIANGLE_MODE" 8 "HARD_PTG_SQUARE_MODE" 16 "HARD_PTG_CONTINUOUS_MODE" 32 "HARD_PTG_PROFIL_MODE" 64 "HARD_PTG_DISJUNCTION_MODE" 128 "HARD_PTG_LOOP_NB_MODE" /end COMPU_VTAB
/end MODULE
/end PROJECT
