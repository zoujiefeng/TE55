ASAP2_VERSION 1 3
/begin PROJECT P_TC387_PLATFORM_0_0 "P_TC387_PLATFORM_0_0"
/begin HEADER "" VERSION "5210.00" PROJECT_NO D0 /end HEADER
/begin MODULE P_TC387_PLATFORM_0_0 "Invt"
/begin MOD_COMMON "" DEPOSIT ABSOLUTE ALIGNMENT_BYTE 1 ALIGNMENT_WORD 2 ALIGNMENT_LONG 4 ALIGNMENT_FLOAT32_IEEE 4 ALIGNMENT_FLOAT64_IEEE 8 BYTE_ORDER MSB_LAST /end MOD_COMMON
/begin RECORD_LAYOUT DATA_RECORD_UBYTE FNC_VALUES 1 UBYTE ROW_DIR DIRECT /end RECORD_LAYOUT
/begin RECORD_LAYOUT DATA_RECORD_UWORD FNC_VALUES 1 UWORD ROW_DIR DIRECT /end RECORD_LAYOUT
/begin RECORD_LAYOUT DATA_RECORD_ULONG FNC_VALUES 1 ULONG ROW_DIR DIRECT /end RECORD_LAYOUT
/begin RECORD_LAYOUT DATA_RECORD_SLONG FNC_VALUES 1 SLONG ROW_DIR DIRECT /end RECORD_LAYOUT
/begin RECORD_LAYOUT DATA_RECORD_FLOAT32_IEEE FNC_VALUES 1 FLOAT32_IEEE ROW_DIR DIRECT /end RECORD_LAYOUT
/begin RECORD_LAYOUT AXIS_PTS_X_UBYTE_VEMS AXIS_PTS_X 1 UBYTE INDEX_INCR DIRECT /end RECORD_LAYOUT
/begin CHARACTERISTIC BSW_ku16CCPReinitTriggerC "Spare" VALUE 0x8005808A DATA_RECORD_UWORD 2621.4 F_0v04_p1_5 1 2622.4 /end CHARACTERISTIC
/begin CHARACTERISTIC GMAIN_HARDBenchOnC "HARD activation" VALUE 0x80058050 DATA_RECORD_UBYTE 1 Bool_ON_OFF 0 1 BIT_MASK 0x01 /end CHARACTERISTIC
/begin CHARACTERISTIC GMAIN_VSIBenchOnWriteDataC "Bench VSI write datas" VALUE 0x8005804F DATA_RECORD_UBYTE 1 Bool_ON_OFF 0 1 BIT_MASK 0x01 /end CHARACTERISTIC
/begin CHARACTERISTIC GMAIN_f32UvwOvCurrThdC "Spare" VALUE 0x80058B3C DATA_RECORD_FLOAT32_IEEE 3.402823466E+038 F_1_p0_16 -3.402823466E+038 3.402823466E+038 /end CHARACTERISTIC
/begin CHARACTERISTIC GMAIN_s32CurHardDelayC "Spare" VALUE 0x80058B30 DATA_RECORD_SLONG 4294967295 F_1_p0_2 -2147483648 2147483647 /end CHARACTERISTIC
/begin CHARACTERISTIC GMAIN_s32ResHardDelayC "Spare" VALUE 0x80058B2C DATA_RECORD_SLONG 4294967295 F_1_p0_2 -2147483648 2147483647 /end CHARACTERISTIC
/begin CHARACTERISTIC GMAIN_s32SampleDelayC "Spare" VALUE 0x80058B28 DATA_RECORD_SLONG 4294967295 F_1_p0_2 -2147483648 2147483647 /end CHARACTERISTIC
/begin CHARACTERISTIC GMAIN_u16OverBhvThdC "Spare" VALUE 0x80058AD4 DATA_RECORD_UWORD 65535 F_1_p0_16 0 65535 /end CHARACTERISTIC
/begin CHARACTERISTIC GMAIN_u32VSICntCkreqESMStartedC "GMAIN_u32VSICntCkreqESMStartedC" VALUE 0x80058B38 DATA_RECORD_ULONG 4294967295 I_1 0 4294967295 /end CHARACTERISTIC
/begin CHARACTERISTIC GMAIN_u32VSICntCkreqVSIStartedC "GMAIN_u32VSICntCkreqVSIStartedC" VALUE 0x80058B34 DATA_RECORD_ULONG 4294967295 I_1 0 4294967295 /end CHARACTERISTIC
/begin CHARACTERISTIC MAIN_HARDBenchOnC "HARD activation" VALUE 0x80058054 DATA_RECORD_UBYTE 1 Bool_ON_OFF 0 1 BIT_MASK 0x01 /end CHARACTERISTIC
/begin CHARACTERISTIC MAIN_MFC_bCanAEnaC "Tx MSG activation" VALUE 0x8005805B DATA_RECORD_UBYTE 1 Bool_ON_OFF 0 1 BIT_MASK 0x01 /end CHARACTERISTIC
/begin CHARACTERISTIC MAIN_MFC_bCanBEnaC "Tx MSG activation" VALUE 0x80058060 DATA_RECORD_UBYTE 1 Bool_ON_OFF 0 1 BIT_MASK 0x01 /end CHARACTERISTIC
/begin CHARACTERISTIC MAIN_MFC_bCanCEnaC "Tx MSG activation" VALUE 0x8005805F DATA_RECORD_UBYTE 1 Bool_ON_OFF 0 1 BIT_MASK 0x01 /end CHARACTERISTIC
/begin CHARACTERISTIC MAIN_MFC_bCanDEnaC "Tx MSG activation" VALUE 0x8005805E DATA_RECORD_UBYTE 1 Bool_ON_OFF 0 1 BIT_MASK 0x01 /end CHARACTERISTIC
/begin CHARACTERISTIC MAIN_MFC_bCanEEnaC "Tx MSG activation" VALUE 0x8005805C DATA_RECORD_UBYTE 1 Bool_ON_OFF 0 1 BIT_MASK 0x01 /end CHARACTERISTIC
/begin CHARACTERISTIC MAIN_MFC_bCanFEnaC "Tx MSG activation" VALUE 0x8005805D DATA_RECORD_UBYTE 1 Bool_ON_OFF 0 1 BIT_MASK 0x01 /end CHARACTERISTIC
/begin CHARACTERISTIC MAIN_MFC_bDcAcEnaC "Tx MSG activation" VALUE 0x8005805A DATA_RECORD_UBYTE 1 Bool_ON_OFF 0 1 BIT_MASK 0x01 /end CHARACTERISTIC
/begin CHARACTERISTIC MAIN_MFC_bTestEnaC "Tx MSG activation" VALUE 0x80058059 DATA_RECORD_UBYTE 1 Bool_ON_OFF 0 1 BIT_MASK 0x01 /end CHARACTERISTIC
/begin CHARACTERISTIC MAIN_MFC_u8TempSensorCfgC_ACM "Spare" VALUE 0x8005807D DATA_RECORD_UBYTE 255 F_1_p0_2 0 255 /end CHARACTERISTIC
/begin CHARACTERISTIC MAIN_MFC_u8TempSensorCfgC_EPS "Spare" VALUE 0x8005807C DATA_RECORD_UBYTE 255 F_1_p0_2 0 255 /end CHARACTERISTIC
/begin CHARACTERISTIC MAIN_MFC_u8TempSensorCfgC_MCU1 "Spare" VALUE 0x8005807F DATA_RECORD_UBYTE 255 F_1_p0_2 0 255 /end CHARACTERISTIC
/begin CHARACTERISTIC MAIN_MFC_u8TempSensorCfgC_MCU2 "Spare" VALUE 0x8005807E DATA_RECORD_UBYTE 255 F_1_p0_2 0 255 /end CHARACTERISTIC
/begin CHARACTERISTIC MAIN_MSGRxBenchOnC "Rx MSG activation" VALUE 0x80058053 DATA_RECORD_UBYTE 1 Bool_ON_OFF 0 1 BIT_MASK 0x01 /end CHARACTERISTIC
/begin CHARACTERISTIC MAIN_MSGbIsulationTxOnC "Rx MSG activation" VALUE 0x80058051 DATA_RECORD_UBYTE 1 Bool_ON_OFF 0 1 BIT_MASK 0x01 /end CHARACTERISTIC
/begin CHARACTERISTIC MAIN_MSGu8PwModFiltCntC "Spare" VALUE 0x80058077 DATA_RECORD_UBYTE 255 I_1 0 255 /end CHARACTERISTIC
/begin CHARACTERISTIC MAIN_VSIBenchOnWriteDataC "Bench VSI write datas" VALUE 0x80058052 DATA_RECORD_UBYTE 1 Bool_ON_OFF 0 1 BIT_MASK 0x01 /end CHARACTERISTIC
/begin CHARACTERISTIC MAIN_b800VsersionSelcetEnC "Tx MSG activation" VALUE 0x8005804C DATA_RECORD_UBYTE 1 Bool_ON_OFF 0 1 BIT_MASK 0x01 /end CHARACTERISTIC
/begin CHARACTERISTIC MAIN_bMSGRxToutBenchOnC "COM MSG Rx activation" VALUE 0x80058056 DATA_RECORD_UBYTE 1 Bool_ON_OFF 0 1 BIT_MASK 0x01 /end CHARACTERISTIC
/begin CHARACTERISTIC MAIN_f32PowerdownVoltC "Spare" VALUE 0x80058B40 DATA_RECORD_FLOAT32_IEEE 3.402823466E+038 F_1_p0_2 -3.402823466E+038 3.402823466E+038 /end CHARACTERISTIC
/begin CHARACTERISTIC MAIN_f32UvwOvCurrThdC "Spare" VALUE 0x80058B64 DATA_RECORD_FLOAT32_IEEE 3.402823466E+038 F_1_p0_16 -3.402823466E+038 3.402823466E+038 /end CHARACTERISTIC
/begin CHARACTERISTIC MAIN_ku16SpdReadyEstConfirmC "Spare" VALUE 0x80058ADA DATA_RECORD_UWORD 65535 F_1_p0_2 0 65535 /end CHARACTERISTIC
/begin CHARACTERISTIC MAIN_s32CurHardDelayC "Spare" VALUE 0x80058B4C DATA_RECORD_SLONG 4294967295 F_1_p0_2 -2147483648 2147483647 /end CHARACTERISTIC
/begin CHARACTERISTIC MAIN_s32ResHardDelayC "Spare" VALUE 0x80058B48 DATA_RECORD_SLONG 4294967295 F_1_p0_2 -2147483648 2147483647 /end CHARACTERISTIC
/begin CHARACTERISTIC MAIN_s32SampleDelayC "Spare" VALUE 0x80058B44 DATA_RECORD_SLONG 4294967295 F_1_p0_2 -2147483648 2147483647 /end CHARACTERISTIC
/begin CHARACTERISTIC MAIN_u16OverBhvThdC "Spare" VALUE 0x80058AD8 DATA_RECORD_UWORD 65535 F_1_p0_16 0 65535 /end CHARACTERISTIC
/begin CHARACTERISTIC MAIN_u32VSICntCkreqESMStartedC "MAIN_u32VSICntCkreqESMStartedC" VALUE 0x80058B60 DATA_RECORD_ULONG 4294967295 I_1 0 4294967295 /end CHARACTERISTIC
/begin CHARACTERISTIC MAIN_u32VSICntCkreqVSIStartedC "MAIN_u32VSICntCkreqVSIStartedC" VALUE 0x80058B5C DATA_RECORD_ULONG 4294967295 I_1 0 4294967295 /end CHARACTERISTIC
/begin CHARACTERISTIC MAIN_u8TcuCapPreDrvTypeC "Spare" VALUE 0x80058075 DATA_RECORD_UBYTE 255 F_1_p0_2 0 255 /end CHARACTERISTIC
/begin CHARACTERISTIC OMAIN_HARDBenchOnC "Bench VSI write datas" VALUE 0x80058058 DATA_RECORD_UBYTE 1 Bool_ON_OFF 0 1 BIT_MASK 0x01 /end CHARACTERISTIC
/begin CHARACTERISTIC OMAIN_VSIBenchOnWriteDataC "Bench VSI write datas" VALUE 0x80058057 DATA_RECORD_UBYTE 1 Bool_ON_OFF 0 1 BIT_MASK 0x01 /end CHARACTERISTIC
/begin CHARACTERISTIC OMAIN_f32CanSpeedTgtSetC "..." VALUE 0x80058B78 DATA_RECORD_FLOAT32_IEEE 3.402823466E+038 F_1_p0_2 -3.402823466E+038 3.402823466E+038 /end CHARACTERISTIC
/begin CHARACTERISTIC OMAIN_f32OverBhvThdC "..." VALUE 0x80058B68 DATA_RECORD_FLOAT32_IEEE 3.402823466E+038 F_1_p0_2 -3.402823466E+038 3.402823466E+038 /end CHARACTERISTIC
/begin CHARACTERISTIC OMAIN_f32UvwOvCurrThdC "..." VALUE 0x80058B74 DATA_RECORD_FLOAT32_IEEE 3.402823466E+038 F_1_p0_2 -3.402823466E+038 3.402823466E+038 /end CHARACTERISTIC
/begin CHARACTERISTIC OMAIN_u32VSICntCkreqESMStartedC "Spare" VALUE 0x80058B70 DATA_RECORD_ULONG 4294967295 F_1_p0_2 0 4294967295 /end CHARACTERISTIC
/begin CHARACTERISTIC OMAIN_u32VSICntCkreqVSIStartedC "Spare" VALUE 0x80058B70 DATA_RECORD_ULONG 4294967295 F_1_p0_2 0 4294967295 /end CHARACTERISTIC
/begin CHARACTERISTIC SBC_bServiceDisableC "Spare" VALUE 0x80058AF0 DATA_RECORD_UBYTE 1 Bool_ON_OFF 0 1 BIT_MASK 0x01 /end CHARACTERISTIC
/begin CHARACTERISTIC SBC_f32RecoverThresholdC "Spare" VALUE 0x80058AF4 DATA_RECORD_FLOAT32_IEEE 3.402823466E+038 F_1_p0_2 -3.402823466E+038 3.402823466E+038 /end CHARACTERISTIC
/begin CHARACTERISTIC SBC_f32UnderVolHighThresholdC "Spare" VALUE 0x80058AFC DATA_RECORD_FLOAT32_IEEE 3.402823466E+038 F_1_p0_2 -3.402823466E+038 3.402823466E+038 /end CHARACTERISTIC
/begin CHARACTERISTIC SBC_f32UnderVolLowThresholdC "Spare" VALUE 0x80058AF8 DATA_RECORD_FLOAT32_IEEE 3.402823466E+038 F_1_p0_2 -3.402823466E+038 3.402823466E+038 /end CHARACTERISTIC
/begin MEASUREMENT ADCTotalTime "ADCTotalTime" ULONG I_1 1 2 0 4294967295 ECU_ADDRESS 0x70001B78 /end MEASUREMENT
/begin MEASUREMENT ASWNM_bFullComSts "..." UBYTE Bool_ON_OFF 1 2 0 1 BIT_MASK 0x01 ECU_ADDRESS 0x70001AEC /end MEASUREMENT
/begin MEASUREMENT ASWNM_u8CurrentState "..." UBYTE Id_0x00 1 2 0 255 MATRIX_DIM 21 1 1 ECU_ADDRESS 0x700159BC /end MEASUREMENT
/begin MEASUREMENT ASWNM_u8CurrentState[0] "ASWNM_u8CurrentState[0]" UBYTE Id_0x00 1 2 0 255 ECU_ADDRESS 0x700159BC /end MEASUREMENT
/begin MEASUREMENT ASWNM_u8CurrentState[10] "ASWNM_u8CurrentState[10]" UBYTE Id_0x00 1 2 0 255 ECU_ADDRESS 0x700159C6 /end MEASUREMENT
/begin MEASUREMENT ASWNM_u8CurrentState[11] "ASWNM_u8CurrentState[11]" UBYTE Id_0x00 1 2 0 255 ECU_ADDRESS 0x700159C7 /end MEASUREMENT
/begin MEASUREMENT ASWNM_u8CurrentState[12] "ASWNM_u8CurrentState[12]" UBYTE Id_0x00 1 2 0 255 ECU_ADDRESS 0x700159C8 /end MEASUREMENT
/begin MEASUREMENT ASWNM_u8CurrentState[13] "ASWNM_u8CurrentState[13]" UBYTE Id_0x00 1 2 0 255 ECU_ADDRESS 0x700159C9 /end MEASUREMENT
/begin MEASUREMENT ASWNM_u8CurrentState[14] "ASWNM_u8CurrentState[14]" UBYTE Id_0x00 1 2 0 255 ECU_ADDRESS 0x700159CA /end MEASUREMENT
/begin MEASUREMENT ASWNM_u8CurrentState[15] "ASWNM_u8CurrentState[15]" UBYTE Id_0x00 1 2 0 255 ECU_ADDRESS 0x700159CB /end MEASUREMENT
/begin MEASUREMENT ASWNM_u8CurrentState[16] "ASWNM_u8CurrentState[16]" UBYTE Id_0x00 1 2 0 255 ECU_ADDRESS 0x700159CC /end MEASUREMENT
/begin MEASUREMENT ASWNM_u8CurrentState[17] "ASWNM_u8CurrentState[17]" UBYTE Id_0x00 1 2 0 255 ECU_ADDRESS 0x700159CD /end MEASUREMENT
/begin MEASUREMENT ASWNM_u8CurrentState[18] "ASWNM_u8CurrentState[18]" UBYTE Id_0x00 1 2 0 255 ECU_ADDRESS 0x700159CE /end MEASUREMENT
/begin MEASUREMENT ASWNM_u8CurrentState[19] "ASWNM_u8CurrentState[19]" UBYTE Id_0x00 1 2 0 255 ECU_ADDRESS 0x700159CF /end MEASUREMENT
/begin MEASUREMENT ASWNM_u8CurrentState[1] "ASWNM_u8CurrentState[1]" UBYTE Id_0x00 1 2 0 255 ECU_ADDRESS 0x700159BD /end MEASUREMENT
/begin MEASUREMENT ASWNM_u8CurrentState[20] "ASWNM_u8CurrentState[20]" UBYTE Id_0x00 1 2 0 255 ECU_ADDRESS 0x700159D0 /end MEASUREMENT
/begin MEASUREMENT ASWNM_u8CurrentState[2] "ASWNM_u8CurrentState[2]" UBYTE Id_0x00 1 2 0 255 ECU_ADDRESS 0x700159BE /end MEASUREMENT
/begin MEASUREMENT ASWNM_u8CurrentState[3] "ASWNM_u8CurrentState[3]" UBYTE Id_0x00 1 2 0 255 ECU_ADDRESS 0x700159BF /end MEASUREMENT
/begin MEASUREMENT ASWNM_u8CurrentState[4] "ASWNM_u8CurrentState[4]" UBYTE Id_0x00 1 2 0 255 ECU_ADDRESS 0x700159C0 /end MEASUREMENT
/begin MEASUREMENT ASWNM_u8CurrentState[5] "ASWNM_u8CurrentState[5]" UBYTE Id_0x00 1 2 0 255 ECU_ADDRESS 0x700159C1 /end MEASUREMENT
/begin MEASUREMENT ASWNM_u8CurrentState[6] "ASWNM_u8CurrentState[6]" UBYTE Id_0x00 1 2 0 255 ECU_ADDRESS 0x700159C2 /end MEASUREMENT
/begin MEASUREMENT ASWNM_u8CurrentState[7] "ASWNM_u8CurrentState[7]" UBYTE Id_0x00 1 2 0 255 ECU_ADDRESS 0x700159C3 /end MEASUREMENT
/begin MEASUREMENT ASWNM_u8CurrentState[8] "ASWNM_u8CurrentState[8]" UBYTE Id_0x00 1 2 0 255 ECU_ADDRESS 0x700159C4 /end MEASUREMENT
/begin MEASUREMENT ASWNM_u8CurrentState[9] "ASWNM_u8CurrentState[9]" UBYTE Id_0x00 1 2 0 255 ECU_ADDRESS 0x700159C5 /end MEASUREMENT
/begin MEASUREMENT BSW_kau8IntBswLibDate[0] "BSW_kau8IntBswLibDate" UBYTE F_1_p0_2 1 2 0 255 ECU_ADDRESS 0x801F905C /end MEASUREMENT
/begin MEASUREMENT BSW_kau8IntBswLibDate[1] "BSW_kau8IntBswLibDate" UBYTE F_1_p0_2 1 2 0 255 ECU_ADDRESS 0x801F905D /end MEASUREMENT
/begin MEASUREMENT BSW_kau8IntBswLibDate[2] "BSW_kau8IntBswLibDate" UBYTE F_1_p0_2 1 2 0 255 ECU_ADDRESS 0x801F905E /end MEASUREMENT
/begin MEASUREMENT BSW_kau8IntBswLibDate[3] "BSW_kau8IntBswLibDate" UBYTE F_1_p0_2 1 2 0 255 ECU_ADDRESS 0x801F905F /end MEASUREMENT
/begin MEASUREMENT BSW_kau8IntBswLibDate[4] "BSW_kau8IntBswLibDate" UBYTE F_1_p0_2 1 2 0 255 ECU_ADDRESS 0x801F9060 /end MEASUREMENT
/begin MEASUREMENT BSW_kau8IntBswLibDate[5] "BSW_kau8IntBswLibDate" UBYTE F_1_p0_2 1 2 0 255 ECU_ADDRESS 0x801F9061 /end MEASUREMENT
/begin MEASUREMENT BSW_kau8IntProjectId[0] "BSW_kau8IntProjectId" UBYTE F_1_p0_2 1 2 0 255 ECU_ADDRESS 0x801F9062 /end MEASUREMENT
/begin MEASUREMENT BSW_kau8IntProjectId[1] "BSW_kau8IntProjectId" UBYTE F_1_p0_2 1 2 0 255 ECU_ADDRESS 0x801F9063 /end MEASUREMENT
/begin MEASUREMENT BSW_kau8IntProjectId[2] "BSW_kau8IntProjectId" UBYTE F_1_p0_2 1 2 0 255 ECU_ADDRESS 0x801F9064 /end MEASUREMENT
/begin MEASUREMENT BSW_kau8IntProjectId[3] "BSW_kau8IntProjectId" UBYTE F_1_p0_2 1 2 0 255 ECU_ADDRESS 0x801F9065 /end MEASUREMENT
/begin MEASUREMENT BSW_kau8IntProjectId[4] "BSW_kau8IntProjectId" UBYTE F_1_p0_2 1 2 0 255 ECU_ADDRESS 0x801F9066 /end MEASUREMENT
/begin MEASUREMENT BSW_kau8IntProjectId[5] "BSW_kau8IntProjectId" UBYTE F_1_p0_2 1 2 0 255 ECU_ADDRESS 0x801F9067 /end MEASUREMENT
/begin MEASUREMENT BSW_kau8IntProjectId[6] "BSW_kau8IntProjectId" UBYTE F_1_p0_2 1 2 0 255 ECU_ADDRESS 0x801F9068 /end MEASUREMENT
/begin MEASUREMENT BSW_kau8IntProjectId[7] "BSW_kau8IntProjectId" UBYTE F_1_p0_2 1 2 0 255 ECU_ADDRESS 0x801F9069 /end MEASUREMENT
/begin MEASUREMENT CPU0_MaximumUtilization "..." FLOAT32_IEEE F_1_p0_8 1 2 -3.402823466E+038 3.402823466E+038 ECU_ADDRESS 0x700156D8 /end MEASUREMENT
/begin MEASUREMENT CPU0_PercentUtilization "..." FLOAT32_IEEE F_1_p0_8 1 2 -3.402823466E+038 3.402823466E+038 ECU_ADDRESS 0x700156DC /end MEASUREMENT
/begin MEASUREMENT CPU1_MaximumUtilization "..." FLOAT32_IEEE F_1_p0_8 1 2 -3.402823466E+038 3.402823466E+038 ECU_ADDRESS 0x70015880 /end MEASUREMENT
/begin MEASUREMENT CPU1_PercentUtilization "..." FLOAT32_IEEE F_1_p0_8 1 2 -3.402823466E+038 3.402823466E+038 ECU_ADDRESS 0x70015884 /end MEASUREMENT
/begin MEASUREMENT CPU2_MaximumUtilization "..." FLOAT32_IEEE F_1_p0_8 1 2 -3.402823466E+038 3.402823466E+038 ECU_ADDRESS 0x70015958 /end MEASUREMENT
/begin MEASUREMENT CPU2_PercentUtilization "..." FLOAT32_IEEE F_1_p0_8 1 2 -3.402823466E+038 3.402823466E+038 ECU_ADDRESS 0x7001595C /end MEASUREMENT
/begin MEASUREMENT CPU3_MaximumUtilization "..." FLOAT32_IEEE F_1_p0_8 1 2 -3.402823466E+038 3.402823466E+038 ECU_ADDRESS 0x70015970 /end MEASUREMENT
/begin MEASUREMENT CPU3_PercentUtilization "..." FLOAT32_IEEE F_1_p0_8 1 2 -3.402823466E+038 3.402823466E+038 ECU_ADDRESS 0x70015974 /end MEASUREMENT
/begin MEASUREMENT Calibration_debut "Calibration_debut" UWORD I_1 1 2 0 65535 ECU_ADDRESS 0x80058000 /end MEASUREMENT
/begin MEASUREMENT Core0_MaxUserStackUtilization "..." FLOAT32_IEEE F_1_p0_8 1 2 -3.402823466E+038 3.402823466E+038 ECU_ADDRESS 0x700156D4 /end MEASUREMENT
/begin MEASUREMENT Core1_MaxUserStackUtilization "..." FLOAT32_IEEE F_1_p0_8 1 2 -3.402823466E+038 3.402823466E+038 ECU_ADDRESS 0x7001587C /end MEASUREMENT
/begin MEASUREMENT Core2_MaxUserStackUtilization "..." FLOAT32_IEEE F_1_p0_8 1 2 -3.402823466E+038 3.402823466E+038 ECU_ADDRESS 0x70015954 /end MEASUREMENT
/begin MEASUREMENT GMAIN_ESMGo2StartupIEvent "Evï¿½nement pour rï¿½initialiser lautomate ESM" UBYTE Bool_ON_OFF 1 2 0 1 BIT_MASK 0x01 ECU_ADDRESS 0x7001FE7D /end MEASUREMENT
/begin MEASUREMENT GMAIN_TotalTime "GMAIN_TotalTime" ULONG I_1 1 2 0 4294967295 ECU_ADDRESS 0x7001FDF0 /end MEASUREMENT
/begin MEASUREMENT GMAIN_as32OCTrimNvm "-" SLONG Id_0x00 1 2 -2147483648 2147483647 MATRIX_DIM 5 1 1 ECU_ADDRESS 0x7001FDCC /end MEASUREMENT
/begin MEASUREMENT GMAIN_as32OCTrimNvm[0] "GMAIN_as32OCTrimNvm[0]" SLONG Id_0x00 1 2 -2147483648 2147483647 ECU_ADDRESS 0x7001FDCC /end MEASUREMENT
/begin MEASUREMENT GMAIN_as32OCTrimNvm[1] "GMAIN_as32OCTrimNvm[1]" SLONG Id_0x00 1 2 -2147483648 2147483647 ECU_ADDRESS 0x7001FDD0 /end MEASUREMENT
/begin MEASUREMENT GMAIN_as32OCTrimNvm[2] "GMAIN_as32OCTrimNvm[2]" SLONG Id_0x00 1 2 -2147483648 2147483647 ECU_ADDRESS 0x7001FDD4 /end MEASUREMENT
/begin MEASUREMENT GMAIN_as32OCTrimNvm[3] "GMAIN_as32OCTrimNvm[3]" SLONG Id_0x00 1 2 -2147483648 2147483647 ECU_ADDRESS 0x7001FDD8 /end MEASUREMENT
/begin MEASUREMENT GMAIN_as32OCTrimNvm[4] "GMAIN_as32OCTrimNvm[4]" SLONG Id_0x00 1 2 -2147483648 2147483647 ECU_ADDRESS 0x7001FDDC /end MEASUREMENT
/begin MEASUREMENT GMAIN_bAscFlag "Flag ESM started" UBYTE Bool_ON_OFF 1 2 0 1 BIT_MASK 0x01 ECU_ADDRESS 0x7001FE88 /end MEASUREMENT
/begin MEASUREMENT GMAIN_bBswReadySts "BSW Power on check finish flag." UBYTE Bool_ON_OFF 1 2 0 1 BIT_MASK 0x01 ECU_ADDRESS 0x7001FE87 /end MEASUREMENT
/begin MEASUREMENT GMAIN_bESMStarted "Flag ESM started" UBYTE Bool_ON_OFF 1 2 0 1 BIT_MASK 0x01 ECU_ADDRESS 0x7001FE86 /end MEASUREMENT
/begin MEASUREMENT GMAIN_bOCStoreAswReq "GMAIN_bOCStoreAswReq" UBYTE Bool_ON_OFF 1 2 0 1 BIT_MASK 0x01 ECU_ADDRESS 0x70020374 /end MEASUREMENT
/begin MEASUREMENT GMAIN_bOcFailureFlg "..." UBYTE Bool_ON_OFF 1 2 0 1 BIT_MASK 0x01 ECU_ADDRESS 0x70020346 /end MEASUREMENT
/begin MEASUREMENT GMAIN_bOcFinshFlg "..." UBYTE Bool_ON_OFF 1 2 0 1 BIT_MASK 0x01 ECU_ADDRESS 0x70020345 /end MEASUREMENT
/begin MEASUREMENT GMAIN_bOcModeEna "..." UBYTE Bool_ON_OFF 1 2 0 1 BIT_MASK 0x01 ECU_ADDRESS 0x70020342 /end MEASUREMENT
/begin MEASUREMENT GMAIN_bOcNotRatFlg "..." UBYTE Bool_ON_OFF 1 2 0 1 BIT_MASK 0x01 ECU_ADDRESS 0x70020347 /end MEASUREMENT
/begin MEASUREMENT GMAIN_bOcRdResultFlag "..." UBYTE Bool_ON_OFF 1 2 0 1 BIT_MASK 0x01 ECU_ADDRESS 0x70020344 /end MEASUREMENT
/begin MEASUREMENT GMAIN_bOcStartFlag "..." UBYTE Bool_ON_OFF 1 2 0 1 BIT_MASK 0x01 ECU_ADDRESS 0x70020343 /end MEASUREMENT
/begin MEASUREMENT GMAIN_bProgConditionOk "..." UBYTE Bool_ON_OFF 1 2 0 1 BIT_MASK 0x01 ECU_ADDRESS 0x7001FE7C /end MEASUREMENT
/begin MEASUREMENT GMAIN_bResExcFltDetEna "..." UBYTE Bool_ON_OFF 1 2 0 1 BIT_MASK 0x01 ECU_ADDRESS 0x7001FE85 /end MEASUREMENT
/begin MEASUREMENT GMAIN_bSoftOvBhvFlg "..." UBYTE Bool_ON_OFF 1 2 0 1 BIT_MASK 0x01 ECU_ADDRESS 0x7001FE84 /end MEASUREMENT
/begin MEASUREMENT GMAIN_bSoftOvCurrPhsUFlg "..." UBYTE Bool_ON_OFF 1 2 0 1 BIT_MASK 0x01 ECU_ADDRESS 0x7001FE83 /end MEASUREMENT
/begin MEASUREMENT GMAIN_bSoftOvCurrPhsVFlg "..." UBYTE Bool_ON_OFF 1 2 0 1 BIT_MASK 0x01 ECU_ADDRESS 0x7001FE82 /end MEASUREMENT
/begin MEASUREMENT GMAIN_bSoftOvCurrPhsWFlg "..." UBYTE Bool_ON_OFF 1 2 0 1 BIT_MASK 0x01 ECU_ADDRESS 0x7001FE81 /end MEASUREMENT
/begin MEASUREMENT GMAIN_bSpdReadyEst "..." UBYTE Bool_ON_OFF 1 2 0 1 BIT_MASK 0x01 ECU_ADDRESS 0x7001FE80 /end MEASUREMENT
/begin MEASUREMENT GMAIN_bSpeedReadyFlg "..." UBYTE Bool_ON_OFF 1 2 0 1 BIT_MASK 0x01 ECU_ADDRESS 0x7001FE7F /end MEASUREMENT
/begin MEASUREMENT GMAIN_bVSIStarted "Flag VSI started" UBYTE Bool_ON_OFF 1 2 0 1 BIT_MASK 0x01 ECU_ADDRESS 0x7001FE7E /end MEASUREMENT
/begin MEASUREMENT GMAIN_f32ElecSpeedRds "..." FLOAT32_IEEE F_1_p0_8 1 2 -3.402823466E+038 3.402823466E+038 ECU_ADDRESS 0x7001FE78 /end MEASUREMENT
/begin MEASUREMENT GMAIN_f32EmailElecSpeedRds "..." FLOAT32_IEEE F_1_p0_8 1 2 -3.402823466E+038 3.402823466E+038 ECU_ADDRESS 0x7001FE74 /end MEASUREMENT
/begin MEASUREMENT GMAIN_f32EmailErrThetaRdSurPi "..." FLOAT32_IEEE F_1_p0_8 1 2 -3.402823466E+038 3.402823466E+038 ECU_ADDRESS 0x7001FE70 /end MEASUREMENT
/begin MEASUREMENT GMAIN_f32EmailMecaSpeedRds "..." FLOAT32_IEEE F_1_p0_8 1 2 -3.402823466E+038 3.402823466E+038 ECU_ADDRESS 0x7001FE6C /end MEASUREMENT
/begin MEASUREMENT GMAIN_f32EmailMecaSpeedRpm "..." FLOAT32_IEEE F_1_p0_8 1 2 -3.402823466E+038 3.402823466E+038 ECU_ADDRESS 0x7001FE68 /end MEASUREMENT
/begin MEASUREMENT GMAIN_f32EmailThetaElecRdSurPi "..." FLOAT32_IEEE F_1_p0_8 1 2 -3.402823466E+038 3.402823466E+038 ECU_ADDRESS 0x7001FE64 /end MEASUREMENT
/begin MEASUREMENT GMAIN_f32ErrThetaRdSurPi "..." FLOAT32_IEEE F_1_p0_8 1 2 -3.402823466E+038 3.402823466E+038 ECU_ADDRESS 0x7001FE60 /end MEASUREMENT
/begin MEASUREMENT GMAIN_f32IuFrequency "..." FLOAT32_IEEE F_1_p0_14 1 2 -3.402823466E+038 3.402823466E+038 ECU_ADDRESS 0x7001FE5C /end MEASUREMENT
/begin MEASUREMENT GMAIN_f32IuPeriod "..." FLOAT32_IEEE F_1_p0_15 1 2 -3.402823466E+038 3.402823466E+038 ECU_ADDRESS 0x7001FE58 /end MEASUREMENT
/begin MEASUREMENT GMAIN_f32MecaSpeedRds "..." FLOAT32_IEEE F_1_p0_8 1 2 -3.402823466E+038 3.402823466E+038 ECU_ADDRESS 0x7001FE54 /end MEASUREMENT
/begin MEASUREMENT GMAIN_f32MecaSpeedRpm "..." FLOAT32_IEEE F_1_p0_8 1 2 -3.402823466E+038 3.402823466E+038 ECU_ADDRESS 0x7001FE50 /end MEASUREMENT
/begin MEASUREMENT GMAIN_f32MotSpdEst "..." FLOAT32_IEEE F_1_p0_15 1 2 -3.402823466E+038 3.402823466E+038 ECU_ADDRESS 0x7001FE4C /end MEASUREMENT
/begin MEASUREMENT GMAIN_f32PWMDutyUPhys "..." FLOAT32_IEEE F_100_p0_3 1 2 -3.402823466E+038 3.402823466E+038 ECU_ADDRESS 0x7001FE48 /end MEASUREMENT
/begin MEASUREMENT GMAIN_f32PWMDutyVPhys "..." FLOAT32_IEEE F_100_p0_3 1 2 -3.402823466E+038 3.402823466E+038 ECU_ADDRESS 0x7001FE44 /end MEASUREMENT
/begin MEASUREMENT GMAIN_f32PWMDutyWPhys "..." FLOAT32_IEEE F_100_p0_3 1 2 -3.402823466E+038 3.402823466E+038 ECU_ADDRESS 0x7001FE40 /end MEASUREMENT
/begin MEASUREMENT GMAIN_f32ThetaElecRdSurPi "..." FLOAT32_IEEE F_1_p0_8 1 2 -3.402823466E+038 3.402823466E+038 ECU_ADDRESS 0x7001FE3C /end MEASUREMENT
/begin MEASUREMENT GMAIN_f32VsiPwmPeriod "..." FLOAT32_IEEE F_1000000_p0_17 1 2 -3.402823466E+038 3.402823466E+038 ECU_ADDRESS 0x7001FE38 /end MEASUREMENT
/begin MEASUREMENT GMAIN_s32Email2PosTreqDiff "..." SLONG I_1 1 2 -2147483648 2147483647 ECU_ADDRESS 0x7001FDC8 /end MEASUREMENT
/begin MEASUREMENT GMAIN_s32PosA2BDeltTime "..." SLONG F_0v1_p0_18 1 2 -214748364.8 214748364.7 ECU_ADDRESS 0x7001FDC4 /end MEASUREMENT
/begin MEASUREMENT GMAIN_u16IuCycleCnt "..." UWORD I_1 1 2 0 65535 ECU_ADDRESS 0x7001FE0C /end MEASUREMENT
/begin MEASUREMENT GMAIN_u16IuMiddleCnt "..." UWORD I_1 1 2 0 65535 ECU_ADDRESS 0x7001FE0A /end MEASUREMENT
/begin MEASUREMENT GMAIN_u16IuMiddleSum "..." UWORD I_1 1 2 0 65535 ECU_ADDRESS 0x7001FE08 /end MEASUREMENT
/begin MEASUREMENT GMAIN_u16IuNegtiveCnt "..." UWORD I_1 1 2 0 65535 ECU_ADDRESS 0x7001FE06 /end MEASUREMENT
/begin MEASUREMENT GMAIN_u16IuNegtiveSum "..." UWORD I_1 1 2 0 65535 ECU_ADDRESS 0x7001FE04 /end MEASUREMENT
/begin MEASUREMENT GMAIN_u16IuPositiveCnt "..." UWORD I_1 1 2 0 65535 ECU_ADDRESS 0x7001FE02 /end MEASUREMENT
/begin MEASUREMENT GMAIN_u16IuPositiveSum "..." UWORD I_1 1 2 0 65535 ECU_ADDRESS 0x7001FE00 /end MEASUREMENT
/begin MEASUREMENT GMAIN_u16PWMPeriodVal "GMAIN_u16PWMPeriodVal" UWORD I_1 1 2 0 65535 ECU_ADDRESS 0x70001AEE /end MEASUREMENT
/begin MEASUREMENT GMAIN_u16SpdReadyEstCnt "..." UWORD I_1 1 2 0 65535 ECU_ADDRESS 0x7001FDFE /end MEASUREMENT
/begin MEASUREMENT GMAIN_u16VadcBhv "GMAIN_u16VadcBhv" UWORD I_1 1 2 0 65535 ECU_ADDRESS 0x7001FDFC /end MEASUREMENT
/begin MEASUREMENT GMAIN_u32EmailCkreq "..." ULONG I_1 1 2 0 4294967295 ECU_ADDRESS 0x7001FE34 /end MEASUREMENT
/begin MEASUREMENT GMAIN_u32EmailPosATimeStamp "..." ULONG I_1 1 2 0 4294967295 ECU_ADDRESS 0x7001FE30 /end MEASUREMENT
/begin MEASUREMENT GMAIN_u32IuCycleTim "..." ULONG I_1 1 2 0 4294967295 ECU_ADDRESS 0x7001FE2C /end MEASUREMENT
/begin MEASUREMENT GMAIN_u32PosATimeStamp "..." ULONG I_1 1 2 0 4294967295 ECU_ADDRESS 0x7001FE28 /end MEASUREMENT
/begin MEASUREMENT GMAIN_u32PosBTimeStamp "..." ULONG I_1 1 2 0 4294967295 ECU_ADDRESS 0x7001FE24 /end MEASUREMENT
/begin MEASUREMENT GMAIN_u32PosTreatCkreq "..." ULONG I_1 1 2 0 4294967295 ECU_ADDRESS 0x7001FE20 /end MEASUREMENT
/begin MEASUREMENT GMAIN_u32TestVar2 "GMAIN_u32TestVar2" ULONG I_1 1 2 0 4294967295 ECU_ADDRESS 0x7001FE1C /end MEASUREMENT
/begin MEASUREMENT GMAIN_u8DEV_Fault "-" UBYTE F_1_p0_2 1 2 0 255 MATRIX_DIM 16 1 1 ECU_ADDRESS 0x7001FDE0 /end MEASUREMENT
/begin MEASUREMENT GMAIN_u8DEV_Fault[0] "GMAIN_u8DEV_Fault[0]" UBYTE F_1_p0_2 1 2 0 255 ECU_ADDRESS 0x7001FDE0 /end MEASUREMENT
/begin MEASUREMENT GMAIN_u8DEV_Fault[10] "GMAIN_u8DEV_Fault[10]" UBYTE F_1_p0_2 1 2 0 255 ECU_ADDRESS 0x7001FDEA /end MEASUREMENT
/begin MEASUREMENT GMAIN_u8DEV_Fault[11] "GMAIN_u8DEV_Fault[11]" UBYTE F_1_p0_2 1 2 0 255 ECU_ADDRESS 0x7001FDEB /end MEASUREMENT
/begin MEASUREMENT GMAIN_u8DEV_Fault[12] "GMAIN_u8DEV_Fault[12]" UBYTE F_1_p0_2 1 2 0 255 ECU_ADDRESS 0x7001FDEC /end MEASUREMENT
/begin MEASUREMENT GMAIN_u8DEV_Fault[13] "GMAIN_u8DEV_Fault[13]" UBYTE F_1_p0_2 1 2 0 255 ECU_ADDRESS 0x7001FDED /end MEASUREMENT
/begin MEASUREMENT GMAIN_u8DEV_Fault[14] "GMAIN_u8DEV_Fault[14]" UBYTE F_1_p0_2 1 2 0 255 ECU_ADDRESS 0x7001FDEE /end MEASUREMENT
/begin MEASUREMENT GMAIN_u8DEV_Fault[15] "GMAIN_u8DEV_Fault[15]" UBYTE F_1_p0_2 1 2 0 255 ECU_ADDRESS 0x7001FDEF /end MEASUREMENT
/begin MEASUREMENT GMAIN_u8DEV_Fault[1] "GMAIN_u8DEV_Fault[1]" UBYTE F_1_p0_2 1 2 0 255 ECU_ADDRESS 0x7001FDE1 /end MEASUREMENT
/begin MEASUREMENT GMAIN_u8DEV_Fault[2] "GMAIN_u8DEV_Fault[2]" UBYTE F_1_p0_2 1 2 0 255 ECU_ADDRESS 0x7001FDE2 /end MEASUREMENT
/begin MEASUREMENT GMAIN_u8DEV_Fault[3] "GMAIN_u8DEV_Fault[3]" UBYTE F_1_p0_2 1 2 0 255 ECU_ADDRESS 0x7001FDE3 /end MEASUREMENT
/begin MEASUREMENT GMAIN_u8DEV_Fault[4] "GMAIN_u8DEV_Fault[4]" UBYTE F_1_p0_2 1 2 0 255 ECU_ADDRESS 0x7001FDE4 /end MEASUREMENT
/begin MEASUREMENT GMAIN_u8DEV_Fault[5] "GMAIN_u8DEV_Fault[5]" UBYTE F_1_p0_2 1 2 0 255 ECU_ADDRESS 0x7001FDE5 /end MEASUREMENT
/begin MEASUREMENT GMAIN_u8DEV_Fault[6] "GMAIN_u8DEV_Fault[6]" UBYTE F_1_p0_2 1 2 0 255 ECU_ADDRESS 0x7001FDE6 /end MEASUREMENT
/begin MEASUREMENT GMAIN_u8DEV_Fault[7] "GMAIN_u8DEV_Fault[7]" UBYTE F_1_p0_2 1 2 0 255 ECU_ADDRESS 0x7001FDE7 /end MEASUREMENT
/begin MEASUREMENT GMAIN_u8DEV_Fault[8] "GMAIN_u8DEV_Fault[8]" UBYTE F_1_p0_2 1 2 0 255 ECU_ADDRESS 0x7001FDE8 /end MEASUREMENT
/begin MEASUREMENT GMAIN_u8DEV_Fault[9] "GMAIN_u8DEV_Fault[9]" UBYTE F_1_p0_2 1 2 0 255 ECU_ADDRESS 0x7001FDE9 /end MEASUREMENT
/begin MEASUREMENT GMAIN_u8OcState "..." UBYTE I_1 1 2 0 255 ECU_ADDRESS 0x7002033E /end MEASUREMENT
/begin MEASUREMENT GMAIN_u8OcStsRptDelayCnt "..." UBYTE I_1 1 2 0 255 ECU_ADDRESS 0x70020341 /end MEASUREMENT
/begin MEASUREMENT GMAIN_u8OfsAlCalSts "..." UBYTE I_1 1 2 0 255 ECU_ADDRESS 0x7002033F /end MEASUREMENT
/begin MEASUREMENT GMAIN_u8TrigOcByUser "..." UBYTE I_1 1 2 0 255 ECU_ADDRESS 0x70020340 /end MEASUREMENT
/begin MEASUREMENT HARD_bDioWriteTestEna "HARD activation" UBYTE Bool_ON_OFF 1 2 0 1 BIT_MASK 0x01 ECU_ADDRESS 0x70013D54 /end MEASUREMENT
/begin MEASUREMENT MAIN_MFC_au8CfgMap "-" UBYTE F_1_p0_2 1 2 0 255 MATRIX_DIM 2 1 1 ECU_ADDRESS 0x700202F1 /end MEASUREMENT
/begin MEASUREMENT MAIN_MFC_au8CfgMap[0] "MAIN_MFC_au8CfgMap[0]" UBYTE F_1_p0_2 1 2 0 255 ECU_ADDRESS 0x700202F1 /end MEASUREMENT
/begin MEASUREMENT MAIN_MFC_au8CfgMap[1] "MAIN_MFC_au8CfgMap[1]" UBYTE F_1_p0_2 1 2 0 255 ECU_ADDRESS 0x700202F2 /end MEASUREMENT
/begin MEASUREMENT MAIN_MSGbCan01_Rx01_Auxiliary_Contactor_Enable "MAIN_MSGbCan01_Rx01_Auxiliary_Contactor_Enable" UBYTE Bool_ON_OFF 1 2 0 1 BIT_MASK 0x01 ECU_ADDRESS 0x7001FC35 /end MEASUREMENT
/begin MEASUREMENT MAIN_MSGbCan01_Rx01_Batteryheat1_MOS_Switch_Cmd "MAIN_MSGbCan01_Rx01_Batteryheat1_MOS_Switch_Cmd" UBYTE Bool_ON_OFF 1 2 0 1 BIT_MASK 0x01 ECU_ADDRESS 0x7001FC2E /end MEASUREMENT
/begin MEASUREMENT MAIN_MSGbCan01_Rx01_Batteryheat2_MOS_Switch_Cmd "MAIN_MSGbCan01_Rx01_Batteryheat2_MOS_Switch_Cmd" UBYTE Bool_ON_OFF 1 2 0 1 BIT_MASK 0x01 ECU_ADDRESS 0x7001FC2D /end MEASUREMENT
/begin MEASUREMENT MAIN_MSGbCan01_Rx01_Batteryheat3_MOS_Switch_Cmd "MAIN_MSGbCan01_Rx01_Batteryheat3_MOS_Switch_Cmd" UBYTE Bool_ON_OFF 1 2 0 1 BIT_MASK 0x01 ECU_ADDRESS 0x7001FC2C /end MEASUREMENT
/begin MEASUREMENT MAIN_MSGbCan01_Rx01_Batteryheat4_MOS_Switch_Cmd "MAIN_MSGbCan01_Rx01_Batteryheat4_MOS_Switch_Cmd" UBYTE Bool_ON_OFF 1 2 0 1 BIT_MASK 0x01 ECU_ADDRESS 0x7001FC2B /end MEASUREMENT
/begin MEASUREMENT MAIN_MSGbCan01_Rx01_Cab1_PTC_MOS_Switch_Cmd "MAIN_MSGbCan01_Rx01_Cab1_PTC_MOS_Switch_Cmd" UBYTE Bool_ON_OFF 1 2 0 1 BIT_MASK 0x01 ECU_ADDRESS 0x7001FC30 /end MEASUREMENT
/begin MEASUREMENT MAIN_MSGbCan01_Rx01_Cab2_PTC_MOS_Switch_Cmd "MAIN_MSGbCan01_Rx01_Cab2_PTC_MOS_Switch_Cmd" UBYTE Bool_ON_OFF 1 2 0 1 BIT_MASK 0x01 ECU_ADDRESS 0x7001FC2F /end MEASUREMENT
/begin MEASUREMENT MAIN_MSGbCan01_Rx01_ChargCircuit1_NegContactor_Ctrl_Cmd "MAIN_MSGbCan01_Rx01_ChargCircuit1_NegContactor_Ctrl_Cmd" UBYTE Bool_ON_OFF 1 2 0 1 BIT_MASK 0x01 ECU_ADDRESS 0x7001FC29 /end MEASUREMENT
/begin MEASUREMENT MAIN_MSGbCan01_Rx01_ChargCircuit1_PosContactor_Ctrl_Cmd "MAIN_MSGbCan01_Rx01_ChargCircuit1_PosContactor_Ctrl_Cmd" UBYTE Bool_ON_OFF 1 2 0 1 BIT_MASK 0x01 ECU_ADDRESS 0x7001FC2A /end MEASUREMENT
/begin MEASUREMENT MAIN_MSGbCan01_Rx01_ChargCircuit2_NegContactor_Ctrl_Cmd "MAIN_MSGbCan01_Rx01_ChargCircuit2_NegContactor_Ctrl_Cmd" UBYTE Bool_ON_OFF 1 2 0 1 BIT_MASK 0x01 ECU_ADDRESS 0x7001FC27 /end MEASUREMENT
/begin MEASUREMENT MAIN_MSGbCan01_Rx01_ChargCircuit2_PosContactor_Ctrl_Cmd "MAIN_MSGbCan01_Rx01_ChargCircuit2_PosContactor_Ctrl_Cmd" UBYTE Bool_ON_OFF 1 2 0 1 BIT_MASK 0x01 ECU_ADDRESS 0x7001FC28 /end MEASUREMENT
/begin MEASUREMENT MAIN_MSGbCan01_Rx01_ChargCircuit3_NegContactor_Ctrl_Cmd "MAIN_MSGbCan01_Rx01_ChargCircuit3_NegContactor_Ctrl_Cmd" UBYTE Bool_ON_OFF 1 2 0 1 BIT_MASK 0x01 ECU_ADDRESS 0x7001FC25 /end MEASUREMENT
/begin MEASUREMENT MAIN_MSGbCan01_Rx01_ChargCircuit3_PosContactor_Ctrl_Cmd "MAIN_MSGbCan01_Rx01_ChargCircuit3_PosContactor_Ctrl_Cmd" UBYTE Bool_ON_OFF 1 2 0 1 BIT_MASK 0x01 ECU_ADDRESS 0x7001FC26 /end MEASUREMENT
/begin MEASUREMENT MAIN_MSGbCan01_Rx01_ChargCircuit4_NegContactor_Ctrl_Cmd "MAIN_MSGbCan01_Rx01_ChargCircuit4_NegContactor_Ctrl_Cmd" UBYTE Bool_ON_OFF 1 2 0 1 BIT_MASK 0x01 ECU_ADDRESS 0x7001FC23 /end MEASUREMENT
/begin MEASUREMENT MAIN_MSGbCan01_Rx01_ChargCircuit4_PosContactor_Ctrl_Cmd "MAIN_MSGbCan01_Rx01_ChargCircuit4_PosContactor_Ctrl_Cmd" UBYTE Bool_ON_OFF 1 2 0 1 BIT_MASK 0x01 ECU_ADDRESS 0x7001FC24 /end MEASUREMENT
/begin MEASUREMENT MAIN_MSGbCan01_Rx01_Insulationresistance_Ctrl_Cmd "MAIN_MSGbCan01_Rx01_Insulationresistance_Ctrl_Cmd" UBYTE Bool_ON_OFF 1 2 0 1 BIT_MASK 0x01 ECU_ADDRESS 0x70001AED /end MEASUREMENT
/begin MEASUREMENT MAIN_MSGbCan01_Rx01_Key_Signal "MAIN_MSGbCan01_Rx01_Key_Signal" UBYTE Bool_ON_OFF 1 2 0 1 BIT_MASK 0x01 ECU_ADDRESS 0x7001FC36 /end MEASUREMENT
/begin MEASUREMENT MAIN_MSGbCan01_Rx01_Keyon_Signal_Sts "MAIN_MSGbCan01_Rx01_Keyon_Signal_Sts" UBYTE Bool_ON_OFF 1 2 0 1 BIT_MASK 0x01 ECU_ADDRESS 0x7001FC32 /end MEASUREMENT
/begin MEASUREMENT MAIN_MSGbCan01_Rx01_NegContactor_Ctrl_Cmd "MAIN_MSGbCan01_Rx01_NegContactor_Ctrl_Cmd" UBYTE Bool_ON_OFF 1 2 0 1 BIT_MASK 0x01 ECU_ADDRESS 0x7001FC31 /end MEASUREMENT
/begin MEASUREMENT MAIN_MSGbCan01_Rx01_PTC_Enable_Signal "MAIN_MSGbCan01_Rx01_PTC_Enable_Signal" UBYTE Bool_ON_OFF 1 2 0 1 BIT_MASK 0x01 ECU_ADDRESS 0x7001FC34 /end MEASUREMENT
/begin MEASUREMENT MAIN_MSGbCan01_Rx01_Power_Enable_Signal "MAIN_MSGbCan01_Rx01_Power_Enable_Signal" UBYTE Bool_ON_OFF 1 2 0 1 BIT_MASK 0x01 ECU_ADDRESS 0x7001FC37 /end MEASUREMENT
/begin MEASUREMENT MAIN_MSGbCan01_Rx01_Upper_Enable_Signal "MAIN_MSGbCan01_Rx01_Upper_Enable_Signal" UBYTE Bool_ON_OFF 1 2 0 1 BIT_MASK 0x01 ECU_ADDRESS 0x7001FC33 /end MEASUREMENT
/begin MEASUREMENT MAIN_MSGbCan01_Rx04_Acu_Inhibit_Cmd "MAIN_MSGbCan01_Rx04_Acu_Inhibit_Cmd" UBYTE Bool_ON_OFF 1 2 0 1 BIT_MASK 0x01 ECU_ADDRESS 0x7001FC18 /end MEASUREMENT
/begin MEASUREMENT MAIN_MSGbCan01_Tx01_Enable_signal "MAIN_MSGbCan01_Tx01_Enable_signal" UBYTE Bool_ON_OFF 1 2 0 1 BIT_MASK 0x01 ECU_ADDRESS 0x7001FBEB /end MEASUREMENT
/begin MEASUREMENT MAIN_MSGbCan01_Tx01_Highvoltage_of_circuit_positive_contactor "MAIN_MSGbCan01_Tx01_Highvoltage_of_circuit_positive_contactor" UBYTE Bool_ON_OFF 1 2 0 1 BIT_MASK 0x01 ECU_ADDRESS 0x7001FBE4 /end MEASUREMENT
/begin MEASUREMENT MAIN_MSGbCan01_Tx01_Key_signal "MAIN_MSGbCan01_Tx01_Key_signal" UBYTE Bool_ON_OFF 1 2 0 1 BIT_MASK 0x01 ECU_ADDRESS 0x7001FBEA /end MEASUREMENT
/begin MEASUREMENT MAIN_MSGbCan01_Tx01_Positive_contactor_on "MAIN_MSGbCan01_Tx01_Positive_contactor_on" UBYTE Bool_ON_OFF 1 2 0 1 BIT_MASK 0x01 ECU_ADDRESS 0x7001FBE8 /end MEASUREMENT
/begin MEASUREMENT MAIN_MSGbCan01_Tx01_Positive_contactor_status "MAIN_MSGbCan01_Tx01_Positive_contactor_status" UBYTE Bool_ON_OFF 1 2 0 1 BIT_MASK 0x01 ECU_ADDRESS 0x7001FBE6 /end MEASUREMENT
/begin MEASUREMENT MAIN_MSGbCan01_Tx01_Poweron_selftest_ok_signal "MAIN_MSGbCan01_Tx01_Poweron_selftest_ok_signal" UBYTE Bool_ON_OFF 1 2 0 1 BIT_MASK 0x01 ECU_ADDRESS 0x7001FBE5 /end MEASUREMENT
/begin MEASUREMENT MAIN_MSGbCan01_Tx01_Precharge_contactor_on "MAIN_MSGbCan01_Tx01_Precharge_contactor_on" UBYTE Bool_ON_OFF 1 2 0 1 BIT_MASK 0x01 ECU_ADDRESS 0x7001FBE9 /end MEASUREMENT
/begin MEASUREMENT MAIN_MSGbCan01_Tx01_Voltage_diff_of_positive_contactor "MAIN_MSGbCan01_Tx01_Voltage_diff_of_positive_contactor" UBYTE Bool_ON_OFF 1 2 0 1 BIT_MASK 0x01 ECU_ADDRESS 0x7001FBE7 /end MEASUREMENT
/begin MEASUREMENT MAIN_MSGbCan01_Tx02_AuxiliaryContactor_Status "MAIN_MSGbCan01_Tx02_AuxiliaryContactor_Status" UBYTE Bool_ON_OFF 1 2 0 1 BIT_MASK 0x01 ECU_ADDRESS 0x7001FBD2 /end MEASUREMENT
/begin MEASUREMENT MAIN_MSGbCan01_Tx02_PTC_Contactor_Status "MAIN_MSGbCan01_Tx02_PTC_Contactor_Status" UBYTE Bool_ON_OFF 1 2 0 1 BIT_MASK 0x01 ECU_ADDRESS 0x7001FBE0 /end MEASUREMENT
/begin MEASUREMENT MAIN_MSGbCan01_Tx02_UpperCircuit_Contactor_On "MAIN_MSGbCan01_Tx02_UpperCircuit_Contactor_On" UBYTE Bool_ON_OFF 1 2 0 1 BIT_MASK 0x01 ECU_ADDRESS 0x7001FBDF /end MEASUREMENT
/begin MEASUREMENT MAIN_MSGbCan01_Tx02_UpperCircuit_Contactor_Status "MAIN_MSGbCan01_Tx02_UpperCircuit_Contactor_Status" UBYTE Bool_ON_OFF 1 2 0 1 BIT_MASK 0x01 ECU_ADDRESS 0x7001FBDD /end MEASUREMENT
/begin MEASUREMENT MAIN_MSGbCan01_Tx02_UpperCircuit_Precharge_Contactor_On "MAIN_MSGbCan01_Tx02_UpperCircuit_Precharge_Contactor_On" UBYTE Bool_ON_OFF 1 2 0 1 BIT_MASK 0x01 ECU_ADDRESS 0x7001FBDE /end MEASUREMENT
/begin MEASUREMENT MAIN_MSGbCan01_Tx07_Hardwire_Enable_Signal_Sts "MAIN_MSGbCan01_Tx07_Hardwire_Enable_Signal_Sts" UBYTE Bool_ON_OFF 1 2 0 1 BIT_MASK 0x01 ECU_ADDRESS 0x7001FB71 /end MEASUREMENT
/begin MEASUREMENT MAIN_MSGbCan02_Rx01_MCU1_Mor_Cmd "MAIN_MSGbCan02_Rx01_MCU1_Mor_Cmd" UBYTE Bool_ON_OFF 1 2 0 1 BIT_MASK 0x01 ECU_ADDRESS 0x7001FD3F /end MEASUREMENT
/begin MEASUREMENT MAIN_MSGf32Can01_Rx03_Steerpump_Motor_Targetspeed "..." FLOAT32_IEEE I_1 1 2 -3.402823466E+038 3.402823466E+038 ECU_ADDRESS 0x7001FC1C /end MEASUREMENT
/begin MEASUREMENT MAIN_MSGf32Can01_Rx04_Aircompressor_Motor_Targspeed "..." FLOAT32_IEEE I_1 1 2 -3.402823466E+038 3.402823466E+038 ECU_ADDRESS 0x7001FC14 /end MEASUREMENT
/begin MEASUREMENT MAIN_MSGf32Can01_Rx05_TCU_MotorTorReq "..." FLOAT32_IEEE I_1 1 2 -3.402823466E+038 3.402823466E+038 ECU_ADDRESS 0x7001FC08 /end MEASUREMENT
/begin MEASUREMENT MAIN_MSGf32Can01_Rx05_TCU_MotorWorkModReq "..." FLOAT32_IEEE I_1 1 2 -3.402823466E+038 3.402823466E+038 ECU_ADDRESS 0x7001FC0C /end MEASUREMENT
/begin MEASUREMENT MAIN_MSGf32Can01_Rx06_TCU_MotorTorReq "..." FLOAT32_IEEE I_1 1 2 -3.402823466E+038 3.402823466E+038 ECU_ADDRESS 0x7001FC00 /end MEASUREMENT
/begin MEASUREMENT MAIN_MSGf32Can01_Rx06_TCU_MotorWorkModReq "..." FLOAT32_IEEE I_1 1 2 -3.402823466E+038 3.402823466E+038 ECU_ADDRESS 0x7001FC04 /end MEASUREMENT
/begin MEASUREMENT MAIN_MSGf32Can01_Tx01_Low_input_voltage "..." FLOAT32_IEEE I_1 1 2 -3.402823466E+038 3.402823466E+038 ECU_ADDRESS 0x7001FBFC /end MEASUREMENT
/begin MEASUREMENT MAIN_MSGf32Can01_Tx01_Main_pos_contactor_out_voltage "..." FLOAT32_IEEE I_1 1 2 -3.402823466E+038 3.402823466E+038 ECU_ADDRESS 0x7001FBF4 /end MEASUREMENT
/begin MEASUREMENT MAIN_MSGf32Can01_Tx01_Power_battery_pack_voltage "..." FLOAT32_IEEE I_1 1 2 -3.402823466E+038 3.402823466E+038 ECU_ADDRESS 0x7001FBF8 /end MEASUREMENT
/begin MEASUREMENT MAIN_MSGf32Can01_Tx01_Precharg_resistor_temp "..." FLOAT32_IEEE I_1 1 2 -3.402823466E+038 3.402823466E+038 ECU_ADDRESS 0x7001FBF0 /end MEASUREMENT
/begin MEASUREMENT MAIN_MSGf32Can01_Tx01_Precharg_time_consumption "..." FLOAT32_IEEE I_1 1 2 -3.402823466E+038 3.402823466E+038 ECU_ADDRESS 0x7001FBEC /end MEASUREMENT
/begin MEASUREMENT MAIN_MSGf32Can01_Tx02_Outputvoltage_of_UpperCircuit_Contactor "..." FLOAT32_IEEE I_1 1 2 -3.402823466E+038 3.402823466E+038 ECU_ADDRESS 0x7001FBD4 /end MEASUREMENT
/begin MEASUREMENT MAIN_MSGf32Can01_Tx02_Software_Version "..." FLOAT32_IEEE I_1 1 2 -3.402823466E+038 3.402823466E+038 ECU_ADDRESS 0x7001FBD8 /end MEASUREMENT
/begin MEASUREMENT MAIN_MSGf32Can01_Tx04_Chargingpile_voltage "..." FLOAT32_IEEE I_1 1 2 -3.402823466E+038 3.402823466E+038 ECU_ADDRESS 0x7001FBAC /end MEASUREMENT
/begin MEASUREMENT MAIN_MSGf32Can01_Tx04_Negativepole_to_ground_resistance_value "..." FLOAT32_IEEE I_1 1 2 -3.402823466E+038 3.402823466E+038 ECU_ADDRESS 0x7001FBB0 /end MEASUREMENT
/begin MEASUREMENT MAIN_MSGf32Can01_Tx04_Positivepole_to_ground_resistance_value "..." FLOAT32_IEEE I_1 1 2 -3.402823466E+038 3.402823466E+038 ECU_ADDRESS 0x7001FBB4 /end MEASUREMENT
/begin MEASUREMENT MAIN_MSGf32Can01_Tx05_Output_Current "..." FLOAT32_IEEE I_1 1 2 -3.402823466E+038 3.402823466E+038 ECU_ADDRESS 0x7001FBA4 /end MEASUREMENT
/begin MEASUREMENT MAIN_MSGf32Can01_Tx05_Steering_Oil_DCAC_Module_Temp "..." FLOAT32_IEEE I_1 1 2 -3.402823466E+038 3.402823466E+038 ECU_ADDRESS 0x7001FBA0 /end MEASUREMENT
/begin MEASUREMENT MAIN_MSGf32Can01_Tx06_Input_Voltage "..." FLOAT32_IEEE I_1 1 2 -3.402823466E+038 3.402823466E+038 ECU_ADDRESS 0x7001FB94 /end MEASUREMENT
/begin MEASUREMENT MAIN_MSGf32Can01_Tx06_Software_Version "..." FLOAT32_IEEE I_1 1 2 -3.402823466E+038 3.402823466E+038 ECU_ADDRESS 0x7001FB8C /end MEASUREMENT
/begin MEASUREMENT MAIN_MSGf32Can01_Tx06_Steer_Motor_Temp "..." FLOAT32_IEEE I_1 1 2 -3.402823466E+038 3.402823466E+038 ECU_ADDRESS 0x7001FB98 /end MEASUREMENT
/begin MEASUREMENT MAIN_MSGf32Can01_Tx07_AirCompressor_Temp "..." FLOAT32_IEEE I_1 1 2 -3.402823466E+038 3.402823466E+038 ECU_ADDRESS 0x7001FB74 /end MEASUREMENT
/begin MEASUREMENT MAIN_MSGf32Can01_Tx07_Input_Voltage "..." FLOAT32_IEEE I_1 1 2 -3.402823466E+038 3.402823466E+038 ECU_ADDRESS 0x7001FB88 /end MEASUREMENT
/begin MEASUREMENT MAIN_MSGf32Can01_Tx07_Output_Voltage "..." FLOAT32_IEEE I_1 1 2 -3.402823466E+038 3.402823466E+038 ECU_ADDRESS 0x7001FB80 /end MEASUREMENT
/begin MEASUREMENT MAIN_MSGf32Can01_Tx07_SDCAC_MotorTemp "..." FLOAT32_IEEE I_1 1 2 -3.402823466E+038 3.402823466E+038 ECU_ADDRESS 0x7001FB78 /end MEASUREMENT
/begin MEASUREMENT MAIN_MSGf32Can01_Tx08_AirCompressor_Motor_Speed "..." FLOAT32_IEEE I_1 1 2 -3.402823466E+038 3.402823466E+038 ECU_ADDRESS 0x7001FB6C /end MEASUREMENT
/begin MEASUREMENT MAIN_MSGf32Can01_Tx08_Software_Version "..." FLOAT32_IEEE I_1 1 2 -3.402823466E+038 3.402823466E+038 ECU_ADDRESS 0x7001FB64 /end MEASUREMENT
/begin MEASUREMENT MAIN_MSGf32Can02_Rx01_MC1_Mor_Tgt_Spd "..." FLOAT32_IEEE I_1 1 2 -3.402823466E+038 3.402823466E+038 ECU_ADDRESS 0x7001FD30 /end MEASUREMENT
/begin MEASUREMENT MAIN_MSGf32Can02_Rx01_MC1_Mor_Tgt_Trq "..." FLOAT32_IEEE I_1 1 2 -3.402823466E+038 3.402823466E+038 ECU_ADDRESS 0x7001FD34 /end MEASUREMENT
/begin MEASUREMENT MAIN_MSGf32Can02_Rx02_HCU1_MCU_LimitLowTrq "..." FLOAT32_IEEE I_1 1 2 -3.402823466E+038 3.402823466E+038 ECU_ADDRESS 0x7001FD24 /end MEASUREMENT
/begin MEASUREMENT MAIN_MSGf32Can02_Rx03_HCU_GearNum "..." FLOAT32_IEEE I_1 1 2 -3.402823466E+038 3.402823466E+038 ECU_ADDRESS 0x7001FD1C /end MEASUREMENT
/begin MEASUREMENT MAIN_MSGf32Can02_Rx03_HCU_OutputShaftSpeed "..." FLOAT32_IEEE I_1 1 2 -3.402823466E+038 3.402823466E+038 ECU_ADDRESS 0x7001FD10 /end MEASUREMENT
/begin MEASUREMENT MAIN_MSGf32Can02_Tx01_TS3_Motor_Out_Current "..." FLOAT32_IEEE I_1 1 2 -3.402823466E+038 3.402823466E+038 ECU_ADDRESS 0x7001FD0C /end MEASUREMENT
/begin MEASUREMENT MAIN_MSGf32Can02_Tx02_TS3_Motor_AC_Voltage "..." FLOAT32_IEEE I_1 1 2 -3.402823466E+038 3.402823466E+038 ECU_ADDRESS 0x7001FCF8 /end MEASUREMENT
/begin MEASUREMENT MAIN_MSGf32Can02_Tx02_TS3_Motor_DC_Current "..." FLOAT32_IEEE I_1 1 2 -3.402823466E+038 3.402823466E+038 ECU_ADDRESS 0x7001FCFC /end MEASUREMENT
/begin MEASUREMENT MAIN_MSGf32Can02_Tx02_TS3_Motor_Speed "..." FLOAT32_IEEE I_1 1 2 -3.402823466E+038 3.402823466E+038 ECU_ADDRESS 0x7001FCF4 /end MEASUREMENT
/begin MEASUREMENT MAIN_MSGf32Can02_Tx03_TS3_Motor_CanVersion "..." FLOAT32_IEEE I_1 1 2 -3.402823466E+038 3.402823466E+038 ECU_ADDRESS 0x7001FCD4 /end MEASUREMENT
/begin MEASUREMENT MAIN_MSGf32Can02_Tx03_TS3_Motor_MaxBrkiTrqLmt "..." FLOAT32_IEEE I_1 1 2 -3.402823466E+038 3.402823466E+038 ECU_ADDRESS 0x7001FCE8 /end MEASUREMENT
/begin MEASUREMENT MAIN_MSGf32Can02_Tx03_TS3_Motor_MaxDrviTrqLmt "..." FLOAT32_IEEE I_1 1 2 -3.402823466E+038 3.402823466E+038 ECU_ADDRESS 0x7001FCEC /end MEASUREMENT
/begin MEASUREMENT MAIN_MSGf32Can02_Tx03_TS3_Motor_MotControllerTemp "..." FLOAT32_IEEE I_1 1 2 -3.402823466E+038 3.402823466E+038 ECU_ADDRESS 0x7001FCDC /end MEASUREMENT
/begin MEASUREMENT MAIN_MSGf32Can02_Tx03_TS3_Motor_MotMaxspdLmt "..." FLOAT32_IEEE I_1 1 2 -3.402823466E+038 3.402823466E+038 ECU_ADDRESS 0x7001FCE4 /end MEASUREMENT
/begin MEASUREMENT MAIN_MSGf32Can02_Tx03_TS3_Motor_MotTemp "..." FLOAT32_IEEE I_1 1 2 -3.402823466E+038 3.402823466E+038 ECU_ADDRESS 0x7001FCE0 /end MEASUREMENT
/begin MEASUREMENT MAIN_MSGf32Can02_Tx05_TS3_DC_NTC_Temp "..." FLOAT32_IEEE I_1 1 2 -3.402823466E+038 3.402823466E+038 ECU_ADDRESS 0x7001FCCC /end MEASUREMENT
/begin MEASUREMENT MAIN_MSGu16Can01_Tx01_Main_pos_contactor_out_voltageRaw "..." UWORD I_1 1 2 0 65535 ECU_ADDRESS 0x7001FC50 /end MEASUREMENT
/begin MEASUREMENT MAIN_MSGu16Can01_Tx01_Power_battery_pack_voltageRaw "..." UWORD I_1 1 2 0 65535 ECU_ADDRESS 0x7001FC52 /end MEASUREMENT
/begin MEASUREMENT MAIN_MSGu16Can01_Tx02_Outputvoltage_of_UpperCircuit_ContactorRaw "..." UWORD I_1 1 2 0 65535 ECU_ADDRESS 0x7001FC4A /end MEASUREMENT
/begin MEASUREMENT MAIN_MSGu16Can01_Tx04_Chargingpile_voltageRaw "..." UWORD I_1 1 2 0 65535 ECU_ADDRESS 0x7001FC44 /end MEASUREMENT
/begin MEASUREMENT MAIN_MSGu16Can01_Tx04_Negativepole_to_ground_resistance_valueRaw "..." UWORD I_1 1 2 0 65535 ECU_ADDRESS 0x7001FC46 /end MEASUREMENT
/begin MEASUREMENT MAIN_MSGu16Can01_Tx04_Positivepole_to_ground_resistance_valueRaw "..." UWORD I_1 1 2 0 65535 ECU_ADDRESS 0x7001FC48 /end MEASUREMENT
/begin MEASUREMENT MAIN_MSGu16Can01_Tx05_Motor_Speed "..." UWORD I_1 1 2 0 65535 ECU_ADDRESS 0x7001FBA8 /end MEASUREMENT
/begin MEASUREMENT MAIN_MSGu16Can01_Tx05_Output_CurrentRaw "..." UWORD I_1 1 2 0 65535 ECU_ADDRESS 0x7001FC42 /end MEASUREMENT
/begin MEASUREMENT MAIN_MSGu16Can02_Rx01_MC1_Mor_Tgt_SpdRaw "..." UWORD I_1 1 2 0 65535 ECU_ADDRESS 0x7001FD5A /end MEASUREMENT
/begin MEASUREMENT MAIN_MSGu16Can02_Rx01_MC1_Mor_Tgt_TrqRaw "..." UWORD I_1 1 2 0 65535 ECU_ADDRESS 0x7001FD5C /end MEASUREMENT
/begin MEASUREMENT MAIN_MSGu16Can02_Rx01_MCU1_CycMsg_LimitHigh "..." UWORD I_1 1 2 0 65535 ECU_ADDRESS 0x7001FD3A /end MEASUREMENT
/begin MEASUREMENT MAIN_MSGu16Can02_Rx01_MCU1_CycMsg_LimitLow "..." UWORD I_1 1 2 0 65535 ECU_ADDRESS 0x7001FD38 /end MEASUREMENT
/begin MEASUREMENT MAIN_MSGu16Can02_Rx02_Allow_Pulse_Charge_Current "..." UWORD I_1 1 2 0 65535 ECU_ADDRESS 0x7001FD2A /end MEASUREMENT
/begin MEASUREMENT MAIN_MSGu16Can02_Rx02_Allow_Pulse_Discharge_Current "..." UWORD I_1 1 2 0 65535 ECU_ADDRESS 0x7001FD2C /end MEASUREMENT
/begin MEASUREMENT MAIN_MSGu16Can02_Rx02_HCU1_MCU_LimitHighTrq "..." UWORD I_1 1 2 0 65535 ECU_ADDRESS 0x7001FD20 /end MEASUREMENT
/begin MEASUREMENT MAIN_MSGu16Can02_Rx02_HCU1_MCU_LimitLowTrqRaw "..." UWORD I_1 1 2 0 65535 ECU_ADDRESS 0x7001FD58 /end MEASUREMENT
/begin MEASUREMENT MAIN_MSGu16Can02_Rx03_HCU_OutputShaftSpeedRaw "..." UWORD I_1 1 2 0 65535 ECU_ADDRESS 0x7001FD54 /end MEASUREMENT
/begin MEASUREMENT MAIN_MSGu16Can02_Tx01_TS3_Motor_Out_CurrentRaw "..." UWORD I_1 1 2 0 65535 ECU_ADDRESS 0x7001FD52 /end MEASUREMENT
/begin MEASUREMENT MAIN_MSGu16Can02_Tx02_TS3_Motor_AC_VoltageRaw "..." UWORD I_1 1 2 0 65535 ECU_ADDRESS 0x7001FD4A /end MEASUREMENT
/begin MEASUREMENT MAIN_MSGu16Can02_Tx02_TS3_Motor_DC_CurrentRaw "..." UWORD I_1 1 2 0 65535 ECU_ADDRESS 0x7001FD4C /end MEASUREMENT
/begin MEASUREMENT MAIN_MSGu16Can02_Tx02_TS3_Motor_SpeedRaw "..." UWORD I_1 1 2 0 65535 ECU_ADDRESS 0x7001FD48 /end MEASUREMENT
/begin MEASUREMENT MAIN_MSGu16Can02_Tx02_TS3_Motor_Torque "..." UWORD I_1 1 2 0 65535 ECU_ADDRESS 0x7001FCF2 /end MEASUREMENT
/begin MEASUREMENT MAIN_MSGu8Can01_Rx01_Heartbeat_Signal "..." UBYTE I_1 1 2 0 255 ECU_ADDRESS 0x7001FC22 /end MEASUREMENT
/begin MEASUREMENT MAIN_MSGu8Can01_Rx01_PDUMC1_buf "-" UBYTE Id_0x00 1 2 0 255 MATRIX_DIM 8 1 1 ECU_ADDRESS 0x7001FCC3 /end MEASUREMENT
/begin MEASUREMENT MAIN_MSGu8Can01_Rx01_PDUMC1_buf[0] "MAIN_MSGu8Can01_Rx01_PDUMC1_buf[0]" UBYTE Id_0x00 1 2 0 255 ECU_ADDRESS 0x7001FCC3 /end MEASUREMENT
/begin MEASUREMENT MAIN_MSGu8Can01_Rx01_PDUMC1_buf[1] "MAIN_MSGu8Can01_Rx01_PDUMC1_buf[1]" UBYTE Id_0x00 1 2 0 255 ECU_ADDRESS 0x7001FCC4 /end MEASUREMENT
/begin MEASUREMENT MAIN_MSGu8Can01_Rx01_PDUMC1_buf[2] "MAIN_MSGu8Can01_Rx01_PDUMC1_buf[2]" UBYTE Id_0x00 1 2 0 255 ECU_ADDRESS 0x7001FCC5 /end MEASUREMENT
/begin MEASUREMENT MAIN_MSGu8Can01_Rx01_PDUMC1_buf[3] "MAIN_MSGu8Can01_Rx01_PDUMC1_buf[3]" UBYTE Id_0x00 1 2 0 255 ECU_ADDRESS 0x7001FCC6 /end MEASUREMENT
/begin MEASUREMENT MAIN_MSGu8Can01_Rx01_PDUMC1_buf[4] "MAIN_MSGu8Can01_Rx01_PDUMC1_buf[4]" UBYTE Id_0x00 1 2 0 255 ECU_ADDRESS 0x7001FCC7 /end MEASUREMENT
/begin MEASUREMENT MAIN_MSGu8Can01_Rx01_PDUMC1_buf[5] "MAIN_MSGu8Can01_Rx01_PDUMC1_buf[5]" UBYTE Id_0x00 1 2 0 255 ECU_ADDRESS 0x7001FCC8 /end MEASUREMENT
/begin MEASUREMENT MAIN_MSGu8Can01_Rx01_PDUMC1_buf[6] "MAIN_MSGu8Can01_Rx01_PDUMC1_buf[6]" UBYTE Id_0x00 1 2 0 255 ECU_ADDRESS 0x7001FCC9 /end MEASUREMENT
/begin MEASUREMENT MAIN_MSGu8Can01_Rx01_PDUMC1_buf[7] "MAIN_MSGu8Can01_Rx01_PDUMC1_buf[7]" UBYTE Id_0x00 1 2 0 255 ECU_ADDRESS 0x7001FCCA /end MEASUREMENT
/begin MEASUREMENT MAIN_MSGu8Can01_Rx02_HSMC1_buf "-" UBYTE Id_0x00 1 2 0 255 MATRIX_DIM 8 1 1 ECU_ADDRESS 0x7001FCBB /end MEASUREMENT
/begin MEASUREMENT MAIN_MSGu8Can01_Rx02_HSMC1_buf[0] "MAIN_MSGu8Can01_Rx02_HSMC1_buf[0]" UBYTE Id_0x00 1 2 0 255 ECU_ADDRESS 0x7001FCBB /end MEASUREMENT
/begin MEASUREMENT MAIN_MSGu8Can01_Rx02_HSMC1_buf[1] "MAIN_MSGu8Can01_Rx02_HSMC1_buf[1]" UBYTE Id_0x00 1 2 0 255 ECU_ADDRESS 0x7001FCBC /end MEASUREMENT
/begin MEASUREMENT MAIN_MSGu8Can01_Rx02_HSMC1_buf[2] "MAIN_MSGu8Can01_Rx02_HSMC1_buf[2]" UBYTE Id_0x00 1 2 0 255 ECU_ADDRESS 0x7001FCBD /end MEASUREMENT
/begin MEASUREMENT MAIN_MSGu8Can01_Rx02_HSMC1_buf[3] "MAIN_MSGu8Can01_Rx02_HSMC1_buf[3]" UBYTE Id_0x00 1 2 0 255 ECU_ADDRESS 0x7001FCBE /end MEASUREMENT
/begin MEASUREMENT MAIN_MSGu8Can01_Rx02_HSMC1_buf[4] "MAIN_MSGu8Can01_Rx02_HSMC1_buf[4]" UBYTE Id_0x00 1 2 0 255 ECU_ADDRESS 0x7001FCBF /end MEASUREMENT
/begin MEASUREMENT MAIN_MSGu8Can01_Rx02_HSMC1_buf[5] "MAIN_MSGu8Can01_Rx02_HSMC1_buf[5]" UBYTE Id_0x00 1 2 0 255 ECU_ADDRESS 0x7001FCC0 /end MEASUREMENT
/begin MEASUREMENT MAIN_MSGu8Can01_Rx02_HSMC1_buf[6] "MAIN_MSGu8Can01_Rx02_HSMC1_buf[6]" UBYTE Id_0x00 1 2 0 255 ECU_ADDRESS 0x7001FCC1 /end MEASUREMENT
/begin MEASUREMENT MAIN_MSGu8Can01_Rx02_HSMC1_buf[7] "MAIN_MSGu8Can01_Rx02_HSMC1_buf[7]" UBYTE Id_0x00 1 2 0 255 ECU_ADDRESS 0x7001FCC2 /end MEASUREMENT
/begin MEASUREMENT MAIN_MSGu8Can01_Rx03_HSSTC_buf "-" UBYTE Id_0x00 1 2 0 255 MATRIX_DIM 8 1 1 ECU_ADDRESS 0x7001FCB3 /end MEASUREMENT
/begin MEASUREMENT MAIN_MSGu8Can01_Rx03_HSSTC_buf[0] "MAIN_MSGu8Can01_Rx03_HSSTC_buf[0]" UBYTE Id_0x00 1 2 0 255 ECU_ADDRESS 0x7001FCB3 /end MEASUREMENT
/begin MEASUREMENT MAIN_MSGu8Can01_Rx03_HSSTC_buf[1] "MAIN_MSGu8Can01_Rx03_HSSTC_buf[1]" UBYTE Id_0x00 1 2 0 255 ECU_ADDRESS 0x7001FCB4 /end MEASUREMENT
/begin MEASUREMENT MAIN_MSGu8Can01_Rx03_HSSTC_buf[2] "MAIN_MSGu8Can01_Rx03_HSSTC_buf[2]" UBYTE Id_0x00 1 2 0 255 ECU_ADDRESS 0x7001FCB5 /end MEASUREMENT
/begin MEASUREMENT MAIN_MSGu8Can01_Rx03_HSSTC_buf[3] "MAIN_MSGu8Can01_Rx03_HSSTC_buf[3]" UBYTE Id_0x00 1 2 0 255 ECU_ADDRESS 0x7001FCB6 /end MEASUREMENT
/begin MEASUREMENT MAIN_MSGu8Can01_Rx03_HSSTC_buf[4] "MAIN_MSGu8Can01_Rx03_HSSTC_buf[4]" UBYTE Id_0x00 1 2 0 255 ECU_ADDRESS 0x7001FCB7 /end MEASUREMENT
/begin MEASUREMENT MAIN_MSGu8Can01_Rx03_HSSTC_buf[5] "MAIN_MSGu8Can01_Rx03_HSSTC_buf[5]" UBYTE Id_0x00 1 2 0 255 ECU_ADDRESS 0x7001FCB8 /end MEASUREMENT
/begin MEASUREMENT MAIN_MSGu8Can01_Rx03_HSSTC_buf[6] "MAIN_MSGu8Can01_Rx03_HSSTC_buf[6]" UBYTE Id_0x00 1 2 0 255 ECU_ADDRESS 0x7001FCB9 /end MEASUREMENT
/begin MEASUREMENT MAIN_MSGu8Can01_Rx03_HSSTC_buf[7] "MAIN_MSGu8Can01_Rx03_HSSTC_buf[7]" UBYTE Id_0x00 1 2 0 255 ECU_ADDRESS 0x7001FCBA /end MEASUREMENT
/begin MEASUREMENT MAIN_MSGu8Can01_Rx03_Heartbeat_Signal "..." UBYTE I_1 1 2 0 255 ECU_ADDRESS 0x7001FC19 /end MEASUREMENT
/begin MEASUREMENT MAIN_MSGu8Can01_Rx03_Steerpump_Motor_TargetspeedRaw "..." UBYTE I_1 1 2 0 255 ECU_ADDRESS 0x7001FC5A /end MEASUREMENT
/begin MEASUREMENT MAIN_MSGu8Can01_Rx04_ACUMC1_buf "-" UBYTE Id_0x00 1 2 0 255 MATRIX_DIM 8 1 1 ECU_ADDRESS 0x7001FCAB /end MEASUREMENT
/begin MEASUREMENT MAIN_MSGu8Can01_Rx04_ACUMC1_buf[0] "MAIN_MSGu8Can01_Rx04_ACUMC1_buf[0]" UBYTE Id_0x00 1 2 0 255 ECU_ADDRESS 0x7001FCAB /end MEASUREMENT
/begin MEASUREMENT MAIN_MSGu8Can01_Rx04_ACUMC1_buf[1] "MAIN_MSGu8Can01_Rx04_ACUMC1_buf[1]" UBYTE Id_0x00 1 2 0 255 ECU_ADDRESS 0x7001FCAC /end MEASUREMENT
/begin MEASUREMENT MAIN_MSGu8Can01_Rx04_ACUMC1_buf[2] "MAIN_MSGu8Can01_Rx04_ACUMC1_buf[2]" UBYTE Id_0x00 1 2 0 255 ECU_ADDRESS 0x7001FCAD /end MEASUREMENT
/begin MEASUREMENT MAIN_MSGu8Can01_Rx04_ACUMC1_buf[3] "MAIN_MSGu8Can01_Rx04_ACUMC1_buf[3]" UBYTE Id_0x00 1 2 0 255 ECU_ADDRESS 0x7001FCAE /end MEASUREMENT
/begin MEASUREMENT MAIN_MSGu8Can01_Rx04_ACUMC1_buf[4] "MAIN_MSGu8Can01_Rx04_ACUMC1_buf[4]" UBYTE Id_0x00 1 2 0 255 ECU_ADDRESS 0x7001FCAF /end MEASUREMENT
/begin MEASUREMENT MAIN_MSGu8Can01_Rx04_ACUMC1_buf[5] "MAIN_MSGu8Can01_Rx04_ACUMC1_buf[5]" UBYTE Id_0x00 1 2 0 255 ECU_ADDRESS 0x7001FCB0 /end MEASUREMENT
/begin MEASUREMENT MAIN_MSGu8Can01_Rx04_ACUMC1_buf[6] "MAIN_MSGu8Can01_Rx04_ACUMC1_buf[6]" UBYTE Id_0x00 1 2 0 255 ECU_ADDRESS 0x7001FCB1 /end MEASUREMENT
/begin MEASUREMENT MAIN_MSGu8Can01_Rx04_ACUMC1_buf[7] "MAIN_MSGu8Can01_Rx04_ACUMC1_buf[7]" UBYTE Id_0x00 1 2 0 255 ECU_ADDRESS 0x7001FCB2 /end MEASUREMENT
/begin MEASUREMENT MAIN_MSGu8Can01_Rx04_Aircompressor_Motor_TargspeedRaw "..." UBYTE I_1 1 2 0 255 ECU_ADDRESS 0x7001FC59 /end MEASUREMENT
/begin MEASUREMENT MAIN_MSGu8Can01_Rx04_CtrlMsg_Cycle_Counter "..." UBYTE I_1 1 2 0 255 ECU_ADDRESS 0x7001FC10 /end MEASUREMENT
/begin MEASUREMENT MAIN_MSGu8Can01_Rx05_AIR1_buf "-" UBYTE Id_0x00 1 2 0 255 MATRIX_DIM 8 1 1 ECU_ADDRESS 0x7001FCA3 /end MEASUREMENT
/begin MEASUREMENT MAIN_MSGu8Can01_Rx05_AIR1_buf[0] "MAIN_MSGu8Can01_Rx05_AIR1_buf[0]" UBYTE Id_0x00 1 2 0 255 ECU_ADDRESS 0x7001FCA3 /end MEASUREMENT
/begin MEASUREMENT MAIN_MSGu8Can01_Rx05_AIR1_buf[1] "MAIN_MSGu8Can01_Rx05_AIR1_buf[1]" UBYTE Id_0x00 1 2 0 255 ECU_ADDRESS 0x7001FCA4 /end MEASUREMENT
/begin MEASUREMENT MAIN_MSGu8Can01_Rx05_AIR1_buf[2] "MAIN_MSGu8Can01_Rx05_AIR1_buf[2]" UBYTE Id_0x00 1 2 0 255 ECU_ADDRESS 0x7001FCA5 /end MEASUREMENT
/begin MEASUREMENT MAIN_MSGu8Can01_Rx05_AIR1_buf[3] "MAIN_MSGu8Can01_Rx05_AIR1_buf[3]" UBYTE Id_0x00 1 2 0 255 ECU_ADDRESS 0x7001FCA6 /end MEASUREMENT
/begin MEASUREMENT MAIN_MSGu8Can01_Rx05_AIR1_buf[4] "MAIN_MSGu8Can01_Rx05_AIR1_buf[4]" UBYTE Id_0x00 1 2 0 255 ECU_ADDRESS 0x7001FCA7 /end MEASUREMENT
/begin MEASUREMENT MAIN_MSGu8Can01_Rx05_AIR1_buf[5] "MAIN_MSGu8Can01_Rx05_AIR1_buf[5]" UBYTE Id_0x00 1 2 0 255 ECU_ADDRESS 0x7001FCA8 /end MEASUREMENT
/begin MEASUREMENT MAIN_MSGu8Can01_Rx05_AIR1_buf[6] "MAIN_MSGu8Can01_Rx05_AIR1_buf[6]" UBYTE Id_0x00 1 2 0 255 ECU_ADDRESS 0x7001FCA9 /end MEASUREMENT
/begin MEASUREMENT MAIN_MSGu8Can01_Rx05_AIR1_buf[7] "MAIN_MSGu8Can01_Rx05_AIR1_buf[7]" UBYTE Id_0x00 1 2 0 255 ECU_ADDRESS 0x7001FCAA /end MEASUREMENT
/begin MEASUREMENT MAIN_MSGu8Can01_Rx05_TCU_MotorTorReqRaw "..." UBYTE I_1 1 2 0 255 ECU_ADDRESS 0x7001FC57 /end MEASUREMENT
/begin MEASUREMENT MAIN_MSGu8Can01_Rx05_TCU_MotorWorkModReqRaw "..." UBYTE I_1 1 2 0 255 ECU_ADDRESS 0x7001FC58 /end MEASUREMENT
/begin MEASUREMENT MAIN_MSGu8Can01_Rx06_AIR1_buf "-" UBYTE Id_0x00 1 2 0 255 MATRIX_DIM 8 1 1 ECU_ADDRESS 0x7001FC9B /end MEASUREMENT
/begin MEASUREMENT MAIN_MSGu8Can01_Rx06_AIR1_buf[0] "MAIN_MSGu8Can01_Rx06_AIR1_buf[0]" UBYTE Id_0x00 1 2 0 255 ECU_ADDRESS 0x7001FC9B /end MEASUREMENT
/begin MEASUREMENT MAIN_MSGu8Can01_Rx06_AIR1_buf[1] "MAIN_MSGu8Can01_Rx06_AIR1_buf[1]" UBYTE Id_0x00 1 2 0 255 ECU_ADDRESS 0x7001FC9C /end MEASUREMENT
/begin MEASUREMENT MAIN_MSGu8Can01_Rx06_AIR1_buf[2] "MAIN_MSGu8Can01_Rx06_AIR1_buf[2]" UBYTE Id_0x00 1 2 0 255 ECU_ADDRESS 0x7001FC9D /end MEASUREMENT
/begin MEASUREMENT MAIN_MSGu8Can01_Rx06_AIR1_buf[3] "MAIN_MSGu8Can01_Rx06_AIR1_buf[3]" UBYTE Id_0x00 1 2 0 255 ECU_ADDRESS 0x7001FC9E /end MEASUREMENT
/begin MEASUREMENT MAIN_MSGu8Can01_Rx06_AIR1_buf[4] "MAIN_MSGu8Can01_Rx06_AIR1_buf[4]" UBYTE Id_0x00 1 2 0 255 ECU_ADDRESS 0x7001FC9F /end MEASUREMENT
/begin MEASUREMENT MAIN_MSGu8Can01_Rx06_AIR1_buf[5] "MAIN_MSGu8Can01_Rx06_AIR1_buf[5]" UBYTE Id_0x00 1 2 0 255 ECU_ADDRESS 0x7001FCA0 /end MEASUREMENT
/begin MEASUREMENT MAIN_MSGu8Can01_Rx06_AIR1_buf[6] "MAIN_MSGu8Can01_Rx06_AIR1_buf[6]" UBYTE Id_0x00 1 2 0 255 ECU_ADDRESS 0x7001FCA1 /end MEASUREMENT
/begin MEASUREMENT MAIN_MSGu8Can01_Rx06_AIR1_buf[7] "MAIN_MSGu8Can01_Rx06_AIR1_buf[7]" UBYTE Id_0x00 1 2 0 255 ECU_ADDRESS 0x7001FCA2 /end MEASUREMENT
/begin MEASUREMENT MAIN_MSGu8Can01_Rx06_TCU_MotorTorReqRaw "..." UBYTE I_1 1 2 0 255 ECU_ADDRESS 0x7001FC55 /end MEASUREMENT
/begin MEASUREMENT MAIN_MSGu8Can01_Tx01_Low_input_voltageRaw "..." UBYTE I_1 1 2 0 255 ECU_ADDRESS 0x7001FC54 /end MEASUREMENT
/begin MEASUREMENT MAIN_MSGu8Can01_Tx01_PDUST1_buf "-" UBYTE Id_0x00 1 2 0 255 MATRIX_DIM 8 1 1 ECU_ADDRESS 0x7001FC93 /end MEASUREMENT
/begin MEASUREMENT MAIN_MSGu8Can01_Tx01_PDUST1_buf[0] "MAIN_MSGu8Can01_Tx01_PDUST1_buf[0]" UBYTE Id_0x00 1 2 0 255 ECU_ADDRESS 0x7001FC93 /end MEASUREMENT
/begin MEASUREMENT MAIN_MSGu8Can01_Tx01_PDUST1_buf[1] "MAIN_MSGu8Can01_Tx01_PDUST1_buf[1]" UBYTE Id_0x00 1 2 0 255 ECU_ADDRESS 0x7001FC94 /end MEASUREMENT
/begin MEASUREMENT MAIN_MSGu8Can01_Tx01_PDUST1_buf[2] "MAIN_MSGu8Can01_Tx01_PDUST1_buf[2]" UBYTE Id_0x00 1 2 0 255 ECU_ADDRESS 0x7001FC95 /end MEASUREMENT
/begin MEASUREMENT MAIN_MSGu8Can01_Tx01_PDUST1_buf[3] "MAIN_MSGu8Can01_Tx01_PDUST1_buf[3]" UBYTE Id_0x00 1 2 0 255 ECU_ADDRESS 0x7001FC96 /end MEASUREMENT
/begin MEASUREMENT MAIN_MSGu8Can01_Tx01_PDUST1_buf[4] "MAIN_MSGu8Can01_Tx01_PDUST1_buf[4]" UBYTE Id_0x00 1 2 0 255 ECU_ADDRESS 0x7001FC97 /end MEASUREMENT
/begin MEASUREMENT MAIN_MSGu8Can01_Tx01_PDUST1_buf[5] "MAIN_MSGu8Can01_Tx01_PDUST1_buf[5]" UBYTE Id_0x00 1 2 0 255 ECU_ADDRESS 0x7001FC98 /end MEASUREMENT
/begin MEASUREMENT MAIN_MSGu8Can01_Tx01_PDUST1_buf[6] "MAIN_MSGu8Can01_Tx01_PDUST1_buf[6]" UBYTE Id_0x00 1 2 0 255 ECU_ADDRESS 0x7001FC99 /end MEASUREMENT
/begin MEASUREMENT MAIN_MSGu8Can01_Tx01_PDUST1_buf[7] "MAIN_MSGu8Can01_Tx01_PDUST1_buf[7]" UBYTE Id_0x00 1 2 0 255 ECU_ADDRESS 0x7001FC9A /end MEASUREMENT
/begin MEASUREMENT MAIN_MSGu8Can01_Tx01_Precharg_resistor_tempRaw "..." UBYTE I_1 1 2 0 255 ECU_ADDRESS 0x7001FC4E /end MEASUREMENT
/begin MEASUREMENT MAIN_MSGu8Can01_Tx01_Precharg_time_consumptionRaw "..." UBYTE I_1 1 2 0 255 ECU_ADDRESS 0x7001FC4D /end MEASUREMENT
/begin MEASUREMENT MAIN_MSGu8Can01_Tx02_1stStage_PTC_MOS_Switch_Command "..." UBYTE I_1 1 2 0 255 ECU_ADDRESS 0x7001FBE2 /end MEASUREMENT
/begin MEASUREMENT MAIN_MSGu8Can01_Tx02_2stStage_PTC_MOS_Switch_Command "..." UBYTE I_1 1 2 0 255 ECU_ADDRESS 0x7001FBE1 /end MEASUREMENT
/begin MEASUREMENT MAIN_MSGu8Can01_Tx02_AuxiliaryContactor_On "..." UBYTE I_1 1 2 0 255 ECU_ADDRESS 0x7001FBD1 /end MEASUREMENT
/begin MEASUREMENT MAIN_MSGu8Can01_Tx02_Heartbeat_Signal "..." UBYTE I_1 1 2 0 255 ECU_ADDRESS 0x7001FBD3 /end MEASUREMENT
/begin MEASUREMENT MAIN_MSGu8Can01_Tx02_Internal_Trouble_Code "..." UBYTE I_1 1 2 0 255 ECU_ADDRESS 0x7001FBDC /end MEASUREMENT
/begin MEASUREMENT MAIN_MSGu8Can01_Tx02_PDUST2_buf "-" UBYTE Id_0x00 1 2 0 255 MATRIX_DIM 8 1 1 ECU_ADDRESS 0x7001FC8B /end MEASUREMENT
/begin MEASUREMENT MAIN_MSGu8Can01_Tx02_PDUST2_buf[0] "MAIN_MSGu8Can01_Tx02_PDUST2_buf[0]" UBYTE Id_0x00 1 2 0 255 ECU_ADDRESS 0x7001FC8B /end MEASUREMENT
/begin MEASUREMENT MAIN_MSGu8Can01_Tx02_PDUST2_buf[1] "MAIN_MSGu8Can01_Tx02_PDUST2_buf[1]" UBYTE Id_0x00 1 2 0 255 ECU_ADDRESS 0x7001FC8C /end MEASUREMENT
/begin MEASUREMENT MAIN_MSGu8Can01_Tx02_PDUST2_buf[2] "MAIN_MSGu8Can01_Tx02_PDUST2_buf[2]" UBYTE Id_0x00 1 2 0 255 ECU_ADDRESS 0x7001FC8D /end MEASUREMENT
/begin MEASUREMENT MAIN_MSGu8Can01_Tx02_PDUST2_buf[3] "MAIN_MSGu8Can01_Tx02_PDUST2_buf[3]" UBYTE Id_0x00 1 2 0 255 ECU_ADDRESS 0x7001FC8E /end MEASUREMENT
/begin MEASUREMENT MAIN_MSGu8Can01_Tx02_PDUST2_buf[4] "MAIN_MSGu8Can01_Tx02_PDUST2_buf[4]" UBYTE Id_0x00 1 2 0 255 ECU_ADDRESS 0x7001FC8F /end MEASUREMENT
/begin MEASUREMENT MAIN_MSGu8Can01_Tx02_PDUST2_buf[5] "MAIN_MSGu8Can01_Tx02_PDUST2_buf[5]" UBYTE Id_0x00 1 2 0 255 ECU_ADDRESS 0x7001FC90 /end MEASUREMENT
/begin MEASUREMENT MAIN_MSGu8Can01_Tx02_PDUST2_buf[6] "MAIN_MSGu8Can01_Tx02_PDUST2_buf[6]" UBYTE Id_0x00 1 2 0 255 ECU_ADDRESS 0x7001FC91 /end MEASUREMENT
/begin MEASUREMENT MAIN_MSGu8Can01_Tx02_PDUST2_buf[7] "MAIN_MSGu8Can01_Tx02_PDUST2_buf[7]" UBYTE Id_0x00 1 2 0 255 ECU_ADDRESS 0x7001FC92 /end MEASUREMENT
/begin MEASUREMENT MAIN_MSGu8Can01_Tx02_PTCContactor2_On "..." UBYTE I_1 1 2 0 255 ECU_ADDRESS 0x7001FBCF /end MEASUREMENT
/begin MEASUREMENT MAIN_MSGu8Can01_Tx02_PTCContactor_On "..." UBYTE I_1 1 2 0 255 ECU_ADDRESS 0x7001FBD0 /end MEASUREMENT
/begin MEASUREMENT MAIN_MSGu8Can01_Tx02_Software_VersionRaw "..." UBYTE I_1 1 2 0 255 ECU_ADDRESS 0x7001FC4C /end MEASUREMENT
/begin MEASUREMENT MAIN_MSGu8Can01_Tx02_Stuck_Status_Feedback "..." UBYTE I_1 1 2 0 255 ECU_ADDRESS 0x7001FBE3 /end MEASUREMENT
/begin MEASUREMENT MAIN_MSGu8Can01_Tx03_ChargeCircuit1_Negative_Contactor_Sts "..." UBYTE I_1 1 2 0 255 ECU_ADDRESS 0x7001FBC0 /end MEASUREMENT
/begin MEASUREMENT MAIN_MSGu8Can01_Tx03_ChargeCircuit1_Positive_Contactor_Sts "..." UBYTE I_1 1 2 0 255 ECU_ADDRESS 0x7001FBC1 /end MEASUREMENT
/begin MEASUREMENT MAIN_MSGu8Can01_Tx03_ChargeCircuit2_Negative_Contactor_Sts "..." UBYTE I_1 1 2 0 255 ECU_ADDRESS 0x7001FBBE /end MEASUREMENT
/begin MEASUREMENT MAIN_MSGu8Can01_Tx03_ChargeCircuit2_Positive_Contactor_Sts "..." UBYTE I_1 1 2 0 255 ECU_ADDRESS 0x7001FBBF /end MEASUREMENT
/begin MEASUREMENT MAIN_MSGu8Can01_Tx03_ChargeCircuit3_Negative_Contactor_Sts "..." UBYTE I_1 1 2 0 255 ECU_ADDRESS 0x7001FBBC /end MEASUREMENT
/begin MEASUREMENT MAIN_MSGu8Can01_Tx03_ChargeCircuit3_Positive_Contactor_Sts "..." UBYTE I_1 1 2 0 255 ECU_ADDRESS 0x7001FBBD /end MEASUREMENT
/begin MEASUREMENT MAIN_MSGu8Can01_Tx03_ChargeCircuit4_Negative_Contactor_Sts "..." UBYTE I_1 1 2 0 255 ECU_ADDRESS 0x7001FBBA /end MEASUREMENT
/begin MEASUREMENT MAIN_MSGu8Can01_Tx03_ChargeCircuit4_Positive_Contactor_Sts "..." UBYTE I_1 1 2 0 255 ECU_ADDRESS 0x7001FBBB /end MEASUREMENT
/begin MEASUREMENT MAIN_MSGu8Can01_Tx03_Insulation_Resistance_Sts "..." UBYTE I_1 1 2 0 255 ECU_ADDRESS 0x7001FBCE /end MEASUREMENT
/begin MEASUREMENT MAIN_MSGu8Can01_Tx03_Negative_Contactor_Sts "..." UBYTE I_1 1 2 0 255 ECU_ADDRESS 0x7001FBCD /end MEASUREMENT
/begin MEASUREMENT MAIN_MSGu8Can01_Tx03_Number_of_BatteryHeating_PTC_Switch "..." UBYTE I_1 1 2 0 255 ECU_ADDRESS 0x7001FBB8 /end MEASUREMENT
/begin MEASUREMENT MAIN_MSGu8Can01_Tx03_Number_of_Cab_PTC_Switch "..." UBYTE I_1 1 2 0 255 ECU_ADDRESS 0x7001FBB9 /end MEASUREMENT
/begin MEASUREMENT MAIN_MSGu8Can01_Tx03_Number_of_Positive_Contactors "..." UBYTE I_1 1 2 0 255 ECU_ADDRESS 0x7001FBCC /end MEASUREMENT
/begin MEASUREMENT MAIN_MSGu8Can01_Tx03_OnStatus_of_BatteryHeating1_Switch "..." UBYTE I_1 1 2 0 255 ECU_ADDRESS 0x7001FBC5 /end MEASUREMENT
/begin MEASUREMENT MAIN_MSGu8Can01_Tx03_OnStatus_of_BatteryHeating2_Switch "..." UBYTE I_1 1 2 0 255 ECU_ADDRESS 0x7001FBC4 /end MEASUREMENT
/begin MEASUREMENT MAIN_MSGu8Can01_Tx03_OnStatus_of_BatteryHeating3_Switch "..." UBYTE I_1 1 2 0 255 ECU_ADDRESS 0x7001FBC3 /end MEASUREMENT
/begin MEASUREMENT MAIN_MSGu8Can01_Tx03_OnStatus_of_BatteryHeating4_Switch "..." UBYTE I_1 1 2 0 255 ECU_ADDRESS 0x7001FBC2 /end MEASUREMENT
/begin MEASUREMENT MAIN_MSGu8Can01_Tx03_OnStatus_of_Cab1_Stage_PTC_Switch "..." UBYTE I_1 1 2 0 255 ECU_ADDRESS 0x7001FBC7 /end MEASUREMENT
/begin MEASUREMENT MAIN_MSGu8Can01_Tx03_OnStatus_of_Cab2_Stage_PTC_Switch "..." UBYTE I_1 1 2 0 255 ECU_ADDRESS 0x7001FBC6 /end MEASUREMENT
/begin MEASUREMENT MAIN_MSGu8Can01_Tx03_PDUST3_buf "-" UBYTE Id_0x00 1 2 0 255 MATRIX_DIM 8 1 1 ECU_ADDRESS 0x7001FC83 /end MEASUREMENT
/begin MEASUREMENT MAIN_MSGu8Can01_Tx03_PDUST3_buf[0] "MAIN_MSGu8Can01_Tx03_PDUST3_buf[0]" UBYTE Id_0x00 1 2 0 255 ECU_ADDRESS 0x7001FC83 /end MEASUREMENT
/begin MEASUREMENT MAIN_MSGu8Can01_Tx03_PDUST3_buf[1] "MAIN_MSGu8Can01_Tx03_PDUST3_buf[1]" UBYTE Id_0x00 1 2 0 255 ECU_ADDRESS 0x7001FC84 /end MEASUREMENT
/begin MEASUREMENT MAIN_MSGu8Can01_Tx03_PDUST3_buf[2] "MAIN_MSGu8Can01_Tx03_PDUST3_buf[2]" UBYTE Id_0x00 1 2 0 255 ECU_ADDRESS 0x7001FC85 /end MEASUREMENT
/begin MEASUREMENT MAIN_MSGu8Can01_Tx03_PDUST3_buf[3] "MAIN_MSGu8Can01_Tx03_PDUST3_buf[3]" UBYTE Id_0x00 1 2 0 255 ECU_ADDRESS 0x7001FC86 /end MEASUREMENT
/begin MEASUREMENT MAIN_MSGu8Can01_Tx03_PDUST3_buf[4] "MAIN_MSGu8Can01_Tx03_PDUST3_buf[4]" UBYTE Id_0x00 1 2 0 255 ECU_ADDRESS 0x7001FC87 /end MEASUREMENT
/begin MEASUREMENT MAIN_MSGu8Can01_Tx03_PDUST3_buf[5] "MAIN_MSGu8Can01_Tx03_PDUST3_buf[5]" UBYTE Id_0x00 1 2 0 255 ECU_ADDRESS 0x7001FC88 /end MEASUREMENT
/begin MEASUREMENT MAIN_MSGu8Can01_Tx03_PDUST3_buf[6] "MAIN_MSGu8Can01_Tx03_PDUST3_buf[6]" UBYTE Id_0x00 1 2 0 255 ECU_ADDRESS 0x7001FC89 /end MEASUREMENT
/begin MEASUREMENT MAIN_MSGu8Can01_Tx03_PDUST3_buf[7] "MAIN_MSGu8Can01_Tx03_PDUST3_buf[7]" UBYTE Id_0x00 1 2 0 255 ECU_ADDRESS 0x7001FC8A /end MEASUREMENT
/begin MEASUREMENT MAIN_MSGu8Can01_Tx03_Positive_Contactor1_Sts "..." UBYTE I_1 1 2 0 255 ECU_ADDRESS 0x7001FBCB /end MEASUREMENT
/begin MEASUREMENT MAIN_MSGu8Can01_Tx03_Positive_Contactor2_Sts "..." UBYTE I_1 1 2 0 255 ECU_ADDRESS 0x7001FBCA /end MEASUREMENT
/begin MEASUREMENT MAIN_MSGu8Can01_Tx03_Positive_Contactor3_Sts "..." UBYTE I_1 1 2 0 255 ECU_ADDRESS 0x7001FBC9 /end MEASUREMENT
/begin MEASUREMENT MAIN_MSGu8Can01_Tx03_Positive_Contactor4_Sts "..." UBYTE I_1 1 2 0 255 ECU_ADDRESS 0x7001FBC8 /end MEASUREMENT
/begin MEASUREMENT MAIN_MSGu8Can01_Tx04_PDUST4_buf "-" UBYTE Id_0x00 1 2 0 255 MATRIX_DIM 8 1 1 ECU_ADDRESS 0x7001FC7B /end MEASUREMENT
/begin MEASUREMENT MAIN_MSGu8Can01_Tx04_PDUST4_buf[0] "MAIN_MSGu8Can01_Tx04_PDUST4_buf[0]" UBYTE Id_0x00 1 2 0 255 ECU_ADDRESS 0x7001FC7B /end MEASUREMENT
/begin MEASUREMENT MAIN_MSGu8Can01_Tx04_PDUST4_buf[1] "MAIN_MSGu8Can01_Tx04_PDUST4_buf[1]" UBYTE Id_0x00 1 2 0 255 ECU_ADDRESS 0x7001FC7C /end MEASUREMENT
/begin MEASUREMENT MAIN_MSGu8Can01_Tx04_PDUST4_buf[2] "MAIN_MSGu8Can01_Tx04_PDUST4_buf[2]" UBYTE Id_0x00 1 2 0 255 ECU_ADDRESS 0x7001FC7D /end MEASUREMENT
/begin MEASUREMENT MAIN_MSGu8Can01_Tx04_PDUST4_buf[3] "MAIN_MSGu8Can01_Tx04_PDUST4_buf[3]" UBYTE Id_0x00 1 2 0 255 ECU_ADDRESS 0x7001FC7E /end MEASUREMENT
/begin MEASUREMENT MAIN_MSGu8Can01_Tx04_PDUST4_buf[4] "MAIN_MSGu8Can01_Tx04_PDUST4_buf[4]" UBYTE Id_0x00 1 2 0 255 ECU_ADDRESS 0x7001FC7F /end MEASUREMENT
/begin MEASUREMENT MAIN_MSGu8Can01_Tx04_PDUST4_buf[5] "MAIN_MSGu8Can01_Tx04_PDUST4_buf[5]" UBYTE Id_0x00 1 2 0 255 ECU_ADDRESS 0x7001FC80 /end MEASUREMENT
/begin MEASUREMENT MAIN_MSGu8Can01_Tx04_PDUST4_buf[6] "MAIN_MSGu8Can01_Tx04_PDUST4_buf[6]" UBYTE Id_0x00 1 2 0 255 ECU_ADDRESS 0x7001FC81 /end MEASUREMENT
/begin MEASUREMENT MAIN_MSGu8Can01_Tx04_PDUST4_buf[7] "MAIN_MSGu8Can01_Tx04_PDUST4_buf[7]" UBYTE Id_0x00 1 2 0 255 ECU_ADDRESS 0x7001FC82 /end MEASUREMENT
/begin MEASUREMENT MAIN_MSGu8Can01_Tx05_Fault_Level "..." UBYTE I_1 1 2 0 255 ECU_ADDRESS 0x7001FB9C /end MEASUREMENT
/begin MEASUREMENT MAIN_MSGu8Can01_Tx05_HSST1_buf "-" UBYTE Id_0x00 1 2 0 255 MATRIX_DIM 8 1 1 ECU_ADDRESS 0x7001FC73 /end MEASUREMENT
/begin MEASUREMENT MAIN_MSGu8Can01_Tx05_HSST1_buf[0] "MAIN_MSGu8Can01_Tx05_HSST1_buf[0]" UBYTE Id_0x00 1 2 0 255 ECU_ADDRESS 0x7001FC73 /end MEASUREMENT
/begin MEASUREMENT MAIN_MSGu8Can01_Tx05_HSST1_buf[1] "MAIN_MSGu8Can01_Tx05_HSST1_buf[1]" UBYTE Id_0x00 1 2 0 255 ECU_ADDRESS 0x7001FC74 /end MEASUREMENT
/begin MEASUREMENT MAIN_MSGu8Can01_Tx05_HSST1_buf[2] "MAIN_MSGu8Can01_Tx05_HSST1_buf[2]" UBYTE Id_0x00 1 2 0 255 ECU_ADDRESS 0x7001FC75 /end MEASUREMENT
/begin MEASUREMENT MAIN_MSGu8Can01_Tx05_HSST1_buf[3] "MAIN_MSGu8Can01_Tx05_HSST1_buf[3]" UBYTE Id_0x00 1 2 0 255 ECU_ADDRESS 0x7001FC76 /end MEASUREMENT
/begin MEASUREMENT MAIN_MSGu8Can01_Tx05_HSST1_buf[4] "MAIN_MSGu8Can01_Tx05_HSST1_buf[4]" UBYTE Id_0x00 1 2 0 255 ECU_ADDRESS 0x7001FC77 /end MEASUREMENT
/begin MEASUREMENT MAIN_MSGu8Can01_Tx05_HSST1_buf[5] "MAIN_MSGu8Can01_Tx05_HSST1_buf[5]" UBYTE Id_0x00 1 2 0 255 ECU_ADDRESS 0x7001FC78 /end MEASUREMENT
/begin MEASUREMENT MAIN_MSGu8Can01_Tx05_HSST1_buf[6] "MAIN_MSGu8Can01_Tx05_HSST1_buf[6]" UBYTE Id_0x00 1 2 0 255 ECU_ADDRESS 0x7001FC79 /end MEASUREMENT
/begin MEASUREMENT MAIN_MSGu8Can01_Tx05_HSST1_buf[7] "MAIN_MSGu8Can01_Tx05_HSST1_buf[7]" UBYTE Id_0x00 1 2 0 255 ECU_ADDRESS 0x7001FC7A /end MEASUREMENT
/begin MEASUREMENT MAIN_MSGu8Can01_Tx05_Heartbeat_Signal "..." UBYTE I_1 1 2 0 255 ECU_ADDRESS 0x7001FBAA /end MEASUREMENT
/begin MEASUREMENT MAIN_MSGu8Can01_Tx05_Motor_Sts "..." UBYTE I_1 1 2 0 255 ECU_ADDRESS 0x7001FB9D /end MEASUREMENT
/begin MEASUREMENT MAIN_MSGu8Can01_Tx05_Steering_Oil_DCAC_Module_TempRaw "..." UBYTE I_1 1 2 0 255 ECU_ADDRESS 0x7001FC41 /end MEASUREMENT
/begin MEASUREMENT MAIN_MSGu8Can01_Tx06_HSST2_buf "-" UBYTE Id_0x00 1 2 0 255 MATRIX_DIM 8 1 1 ECU_ADDRESS 0x7001FC6B /end MEASUREMENT
/begin MEASUREMENT MAIN_MSGu8Can01_Tx06_HSST2_buf[0] "MAIN_MSGu8Can01_Tx06_HSST2_buf[0]" UBYTE Id_0x00 1 2 0 255 ECU_ADDRESS 0x7001FC6B /end MEASUREMENT
/begin MEASUREMENT MAIN_MSGu8Can01_Tx06_HSST2_buf[1] "MAIN_MSGu8Can01_Tx06_HSST2_buf[1]" UBYTE Id_0x00 1 2 0 255 ECU_ADDRESS 0x7001FC6C /end MEASUREMENT
/begin MEASUREMENT MAIN_MSGu8Can01_Tx06_HSST2_buf[2] "MAIN_MSGu8Can01_Tx06_HSST2_buf[2]" UBYTE Id_0x00 1 2 0 255 ECU_ADDRESS 0x7001FC6D /end MEASUREMENT
/begin MEASUREMENT MAIN_MSGu8Can01_Tx06_HSST2_buf[3] "MAIN_MSGu8Can01_Tx06_HSST2_buf[3]" UBYTE Id_0x00 1 2 0 255 ECU_ADDRESS 0x7001FC6E /end MEASUREMENT
/begin MEASUREMENT MAIN_MSGu8Can01_Tx06_HSST2_buf[4] "MAIN_MSGu8Can01_Tx06_HSST2_buf[4]" UBYTE Id_0x00 1 2 0 255 ECU_ADDRESS 0x7001FC6F /end MEASUREMENT
/begin MEASUREMENT MAIN_MSGu8Can01_Tx06_HSST2_buf[5] "MAIN_MSGu8Can01_Tx06_HSST2_buf[5]" UBYTE Id_0x00 1 2 0 255 ECU_ADDRESS 0x7001FC70 /end MEASUREMENT
/begin MEASUREMENT MAIN_MSGu8Can01_Tx06_HSST2_buf[6] "MAIN_MSGu8Can01_Tx06_HSST2_buf[6]" UBYTE Id_0x00 1 2 0 255 ECU_ADDRESS 0x7001FC71 /end MEASUREMENT
/begin MEASUREMENT MAIN_MSGu8Can01_Tx06_HSST2_buf[7] "MAIN_MSGu8Can01_Tx06_HSST2_buf[7]" UBYTE Id_0x00 1 2 0 255 ECU_ADDRESS 0x7001FC72 /end MEASUREMENT
/begin MEASUREMENT MAIN_MSGu8Can01_Tx06_Input_Current "..." UBYTE I_1 1 2 0 255 ECU_ADDRESS 0x7001FB91 /end MEASUREMENT
/begin MEASUREMENT MAIN_MSGu8Can01_Tx06_Input_VoltageRaw "..." UBYTE I_1 1 2 0 255 ECU_ADDRESS 0x7001FC3F /end MEASUREMENT
/begin MEASUREMENT MAIN_MSGu8Can01_Tx06_Internal_FaultCode "..." UBYTE I_1 1 2 0 255 ECU_ADDRESS 0x7001FB90 /end MEASUREMENT
/begin MEASUREMENT MAIN_MSGu8Can01_Tx06_Software_VersionRaw "..." UBYTE I_1 1 2 0 255 ECU_ADDRESS 0x7001FC3E /end MEASUREMENT
/begin MEASUREMENT MAIN_MSGu8Can01_Tx06_Steer_Motor_TempRaw "..." UBYTE I_1 1 2 0 255 ECU_ADDRESS 0x7001FC40 /end MEASUREMENT
/begin MEASUREMENT MAIN_MSGu8Can01_Tx07_ACUST1_buf "-" UBYTE Id_0x00 1 2 0 255 MATRIX_DIM 8 1 1 ECU_ADDRESS 0x7001FC63 /end MEASUREMENT
/begin MEASUREMENT MAIN_MSGu8Can01_Tx07_ACUST1_buf[0] "MAIN_MSGu8Can01_Tx07_ACUST1_buf[0]" UBYTE Id_0x00 1 2 0 255 ECU_ADDRESS 0x7001FC63 /end MEASUREMENT
/begin MEASUREMENT MAIN_MSGu8Can01_Tx07_ACUST1_buf[1] "MAIN_MSGu8Can01_Tx07_ACUST1_buf[1]" UBYTE Id_0x00 1 2 0 255 ECU_ADDRESS 0x7001FC64 /end MEASUREMENT
/begin MEASUREMENT MAIN_MSGu8Can01_Tx07_ACUST1_buf[2] "MAIN_MSGu8Can01_Tx07_ACUST1_buf[2]" UBYTE Id_0x00 1 2 0 255 ECU_ADDRESS 0x7001FC65 /end MEASUREMENT
/begin MEASUREMENT MAIN_MSGu8Can01_Tx07_ACUST1_buf[3] "MAIN_MSGu8Can01_Tx07_ACUST1_buf[3]" UBYTE Id_0x00 1 2 0 255 ECU_ADDRESS 0x7001FC66 /end MEASUREMENT
/begin MEASUREMENT MAIN_MSGu8Can01_Tx07_ACUST1_buf[4] "MAIN_MSGu8Can01_Tx07_ACUST1_buf[4]" UBYTE Id_0x00 1 2 0 255 ECU_ADDRESS 0x7001FC67 /end MEASUREMENT
/begin MEASUREMENT MAIN_MSGu8Can01_Tx07_ACUST1_buf[5] "MAIN_MSGu8Can01_Tx07_ACUST1_buf[5]" UBYTE Id_0x00 1 2 0 255 ECU_ADDRESS 0x7001FC68 /end MEASUREMENT
/begin MEASUREMENT MAIN_MSGu8Can01_Tx07_ACUST1_buf[6] "MAIN_MSGu8Can01_Tx07_ACUST1_buf[6]" UBYTE Id_0x00 1 2 0 255 ECU_ADDRESS 0x7001FC69 /end MEASUREMENT
/begin MEASUREMENT MAIN_MSGu8Can01_Tx07_ACUST1_buf[7] "MAIN_MSGu8Can01_Tx07_ACUST1_buf[7]" UBYTE Id_0x00 1 2 0 255 ECU_ADDRESS 0x7001FC6A /end MEASUREMENT
/begin MEASUREMENT MAIN_MSGu8Can01_Tx07_AirCompressor_TempRaw "..." UBYTE I_1 1 2 0 255 ECU_ADDRESS 0x7001FC3A /end MEASUREMENT
/begin MEASUREMENT MAIN_MSGu8Can01_Tx07_Controller_Operating_Sts "..." UBYTE I_1 1 2 0 255 ECU_ADDRESS 0x7001FB72 /end MEASUREMENT
/begin MEASUREMENT MAIN_MSGu8Can01_Tx07_Heartbeat_Signal "..." UBYTE I_1 1 2 0 255 ECU_ADDRESS 0x7001FB70 /end MEASUREMENT
/begin MEASUREMENT MAIN_MSGu8Can01_Tx07_Input_Current "..." UBYTE I_1 1 2 0 255 ECU_ADDRESS 0x7001FB84 /end MEASUREMENT
/begin MEASUREMENT MAIN_MSGu8Can01_Tx07_Input_VoltageRaw "..." UBYTE I_1 1 2 0 255 ECU_ADDRESS 0x7001FC3D /end MEASUREMENT
/begin MEASUREMENT MAIN_MSGu8Can01_Tx07_Output_Current "..." UBYTE I_1 1 2 0 255 ECU_ADDRESS 0x7001FB7C /end MEASUREMENT
/begin MEASUREMENT MAIN_MSGu8Can01_Tx07_Output_VoltageRaw "..." UBYTE I_1 1 2 0 255 ECU_ADDRESS 0x7001FC3C /end MEASUREMENT
/begin MEASUREMENT MAIN_MSGu8Can01_Tx07_SDCAC_MotorTempRaw "..." UBYTE I_1 1 2 0 255 ECU_ADDRESS 0x7001FC3B /end MEASUREMENT
/begin MEASUREMENT MAIN_MSGu8Can01_Tx08_ACUST2_buf "-" UBYTE Id_0x00 1 2 0 255 MATRIX_DIM 8 1 1 ECU_ADDRESS 0x7001FC5B /end MEASUREMENT
/begin MEASUREMENT MAIN_MSGu8Can01_Tx08_ACUST2_buf[0] "MAIN_MSGu8Can01_Tx08_ACUST2_buf[0]" UBYTE Id_0x00 1 2 0 255 ECU_ADDRESS 0x7001FC5B /end MEASUREMENT
/begin MEASUREMENT MAIN_MSGu8Can01_Tx08_ACUST2_buf[1] "MAIN_MSGu8Can01_Tx08_ACUST2_buf[1]" UBYTE Id_0x00 1 2 0 255 ECU_ADDRESS 0x7001FC5C /end MEASUREMENT
/begin MEASUREMENT MAIN_MSGu8Can01_Tx08_ACUST2_buf[2] "MAIN_MSGu8Can01_Tx08_ACUST2_buf[2]" UBYTE Id_0x00 1 2 0 255 ECU_ADDRESS 0x7001FC5D /end MEASUREMENT
/begin MEASUREMENT MAIN_MSGu8Can01_Tx08_ACUST2_buf[3] "MAIN_MSGu8Can01_Tx08_ACUST2_buf[3]" UBYTE Id_0x00 1 2 0 255 ECU_ADDRESS 0x7001FC5E /end MEASUREMENT
/begin MEASUREMENT MAIN_MSGu8Can01_Tx08_ACUST2_buf[4] "MAIN_MSGu8Can01_Tx08_ACUST2_buf[4]" UBYTE Id_0x00 1 2 0 255 ECU_ADDRESS 0x7001FC5F /end MEASUREMENT
/begin MEASUREMENT MAIN_MSGu8Can01_Tx08_ACUST2_buf[5] "MAIN_MSGu8Can01_Tx08_ACUST2_buf[5]" UBYTE Id_0x00 1 2 0 255 ECU_ADDRESS 0x7001FC60 /end MEASUREMENT
/begin MEASUREMENT MAIN_MSGu8Can01_Tx08_ACUST2_buf[6] "MAIN_MSGu8Can01_Tx08_ACUST2_buf[6]" UBYTE Id_0x00 1 2 0 255 ECU_ADDRESS 0x7001FC61 /end MEASUREMENT
/begin MEASUREMENT MAIN_MSGu8Can01_Tx08_ACUST2_buf[7] "MAIN_MSGu8Can01_Tx08_ACUST2_buf[7]" UBYTE Id_0x00 1 2 0 255 ECU_ADDRESS 0x7001FC62 /end MEASUREMENT
/begin MEASUREMENT MAIN_MSGu8Can01_Tx08_AirCompressor_Motor_SpeedRaw "..." UBYTE I_1 1 2 0 255 ECU_ADDRESS 0x7001FC39 /end MEASUREMENT
/begin MEASUREMENT MAIN_MSGu8Can01_Tx08_Internal_Fault_Code "..." UBYTE I_1 1 2 0 255 ECU_ADDRESS 0x7001FB68 /end MEASUREMENT
/begin MEASUREMENT MAIN_MSGu8Can01_Tx08_Software_VersionRaw "..." UBYTE I_1 1 2 0 255 ECU_ADDRESS 0x7001FC38 /end MEASUREMENT
/begin MEASUREMENT MAIN_MSGu8Can02_Rx01_MC2_buf "-" UBYTE Id_0x00 1 2 0 255 MATRIX_DIM 8 1 1 ECU_ADDRESS 0x7001FD96 /end MEASUREMENT
/begin MEASUREMENT MAIN_MSGu8Can02_Rx01_MC2_buf[0] "MAIN_MSGu8Can02_Rx01_MC2_buf[0]" UBYTE Id_0x00 1 2 0 255 ECU_ADDRESS 0x7001FD96 /end MEASUREMENT
/begin MEASUREMENT MAIN_MSGu8Can02_Rx01_MC2_buf[1] "MAIN_MSGu8Can02_Rx01_MC2_buf[1]" UBYTE Id_0x00 1 2 0 255 ECU_ADDRESS 0x7001FD97 /end MEASUREMENT
/begin MEASUREMENT MAIN_MSGu8Can02_Rx01_MC2_buf[2] "MAIN_MSGu8Can02_Rx01_MC2_buf[2]" UBYTE Id_0x00 1 2 0 255 ECU_ADDRESS 0x7001FD98 /end MEASUREMENT
/begin MEASUREMENT MAIN_MSGu8Can02_Rx01_MC2_buf[3] "MAIN_MSGu8Can02_Rx01_MC2_buf[3]" UBYTE Id_0x00 1 2 0 255 ECU_ADDRESS 0x7001FD99 /end MEASUREMENT
/begin MEASUREMENT MAIN_MSGu8Can02_Rx01_MC2_buf[4] "MAIN_MSGu8Can02_Rx01_MC2_buf[4]" UBYTE Id_0x00 1 2 0 255 ECU_ADDRESS 0x7001FD9A /end MEASUREMENT
/begin MEASUREMENT MAIN_MSGu8Can02_Rx01_MC2_buf[5] "MAIN_MSGu8Can02_Rx01_MC2_buf[5]" UBYTE Id_0x00 1 2 0 255 ECU_ADDRESS 0x7001FD9B /end MEASUREMENT
/begin MEASUREMENT MAIN_MSGu8Can02_Rx01_MC2_buf[6] "MAIN_MSGu8Can02_Rx01_MC2_buf[6]" UBYTE Id_0x00 1 2 0 255 ECU_ADDRESS 0x7001FD9C /end MEASUREMENT
/begin MEASUREMENT MAIN_MSGu8Can02_Rx01_MC2_buf[7] "MAIN_MSGu8Can02_Rx01_MC2_buf[7]" UBYTE Id_0x00 1 2 0 255 ECU_ADDRESS 0x7001FD9D /end MEASUREMENT
/begin MEASUREMENT MAIN_MSGu8Can02_Rx01_MCU1_CycMsg_Num "..." UBYTE I_1 1 2 0 255 ECU_ADDRESS 0x7001FD3C /end MEASUREMENT
/begin MEASUREMENT MAIN_MSGu8Can02_Rx01_TCU3_Mor_Con_Mode "..." UBYTE I_1 1 2 0 255 ECU_ADDRESS 0x7001FD3D /end MEASUREMENT
/begin MEASUREMENT MAIN_MSGu8Can02_Rx02_CCVS_buf "-" UBYTE Id_0x00 1 2 0 255 MATRIX_DIM 8 1 1 ECU_ADDRESS 0x7001FD8E /end MEASUREMENT
/begin MEASUREMENT MAIN_MSGu8Can02_Rx02_CCVS_buf[0] "MAIN_MSGu8Can02_Rx02_CCVS_buf[0]" UBYTE Id_0x00 1 2 0 255 ECU_ADDRESS 0x7001FD8E /end MEASUREMENT
/begin MEASUREMENT MAIN_MSGu8Can02_Rx02_CCVS_buf[1] "MAIN_MSGu8Can02_Rx02_CCVS_buf[1]" UBYTE Id_0x00 1 2 0 255 ECU_ADDRESS 0x7001FD8F /end MEASUREMENT
/begin MEASUREMENT MAIN_MSGu8Can02_Rx02_CCVS_buf[2] "MAIN_MSGu8Can02_Rx02_CCVS_buf[2]" UBYTE Id_0x00 1 2 0 255 ECU_ADDRESS 0x7001FD90 /end MEASUREMENT
/begin MEASUREMENT MAIN_MSGu8Can02_Rx02_CCVS_buf[3] "MAIN_MSGu8Can02_Rx02_CCVS_buf[3]" UBYTE Id_0x00 1 2 0 255 ECU_ADDRESS 0x7001FD91 /end MEASUREMENT
/begin MEASUREMENT MAIN_MSGu8Can02_Rx02_CCVS_buf[4] "MAIN_MSGu8Can02_Rx02_CCVS_buf[4]" UBYTE Id_0x00 1 2 0 255 ECU_ADDRESS 0x7001FD92 /end MEASUREMENT
/begin MEASUREMENT MAIN_MSGu8Can02_Rx02_CCVS_buf[5] "MAIN_MSGu8Can02_Rx02_CCVS_buf[5]" UBYTE Id_0x00 1 2 0 255 ECU_ADDRESS 0x7001FD93 /end MEASUREMENT
/begin MEASUREMENT MAIN_MSGu8Can02_Rx02_CCVS_buf[6] "MAIN_MSGu8Can02_Rx02_CCVS_buf[6]" UBYTE Id_0x00 1 2 0 255 ECU_ADDRESS 0x7001FD94 /end MEASUREMENT
/begin MEASUREMENT MAIN_MSGu8Can02_Rx02_CCVS_buf[7] "MAIN_MSGu8Can02_Rx02_CCVS_buf[7]" UBYTE Id_0x00 1 2 0 255 ECU_ADDRESS 0x7001FD95 /end MEASUREMENT
/begin MEASUREMENT MAIN_MSGu8Can02_Rx02_HCU1_BrakePed "..." UBYTE I_1 1 2 0 255 ECU_ADDRESS 0x7001FD28 /end MEASUREMENT
/begin MEASUREMENT MAIN_MSGu8Can02_Rx02_HCU1_PKB "..." UBYTE I_1 1 2 0 255 ECU_ADDRESS 0x7001FD2E /end MEASUREMENT
/begin MEASUREMENT MAIN_MSGu8Can02_Rx03_HCU_GearNumRaw "..." UBYTE I_1 1 2 0 255 ECU_ADDRESS 0x7001FD56 /end MEASUREMENT
/begin MEASUREMENT MAIN_MSGu8Can02_Rx03_HCU_Gearshift_State "..." UBYTE I_1 1 2 0 255 ECU_ADDRESS 0x7001FD17 /end MEASUREMENT
/begin MEASUREMENT MAIN_MSGu8Can02_Rx03_HCU_HandleShift "..." UBYTE I_1 1 2 0 255 ECU_ADDRESS 0x7001FD16 /end MEASUREMENT
/begin MEASUREMENT MAIN_MSGu8Can02_Rx03_HCU_PTOWorkState "..." UBYTE I_1 1 2 0 255 ECU_ADDRESS 0x7001FD14 /end MEASUREMENT
/begin MEASUREMENT MAIN_MSGu8Can02_Rx03_HCU_SelfLearningSignal "..." UBYTE I_1 1 2 0 255 ECU_ADDRESS 0x7001FD15 /end MEASUREMENT
/begin MEASUREMENT MAIN_MSGu8Can02_Rx03_HCU_Targear_State "..." UBYTE I_1 1 2 0 255 ECU_ADDRESS 0x7001FD18 /end MEASUREMENT
/begin MEASUREMENT MAIN_MSGu8Can02_Rx03_TS1_buf "-" UBYTE Id_0x00 1 2 0 255 MATRIX_DIM 8 1 1 ECU_ADDRESS 0x7001FD86 /end MEASUREMENT
/begin MEASUREMENT MAIN_MSGu8Can02_Rx03_TS1_buf[0] "MAIN_MSGu8Can02_Rx03_TS1_buf[0]" UBYTE Id_0x00 1 2 0 255 ECU_ADDRESS 0x7001FD86 /end MEASUREMENT
/begin MEASUREMENT MAIN_MSGu8Can02_Rx03_TS1_buf[1] "MAIN_MSGu8Can02_Rx03_TS1_buf[1]" UBYTE Id_0x00 1 2 0 255 ECU_ADDRESS 0x7001FD87 /end MEASUREMENT
/begin MEASUREMENT MAIN_MSGu8Can02_Rx03_TS1_buf[2] "MAIN_MSGu8Can02_Rx03_TS1_buf[2]" UBYTE Id_0x00 1 2 0 255 ECU_ADDRESS 0x7001FD88 /end MEASUREMENT
/begin MEASUREMENT MAIN_MSGu8Can02_Rx03_TS1_buf[3] "MAIN_MSGu8Can02_Rx03_TS1_buf[3]" UBYTE Id_0x00 1 2 0 255 ECU_ADDRESS 0x7001FD89 /end MEASUREMENT
/begin MEASUREMENT MAIN_MSGu8Can02_Rx03_TS1_buf[4] "MAIN_MSGu8Can02_Rx03_TS1_buf[4]" UBYTE Id_0x00 1 2 0 255 ECU_ADDRESS 0x7001FD8A /end MEASUREMENT
/begin MEASUREMENT MAIN_MSGu8Can02_Rx03_TS1_buf[5] "MAIN_MSGu8Can02_Rx03_TS1_buf[5]" UBYTE Id_0x00 1 2 0 255 ECU_ADDRESS 0x7001FD8B /end MEASUREMENT
/begin MEASUREMENT MAIN_MSGu8Can02_Rx03_TS1_buf[6] "MAIN_MSGu8Can02_Rx03_TS1_buf[6]" UBYTE Id_0x00 1 2 0 255 ECU_ADDRESS 0x7001FD8C /end MEASUREMENT
/begin MEASUREMENT MAIN_MSGu8Can02_Rx03_TS1_buf[7] "MAIN_MSGu8Can02_Rx03_TS1_buf[7]" UBYTE Id_0x00 1 2 0 255 ECU_ADDRESS 0x7001FD8D /end MEASUREMENT
/begin MEASUREMENT MAIN_MSGu8Can02_Tx01_MS0_buf "-" UBYTE Id_0x00 1 2 0 255 MATRIX_DIM 8 1 1 ECU_ADDRESS 0x7001FD7E /end MEASUREMENT
/begin MEASUREMENT MAIN_MSGu8Can02_Tx01_MS0_buf[0] "MAIN_MSGu8Can02_Tx01_MS0_buf[0]" UBYTE Id_0x00 1 2 0 255 ECU_ADDRESS 0x7001FD7E /end MEASUREMENT
/begin MEASUREMENT MAIN_MSGu8Can02_Tx01_MS0_buf[1] "MAIN_MSGu8Can02_Tx01_MS0_buf[1]" UBYTE Id_0x00 1 2 0 255 ECU_ADDRESS 0x7001FD7F /end MEASUREMENT
/begin MEASUREMENT MAIN_MSGu8Can02_Tx01_MS0_buf[2] "MAIN_MSGu8Can02_Tx01_MS0_buf[2]" UBYTE Id_0x00 1 2 0 255 ECU_ADDRESS 0x7001FD80 /end MEASUREMENT
/begin MEASUREMENT MAIN_MSGu8Can02_Tx01_MS0_buf[3] "MAIN_MSGu8Can02_Tx01_MS0_buf[3]" UBYTE Id_0x00 1 2 0 255 ECU_ADDRESS 0x7001FD81 /end MEASUREMENT
/begin MEASUREMENT MAIN_MSGu8Can02_Tx01_MS0_buf[4] "MAIN_MSGu8Can02_Tx01_MS0_buf[4]" UBYTE Id_0x00 1 2 0 255 ECU_ADDRESS 0x7001FD82 /end MEASUREMENT
/begin MEASUREMENT MAIN_MSGu8Can02_Tx01_MS0_buf[5] "MAIN_MSGu8Can02_Tx01_MS0_buf[5]" UBYTE Id_0x00 1 2 0 255 ECU_ADDRESS 0x7001FD83 /end MEASUREMENT
/begin MEASUREMENT MAIN_MSGu8Can02_Tx01_MS0_buf[6] "MAIN_MSGu8Can02_Tx01_MS0_buf[6]" UBYTE Id_0x00 1 2 0 255 ECU_ADDRESS 0x7001FD84 /end MEASUREMENT
/begin MEASUREMENT MAIN_MSGu8Can02_Tx01_MS0_buf[7] "MAIN_MSGu8Can02_Tx01_MS0_buf[7]" UBYTE Id_0x00 1 2 0 255 ECU_ADDRESS 0x7001FD85 /end MEASUREMENT
/begin MEASUREMENT MAIN_MSGu8Can02_Tx01_TS3_Mor_Con_Mode "..." UBYTE I_1 1 2 0 255 ECU_ADDRESS 0x7001FD08 /end MEASUREMENT
/begin MEASUREMENT MAIN_MSGu8Can02_Tx02_MS1_buf "-" UBYTE Id_0x00 1 2 0 255 MATRIX_DIM 8 1 1 ECU_ADDRESS 0x7001FD76 /end MEASUREMENT
/begin MEASUREMENT MAIN_MSGu8Can02_Tx02_MS1_buf[0] "MAIN_MSGu8Can02_Tx02_MS1_buf[0]" UBYTE Id_0x00 1 2 0 255 ECU_ADDRESS 0x7001FD76 /end MEASUREMENT
/begin MEASUREMENT MAIN_MSGu8Can02_Tx02_MS1_buf[1] "MAIN_MSGu8Can02_Tx02_MS1_buf[1]" UBYTE Id_0x00 1 2 0 255 ECU_ADDRESS 0x7001FD77 /end MEASUREMENT
/begin MEASUREMENT MAIN_MSGu8Can02_Tx02_MS1_buf[2] "MAIN_MSGu8Can02_Tx02_MS1_buf[2]" UBYTE Id_0x00 1 2 0 255 ECU_ADDRESS 0x7001FD78 /end MEASUREMENT
/begin MEASUREMENT MAIN_MSGu8Can02_Tx02_MS1_buf[3] "MAIN_MSGu8Can02_Tx02_MS1_buf[3]" UBYTE Id_0x00 1 2 0 255 ECU_ADDRESS 0x7001FD79 /end MEASUREMENT
/begin MEASUREMENT MAIN_MSGu8Can02_Tx02_MS1_buf[4] "MAIN_MSGu8Can02_Tx02_MS1_buf[4]" UBYTE Id_0x00 1 2 0 255 ECU_ADDRESS 0x7001FD7A /end MEASUREMENT
/begin MEASUREMENT MAIN_MSGu8Can02_Tx02_MS1_buf[5] "MAIN_MSGu8Can02_Tx02_MS1_buf[5]" UBYTE Id_0x00 1 2 0 255 ECU_ADDRESS 0x7001FD7B /end MEASUREMENT
/begin MEASUREMENT MAIN_MSGu8Can02_Tx02_MS1_buf[6] "MAIN_MSGu8Can02_Tx02_MS1_buf[6]" UBYTE Id_0x00 1 2 0 255 ECU_ADDRESS 0x7001FD7C /end MEASUREMENT
/begin MEASUREMENT MAIN_MSGu8Can02_Tx02_MS1_buf[7] "MAIN_MSGu8Can02_Tx02_MS1_buf[7]" UBYTE Id_0x00 1 2 0 255 ECU_ADDRESS 0x7001FD7D /end MEASUREMENT
/begin MEASUREMENT MAIN_MSGu8Can02_Tx03_MS2_buf "-" UBYTE Id_0x00 1 2 0 255 MATRIX_DIM 8 1 1 ECU_ADDRESS 0x7001FD6E /end MEASUREMENT
/begin MEASUREMENT MAIN_MSGu8Can02_Tx03_MS2_buf[0] "MAIN_MSGu8Can02_Tx03_MS2_buf[0]" UBYTE Id_0x00 1 2 0 255 ECU_ADDRESS 0x7001FD6E /end MEASUREMENT
/begin MEASUREMENT MAIN_MSGu8Can02_Tx03_MS2_buf[1] "MAIN_MSGu8Can02_Tx03_MS2_buf[1]" UBYTE Id_0x00 1 2 0 255 ECU_ADDRESS 0x7001FD6F /end MEASUREMENT
/begin MEASUREMENT MAIN_MSGu8Can02_Tx03_MS2_buf[2] "MAIN_MSGu8Can02_Tx03_MS2_buf[2]" UBYTE Id_0x00 1 2 0 255 ECU_ADDRESS 0x7001FD70 /end MEASUREMENT
/begin MEASUREMENT MAIN_MSGu8Can02_Tx03_MS2_buf[3] "MAIN_MSGu8Can02_Tx03_MS2_buf[3]" UBYTE Id_0x00 1 2 0 255 ECU_ADDRESS 0x7001FD71 /end MEASUREMENT
/begin MEASUREMENT MAIN_MSGu8Can02_Tx03_MS2_buf[4] "MAIN_MSGu8Can02_Tx03_MS2_buf[4]" UBYTE Id_0x00 1 2 0 255 ECU_ADDRESS 0x7001FD72 /end MEASUREMENT
/begin MEASUREMENT MAIN_MSGu8Can02_Tx03_MS2_buf[5] "MAIN_MSGu8Can02_Tx03_MS2_buf[5]" UBYTE Id_0x00 1 2 0 255 ECU_ADDRESS 0x7001FD73 /end MEASUREMENT
/begin MEASUREMENT MAIN_MSGu8Can02_Tx03_MS2_buf[6] "MAIN_MSGu8Can02_Tx03_MS2_buf[6]" UBYTE Id_0x00 1 2 0 255 ECU_ADDRESS 0x7001FD74 /end MEASUREMENT
/begin MEASUREMENT MAIN_MSGu8Can02_Tx03_MS2_buf[7] "MAIN_MSGu8Can02_Tx03_MS2_buf[7]" UBYTE Id_0x00 1 2 0 255 ECU_ADDRESS 0x7001FD75 /end MEASUREMENT
/begin MEASUREMENT MAIN_MSGu8Can02_Tx03_TS3_Motor_CanVersionRaw "..." UBYTE I_1 1 2 0 255 ECU_ADDRESS 0x7001FD41 /end MEASUREMENT
/begin MEASUREMENT MAIN_MSGu8Can02_Tx03_TS3_Motor_LiveCounter "..." UBYTE I_1 1 2 0 255 ECU_ADDRESS 0x7001FCD8 /end MEASUREMENT
/begin MEASUREMENT MAIN_MSGu8Can02_Tx03_TS3_Motor_MaxBrkiTrqLmtRaw "..." UBYTE I_1 1 2 0 255 ECU_ADDRESS 0x7001FD45 /end MEASUREMENT
/begin MEASUREMENT MAIN_MSGu8Can02_Tx03_TS3_Motor_MaxDrviTrqLmtRaw "..." UBYTE I_1 1 2 0 255 ECU_ADDRESS 0x7001FD46 /end MEASUREMENT
/begin MEASUREMENT MAIN_MSGu8Can02_Tx03_TS3_Motor_MotContrlReqInstruction "..." UBYTE I_1 1 2 0 255 ECU_ADDRESS 0x7001FCD9 /end MEASUREMENT
/begin MEASUREMENT MAIN_MSGu8Can02_Tx03_TS3_Motor_MotControllerTempRaw "..." UBYTE I_1 1 2 0 255 ECU_ADDRESS 0x7001FD42 /end MEASUREMENT
/begin MEASUREMENT MAIN_MSGu8Can02_Tx03_TS3_Motor_MotMaxspdLmtRaw "..." UBYTE I_1 1 2 0 255 ECU_ADDRESS 0x7001FD44 /end MEASUREMENT
/begin MEASUREMENT MAIN_MSGu8Can02_Tx03_TS3_Motor_MotTempRaw "..." UBYTE I_1 1 2 0 255 ECU_ADDRESS 0x7001FD43 /end MEASUREMENT
/begin MEASUREMENT MAIN_MSGu8Can02_Tx03_TS3_Motor_WORKfeed "..." UBYTE I_1 1 2 0 255 ECU_ADDRESS 0x7001FCF1 /end MEASUREMENT
/begin MEASUREMENT MAIN_MSGu8Can02_Tx03_TS3_Motor_WORKmodefeed "..." UBYTE I_1 1 2 0 255 ECU_ADDRESS 0x7001FCF0 /end MEASUREMENT
/begin MEASUREMENT MAIN_MSGu8Can02_Tx04_MCU_Err_code "..." UBYTE I_1 1 2 0 255 ECU_ADDRESS 0x7001FCD0 /end MEASUREMENT
/begin MEASUREMENT MAIN_MSGu8Can02_Tx04_MCU_Err_level "..." UBYTE I_1 1 2 0 255 ECU_ADDRESS 0x7001FCD1 /end MEASUREMENT
/begin MEASUREMENT MAIN_MSGu8Can02_Tx04_MDM1_buf "-" UBYTE Id_0x00 1 2 0 255 MATRIX_DIM 8 1 1 ECU_ADDRESS 0x7001FD66 /end MEASUREMENT
/begin MEASUREMENT MAIN_MSGu8Can02_Tx04_MDM1_buf[0] "MAIN_MSGu8Can02_Tx04_MDM1_buf[0]" UBYTE Id_0x00 1 2 0 255 ECU_ADDRESS 0x7001FD66 /end MEASUREMENT
/begin MEASUREMENT MAIN_MSGu8Can02_Tx04_MDM1_buf[1] "MAIN_MSGu8Can02_Tx04_MDM1_buf[1]" UBYTE Id_0x00 1 2 0 255 ECU_ADDRESS 0x7001FD67 /end MEASUREMENT
/begin MEASUREMENT MAIN_MSGu8Can02_Tx04_MDM1_buf[2] "MAIN_MSGu8Can02_Tx04_MDM1_buf[2]" UBYTE Id_0x00 1 2 0 255 ECU_ADDRESS 0x7001FD68 /end MEASUREMENT
/begin MEASUREMENT MAIN_MSGu8Can02_Tx04_MDM1_buf[3] "MAIN_MSGu8Can02_Tx04_MDM1_buf[3]" UBYTE Id_0x00 1 2 0 255 ECU_ADDRESS 0x7001FD69 /end MEASUREMENT
/begin MEASUREMENT MAIN_MSGu8Can02_Tx04_MDM1_buf[4] "MAIN_MSGu8Can02_Tx04_MDM1_buf[4]" UBYTE Id_0x00 1 2 0 255 ECU_ADDRESS 0x7001FD6A /end MEASUREMENT
/begin MEASUREMENT MAIN_MSGu8Can02_Tx04_MDM1_buf[5] "MAIN_MSGu8Can02_Tx04_MDM1_buf[5]" UBYTE Id_0x00 1 2 0 255 ECU_ADDRESS 0x7001FD6B /end MEASUREMENT
/begin MEASUREMENT MAIN_MSGu8Can02_Tx04_MDM1_buf[6] "MAIN_MSGu8Can02_Tx04_MDM1_buf[6]" UBYTE Id_0x00 1 2 0 255 ECU_ADDRESS 0x7001FD6C /end MEASUREMENT
/begin MEASUREMENT MAIN_MSGu8Can02_Tx04_MDM1_buf[7] "MAIN_MSGu8Can02_Tx04_MDM1_buf[7]" UBYTE Id_0x00 1 2 0 255 ECU_ADDRESS 0x7001FD6D /end MEASUREMENT
/begin MEASUREMENT MAIN_MSGu8Can02_Tx05_MS3_buf "-" UBYTE Id_0x00 1 2 0 255 MATRIX_DIM 8 1 1 ECU_ADDRESS 0x7001FD5E /end MEASUREMENT
/begin MEASUREMENT MAIN_MSGu8Can02_Tx05_MS3_buf[0] "MAIN_MSGu8Can02_Tx05_MS3_buf[0]" UBYTE Id_0x00 1 2 0 255 ECU_ADDRESS 0x7001FD5E /end MEASUREMENT
/begin MEASUREMENT MAIN_MSGu8Can02_Tx05_MS3_buf[1] "MAIN_MSGu8Can02_Tx05_MS3_buf[1]" UBYTE Id_0x00 1 2 0 255 ECU_ADDRESS 0x7001FD5F /end MEASUREMENT
/begin MEASUREMENT MAIN_MSGu8Can02_Tx05_MS3_buf[2] "MAIN_MSGu8Can02_Tx05_MS3_buf[2]" UBYTE Id_0x00 1 2 0 255 ECU_ADDRESS 0x7001FD60 /end MEASUREMENT
/begin MEASUREMENT MAIN_MSGu8Can02_Tx05_MS3_buf[3] "MAIN_MSGu8Can02_Tx05_MS3_buf[3]" UBYTE Id_0x00 1 2 0 255 ECU_ADDRESS 0x7001FD61 /end MEASUREMENT
/begin MEASUREMENT MAIN_MSGu8Can02_Tx05_MS3_buf[4] "MAIN_MSGu8Can02_Tx05_MS3_buf[4]" UBYTE Id_0x00 1 2 0 255 ECU_ADDRESS 0x7001FD62 /end MEASUREMENT
/begin MEASUREMENT MAIN_MSGu8Can02_Tx05_MS3_buf[5] "MAIN_MSGu8Can02_Tx05_MS3_buf[5]" UBYTE Id_0x00 1 2 0 255 ECU_ADDRESS 0x7001FD63 /end MEASUREMENT
/begin MEASUREMENT MAIN_MSGu8Can02_Tx05_MS3_buf[6] "MAIN_MSGu8Can02_Tx05_MS3_buf[6]" UBYTE Id_0x00 1 2 0 255 ECU_ADDRESS 0x7001FD64 /end MEASUREMENT
/begin MEASUREMENT MAIN_MSGu8Can02_Tx05_MS3_buf[7] "MAIN_MSGu8Can02_Tx05_MS3_buf[7]" UBYTE Id_0x00 1 2 0 255 ECU_ADDRESS 0x7001FD65 /end MEASUREMENT
/begin MEASUREMENT MAIN_MSGu8Can02_Tx05_TS3_DC_NTC_TempRaw "..." UBYTE I_1 1 2 0 255 ECU_ADDRESS 0x7001FD40 /end MEASUREMENT
/begin MEASUREMENT MAIN_MSGu8PwModOffCnt "MAIN_MSGu8PwModOffCnt" UBYTE I_1 1 2 0 255 ECU_ADDRESS 0x7001FE9A /end MEASUREMENT
/begin MEASUREMENT MAIN_MSGu8PwModOnCnt "MAIN_MSGu8PwModOnCnt" UBYTE I_1 1 2 0 255 ECU_ADDRESS 0x7001FE9B /end MEASUREMENT
/begin MEASUREMENT MAIN_TotalTime "MAIN_TotalTime" ULONG I_1 1 2 0 4294967295 ECU_ADDRESS 0x7001FF1C /end MEASUREMENT
/begin MEASUREMENT MAIN_as32OCTrimNvm "-" SLONG Id_0x00 1 2 -2147483648 2147483647 MATRIX_DIM 5 1 1 ECU_ADDRESS 0x7001FEA4 /end MEASUREMENT
/begin MEASUREMENT MAIN_as32OCTrimNvm[0] "MAIN_as32OCTrimNvm[0]" SLONG Id_0x00 1 2 -2147483648 2147483647 ECU_ADDRESS 0x7001FEA4 /end MEASUREMENT
/begin MEASUREMENT MAIN_as32OCTrimNvm[1] "MAIN_as32OCTrimNvm[1]" SLONG Id_0x00 1 2 -2147483648 2147483647 ECU_ADDRESS 0x7001FEA8 /end MEASUREMENT
/begin MEASUREMENT MAIN_as32OCTrimNvm[2] "MAIN_as32OCTrimNvm[2]" SLONG Id_0x00 1 2 -2147483648 2147483647 ECU_ADDRESS 0x7001FEAC /end MEASUREMENT
/begin MEASUREMENT MAIN_as32OCTrimNvm[3] "MAIN_as32OCTrimNvm[3]" SLONG Id_0x00 1 2 -2147483648 2147483647 ECU_ADDRESS 0x7001FEB0 /end MEASUREMENT
/begin MEASUREMENT MAIN_as32OCTrimNvm[4] "MAIN_as32OCTrimNvm[4]" SLONG Id_0x00 1 2 -2147483648 2147483647 ECU_ADDRESS 0x7001FEB4 /end MEASUREMENT
/begin MEASUREMENT MAIN_au16CalibParamNvm "-" UWORD F_1_p0_2 1 2 0 65535 MATRIX_DIM 16 4 1 ECU_ADDRESS 0x700200F0 /end MEASUREMENT
/begin MEASUREMENT MAIN_au16CalibParamNvm[0][0] "MAIN_au16CalibParamNvm[0][0]" UWORD F_1_p0_2 1 2 0 65535 ECU_ADDRESS 0x700200F0 /end MEASUREMENT
/begin MEASUREMENT MAIN_au16CalibParamNvm[0][10] "MAIN_au16CalibParamNvm[0][10]" UWORD F_1_p0_2 1 2 0 65535 ECU_ADDRESS 0x70020104 /end MEASUREMENT
/begin MEASUREMENT MAIN_au16CalibParamNvm[0][11] "MAIN_au16CalibParamNvm[0][11]" UWORD F_1_p0_2 1 2 0 65535 ECU_ADDRESS 0x70020106 /end MEASUREMENT
/begin MEASUREMENT MAIN_au16CalibParamNvm[0][12] "MAIN_au16CalibParamNvm[0][12]" UWORD F_1_p0_2 1 2 0 65535 ECU_ADDRESS 0x70020108 /end MEASUREMENT
/begin MEASUREMENT MAIN_au16CalibParamNvm[0][13] "MAIN_au16CalibParamNvm[0][13]" UWORD F_1_p0_2 1 2 0 65535 ECU_ADDRESS 0x7002010A /end MEASUREMENT
/begin MEASUREMENT MAIN_au16CalibParamNvm[0][14] "MAIN_au16CalibParamNvm[0][14]" UWORD F_1_p0_2 1 2 0 65535 ECU_ADDRESS 0x7002010C /end MEASUREMENT
/begin MEASUREMENT MAIN_au16CalibParamNvm[0][15] "MAIN_au16CalibParamNvm[0][15]" UWORD F_1_p0_2 1 2 0 65535 ECU_ADDRESS 0x7002010E /end MEASUREMENT
/begin MEASUREMENT MAIN_au16CalibParamNvm[0][1] "MAIN_au16CalibParamNvm[0][1]" UWORD F_1_p0_2 1 2 0 65535 ECU_ADDRESS 0x700200F2 /end MEASUREMENT
/begin MEASUREMENT MAIN_au16CalibParamNvm[0][2] "MAIN_au16CalibParamNvm[0][2]" UWORD F_1_p0_2 1 2 0 65535 ECU_ADDRESS 0x700200F4 /end MEASUREMENT
/begin MEASUREMENT MAIN_au16CalibParamNvm[0][3] "MAIN_au16CalibParamNvm[0][3]" UWORD F_1_p0_2 1 2 0 65535 ECU_ADDRESS 0x700200F6 /end MEASUREMENT
/begin MEASUREMENT MAIN_au16CalibParamNvm[0][4] "MAIN_au16CalibParamNvm[0][4]" UWORD F_1_p0_2 1 2 0 65535 ECU_ADDRESS 0x700200F8 /end MEASUREMENT
/begin MEASUREMENT MAIN_au16CalibParamNvm[0][5] "MAIN_au16CalibParamNvm[0][5]" UWORD F_1_p0_2 1 2 0 65535 ECU_ADDRESS 0x700200FA /end MEASUREMENT
/begin MEASUREMENT MAIN_au16CalibParamNvm[0][6] "MAIN_au16CalibParamNvm[0][6]" UWORD F_1_p0_2 1 2 0 65535 ECU_ADDRESS 0x700200FC /end MEASUREMENT
/begin MEASUREMENT MAIN_au16CalibParamNvm[0][7] "MAIN_au16CalibParamNvm[0][7]" UWORD F_1_p0_2 1 2 0 65535 ECU_ADDRESS 0x700200FE /end MEASUREMENT
/begin MEASUREMENT MAIN_au16CalibParamNvm[0][8] "MAIN_au16CalibParamNvm[0][8]" UWORD F_1_p0_2 1 2 0 65535 ECU_ADDRESS 0x70020100 /end MEASUREMENT
/begin MEASUREMENT MAIN_au16CalibParamNvm[0][9] "MAIN_au16CalibParamNvm[0][9]" UWORD F_1_p0_2 1 2 0 65535 ECU_ADDRESS 0x70020102 /end MEASUREMENT
/begin MEASUREMENT MAIN_au16CalibParamNvm[1][0] "MAIN_au16CalibParamNvm[1][0]" UWORD F_1_p0_2 1 2 0 65535 ECU_ADDRESS 0x70020110 /end MEASUREMENT
/begin MEASUREMENT MAIN_au16CalibParamNvm[1][10] "MAIN_au16CalibParamNvm[1][10]" UWORD F_1_p0_2 1 2 0 65535 ECU_ADDRESS 0x70020124 /end MEASUREMENT
/begin MEASUREMENT MAIN_au16CalibParamNvm[1][11] "MAIN_au16CalibParamNvm[1][11]" UWORD F_1_p0_2 1 2 0 65535 ECU_ADDRESS 0x70020126 /end MEASUREMENT
/begin MEASUREMENT MAIN_au16CalibParamNvm[1][12] "MAIN_au16CalibParamNvm[1][12]" UWORD F_1_p0_2 1 2 0 65535 ECU_ADDRESS 0x70020128 /end MEASUREMENT
/begin MEASUREMENT MAIN_au16CalibParamNvm[1][13] "MAIN_au16CalibParamNvm[1][13]" UWORD F_1_p0_2 1 2 0 65535 ECU_ADDRESS 0x7002012A /end MEASUREMENT
/begin MEASUREMENT MAIN_au16CalibParamNvm[1][14] "MAIN_au16CalibParamNvm[1][14]" UWORD F_1_p0_2 1 2 0 65535 ECU_ADDRESS 0x7002012C /end MEASUREMENT
/begin MEASUREMENT MAIN_au16CalibParamNvm[1][15] "MAIN_au16CalibParamNvm[1][15]" UWORD F_1_p0_2 1 2 0 65535 ECU_ADDRESS 0x7002012E /end MEASUREMENT
/begin MEASUREMENT MAIN_au16CalibParamNvm[1][1] "MAIN_au16CalibParamNvm[1][1]" UWORD F_1_p0_2 1 2 0 65535 ECU_ADDRESS 0x70020112 /end MEASUREMENT
/begin MEASUREMENT MAIN_au16CalibParamNvm[1][2] "MAIN_au16CalibParamNvm[1][2]" UWORD F_1_p0_2 1 2 0 65535 ECU_ADDRESS 0x70020114 /end MEASUREMENT
/begin MEASUREMENT MAIN_au16CalibParamNvm[1][3] "MAIN_au16CalibParamNvm[1][3]" UWORD F_1_p0_2 1 2 0 65535 ECU_ADDRESS 0x70020116 /end MEASUREMENT
/begin MEASUREMENT MAIN_au16CalibParamNvm[1][4] "MAIN_au16CalibParamNvm[1][4]" UWORD F_1_p0_2 1 2 0 65535 ECU_ADDRESS 0x70020118 /end MEASUREMENT
/begin MEASUREMENT MAIN_au16CalibParamNvm[1][5] "MAIN_au16CalibParamNvm[1][5]" UWORD F_1_p0_2 1 2 0 65535 ECU_ADDRESS 0x7002011A /end MEASUREMENT
/begin MEASUREMENT MAIN_au16CalibParamNvm[1][6] "MAIN_au16CalibParamNvm[1][6]" UWORD F_1_p0_2 1 2 0 65535 ECU_ADDRESS 0x7002011C /end MEASUREMENT
/begin MEASUREMENT MAIN_au16CalibParamNvm[1][7] "MAIN_au16CalibParamNvm[1][7]" UWORD F_1_p0_2 1 2 0 65535 ECU_ADDRESS 0x7002011E /end MEASUREMENT
/begin MEASUREMENT MAIN_au16CalibParamNvm[1][8] "MAIN_au16CalibParamNvm[1][8]" UWORD F_1_p0_2 1 2 0 65535 ECU_ADDRESS 0x70020120 /end MEASUREMENT
/begin MEASUREMENT MAIN_au16CalibParamNvm[1][9] "MAIN_au16CalibParamNvm[1][9]" UWORD F_1_p0_2 1 2 0 65535 ECU_ADDRESS 0x70020122 /end MEASUREMENT
/begin MEASUREMENT MAIN_au16CalibParamNvm[2][0] "MAIN_au16CalibParamNvm[2][0]" UWORD F_1_p0_2 1 2 0 65535 ECU_ADDRESS 0x70020130 /end MEASUREMENT
/begin MEASUREMENT MAIN_au16CalibParamNvm[2][10] "MAIN_au16CalibParamNvm[2][10]" UWORD F_1_p0_2 1 2 0 65535 ECU_ADDRESS 0x70020144 /end MEASUREMENT
/begin MEASUREMENT MAIN_au16CalibParamNvm[2][11] "MAIN_au16CalibParamNvm[2][11]" UWORD F_1_p0_2 1 2 0 65535 ECU_ADDRESS 0x70020146 /end MEASUREMENT
/begin MEASUREMENT MAIN_au16CalibParamNvm[2][12] "MAIN_au16CalibParamNvm[2][12]" UWORD F_1_p0_2 1 2 0 65535 ECU_ADDRESS 0x70020148 /end MEASUREMENT
/begin MEASUREMENT MAIN_au16CalibParamNvm[2][13] "MAIN_au16CalibParamNvm[2][13]" UWORD F_1_p0_2 1 2 0 65535 ECU_ADDRESS 0x7002014A /end MEASUREMENT
/begin MEASUREMENT MAIN_au16CalibParamNvm[2][14] "MAIN_au16CalibParamNvm[2][14]" UWORD F_1_p0_2 1 2 0 65535 ECU_ADDRESS 0x7002014C /end MEASUREMENT
/begin MEASUREMENT MAIN_au16CalibParamNvm[2][15] "MAIN_au16CalibParamNvm[2][15]" UWORD F_1_p0_2 1 2 0 65535 ECU_ADDRESS 0x7002014E /end MEASUREMENT
/begin MEASUREMENT MAIN_au16CalibParamNvm[2][1] "MAIN_au16CalibParamNvm[2][1]" UWORD F_1_p0_2 1 2 0 65535 ECU_ADDRESS 0x70020132 /end MEASUREMENT
/begin MEASUREMENT MAIN_au16CalibParamNvm[2][2] "MAIN_au16CalibParamNvm[2][2]" UWORD F_1_p0_2 1 2 0 65535 ECU_ADDRESS 0x70020134 /end MEASUREMENT
/begin MEASUREMENT MAIN_au16CalibParamNvm[2][3] "MAIN_au16CalibParamNvm[2][3]" UWORD F_1_p0_2 1 2 0 65535 ECU_ADDRESS 0x70020136 /end MEASUREMENT
/begin MEASUREMENT MAIN_au16CalibParamNvm[2][4] "MAIN_au16CalibParamNvm[2][4]" UWORD F_1_p0_2 1 2 0 65535 ECU_ADDRESS 0x70020138 /end MEASUREMENT
/begin MEASUREMENT MAIN_au16CalibParamNvm[2][5] "MAIN_au16CalibParamNvm[2][5]" UWORD F_1_p0_2 1 2 0 65535 ECU_ADDRESS 0x7002013A /end MEASUREMENT
/begin MEASUREMENT MAIN_au16CalibParamNvm[2][6] "MAIN_au16CalibParamNvm[2][6]" UWORD F_1_p0_2 1 2 0 65535 ECU_ADDRESS 0x7002013C /end MEASUREMENT
/begin MEASUREMENT MAIN_au16CalibParamNvm[2][7] "MAIN_au16CalibParamNvm[2][7]" UWORD F_1_p0_2 1 2 0 65535 ECU_ADDRESS 0x7002013E /end MEASUREMENT
/begin MEASUREMENT MAIN_au16CalibParamNvm[2][8] "MAIN_au16CalibParamNvm[2][8]" UWORD F_1_p0_2 1 2 0 65535 ECU_ADDRESS 0x70020140 /end MEASUREMENT
/begin MEASUREMENT MAIN_au16CalibParamNvm[2][9] "MAIN_au16CalibParamNvm[2][9]" UWORD F_1_p0_2 1 2 0 65535 ECU_ADDRESS 0x70020142 /end MEASUREMENT
/begin MEASUREMENT MAIN_au16CalibParamNvm[3][0] "MAIN_au16CalibParamNvm[3][0]" UWORD F_1_p0_2 1 2 0 65535 ECU_ADDRESS 0x70020150 /end MEASUREMENT
/begin MEASUREMENT MAIN_au16CalibParamNvm[3][10] "MAIN_au16CalibParamNvm[3][10]" UWORD F_1_p0_2 1 2 0 65535 ECU_ADDRESS 0x70020164 /end MEASUREMENT
/begin MEASUREMENT MAIN_au16CalibParamNvm[3][11] "MAIN_au16CalibParamNvm[3][11]" UWORD F_1_p0_2 1 2 0 65535 ECU_ADDRESS 0x70020166 /end MEASUREMENT
/begin MEASUREMENT MAIN_au16CalibParamNvm[3][12] "MAIN_au16CalibParamNvm[3][12]" UWORD F_1_p0_2 1 2 0 65535 ECU_ADDRESS 0x70020168 /end MEASUREMENT
/begin MEASUREMENT MAIN_au16CalibParamNvm[3][13] "MAIN_au16CalibParamNvm[3][13]" UWORD F_1_p0_2 1 2 0 65535 ECU_ADDRESS 0x7002016A /end MEASUREMENT
/begin MEASUREMENT MAIN_au16CalibParamNvm[3][14] "MAIN_au16CalibParamNvm[3][14]" UWORD F_1_p0_2 1 2 0 65535 ECU_ADDRESS 0x7002016C /end MEASUREMENT
/begin MEASUREMENT MAIN_au16CalibParamNvm[3][15] "MAIN_au16CalibParamNvm[3][15]" UWORD F_1_p0_2 1 2 0 65535 ECU_ADDRESS 0x7002016E /end MEASUREMENT
/begin MEASUREMENT MAIN_au16CalibParamNvm[3][1] "MAIN_au16CalibParamNvm[3][1]" UWORD F_1_p0_2 1 2 0 65535 ECU_ADDRESS 0x70020152 /end MEASUREMENT
/begin MEASUREMENT MAIN_au16CalibParamNvm[3][2] "MAIN_au16CalibParamNvm[3][2]" UWORD F_1_p0_2 1 2 0 65535 ECU_ADDRESS 0x70020154 /end MEASUREMENT
/begin MEASUREMENT MAIN_au16CalibParamNvm[3][3] "MAIN_au16CalibParamNvm[3][3]" UWORD F_1_p0_2 1 2 0 65535 ECU_ADDRESS 0x70020156 /end MEASUREMENT
/begin MEASUREMENT MAIN_au16CalibParamNvm[3][4] "MAIN_au16CalibParamNvm[3][4]" UWORD F_1_p0_2 1 2 0 65535 ECU_ADDRESS 0x70020158 /end MEASUREMENT
/begin MEASUREMENT MAIN_au16CalibParamNvm[3][5] "MAIN_au16CalibParamNvm[3][5]" UWORD F_1_p0_2 1 2 0 65535 ECU_ADDRESS 0x7002015A /end MEASUREMENT
/begin MEASUREMENT MAIN_au16CalibParamNvm[3][6] "MAIN_au16CalibParamNvm[3][6]" UWORD F_1_p0_2 1 2 0 65535 ECU_ADDRESS 0x7002015C /end MEASUREMENT
/begin MEASUREMENT MAIN_au16CalibParamNvm[3][7] "MAIN_au16CalibParamNvm[3][7]" UWORD F_1_p0_2 1 2 0 65535 ECU_ADDRESS 0x7002015E /end MEASUREMENT
/begin MEASUREMENT MAIN_au16CalibParamNvm[3][8] "MAIN_au16CalibParamNvm[3][8]" UWORD F_1_p0_2 1 2 0 65535 ECU_ADDRESS 0x70020160 /end MEASUREMENT
/begin MEASUREMENT MAIN_au16CalibParamNvm[3][9] "MAIN_au16CalibParamNvm[3][9]" UWORD F_1_p0_2 1 2 0 65535 ECU_ADDRESS 0x70020162 /end MEASUREMENT
/begin MEASUREMENT MAIN_bAkdAfterAscReq "..." UBYTE Bool_ON_OFF 1 2 0 1 BIT_MASK 0x01 ECU_ADDRESS 0x70020027 /end MEASUREMENT
/begin MEASUREMENT MAIN_bAscFlag "Flag ESM started" UBYTE Bool_ON_OFF 1 2 0 1 BIT_MASK 0x01 ECU_ADDRESS 0x70020026 /end MEASUREMENT
/begin MEASUREMENT MAIN_bBswReadySts "BSW Power on check finish flag." UBYTE Bool_ON_OFF 1 2 0 1 BIT_MASK 0x01 ECU_ADDRESS 0x70020025 /end MEASUREMENT
/begin MEASUREMENT MAIN_bCalibStoreEna "MAIN_bCalibStoreEna" UBYTE Bool_ON_OFF 1 2 0 1 BIT_MASK 0x01 ECU_ADDRESS 0x70020172 /end MEASUREMENT
/begin MEASUREMENT MAIN_bCalibStoreResult "MAIN_bCalibStoreResult" UBYTE Bool_ON_OFF 1 2 0 1 BIT_MASK 0x01 ECU_ADDRESS 0x70020170 /end MEASUREMENT
/begin MEASUREMENT MAIN_bComDisableFlg "..." UBYTE Bool_ON_OFF 1 2 0 1 BIT_MASK 0x01 ECU_ADDRESS 0x70020018 /end MEASUREMENT
/begin MEASUREMENT MAIN_bESMStarted "Flag ESM started" UBYTE Bool_ON_OFF 1 2 0 1 BIT_MASK 0x01 ECU_ADDRESS 0x70020024 /end MEASUREMENT
/begin MEASUREMENT MAIN_bOCStoreAswReq "MAIN_bOCStoreAswReq" UBYTE Bool_ON_OFF 1 2 0 1 BIT_MASK 0x01 ECU_ADDRESS 0x70020375 /end MEASUREMENT
/begin MEASUREMENT MAIN_bOCStoreResult "MAIN_bOCStoreResult" UBYTE Bool_ON_OFF 1 2 0 1 BIT_MASK 0x01 ECU_ADDRESS 0x70020348 /end MEASUREMENT
/begin MEASUREMENT MAIN_bOcDataStoreEna "MAIN_bOcDataStoreEna" UBYTE Bool_ON_OFF 1 2 0 1 BIT_MASK 0x01 ECU_ADDRESS 0x70020349 /end MEASUREMENT
/begin MEASUREMENT MAIN_bOcFailureFlg "..." UBYTE Bool_ON_OFF 1 2 0 1 BIT_MASK 0x01 ECU_ADDRESS 0x7002033C /end MEASUREMENT
/begin MEASUREMENT MAIN_bOcFinshFlg "..." UBYTE Bool_ON_OFF 1 2 0 1 BIT_MASK 0x01 ECU_ADDRESS 0x7002033B /end MEASUREMENT
/begin MEASUREMENT MAIN_bOcModeEna "..." UBYTE Bool_ON_OFF 1 2 0 1 BIT_MASK 0x01 ECU_ADDRESS 0x70020338 /end MEASUREMENT
/begin MEASUREMENT MAIN_bOcNotRatFlg "..." UBYTE Bool_ON_OFF 1 2 0 1 BIT_MASK 0x01 ECU_ADDRESS 0x7002033D /end MEASUREMENT
/begin MEASUREMENT MAIN_bOcRdResultFlag "..." UBYTE Bool_ON_OFF 1 2 0 1 BIT_MASK 0x01 ECU_ADDRESS 0x7002033A /end MEASUREMENT
/begin MEASUREMENT MAIN_bOcStartFlag "..." UBYTE Bool_ON_OFF 1 2 0 1 BIT_MASK 0x01 ECU_ADDRESS 0x70020339 /end MEASUREMENT
/begin MEASUREMENT MAIN_bProgConditionOk "..." UBYTE Bool_ON_OFF 1 2 0 1 BIT_MASK 0x01 ECU_ADDRESS 0x7002001B /end MEASUREMENT
/begin MEASUREMENT MAIN_bRcGainStaoreEna "MAIN_bRcGainStaoreEna" UBYTE Bool_ON_OFF 1 2 0 1 BIT_MASK 0x01 ECU_ADDRESS 0x70020171 /end MEASUREMENT
/begin MEASUREMENT MAIN_bResExcFltDetEna "..." UBYTE Bool_ON_OFF 1 2 0 1 BIT_MASK 0x01 ECU_ADDRESS 0x70020023 /end MEASUREMENT
/begin MEASUREMENT MAIN_bSoftOvBhvFlg "..." UBYTE Bool_ON_OFF 1 2 0 1 BIT_MASK 0x01 ECU_ADDRESS 0x70020022 /end MEASUREMENT
/begin MEASUREMENT MAIN_bSoftOvCurrPhsUFlg "..." UBYTE Bool_ON_OFF 1 2 0 1 BIT_MASK 0x01 ECU_ADDRESS 0x70020021 /end MEASUREMENT
/begin MEASUREMENT MAIN_bSoftOvCurrPhsVFlg "..." UBYTE Bool_ON_OFF 1 2 0 1 BIT_MASK 0x01 ECU_ADDRESS 0x70020020 /end MEASUREMENT
/begin MEASUREMENT MAIN_bSoftOvCurrPhsWFlg "..." UBYTE Bool_ON_OFF 1 2 0 1 BIT_MASK 0x01 ECU_ADDRESS 0x7002001F /end MEASUREMENT
/begin MEASUREMENT MAIN_bSpdReadyEst "..." UBYTE Bool_ON_OFF 1 2 0 1 BIT_MASK 0x01 ECU_ADDRESS 0x7002001E /end MEASUREMENT
/begin MEASUREMENT MAIN_bSpeedReadyFlg "..." UBYTE Bool_ON_OFF 1 2 0 1 BIT_MASK 0x01 ECU_ADDRESS 0x7002001D /end MEASUREMENT
/begin MEASUREMENT MAIN_bVSIStarted "Flag VSI started" UBYTE Bool_ON_OFF 1 2 0 1 BIT_MASK 0x01 ECU_ADDRESS 0x7002001C /end MEASUREMENT
/begin MEASUREMENT MAIN_f32ElecSpeedRds "..." FLOAT32_IEEE F_1_p0_8 1 2 -3.402823466E+038 3.402823466E+038 ECU_ADDRESS 0x70020014 /end MEASUREMENT
/begin MEASUREMENT MAIN_f32EmailElecSpeedRds "..." FLOAT32_IEEE F_1_p0_8 1 2 -3.402823466E+038 3.402823466E+038 ECU_ADDRESS 0x70020010 /end MEASUREMENT
/begin MEASUREMENT MAIN_f32EmailErrThetaRdSurPi "..." FLOAT32_IEEE F_1_p0_8 1 2 -3.402823466E+038 3.402823466E+038 ECU_ADDRESS 0x7002000C /end MEASUREMENT
/begin MEASUREMENT MAIN_f32EmailMecaSpeedRds "..." FLOAT32_IEEE F_1_p0_8 1 2 -3.402823466E+038 3.402823466E+038 ECU_ADDRESS 0x70020008 /end MEASUREMENT
/begin MEASUREMENT MAIN_f32EmailMecaSpeedRpm "..." FLOAT32_IEEE F_1_p0_8 1 2 -3.402823466E+038 3.402823466E+038 ECU_ADDRESS 0x70020004 /end MEASUREMENT
/begin MEASUREMENT MAIN_f32EmailThetaElecRdSurPi "..." FLOAT32_IEEE F_1_p0_8 1 2 -3.402823466E+038 3.402823466E+038 ECU_ADDRESS 0x70020000 /end MEASUREMENT
/begin MEASUREMENT MAIN_f32ErrThetaRdSurPi "..." FLOAT32_IEEE F_1_p0_8 1 2 -3.402823466E+038 3.402823466E+038 ECU_ADDRESS 0x7001FFFC /end MEASUREMENT
/begin MEASUREMENT MAIN_f32IuFrequency "..." FLOAT32_IEEE F_1_p0_14 1 2 -3.402823466E+038 3.402823466E+038 ECU_ADDRESS 0x7001FFF8 /end MEASUREMENT
/begin MEASUREMENT MAIN_f32IuPeriod "..." FLOAT32_IEEE F_1_p0_15 1 2 -3.402823466E+038 3.402823466E+038 ECU_ADDRESS 0x7001FFF4 /end MEASUREMENT
/begin MEASUREMENT MAIN_f32MecaSpeedRds "..." FLOAT32_IEEE F_1_p0_8 1 2 -3.402823466E+038 3.402823466E+038 ECU_ADDRESS 0x7001FFF0 /end MEASUREMENT
/begin MEASUREMENT MAIN_f32MecaSpeedRpm "..." FLOAT32_IEEE F_1_p0_8 1 2 -3.402823466E+038 3.402823466E+038 ECU_ADDRESS 0x7001FFEC /end MEASUREMENT
/begin MEASUREMENT MAIN_f32MotSpdEst "..." FLOAT32_IEEE F_1_p0_15 1 2 -3.402823466E+038 3.402823466E+038 ECU_ADDRESS 0x7001FFE8 /end MEASUREMENT
/begin MEASUREMENT MAIN_f32PWMDutyUPhys "..." FLOAT32_IEEE F_100_p0_3 1 2 -3.402823466E+038 3.402823466E+038 ECU_ADDRESS 0x7001FFE4 /end MEASUREMENT
/begin MEASUREMENT MAIN_f32PWMDutyVPhys "..." FLOAT32_IEEE F_100_p0_3 1 2 -3.402823466E+038 3.402823466E+038 ECU_ADDRESS 0x7001FFE0 /end MEASUREMENT
/begin MEASUREMENT MAIN_f32PWMDutyWPhys "..." FLOAT32_IEEE F_100_p0_3 1 2 -3.402823466E+038 3.402823466E+038 ECU_ADDRESS 0x7001FFDC /end MEASUREMENT
/begin MEASUREMENT MAIN_f32ThetaElecRdSurPi "..." FLOAT32_IEEE F_1_p0_8 1 2 -3.402823466E+038 3.402823466E+038 ECU_ADDRESS 0x7001FFD8 /end MEASUREMENT
/begin MEASUREMENT MAIN_f32VsiPwmPeriod "..." FLOAT32_IEEE F_1000000_p0_17 1 2 -3.402823466E+038 3.402823466E+038 ECU_ADDRESS 0x7001FFD4 /end MEASUREMENT
/begin MEASUREMENT MAIN_s32Email2PosTreqDiff "..." SLONG I_1 1 2 -2147483648 2147483647 ECU_ADDRESS 0x7001FEA0 /end MEASUREMENT
/begin MEASUREMENT MAIN_s32PosA2BDeltTime "..." SLONG F_0v1_p0_18 1 2 -214748364.8 214748364.7 ECU_ADDRESS 0x7001FE9C /end MEASUREMENT
/begin MEASUREMENT MAIN_u16AirConditionerCheck "MAIN_u16AirConditionerCheck" UWORD I_1 1 2 0 65535 ECU_ADDRESS 0x7001FF86 /end MEASUREMENT
/begin MEASUREMENT MAIN_u16BatHeatPTCCheck "MAIN_u16BatHeatPTCCheck" UWORD I_1 1 2 0 65535 ECU_ADDRESS 0x7001FF80 /end MEASUREMENT
/begin MEASUREMENT MAIN_u16DCACInverterCheck "MAIN_u16DCACInverterCheck" UWORD I_1 1 2 0 65535 ECU_ADDRESS 0x7001FF88 /end MEASUREMENT
/begin MEASUREMENT MAIN_u16DCACResevedCheck "MAIN_u16DCACResevedCheck" UWORD I_1 1 2 0 65535 ECU_ADDRESS 0x7001FF8A /end MEASUREMENT
/begin MEASUREMENT MAIN_u16HVFanCheck "MAIN_u16HVFanCheck" UWORD I_1 1 2 0 65535 ECU_ADDRESS 0x7001FF84 /end MEASUREMENT
/begin MEASUREMENT MAIN_u16HVInputCheck "MAIN_u16HVInputCheck" UWORD I_1 1 2 0 65535 ECU_ADDRESS 0x7001FF8E /end MEASUREMENT
/begin MEASUREMENT MAIN_u16IuCycleCnt "..." UWORD I_1 1 2 0 65535 ECU_ADDRESS 0x7001FFA0 /end MEASUREMENT
/begin MEASUREMENT MAIN_u16IuMiddleCnt "..." UWORD I_1 1 2 0 65535 ECU_ADDRESS 0x7001FF9E /end MEASUREMENT
/begin MEASUREMENT MAIN_u16IuMiddleSum "..." UWORD I_1 1 2 0 65535 ECU_ADDRESS 0x7001FF9C /end MEASUREMENT
/begin MEASUREMENT MAIN_u16IuNegtiveCnt "..." UWORD I_1 1 2 0 65535 ECU_ADDRESS 0x7001FF9A /end MEASUREMENT
/begin MEASUREMENT MAIN_u16IuNegtiveSum "..." UWORD I_1 1 2 0 65535 ECU_ADDRESS 0x7001FF98 /end MEASUREMENT
/begin MEASUREMENT MAIN_u16IuPositiveCnt "..." UWORD I_1 1 2 0 65535 ECU_ADDRESS 0x7001FF96 /end MEASUREMENT
/begin MEASUREMENT MAIN_u16IuPositiveSum "..." UWORD I_1 1 2 0 65535 ECU_ADDRESS 0x7001FF94 /end MEASUREMENT
/begin MEASUREMENT MAIN_u16PWMPeriodVal "MAIN_u16PWMPeriodVal" UWORD I_1 1 2 0 65535 ECU_ADDRESS 0x70001B70 /end MEASUREMENT
/begin MEASUREMENT MAIN_u16SpdReadyEstCnt "..." UWORD I_1 1 2 0 65535 ECU_ADDRESS 0x7001FF92 /end MEASUREMENT
/begin MEASUREMENT MAIN_u16SuperStructureCheck "MAIN_u16SuperStructureCheck" UWORD I_1 1 2 0 65535 ECU_ADDRESS 0x7001FF8C /end MEASUREMENT
/begin MEASUREMENT MAIN_u16VadcBhv "MAIN_u16VadcBhv" UWORD I_1 1 2 0 65535 ECU_ADDRESS 0x7001FF90 /end MEASUREMENT
/begin MEASUREMENT MAIN_u16WaterCoolingCheck "MAIN_u16WaterCoolingCheck" UWORD I_1 1 2 0 65535 ECU_ADDRESS 0x7001FF82 /end MEASUREMENT
/begin MEASUREMENT MAIN_u32EmailCkreq "..." ULONG I_1 1 2 0 4294967295 ECU_ADDRESS 0x7001FFD0 /end MEASUREMENT
/begin MEASUREMENT MAIN_u32EmailPosATimeStamp "..." ULONG I_1 1 2 0 4294967295 ECU_ADDRESS 0x7001FFCC /end MEASUREMENT
/begin MEASUREMENT MAIN_u32FixOcDataBuf "-" ULONG F_1_p0_2 1 2 0 4294967295 MATRIX_DIM 16 1 1 ECU_ADDRESS 0x700202F4 /end MEASUREMENT
/begin MEASUREMENT MAIN_u32FixOcDataBuf[0] "MAIN_u32FixOcDataBuf[0]" ULONG F_1_p0_2 1 2 0 4294967295 ECU_ADDRESS 0x700202F4 /end MEASUREMENT
/begin MEASUREMENT MAIN_u32FixOcDataBuf[10] "MAIN_u32FixOcDataBuf[10]" ULONG F_1_p0_2 1 2 0 4294967295 ECU_ADDRESS 0x7002031C /end MEASUREMENT
/begin MEASUREMENT MAIN_u32FixOcDataBuf[11] "MAIN_u32FixOcDataBuf[11]" ULONG F_1_p0_2 1 2 0 4294967295 ECU_ADDRESS 0x70020320 /end MEASUREMENT
/begin MEASUREMENT MAIN_u32FixOcDataBuf[12] "MAIN_u32FixOcDataBuf[12]" ULONG F_1_p0_2 1 2 0 4294967295 ECU_ADDRESS 0x70020324 /end MEASUREMENT
/begin MEASUREMENT MAIN_u32FixOcDataBuf[13] "MAIN_u32FixOcDataBuf[13]" ULONG F_1_p0_2 1 2 0 4294967295 ECU_ADDRESS 0x70020328 /end MEASUREMENT
/begin MEASUREMENT MAIN_u32FixOcDataBuf[14] "MAIN_u32FixOcDataBuf[14]" ULONG F_1_p0_2 1 2 0 4294967295 ECU_ADDRESS 0x7002032C /end MEASUREMENT
/begin MEASUREMENT MAIN_u32FixOcDataBuf[15] "MAIN_u32FixOcDataBuf[15]" ULONG F_1_p0_2 1 2 0 4294967295 ECU_ADDRESS 0x70020330 /end MEASUREMENT
/begin MEASUREMENT MAIN_u32FixOcDataBuf[1] "MAIN_u32FixOcDataBuf[1]" ULONG F_1_p0_2 1 2 0 4294967295 ECU_ADDRESS 0x700202F8 /end MEASUREMENT
/begin MEASUREMENT MAIN_u32FixOcDataBuf[2] "MAIN_u32FixOcDataBuf[2]" ULONG F_1_p0_2 1 2 0 4294967295 ECU_ADDRESS 0x700202FC /end MEASUREMENT
/begin MEASUREMENT MAIN_u32FixOcDataBuf[3] "MAIN_u32FixOcDataBuf[3]" ULONG F_1_p0_2 1 2 0 4294967295 ECU_ADDRESS 0x70020300 /end MEASUREMENT
/begin MEASUREMENT MAIN_u32FixOcDataBuf[4] "MAIN_u32FixOcDataBuf[4]" ULONG F_1_p0_2 1 2 0 4294967295 ECU_ADDRESS 0x70020304 /end MEASUREMENT
/begin MEASUREMENT MAIN_u32FixOcDataBuf[5] "MAIN_u32FixOcDataBuf[5]" ULONG F_1_p0_2 1 2 0 4294967295 ECU_ADDRESS 0x70020308 /end MEASUREMENT
/begin MEASUREMENT MAIN_u32FixOcDataBuf[6] "MAIN_u32FixOcDataBuf[6]" ULONG F_1_p0_2 1 2 0 4294967295 ECU_ADDRESS 0x7002030C /end MEASUREMENT
/begin MEASUREMENT MAIN_u32FixOcDataBuf[7] "MAIN_u32FixOcDataBuf[7]" ULONG F_1_p0_2 1 2 0 4294967295 ECU_ADDRESS 0x70020310 /end MEASUREMENT
/begin MEASUREMENT MAIN_u32FixOcDataBuf[8] "MAIN_u32FixOcDataBuf[8]" ULONG F_1_p0_2 1 2 0 4294967295 ECU_ADDRESS 0x70020314 /end MEASUREMENT
/begin MEASUREMENT MAIN_u32FixOcDataBuf[9] "MAIN_u32FixOcDataBuf[9]" ULONG F_1_p0_2 1 2 0 4294967295 ECU_ADDRESS 0x70020318 /end MEASUREMENT
/begin MEASUREMENT MAIN_u32IuCycleTim "..." ULONG I_1 1 2 0 4294967295 ECU_ADDRESS 0x7001FFC8 /end MEASUREMENT
/begin MEASUREMENT MAIN_u32OCTrimNvmAlignBuf "-" ULONG F_1_p0_2 1 2 0 4294967295 MATRIX_DIM 10 1 1 ECU_ADDRESS 0x7002034C /end MEASUREMENT
/begin MEASUREMENT MAIN_u32OCTrimNvmAlignBuf[0] "MAIN_u32OCTrimNvmAlignBuf[0]" ULONG F_1_p0_2 1 2 0 4294967295 ECU_ADDRESS 0x7002034C /end MEASUREMENT
/begin MEASUREMENT MAIN_u32OCTrimNvmAlignBuf[1] "MAIN_u32OCTrimNvmAlignBuf[1]" ULONG F_1_p0_2 1 2 0 4294967295 ECU_ADDRESS 0x70020350 /end MEASUREMENT
/begin MEASUREMENT MAIN_u32OCTrimNvmAlignBuf[2] "MAIN_u32OCTrimNvmAlignBuf[2]" ULONG F_1_p0_2 1 2 0 4294967295 ECU_ADDRESS 0x70020354 /end MEASUREMENT
/begin MEASUREMENT MAIN_u32OCTrimNvmAlignBuf[3] "MAIN_u32OCTrimNvmAlignBuf[3]" ULONG F_1_p0_2 1 2 0 4294967295 ECU_ADDRESS 0x70020358 /end MEASUREMENT
/begin MEASUREMENT MAIN_u32OCTrimNvmAlignBuf[4] "MAIN_u32OCTrimNvmAlignBuf[4]" ULONG F_1_p0_2 1 2 0 4294967295 ECU_ADDRESS 0x7002035C /end MEASUREMENT
/begin MEASUREMENT MAIN_u32OCTrimNvmAlignBuf[5] "MAIN_u32OCTrimNvmAlignBuf[5]" ULONG F_1_p0_2 1 2 0 4294967295 ECU_ADDRESS 0x70020360 /end MEASUREMENT
/begin MEASUREMENT MAIN_u32OCTrimNvmAlignBuf[6] "MAIN_u32OCTrimNvmAlignBuf[6]" ULONG F_1_p0_2 1 2 0 4294967295 ECU_ADDRESS 0x70020364 /end MEASUREMENT
/begin MEASUREMENT MAIN_u32OCTrimNvmAlignBuf[7] "MAIN_u32OCTrimNvmAlignBuf[7]" ULONG F_1_p0_2 1 2 0 4294967295 ECU_ADDRESS 0x70020368 /end MEASUREMENT
/begin MEASUREMENT MAIN_u32OCTrimNvmAlignBuf[8] "MAIN_u32OCTrimNvmAlignBuf[8]" ULONG F_1_p0_2 1 2 0 4294967295 ECU_ADDRESS 0x7002036C /end MEASUREMENT
/begin MEASUREMENT MAIN_u32OCTrimNvmAlignBuf[9] "MAIN_u32OCTrimNvmAlignBuf[9]" ULONG F_1_p0_2 1 2 0 4294967295 ECU_ADDRESS 0x70020370 /end MEASUREMENT
/begin MEASUREMENT MAIN_u32PosATimeStamp "..." ULONG I_1 1 2 0 4294967295 ECU_ADDRESS 0x7001FFC4 /end MEASUREMENT
/begin MEASUREMENT MAIN_u32PosBTimeStamp "..." ULONG I_1 1 2 0 4294967295 ECU_ADDRESS 0x7001FFC0 /end MEASUREMENT
/begin MEASUREMENT MAIN_u32PosTreatCkreq "..." ULONG I_1 1 2 0 4294967295 ECU_ADDRESS 0x7001FFBC /end MEASUREMENT
/begin MEASUREMENT MAIN_u32TestVar2 "MAIN_u32TestVar2" ULONG I_1 1 2 0 4294967295 ECU_ADDRESS 0x7001FFB8 /end MEASUREMENT
/begin MEASUREMENT MAIN_u32WaitValueVSITreatment "Additional wait value for VSITreatment function (debug)" ULONG F_0v02_p0_24 1 2 0 85899345.9 ECU_ADDRESS 0x7001FFB4 /end MEASUREMENT
/begin MEASUREMENT MAIN_u64RunTime_NVM "-" ULONG F_1_p0_2 1 2 0 4294967295 MATRIX_DIM 2 1 1 ECU_ADDRESS 0x70020400 /end MEASUREMENT
/begin MEASUREMENT MAIN_u64RunTime_NVM[0] "MAIN_u64RunTime_NVM[0]" ULONG F_1_p0_2 1 2 0 4294967295 ECU_ADDRESS 0x70020400 /end MEASUREMENT
/begin MEASUREMENT MAIN_u64RunTime_NVM[1] "MAIN_u64RunTime_NVM[1]" ULONG F_1_p0_2 1 2 0 4294967295 ECU_ADDRESS 0x70020404 /end MEASUREMENT
/begin MEASUREMENT MAIN_u64RunTime_ms "-" ULONG F_1_p0_2 1 2 0 4294967295 MATRIX_DIM 2 1 1 ECU_ADDRESS 0x700203F0 /end MEASUREMENT
/begin MEASUREMENT MAIN_u64RunTime_ms[0] "MAIN_u64RunTime_ms[0]" ULONG F_1_p0_2 1 2 0 4294967295 ECU_ADDRESS 0x700203F0 /end MEASUREMENT
/begin MEASUREMENT MAIN_u64RunTime_ms[1] "MAIN_u64RunTime_ms[1]" ULONG F_1_p0_2 1 2 0 4294967295 ECU_ADDRESS 0x700203F4 /end MEASUREMENT
/begin MEASUREMENT MAIN_u64RunTime_s "-" ULONG F_1_p0_2 1 2 0 4294967295 MATRIX_DIM 2 1 1 ECU_ADDRESS 0x700203F8 /end MEASUREMENT
/begin MEASUREMENT MAIN_u64RunTime_s[0] "MAIN_u64RunTime_s[0]" ULONG F_1_p0_2 1 2 0 4294967295 ECU_ADDRESS 0x700203F8 /end MEASUREMENT
/begin MEASUREMENT MAIN_u64RunTime_s[1] "MAIN_u64RunTime_s[1]" ULONG F_1_p0_2 1 2 0 4294967295 ECU_ADDRESS 0x700203FC /end MEASUREMENT
/begin MEASUREMENT MAIN_u8CalibStoreState "..." UBYTE I_1 1 2 0 255 ECU_ADDRESS 0x70020173 /end MEASUREMENT
/begin MEASUREMENT MAIN_u8DEV_Fault "-" UBYTE F_1_p0_2 1 2 0 255 MATRIX_DIM 16 1 1 ECU_ADDRESS 0x7001FEB8 /end MEASUREMENT
/begin MEASUREMENT MAIN_u8DEV_Fault[0] "MAIN_u8DEV_Fault[0]" UBYTE F_1_p0_2 1 2 0 255 ECU_ADDRESS 0x7001FEB8 /end MEASUREMENT
/begin MEASUREMENT MAIN_u8DEV_Fault[10] "MAIN_u8DEV_Fault[10]" UBYTE F_1_p0_2 1 2 0 255 ECU_ADDRESS 0x7001FEC2 /end MEASUREMENT
/begin MEASUREMENT MAIN_u8DEV_Fault[11] "MAIN_u8DEV_Fault[11]" UBYTE F_1_p0_2 1 2 0 255 ECU_ADDRESS 0x7001FEC3 /end MEASUREMENT
/begin MEASUREMENT MAIN_u8DEV_Fault[12] "MAIN_u8DEV_Fault[12]" UBYTE F_1_p0_2 1 2 0 255 ECU_ADDRESS 0x7001FEC4 /end MEASUREMENT
/begin MEASUREMENT MAIN_u8DEV_Fault[13] "MAIN_u8DEV_Fault[13]" UBYTE F_1_p0_2 1 2 0 255 ECU_ADDRESS 0x7001FEC5 /end MEASUREMENT
/begin MEASUREMENT MAIN_u8DEV_Fault[14] "MAIN_u8DEV_Fault[14]" UBYTE F_1_p0_2 1 2 0 255 ECU_ADDRESS 0x7001FEC6 /end MEASUREMENT
/begin MEASUREMENT MAIN_u8DEV_Fault[15] "MAIN_u8DEV_Fault[15]" UBYTE F_1_p0_2 1 2 0 255 ECU_ADDRESS 0x7001FEC7 /end MEASUREMENT
/begin MEASUREMENT MAIN_u8DEV_Fault[1] "MAIN_u8DEV_Fault[1]" UBYTE F_1_p0_2 1 2 0 255 ECU_ADDRESS 0x7001FEB9 /end MEASUREMENT
/begin MEASUREMENT MAIN_u8DEV_Fault[2] "MAIN_u8DEV_Fault[2]" UBYTE F_1_p0_2 1 2 0 255 ECU_ADDRESS 0x7001FEBA /end MEASUREMENT
/begin MEASUREMENT MAIN_u8DEV_Fault[3] "MAIN_u8DEV_Fault[3]" UBYTE F_1_p0_2 1 2 0 255 ECU_ADDRESS 0x7001FEBB /end MEASUREMENT
/begin MEASUREMENT MAIN_u8DEV_Fault[4] "MAIN_u8DEV_Fault[4]" UBYTE F_1_p0_2 1 2 0 255 ECU_ADDRESS 0x7001FEBC /end MEASUREMENT
/begin MEASUREMENT MAIN_u8DEV_Fault[5] "MAIN_u8DEV_Fault[5]" UBYTE F_1_p0_2 1 2 0 255 ECU_ADDRESS 0x7001FEBD /end MEASUREMENT
/begin MEASUREMENT MAIN_u8DEV_Fault[6] "MAIN_u8DEV_Fault[6]" UBYTE F_1_p0_2 1 2 0 255 ECU_ADDRESS 0x7001FEBE /end MEASUREMENT
/begin MEASUREMENT MAIN_u8DEV_Fault[7] "MAIN_u8DEV_Fault[7]" UBYTE F_1_p0_2 1 2 0 255 ECU_ADDRESS 0x7001FEBF /end MEASUREMENT
/begin MEASUREMENT MAIN_u8DEV_Fault[8] "MAIN_u8DEV_Fault[8]" UBYTE F_1_p0_2 1 2 0 255 ECU_ADDRESS 0x7001FEC0 /end MEASUREMENT
/begin MEASUREMENT MAIN_u8DEV_Fault[9] "MAIN_u8DEV_Fault[9]" UBYTE F_1_p0_2 1 2 0 255 ECU_ADDRESS 0x7001FEC1 /end MEASUREMENT
/begin MEASUREMENT MAIN_u8OCStoreState "..." UBYTE I_1 1 2 0 255 ECU_ADDRESS 0x70001B74 /end MEASUREMENT
/begin MEASUREMENT MAIN_u8OcState "..." UBYTE I_1 1 2 0 255 ECU_ADDRESS 0x70020334 /end MEASUREMENT
/begin MEASUREMENT MAIN_u8OcStsRptDelayCnt "..." UBYTE I_1 1 2 0 255 ECU_ADDRESS 0x70020337 /end MEASUREMENT
/begin MEASUREMENT MAIN_u8OfsAlCalSts "..." UBYTE I_1 1 2 0 255 ECU_ADDRESS 0x70020335 /end MEASUREMENT
/begin MEASUREMENT MAIN_u8TestVar1 "MAIN_u8TestVar1" UBYTE I_1 1 2 0 255 ECU_ADDRESS 0x7001FFB0 /end MEASUREMENT
/begin MEASUREMENT MAIN_u8TrigOcByUser "..." UBYTE I_1 1 2 0 255 ECU_ADDRESS 0x70020336 /end MEASUREMENT
/begin MEASUREMENT MAIN_u8UdsSwVerSup "..." UBYTE Id_0x00 1 2 0 255 MATRIX_DIM 21 1 1 ECU_ADDRESS 0x70001B4E /end MEASUREMENT
/begin MEASUREMENT MAIN_u8UdsSwVerSup[0] "MAIN_u8UdsSwVerSup[0]" UBYTE Id_0x00 1 2 0 255 ECU_ADDRESS 0x70001B4E /end MEASUREMENT
/begin MEASUREMENT MAIN_u8UdsSwVerSup[10] "MAIN_u8UdsSwVerSup[10]" UBYTE Id_0x00 1 2 0 255 ECU_ADDRESS 0x70001B58 /end MEASUREMENT
/begin MEASUREMENT MAIN_u8UdsSwVerSup[11] "MAIN_u8UdsSwVerSup[11]" UBYTE Id_0x00 1 2 0 255 ECU_ADDRESS 0x70001B59 /end MEASUREMENT
/begin MEASUREMENT MAIN_u8UdsSwVerSup[12] "MAIN_u8UdsSwVerSup[12]" UBYTE Id_0x00 1 2 0 255 ECU_ADDRESS 0x70001B5A /end MEASUREMENT
/begin MEASUREMENT MAIN_u8UdsSwVerSup[13] "MAIN_u8UdsSwVerSup[13]" UBYTE Id_0x00 1 2 0 255 ECU_ADDRESS 0x70001B5B /end MEASUREMENT
/begin MEASUREMENT MAIN_u8UdsSwVerSup[14] "MAIN_u8UdsSwVerSup[14]" UBYTE Id_0x00 1 2 0 255 ECU_ADDRESS 0x70001B5C /end MEASUREMENT
/begin MEASUREMENT MAIN_u8UdsSwVerSup[15] "MAIN_u8UdsSwVerSup[15]" UBYTE Id_0x00 1 2 0 255 ECU_ADDRESS 0x70001B5D /end MEASUREMENT
/begin MEASUREMENT MAIN_u8UdsSwVerSup[16] "MAIN_u8UdsSwVerSup[16]" UBYTE Id_0x00 1 2 0 255 ECU_ADDRESS 0x70001B5E /end MEASUREMENT
/begin MEASUREMENT MAIN_u8UdsSwVerSup[17] "MAIN_u8UdsSwVerSup[17]" UBYTE Id_0x00 1 2 0 255 ECU_ADDRESS 0x70001B5F /end MEASUREMENT
/begin MEASUREMENT MAIN_u8UdsSwVerSup[18] "MAIN_u8UdsSwVerSup[18]" UBYTE Id_0x00 1 2 0 255 ECU_ADDRESS 0x70001B60 /end MEASUREMENT
/begin MEASUREMENT MAIN_u8UdsSwVerSup[19] "MAIN_u8UdsSwVerSup[19]" UBYTE Id_0x00 1 2 0 255 ECU_ADDRESS 0x70001B61 /end MEASUREMENT
/begin MEASUREMENT MAIN_u8UdsSwVerSup[1] "MAIN_u8UdsSwVerSup[1]" UBYTE Id_0x00 1 2 0 255 ECU_ADDRESS 0x70001B4F /end MEASUREMENT
/begin MEASUREMENT MAIN_u8UdsSwVerSup[20] "MAIN_u8UdsSwVerSup[20]" UBYTE Id_0x00 1 2 0 255 ECU_ADDRESS 0x70001B62 /end MEASUREMENT
/begin MEASUREMENT MAIN_u8UdsSwVerSup[2] "MAIN_u8UdsSwVerSup[2]" UBYTE Id_0x00 1 2 0 255 ECU_ADDRESS 0x70001B50 /end MEASUREMENT
/begin MEASUREMENT MAIN_u8UdsSwVerSup[3] "MAIN_u8UdsSwVerSup[3]" UBYTE Id_0x00 1 2 0 255 ECU_ADDRESS 0x70001B51 /end MEASUREMENT
/begin MEASUREMENT MAIN_u8UdsSwVerSup[4] "MAIN_u8UdsSwVerSup[4]" UBYTE Id_0x00 1 2 0 255 ECU_ADDRESS 0x70001B52 /end MEASUREMENT
/begin MEASUREMENT MAIN_u8UdsSwVerSup[5] "MAIN_u8UdsSwVerSup[5]" UBYTE Id_0x00 1 2 0 255 ECU_ADDRESS 0x70001B53 /end MEASUREMENT
/begin MEASUREMENT MAIN_u8UdsSwVerSup[6] "MAIN_u8UdsSwVerSup[6]" UBYTE Id_0x00 1 2 0 255 ECU_ADDRESS 0x70001B54 /end MEASUREMENT
/begin MEASUREMENT MAIN_u8UdsSwVerSup[7] "MAIN_u8UdsSwVerSup[7]" UBYTE Id_0x00 1 2 0 255 ECU_ADDRESS 0x70001B55 /end MEASUREMENT
/begin MEASUREMENT MAIN_u8UdsSwVerSup[8] "MAIN_u8UdsSwVerSup[8]" UBYTE Id_0x00 1 2 0 255 ECU_ADDRESS 0x70001B56 /end MEASUREMENT
/begin MEASUREMENT MAIN_u8UdsSwVerSup[9] "MAIN_u8UdsSwVerSup[9]" UBYTE Id_0x00 1 2 0 255 ECU_ADDRESS 0x70001B57 /end MEASUREMENT
/begin MEASUREMENT MAIN_u8UdsSwVerVeh "..." UBYTE Id_0x00 1 2 0 255 MATRIX_DIM 13 1 1 ECU_ADDRESS 0x70001B63 /end MEASUREMENT
/begin MEASUREMENT MAIN_u8UdsSwVerVeh[0] "MAIN_u8UdsSwVerVeh[0]" UBYTE Id_0x00 1 2 0 255 ECU_ADDRESS 0x70001B63 /end MEASUREMENT
/begin MEASUREMENT MAIN_u8UdsSwVerVeh[10] "MAIN_u8UdsSwVerVeh[10]" UBYTE Id_0x00 1 2 0 255 ECU_ADDRESS 0x70001B6D /end MEASUREMENT
/begin MEASUREMENT MAIN_u8UdsSwVerVeh[11] "MAIN_u8UdsSwVerVeh[11]" UBYTE Id_0x00 1 2 0 255 ECU_ADDRESS 0x70001B6E /end MEASUREMENT
/begin MEASUREMENT MAIN_u8UdsSwVerVeh[12] "MAIN_u8UdsSwVerVeh[12]" UBYTE Id_0x00 1 2 0 255 ECU_ADDRESS 0x70001B6F /end MEASUREMENT
/begin MEASUREMENT MAIN_u8UdsSwVerVeh[1] "MAIN_u8UdsSwVerVeh[1]" UBYTE Id_0x00 1 2 0 255 ECU_ADDRESS 0x70001B64 /end MEASUREMENT
/begin MEASUREMENT MAIN_u8UdsSwVerVeh[2] "MAIN_u8UdsSwVerVeh[2]" UBYTE Id_0x00 1 2 0 255 ECU_ADDRESS 0x70001B65 /end MEASUREMENT
/begin MEASUREMENT MAIN_u8UdsSwVerVeh[3] "MAIN_u8UdsSwVerVeh[3]" UBYTE Id_0x00 1 2 0 255 ECU_ADDRESS 0x70001B66 /end MEASUREMENT
/begin MEASUREMENT MAIN_u8UdsSwVerVeh[4] "MAIN_u8UdsSwVerVeh[4]" UBYTE Id_0x00 1 2 0 255 ECU_ADDRESS 0x70001B67 /end MEASUREMENT
/begin MEASUREMENT MAIN_u8UdsSwVerVeh[5] "MAIN_u8UdsSwVerVeh[5]" UBYTE Id_0x00 1 2 0 255 ECU_ADDRESS 0x70001B68 /end MEASUREMENT
/begin MEASUREMENT MAIN_u8UdsSwVerVeh[6] "MAIN_u8UdsSwVerVeh[6]" UBYTE Id_0x00 1 2 0 255 ECU_ADDRESS 0x70001B69 /end MEASUREMENT
/begin MEASUREMENT MAIN_u8UdsSwVerVeh[7] "MAIN_u8UdsSwVerVeh[7]" UBYTE Id_0x00 1 2 0 255 ECU_ADDRESS 0x70001B6A /end MEASUREMENT
/begin MEASUREMENT MAIN_u8UdsSwVerVeh[8] "MAIN_u8UdsSwVerVeh[8]" UBYTE Id_0x00 1 2 0 255 ECU_ADDRESS 0x70001B6B /end MEASUREMENT
/begin MEASUREMENT MAIN_u8UdsSwVerVeh[9] "MAIN_u8UdsSwVerVeh[9]" UBYTE Id_0x00 1 2 0 255 ECU_ADDRESS 0x70001B6C /end MEASUREMENT
/begin MEASUREMENT OBD_u32CalVerifyNum "..." ULONG Id_0x00 1 2 0 4294967295 ECU_ADDRESS 0x7001FF7C /end MEASUREMENT
/begin MEASUREMENT OMAIN_ESMGo2StartupIEvent "BSW Power on check finish flag." UBYTE Bool_ON_OFF 1 2 0 1 BIT_MASK 0x01 ECU_ADDRESS 0x70020069 /end MEASUREMENT
/begin MEASUREMENT OMAIN_EndTime "..." ULONG I_1 1 2 0 4294967295 ECU_ADDRESS 0x70020040 /end MEASUREMENT
/begin MEASUREMENT OMAIN_TotalTime "..." ULONG I_1 1 2 0 4294967295 ECU_ADDRESS 0x7002003C /end MEASUREMENT
/begin MEASUREMENT OMAIN_bBswReadySts "BSW Power on check finish flag." UBYTE Bool_ON_OFF 1 2 0 1 BIT_MASK 0x01 ECU_ADDRESS 0x70020070 /end MEASUREMENT
/begin MEASUREMENT OMAIN_bESMStarted "BSW Power on check finish flag." UBYTE Bool_ON_OFF 1 2 0 1 BIT_MASK 0x01 ECU_ADDRESS 0x7002006F /end MEASUREMENT
/begin MEASUREMENT OMAIN_bProgConditionOk "BSW Power on check finish flag." UBYTE Bool_ON_OFF 1 2 0 1 BIT_MASK 0x01 ECU_ADDRESS 0x70020068 /end MEASUREMENT
/begin MEASUREMENT OMAIN_bSoftOvBhvFlg "BSW Power on check finish flag." UBYTE Bool_ON_OFF 1 2 0 1 BIT_MASK 0x01 ECU_ADDRESS 0x7002006E /end MEASUREMENT
/begin MEASUREMENT OMAIN_bSoftOvCurrPhsUFlg "BSW Power on check finish flag." UBYTE Bool_ON_OFF 1 2 0 1 BIT_MASK 0x01 ECU_ADDRESS 0x7002006D /end MEASUREMENT
/begin MEASUREMENT OMAIN_bSoftOvCurrPhsVFlg "BSW Power on check finish flag." UBYTE Bool_ON_OFF 1 2 0 1 BIT_MASK 0x01 ECU_ADDRESS 0x7002006C /end MEASUREMENT
/begin MEASUREMENT OMAIN_bSoftOvCurrPhsWFlg "BSW Power on check finish flag." UBYTE Bool_ON_OFF 1 2 0 1 BIT_MASK 0x01 ECU_ADDRESS 0x7002006B /end MEASUREMENT
/begin MEASUREMENT OMAIN_bVSIStarted "BSW Power on check finish flag." UBYTE Bool_ON_OFF 1 2 0 1 BIT_MASK 0x01 ECU_ADDRESS 0x7002006A /end MEASUREMENT
/begin MEASUREMENT OMAIN_f32PWMDutyUPhys "..." FLOAT32_IEEE F_1_p0_2 1 2 -3.402823466E+038 3.402823466E+038 ECU_ADDRESS 0x70020064 /end MEASUREMENT
/begin MEASUREMENT OMAIN_f32PWMDutyVPhys "..." FLOAT32_IEEE F_1_p0_2 1 2 -3.402823466E+038 3.402823466E+038 ECU_ADDRESS 0x70020060 /end MEASUREMENT
/begin MEASUREMENT OMAIN_f32PWMDutyWPhys "..." FLOAT32_IEEE F_1_p0_2 1 2 -3.402823466E+038 3.402823466E+038 ECU_ADDRESS 0x7002005C /end MEASUREMENT
/begin MEASUREMENT OMAIN_startTime "..." ULONG I_1 1 2 0 4294967295 ECU_ADDRESS 0x70020044 /end MEASUREMENT
/begin MEASUREMENT OMAIN_u16Cnt1 "..." UWORD I_1 1 2 0 65535 ECU_ADDRESS 0x70020058 /end MEASUREMENT
/begin MEASUREMENT OMAIN_u16Cnt10 "..." UWORD I_1 1 2 0 65535 ECU_ADDRESS 0x70020052 /end MEASUREMENT
/begin MEASUREMENT OMAIN_u16Cnt100 "..." UWORD I_1 1 2 0 65535 ECU_ADDRESS 0x70020050 /end MEASUREMENT
/begin MEASUREMENT OMAIN_u16Cnt2 "..." UWORD I_1 1 2 0 65535 ECU_ADDRESS 0x70020056 /end MEASUREMENT
/begin MEASUREMENT OMAIN_u16Cnt200 "..." UWORD I_1 1 2 0 65535 ECU_ADDRESS 0x7002004E /end MEASUREMENT
/begin MEASUREMENT OMAIN_u16Cnt5 "..." UWORD I_1 1 2 0 65535 ECU_ADDRESS 0x70020054 /end MEASUREMENT
/begin MEASUREMENT OMAIN_u16VadcPhaseCurU "..." UWORD I_1 1 2 0 65535 ECU_ADDRESS 0x7002004C /end MEASUREMENT
/begin MEASUREMENT OMAIN_u16VadcPhaseCurV "..." UWORD I_1 1 2 0 65535 ECU_ADDRESS 0x7002004A /end MEASUREMENT
/begin MEASUREMENT OMAIN_u16VadcPhaseCurW "..." UWORD I_1 1 2 0 65535 ECU_ADDRESS 0x70020048 /end MEASUREMENT
/begin MEASUREMENT OMAIN_u8DEV_Fault "-" UBYTE F_1_p0_2 1 2 0 255 MATRIX_DIM 16 1 1 ECU_ADDRESS 0x7002002C /end MEASUREMENT
/begin MEASUREMENT OMAIN_u8DEV_Fault[0] "OMAIN_u8DEV_Fault[0]" UBYTE F_1_p0_2 1 2 0 255 ECU_ADDRESS 0x7002002C /end MEASUREMENT
/begin MEASUREMENT OMAIN_u8DEV_Fault[10] "OMAIN_u8DEV_Fault[10]" UBYTE F_1_p0_2 1 2 0 255 ECU_ADDRESS 0x70020036 /end MEASUREMENT
/begin MEASUREMENT OMAIN_u8DEV_Fault[11] "OMAIN_u8DEV_Fault[11]" UBYTE F_1_p0_2 1 2 0 255 ECU_ADDRESS 0x70020037 /end MEASUREMENT
/begin MEASUREMENT OMAIN_u8DEV_Fault[12] "OMAIN_u8DEV_Fault[12]" UBYTE F_1_p0_2 1 2 0 255 ECU_ADDRESS 0x70020038 /end MEASUREMENT
/begin MEASUREMENT OMAIN_u8DEV_Fault[13] "OMAIN_u8DEV_Fault[13]" UBYTE F_1_p0_2 1 2 0 255 ECU_ADDRESS 0x70020039 /end MEASUREMENT
/begin MEASUREMENT OMAIN_u8DEV_Fault[14] "OMAIN_u8DEV_Fault[14]" UBYTE F_1_p0_2 1 2 0 255 ECU_ADDRESS 0x7002003A /end MEASUREMENT
/begin MEASUREMENT OMAIN_u8DEV_Fault[15] "OMAIN_u8DEV_Fault[15]" UBYTE F_1_p0_2 1 2 0 255 ECU_ADDRESS 0x7002003B /end MEASUREMENT
/begin MEASUREMENT OMAIN_u8DEV_Fault[1] "OMAIN_u8DEV_Fault[1]" UBYTE F_1_p0_2 1 2 0 255 ECU_ADDRESS 0x7002002D /end MEASUREMENT
/begin MEASUREMENT OMAIN_u8DEV_Fault[2] "OMAIN_u8DEV_Fault[2]" UBYTE F_1_p0_2 1 2 0 255 ECU_ADDRESS 0x7002002E /end MEASUREMENT
/begin MEASUREMENT OMAIN_u8DEV_Fault[3] "OMAIN_u8DEV_Fault[3]" UBYTE F_1_p0_2 1 2 0 255 ECU_ADDRESS 0x7002002F /end MEASUREMENT
/begin MEASUREMENT OMAIN_u8DEV_Fault[4] "OMAIN_u8DEV_Fault[4]" UBYTE F_1_p0_2 1 2 0 255 ECU_ADDRESS 0x70020030 /end MEASUREMENT
/begin MEASUREMENT OMAIN_u8DEV_Fault[5] "OMAIN_u8DEV_Fault[5]" UBYTE F_1_p0_2 1 2 0 255 ECU_ADDRESS 0x70020031 /end MEASUREMENT
/begin MEASUREMENT OMAIN_u8DEV_Fault[6] "OMAIN_u8DEV_Fault[6]" UBYTE F_1_p0_2 1 2 0 255 ECU_ADDRESS 0x70020032 /end MEASUREMENT
/begin MEASUREMENT OMAIN_u8DEV_Fault[7] "OMAIN_u8DEV_Fault[7]" UBYTE F_1_p0_2 1 2 0 255 ECU_ADDRESS 0x70020033 /end MEASUREMENT
/begin MEASUREMENT OMAIN_u8DEV_Fault[8] "OMAIN_u8DEV_Fault[8]" UBYTE F_1_p0_2 1 2 0 255 ECU_ADDRESS 0x70020034 /end MEASUREMENT
/begin MEASUREMENT OMAIN_u8DEV_Fault[9] "OMAIN_u8DEV_Fault[9]" UBYTE F_1_p0_2 1 2 0 255 ECU_ADDRESS 0x70020035 /end MEASUREMENT
/begin MEASUREMENT Os_Task_BackGround_Counter "..." ULONG I_1 1 2 0 4294967295 ECU_ADDRESS 0x70002030 /end MEASUREMENT
/begin MEASUREMENT Os_Task_Idle_Counter "..." ULONG I_1 1 2 0 4294967295 ECU_ADDRESS 0x70001E38 /end MEASUREMENT
/begin MEASUREMENT PMUX_ePMUX_AN_MUX1 "PMux_au16DataBuf" UWORD I_1 1 2 0 65535 MATRIX_DIM 8 1 1 ECU_ADDRESS 0x70013EE0 /end MEASUREMENT
/begin MEASUREMENT PMUX_ePMUX_AN_MUX10 "PMux_au16DataBuf" UWORD I_1 1 2 0 65535 MATRIX_DIM 8 1 1 ECU_ADDRESS 0x70013F70 /end MEASUREMENT
/begin MEASUREMENT PMUX_ePMUX_AN_MUX10[0] "PMux_au16DataBuf[0]" UWORD I_1 1 2 0 65535 ECU_ADDRESS 0x70013F70 /end MEASUREMENT
/begin MEASUREMENT PMUX_ePMUX_AN_MUX10[1] "PMux_au16DataBuf[1]" UWORD I_1 1 2 0 65535 ECU_ADDRESS 0x70013F72 /end MEASUREMENT
/begin MEASUREMENT PMUX_ePMUX_AN_MUX10[2] "PMux_au16DataBuf[2]" UWORD I_1 1 2 0 65535 ECU_ADDRESS 0x70013F74 /end MEASUREMENT
/begin MEASUREMENT PMUX_ePMUX_AN_MUX10[3] "PMux_au16DataBuf[3]" UWORD I_1 1 2 0 65535 ECU_ADDRESS 0x70013F76 /end MEASUREMENT
/begin MEASUREMENT PMUX_ePMUX_AN_MUX10[4] "PMux_au16DataBuf[4]" UWORD I_1 1 2 0 65535 ECU_ADDRESS 0x70013F78 /end MEASUREMENT
/begin MEASUREMENT PMUX_ePMUX_AN_MUX10[5] "PMux_au16DataBuf[5]" UWORD I_1 1 2 0 65535 ECU_ADDRESS 0x70013F7A /end MEASUREMENT
/begin MEASUREMENT PMUX_ePMUX_AN_MUX10[6] "PMux_au16DataBuf[6]" UWORD I_1 1 2 0 65535 ECU_ADDRESS 0x70013F7C /end MEASUREMENT
/begin MEASUREMENT PMUX_ePMUX_AN_MUX10[7] "PMux_au16DataBuf[7]" UWORD I_1 1 2 0 65535 ECU_ADDRESS 0x70013F7E /end MEASUREMENT
/begin MEASUREMENT PMUX_ePMUX_AN_MUX11 "PMux_au16DataBuf" UWORD I_1 1 2 0 65535 MATRIX_DIM 8 1 1 ECU_ADDRESS 0x70013F80 /end MEASUREMENT
/begin MEASUREMENT PMUX_ePMUX_AN_MUX11[0] "PMux_au16DataBuf[0]" UWORD I_1 1 2 0 65535 ECU_ADDRESS 0x70013F80 /end MEASUREMENT
/begin MEASUREMENT PMUX_ePMUX_AN_MUX11[1] "PMux_au16DataBuf[1]" UWORD I_1 1 2 0 65535 ECU_ADDRESS 0x70013F82 /end MEASUREMENT
/begin MEASUREMENT PMUX_ePMUX_AN_MUX11[2] "PMux_au16DataBuf[2]" UWORD I_1 1 2 0 65535 ECU_ADDRESS 0x70013F84 /end MEASUREMENT
/begin MEASUREMENT PMUX_ePMUX_AN_MUX11[3] "PMux_au16DataBuf[3]" UWORD I_1 1 2 0 65535 ECU_ADDRESS 0x70013F86 /end MEASUREMENT
/begin MEASUREMENT PMUX_ePMUX_AN_MUX11[4] "PMux_au16DataBuf[4]" UWORD I_1 1 2 0 65535 ECU_ADDRESS 0x70013F88 /end MEASUREMENT
/begin MEASUREMENT PMUX_ePMUX_AN_MUX11[5] "PMux_au16DataBuf[5]" UWORD I_1 1 2 0 65535 ECU_ADDRESS 0x70013F8A /end MEASUREMENT
/begin MEASUREMENT PMUX_ePMUX_AN_MUX11[6] "PMux_au16DataBuf[6]" UWORD I_1 1 2 0 65535 ECU_ADDRESS 0x70013F8C /end MEASUREMENT
/begin MEASUREMENT PMUX_ePMUX_AN_MUX11[7] "PMux_au16DataBuf[7]" UWORD I_1 1 2 0 65535 ECU_ADDRESS 0x70013F8E /end MEASUREMENT
/begin MEASUREMENT PMUX_ePMUX_AN_MUX12 "PMux_au16DataBuf" UWORD I_1 1 2 0 65535 MATRIX_DIM 8 1 1 ECU_ADDRESS 0x70013F90 /end MEASUREMENT
/begin MEASUREMENT PMUX_ePMUX_AN_MUX12[0] "PMux_au16DataBuf[0]" UWORD I_1 1 2 0 65535 ECU_ADDRESS 0x70013F90 /end MEASUREMENT
/begin MEASUREMENT PMUX_ePMUX_AN_MUX12[1] "PMux_au16DataBuf[1]" UWORD I_1 1 2 0 65535 ECU_ADDRESS 0x70013F92 /end MEASUREMENT
/begin MEASUREMENT PMUX_ePMUX_AN_MUX12[2] "PMux_au16DataBuf[2]" UWORD I_1 1 2 0 65535 ECU_ADDRESS 0x70013F94 /end MEASUREMENT
/begin MEASUREMENT PMUX_ePMUX_AN_MUX12[3] "PMux_au16DataBuf[3]" UWORD I_1 1 2 0 65535 ECU_ADDRESS 0x70013F96 /end MEASUREMENT
/begin MEASUREMENT PMUX_ePMUX_AN_MUX12[4] "PMux_au16DataBuf[4]" UWORD I_1 1 2 0 65535 ECU_ADDRESS 0x70013F98 /end MEASUREMENT
/begin MEASUREMENT PMUX_ePMUX_AN_MUX12[5] "PMux_au16DataBuf[5]" UWORD I_1 1 2 0 65535 ECU_ADDRESS 0x70013F9A /end MEASUREMENT
/begin MEASUREMENT PMUX_ePMUX_AN_MUX12[6] "PMux_au16DataBuf[6]" UWORD I_1 1 2 0 65535 ECU_ADDRESS 0x70013F9C /end MEASUREMENT
/begin MEASUREMENT PMUX_ePMUX_AN_MUX12[7] "PMux_au16DataBuf[7]" UWORD I_1 1 2 0 65535 ECU_ADDRESS 0x70013F9E /end MEASUREMENT
/begin MEASUREMENT PMUX_ePMUX_AN_MUX1[0] "PMux_au16DataBuf[0]" UWORD I_1 1 2 0 65535 ECU_ADDRESS 0x70013EE0 /end MEASUREMENT
/begin MEASUREMENT PMUX_ePMUX_AN_MUX1[1] "PMux_au16DataBuf[1]" UWORD I_1 1 2 0 65535 ECU_ADDRESS 0x70013EE2 /end MEASUREMENT
/begin MEASUREMENT PMUX_ePMUX_AN_MUX1[2] "PMux_au16DataBuf[2]" UWORD I_1 1 2 0 65535 ECU_ADDRESS 0x70013EE4 /end MEASUREMENT
/begin MEASUREMENT PMUX_ePMUX_AN_MUX1[3] "PMux_au16DataBuf[3]" UWORD I_1 1 2 0 65535 ECU_ADDRESS 0x70013EE6 /end MEASUREMENT
/begin MEASUREMENT PMUX_ePMUX_AN_MUX1[4] "PMux_au16DataBuf[4]" UWORD I_1 1 2 0 65535 ECU_ADDRESS 0x70013EE8 /end MEASUREMENT
/begin MEASUREMENT PMUX_ePMUX_AN_MUX1[5] "PMux_au16DataBuf[5]" UWORD I_1 1 2 0 65535 ECU_ADDRESS 0x70013EEA /end MEASUREMENT
/begin MEASUREMENT PMUX_ePMUX_AN_MUX1[6] "PMux_au16DataBuf[6]" UWORD I_1 1 2 0 65535 ECU_ADDRESS 0x70013EEC /end MEASUREMENT
/begin MEASUREMENT PMUX_ePMUX_AN_MUX1[7] "PMux_au16DataBuf[7]" UWORD I_1 1 2 0 65535 ECU_ADDRESS 0x70013EEE /end MEASUREMENT
/begin MEASUREMENT PMUX_ePMUX_AN_MUX2 "PMux_au16DataBuf" UWORD I_1 1 2 0 65535 MATRIX_DIM 8 1 1 ECU_ADDRESS 0x70013EF0 /end MEASUREMENT
/begin MEASUREMENT PMUX_ePMUX_AN_MUX2[0] "PMux_au16DataBuf[0]" UWORD I_1 1 2 0 65535 ECU_ADDRESS 0x70013EF0 /end MEASUREMENT
/begin MEASUREMENT PMUX_ePMUX_AN_MUX2[1] "PMux_au16DataBuf[1]" UWORD I_1 1 2 0 65535 ECU_ADDRESS 0x70013EF2 /end MEASUREMENT
/begin MEASUREMENT PMUX_ePMUX_AN_MUX2[2] "PMux_au16DataBuf[2]" UWORD I_1 1 2 0 65535 ECU_ADDRESS 0x70013EF4 /end MEASUREMENT
/begin MEASUREMENT PMUX_ePMUX_AN_MUX2[3] "PMux_au16DataBuf[3]" UWORD I_1 1 2 0 65535 ECU_ADDRESS 0x70013EF6 /end MEASUREMENT
/begin MEASUREMENT PMUX_ePMUX_AN_MUX2[4] "PMux_au16DataBuf[4]" UWORD I_1 1 2 0 65535 ECU_ADDRESS 0x70013EF8 /end MEASUREMENT
/begin MEASUREMENT PMUX_ePMUX_AN_MUX2[5] "PMux_au16DataBuf[5]" UWORD I_1 1 2 0 65535 ECU_ADDRESS 0x70013EFA /end MEASUREMENT
/begin MEASUREMENT PMUX_ePMUX_AN_MUX2[6] "PMux_au16DataBuf[6]" UWORD I_1 1 2 0 65535 ECU_ADDRESS 0x70013EFC /end MEASUREMENT
/begin MEASUREMENT PMUX_ePMUX_AN_MUX2[7] "PMux_au16DataBuf[7]" UWORD I_1 1 2 0 65535 ECU_ADDRESS 0x70013EFE /end MEASUREMENT
/begin MEASUREMENT PMUX_ePMUX_AN_MUX3 "PMux_au16DataBuf" UWORD I_1 1 2 0 65535 MATRIX_DIM 8 1 1 ECU_ADDRESS 0x70013F00 /end MEASUREMENT
/begin MEASUREMENT PMUX_ePMUX_AN_MUX3[0] "PMux_au16DataBuf[0]" UWORD I_1 1 2 0 65535 ECU_ADDRESS 0x70013F00 /end MEASUREMENT
/begin MEASUREMENT PMUX_ePMUX_AN_MUX3[1] "PMux_au16DataBuf[1]" UWORD I_1 1 2 0 65535 ECU_ADDRESS 0x70013F02 /end MEASUREMENT
/begin MEASUREMENT PMUX_ePMUX_AN_MUX3[2] "PMux_au16DataBuf[2]" UWORD I_1 1 2 0 65535 ECU_ADDRESS 0x70013F04 /end MEASUREMENT
/begin MEASUREMENT PMUX_ePMUX_AN_MUX3[3] "PMux_au16DataBuf[3]" UWORD I_1 1 2 0 65535 ECU_ADDRESS 0x70013F06 /end MEASUREMENT
/begin MEASUREMENT PMUX_ePMUX_AN_MUX3[4] "PMux_au16DataBuf[4]" UWORD I_1 1 2 0 65535 ECU_ADDRESS 0x70013F08 /end MEASUREMENT
/begin MEASUREMENT PMUX_ePMUX_AN_MUX3[5] "PMux_au16DataBuf[5]" UWORD I_1 1 2 0 65535 ECU_ADDRESS 0x70013F0A /end MEASUREMENT
/begin MEASUREMENT PMUX_ePMUX_AN_MUX3[6] "PMux_au16DataBuf[6]" UWORD I_1 1 2 0 65535 ECU_ADDRESS 0x70013F0C /end MEASUREMENT
/begin MEASUREMENT PMUX_ePMUX_AN_MUX3[7] "PMux_au16DataBuf[7]" UWORD I_1 1 2 0 65535 ECU_ADDRESS 0x70013F0E /end MEASUREMENT
/begin MEASUREMENT PMUX_ePMUX_AN_MUX4 "PMux_au16DataBuf" UWORD I_1 1 2 0 65535 MATRIX_DIM 8 1 1 ECU_ADDRESS 0x70013F10 /end MEASUREMENT
/begin MEASUREMENT PMUX_ePMUX_AN_MUX4[0] "PMux_au16DataBuf[0]" UWORD I_1 1 2 0 65535 ECU_ADDRESS 0x70013F10 /end MEASUREMENT
/begin MEASUREMENT PMUX_ePMUX_AN_MUX4[1] "PMux_au16DataBuf[1]" UWORD I_1 1 2 0 65535 ECU_ADDRESS 0x70013F12 /end MEASUREMENT
/begin MEASUREMENT PMUX_ePMUX_AN_MUX4[2] "PMux_au16DataBuf[2]" UWORD I_1 1 2 0 65535 ECU_ADDRESS 0x70013F14 /end MEASUREMENT
/begin MEASUREMENT PMUX_ePMUX_AN_MUX4[3] "PMux_au16DataBuf[3]" UWORD I_1 1 2 0 65535 ECU_ADDRESS 0x70013F16 /end MEASUREMENT
/begin MEASUREMENT PMUX_ePMUX_AN_MUX4[4] "PMux_au16DataBuf[4]" UWORD I_1 1 2 0 65535 ECU_ADDRESS 0x70013F18 /end MEASUREMENT
/begin MEASUREMENT PMUX_ePMUX_AN_MUX4[5] "PMux_au16DataBuf[5]" UWORD I_1 1 2 0 65535 ECU_ADDRESS 0x70013F1A /end MEASUREMENT
/begin MEASUREMENT PMUX_ePMUX_AN_MUX4[6] "PMux_au16DataBuf[6]" UWORD I_1 1 2 0 65535 ECU_ADDRESS 0x70013F1C /end MEASUREMENT
/begin MEASUREMENT PMUX_ePMUX_AN_MUX4[7] "PMux_au16DataBuf[7]" UWORD I_1 1 2 0 65535 ECU_ADDRESS 0x70013F1E /end MEASUREMENT
/begin MEASUREMENT PMUX_ePMUX_AN_MUX5 "PMux_au16DataBuf" UWORD I_1 1 2 0 65535 MATRIX_DIM 8 1 1 ECU_ADDRESS 0x70013F20 /end MEASUREMENT
/begin MEASUREMENT PMUX_ePMUX_AN_MUX5[0] "PMux_au16DataBuf[0]" UWORD I_1 1 2 0 65535 ECU_ADDRESS 0x70013F20 /end MEASUREMENT
/begin MEASUREMENT PMUX_ePMUX_AN_MUX5[1] "PMux_au16DataBuf[1]" UWORD I_1 1 2 0 65535 ECU_ADDRESS 0x70013F22 /end MEASUREMENT
/begin MEASUREMENT PMUX_ePMUX_AN_MUX5[2] "PMux_au16DataBuf[2]" UWORD I_1 1 2 0 65535 ECU_ADDRESS 0x70013F24 /end MEASUREMENT
/begin MEASUREMENT PMUX_ePMUX_AN_MUX5[3] "PMux_au16DataBuf[3]" UWORD I_1 1 2 0 65535 ECU_ADDRESS 0x70013F26 /end MEASUREMENT
/begin MEASUREMENT PMUX_ePMUX_AN_MUX5[4] "PMux_au16DataBuf[4]" UWORD I_1 1 2 0 65535 ECU_ADDRESS 0x70013F28 /end MEASUREMENT
/begin MEASUREMENT PMUX_ePMUX_AN_MUX5[5] "PMux_au16DataBuf[5]" UWORD I_1 1 2 0 65535 ECU_ADDRESS 0x70013F2A /end MEASUREMENT
/begin MEASUREMENT PMUX_ePMUX_AN_MUX5[6] "PMux_au16DataBuf[6]" UWORD I_1 1 2 0 65535 ECU_ADDRESS 0x70013F2C /end MEASUREMENT
/begin MEASUREMENT PMUX_ePMUX_AN_MUX5[7] "PMux_au16DataBuf[7]" UWORD I_1 1 2 0 65535 ECU_ADDRESS 0x70013F2E /end MEASUREMENT
/begin MEASUREMENT PMUX_ePMUX_AN_MUX6 "PMux_au16DataBuf" UWORD I_1 1 2 0 65535 MATRIX_DIM 8 1 1 ECU_ADDRESS 0x70013F30 /end MEASUREMENT
/begin MEASUREMENT PMUX_ePMUX_AN_MUX6[0] "PMux_au16DataBuf[0]" UWORD I_1 1 2 0 65535 ECU_ADDRESS 0x70013F30 /end MEASUREMENT
/begin MEASUREMENT PMUX_ePMUX_AN_MUX6[1] "PMux_au16DataBuf[1]" UWORD I_1 1 2 0 65535 ECU_ADDRESS 0x70013F32 /end MEASUREMENT
/begin MEASUREMENT PMUX_ePMUX_AN_MUX6[2] "PMux_au16DataBuf[2]" UWORD I_1 1 2 0 65535 ECU_ADDRESS 0x70013F34 /end MEASUREMENT
/begin MEASUREMENT PMUX_ePMUX_AN_MUX6[3] "PMux_au16DataBuf[3]" UWORD I_1 1 2 0 65535 ECU_ADDRESS 0x70013F36 /end MEASUREMENT
/begin MEASUREMENT PMUX_ePMUX_AN_MUX6[4] "PMux_au16DataBuf[4]" UWORD I_1 1 2 0 65535 ECU_ADDRESS 0x70013F38 /end MEASUREMENT
/begin MEASUREMENT PMUX_ePMUX_AN_MUX6[5] "PMux_au16DataBuf[5]" UWORD I_1 1 2 0 65535 ECU_ADDRESS 0x70013F3A /end MEASUREMENT
/begin MEASUREMENT PMUX_ePMUX_AN_MUX6[6] "PMux_au16DataBuf[6]" UWORD I_1 1 2 0 65535 ECU_ADDRESS 0x70013F3C /end MEASUREMENT
/begin MEASUREMENT PMUX_ePMUX_AN_MUX6[7] "PMux_au16DataBuf[7]" UWORD I_1 1 2 0 65535 ECU_ADDRESS 0x70013F3E /end MEASUREMENT
/begin MEASUREMENT PMUX_ePMUX_AN_MUX7 "PMux_au16DataBuf" UWORD I_1 1 2 0 65535 MATRIX_DIM 8 1 1 ECU_ADDRESS 0x70013F40 /end MEASUREMENT
/begin MEASUREMENT PMUX_ePMUX_AN_MUX7[0] "PMux_au16DataBuf[0]" UWORD I_1 1 2 0 65535 ECU_ADDRESS 0x70013F40 /end MEASUREMENT
/begin MEASUREMENT PMUX_ePMUX_AN_MUX7[1] "PMux_au16DataBuf[1]" UWORD I_1 1 2 0 65535 ECU_ADDRESS 0x70013F42 /end MEASUREMENT
/begin MEASUREMENT PMUX_ePMUX_AN_MUX7[2] "PMux_au16DataBuf[2]" UWORD I_1 1 2 0 65535 ECU_ADDRESS 0x70013F44 /end MEASUREMENT
/begin MEASUREMENT PMUX_ePMUX_AN_MUX7[3] "PMux_au16DataBuf[3]" UWORD I_1 1 2 0 65535 ECU_ADDRESS 0x70013F46 /end MEASUREMENT
/begin MEASUREMENT PMUX_ePMUX_AN_MUX7[4] "PMux_au16DataBuf[4]" UWORD I_1 1 2 0 65535 ECU_ADDRESS 0x70013F48 /end MEASUREMENT
/begin MEASUREMENT PMUX_ePMUX_AN_MUX7[5] "PMux_au16DataBuf[5]" UWORD I_1 1 2 0 65535 ECU_ADDRESS 0x70013F4A /end MEASUREMENT
/begin MEASUREMENT PMUX_ePMUX_AN_MUX7[6] "PMux_au16DataBuf[6]" UWORD I_1 1 2 0 65535 ECU_ADDRESS 0x70013F4C /end MEASUREMENT
/begin MEASUREMENT PMUX_ePMUX_AN_MUX7[7] "PMux_au16DataBuf[7]" UWORD I_1 1 2 0 65535 ECU_ADDRESS 0x70013F4E /end MEASUREMENT
/begin MEASUREMENT PMUX_ePMUX_AN_MUX8 "PMux_au16DataBuf" UWORD I_1 1 2 0 65535 MATRIX_DIM 8 1 1 ECU_ADDRESS 0x70013F50 /end MEASUREMENT
/begin MEASUREMENT PMUX_ePMUX_AN_MUX8[0] "PMux_au16DataBuf[0]" UWORD I_1 1 2 0 65535 ECU_ADDRESS 0x70013F50 /end MEASUREMENT
/begin MEASUREMENT PMUX_ePMUX_AN_MUX8[1] "PMux_au16DataBuf[1]" UWORD I_1 1 2 0 65535 ECU_ADDRESS 0x70013F52 /end MEASUREMENT
/begin MEASUREMENT PMUX_ePMUX_AN_MUX8[2] "PMux_au16DataBuf[2]" UWORD I_1 1 2 0 65535 ECU_ADDRESS 0x70013F54 /end MEASUREMENT
/begin MEASUREMENT PMUX_ePMUX_AN_MUX8[3] "PMux_au16DataBuf[3]" UWORD I_1 1 2 0 65535 ECU_ADDRESS 0x70013F56 /end MEASUREMENT
/begin MEASUREMENT PMUX_ePMUX_AN_MUX8[4] "PMux_au16DataBuf[4]" UWORD I_1 1 2 0 65535 ECU_ADDRESS 0x70013F58 /end MEASUREMENT
/begin MEASUREMENT PMUX_ePMUX_AN_MUX8[5] "PMux_au16DataBuf[5]" UWORD I_1 1 2 0 65535 ECU_ADDRESS 0x70013F5A /end MEASUREMENT
/begin MEASUREMENT PMUX_ePMUX_AN_MUX8[6] "PMux_au16DataBuf[6]" UWORD I_1 1 2 0 65535 ECU_ADDRESS 0x70013F5C /end MEASUREMENT
/begin MEASUREMENT PMUX_ePMUX_AN_MUX8[7] "PMux_au16DataBuf[7]" UWORD I_1 1 2 0 65535 ECU_ADDRESS 0x70013F5E /end MEASUREMENT
/begin MEASUREMENT PMUX_ePMUX_AN_MUX9 "PMux_au16DataBuf" UWORD I_1 1 2 0 65535 MATRIX_DIM 8 1 1 ECU_ADDRESS 0x70013F60 /end MEASUREMENT
/begin MEASUREMENT PMUX_ePMUX_AN_MUX9[0] "PMux_au16DataBuf[0]" UWORD I_1 1 2 0 65535 ECU_ADDRESS 0x70013F60 /end MEASUREMENT
/begin MEASUREMENT PMUX_ePMUX_AN_MUX9[1] "PMux_au16DataBuf[1]" UWORD I_1 1 2 0 65535 ECU_ADDRESS 0x70013F62 /end MEASUREMENT
/begin MEASUREMENT PMUX_ePMUX_AN_MUX9[2] "PMux_au16DataBuf[2]" UWORD I_1 1 2 0 65535 ECU_ADDRESS 0x70013F64 /end MEASUREMENT
/begin MEASUREMENT PMUX_ePMUX_AN_MUX9[3] "PMux_au16DataBuf[3]" UWORD I_1 1 2 0 65535 ECU_ADDRESS 0x70013F66 /end MEASUREMENT
/begin MEASUREMENT PMUX_ePMUX_AN_MUX9[4] "PMux_au16DataBuf[4]" UWORD I_1 1 2 0 65535 ECU_ADDRESS 0x70013F68 /end MEASUREMENT
/begin MEASUREMENT PMUX_ePMUX_AN_MUX9[5] "PMux_au16DataBuf[5]" UWORD I_1 1 2 0 65535 ECU_ADDRESS 0x70013F6A /end MEASUREMENT
/begin MEASUREMENT PMUX_ePMUX_AN_MUX9[6] "PMux_au16DataBuf[6]" UWORD I_1 1 2 0 65535 ECU_ADDRESS 0x70013F6C /end MEASUREMENT
/begin MEASUREMENT PMUX_ePMUX_AN_MUX9[7] "PMux_au16DataBuf[7]" UWORD I_1 1 2 0 65535 ECU_ADDRESS 0x70013F6E /end MEASUREMENT
/begin MEASUREMENT PMUX_ePMUX_DIO_MUX1 "PMux_au16DataBuf" UWORD I_1 1 2 0 65535 MATRIX_DIM 8 1 1 ECU_ADDRESS 0x70013EB0 /end MEASUREMENT
/begin MEASUREMENT PMUX_ePMUX_DIO_MUX1[0] "PMux_au16DataBuf[0]" UWORD I_1 1 2 0 65535 ECU_ADDRESS 0x70013EB0 /end MEASUREMENT
/begin MEASUREMENT PMUX_ePMUX_DIO_MUX1[1] "PMux_au16DataBuf[1]" UWORD I_1 1 2 0 65535 ECU_ADDRESS 0x70013EB2 /end MEASUREMENT
/begin MEASUREMENT PMUX_ePMUX_DIO_MUX1[2] "PMux_au16DataBuf[2]" UWORD I_1 1 2 0 65535 ECU_ADDRESS 0x70013EB4 /end MEASUREMENT
/begin MEASUREMENT PMUX_ePMUX_DIO_MUX1[3] "PMux_au16DataBuf[3]" UWORD I_1 1 2 0 65535 ECU_ADDRESS 0x70013EB6 /end MEASUREMENT
/begin MEASUREMENT PMUX_ePMUX_DIO_MUX1[4] "PMux_au16DataBuf[4]" UWORD I_1 1 2 0 65535 ECU_ADDRESS 0x70013EB8 /end MEASUREMENT
/begin MEASUREMENT PMUX_ePMUX_DIO_MUX1[5] "PMux_au16DataBuf[5]" UWORD I_1 1 2 0 65535 ECU_ADDRESS 0x70013EBA /end MEASUREMENT
/begin MEASUREMENT PMUX_ePMUX_DIO_MUX1[6] "PMux_au16DataBuf[6]" UWORD I_1 1 2 0 65535 ECU_ADDRESS 0x70013EBC /end MEASUREMENT
/begin MEASUREMENT PMUX_ePMUX_DIO_MUX1[7] "PMux_au16DataBuf[7]" UWORD I_1 1 2 0 65535 ECU_ADDRESS 0x70013EBE /end MEASUREMENT
/begin MEASUREMENT PMUX_ePMUX_DIO_MUX2 "PMux_au16DataBuf" UWORD I_1 1 2 0 65535 MATRIX_DIM 8 1 1 ECU_ADDRESS 0x70013EC0 /end MEASUREMENT
/begin MEASUREMENT PMUX_ePMUX_DIO_MUX2[0] "PMux_au16DataBuf[0]" UWORD I_1 1 2 0 65535 ECU_ADDRESS 0x70013EC0 /end MEASUREMENT
/begin MEASUREMENT PMUX_ePMUX_DIO_MUX2[1] "PMux_au16DataBuf[1]" UWORD I_1 1 2 0 65535 ECU_ADDRESS 0x70013EC2 /end MEASUREMENT
/begin MEASUREMENT PMUX_ePMUX_DIO_MUX2[2] "PMux_au16DataBuf[2]" UWORD I_1 1 2 0 65535 ECU_ADDRESS 0x70013EC4 /end MEASUREMENT
/begin MEASUREMENT PMUX_ePMUX_DIO_MUX2[3] "PMux_au16DataBuf[3]" UWORD I_1 1 2 0 65535 ECU_ADDRESS 0x70013EC6 /end MEASUREMENT
/begin MEASUREMENT PMUX_ePMUX_DIO_MUX2[4] "PMux_au16DataBuf[4]" UWORD I_1 1 2 0 65535 ECU_ADDRESS 0x70013EC8 /end MEASUREMENT
/begin MEASUREMENT PMUX_ePMUX_DIO_MUX2[5] "PMux_au16DataBuf[5]" UWORD I_1 1 2 0 65535 ECU_ADDRESS 0x70013ECA /end MEASUREMENT
/begin MEASUREMENT PMUX_ePMUX_DIO_MUX2[6] "PMux_au16DataBuf[6]" UWORD I_1 1 2 0 65535 ECU_ADDRESS 0x70013ECC /end MEASUREMENT
/begin MEASUREMENT PMUX_ePMUX_DIO_MUX2[7] "PMux_au16DataBuf[7]" UWORD I_1 1 2 0 65535 ECU_ADDRESS 0x70013ECE /end MEASUREMENT
/begin MEASUREMENT PMUX_ePMUX_DIO_MUX3 "PMux_au16DataBuf" UWORD I_1 1 2 0 65535 MATRIX_DIM 8 1 1 ECU_ADDRESS 0x70013ED0 /end MEASUREMENT
/begin MEASUREMENT PMUX_ePMUX_DIO_MUX3[0] "PMux_au16DataBuf[0]" UWORD I_1 1 2 0 65535 ECU_ADDRESS 0x70013ED0 /end MEASUREMENT
/begin MEASUREMENT PMUX_ePMUX_DIO_MUX3[1] "PMux_au16DataBuf[1]" UWORD I_1 1 2 0 65535 ECU_ADDRESS 0x70013ED2 /end MEASUREMENT
/begin MEASUREMENT PMUX_ePMUX_DIO_MUX3[2] "PMux_au16DataBuf[2]" UWORD I_1 1 2 0 65535 ECU_ADDRESS 0x70013ED4 /end MEASUREMENT
/begin MEASUREMENT PMUX_ePMUX_DIO_MUX3[3] "PMux_au16DataBuf[3]" UWORD I_1 1 2 0 65535 ECU_ADDRESS 0x70013ED6 /end MEASUREMENT
/begin MEASUREMENT PMUX_ePMUX_DIO_MUX3[4] "PMux_au16DataBuf[4]" UWORD I_1 1 2 0 65535 ECU_ADDRESS 0x70013ED8 /end MEASUREMENT
/begin MEASUREMENT PMUX_ePMUX_DIO_MUX3[5] "PMux_au16DataBuf[5]" UWORD I_1 1 2 0 65535 ECU_ADDRESS 0x70013EDA /end MEASUREMENT
/begin MEASUREMENT PMUX_ePMUX_DIO_MUX3[6] "PMux_au16DataBuf[6]" UWORD I_1 1 2 0 65535 ECU_ADDRESS 0x70013EDC /end MEASUREMENT
/begin MEASUREMENT PMUX_ePMUX_DIO_MUX3[7] "PMux_au16DataBuf[7]" UWORD I_1 1 2 0 65535 ECU_ADDRESS 0x70013EDE /end MEASUREMENT
/begin MEASUREMENT PMux_au8AddrSet "PMux_au8AddrSet" UBYTE I_1 1 2 0 255 MATRIX_DIM 15 1 1 ECU_ADDRESS 0x70013FA0 /end MEASUREMENT
/begin MEASUREMENT PMux_au8AddrSet[0] "PMux_au8AddrSet[0]" UBYTE I_1 1 2 0 255 ECU_ADDRESS 0x70013FA0 /end MEASUREMENT
/begin MEASUREMENT PMux_au8AddrSet[10] "PMux_au8AddrSet[10]" UBYTE I_1 1 2 0 255 ECU_ADDRESS 0x70013FAA /end MEASUREMENT
/begin MEASUREMENT PMux_au8AddrSet[11] "PMux_au8AddrSet[11]" UBYTE I_1 1 2 0 255 ECU_ADDRESS 0x70013FAB /end MEASUREMENT
/begin MEASUREMENT PMux_au8AddrSet[12] "PMux_au8AddrSet[12]" UBYTE I_1 1 2 0 255 ECU_ADDRESS 0x70013FAC /end MEASUREMENT
/begin MEASUREMENT PMux_au8AddrSet[13] "PMux_au8AddrSet[13]" UBYTE I_1 1 2 0 255 ECU_ADDRESS 0x70013FAD /end MEASUREMENT
/begin MEASUREMENT PMux_au8AddrSet[14] "PMux_au8AddrSet[14]" UBYTE I_1 1 2 0 255 ECU_ADDRESS 0x70013FAE /end MEASUREMENT
/begin MEASUREMENT PMux_au8AddrSet[1] "PMux_au8AddrSet[1]" UBYTE I_1 1 2 0 255 ECU_ADDRESS 0x70013FA1 /end MEASUREMENT
/begin MEASUREMENT PMux_au8AddrSet[2] "PMux_au8AddrSet[2]" UBYTE I_1 1 2 0 255 ECU_ADDRESS 0x70013FA2 /end MEASUREMENT
/begin MEASUREMENT PMux_au8AddrSet[3] "PMux_au8AddrSet[3]" UBYTE I_1 1 2 0 255 ECU_ADDRESS 0x70013FA3 /end MEASUREMENT
/begin MEASUREMENT PMux_au8AddrSet[4] "PMux_au8AddrSet[4]" UBYTE I_1 1 2 0 255 ECU_ADDRESS 0x70013FA4 /end MEASUREMENT
/begin MEASUREMENT PMux_au8AddrSet[5] "PMux_au8AddrSet[5]" UBYTE I_1 1 2 0 255 ECU_ADDRESS 0x70013FA5 /end MEASUREMENT
/begin MEASUREMENT PMux_au8AddrSet[6] "PMux_au8AddrSet[6]" UBYTE I_1 1 2 0 255 ECU_ADDRESS 0x70013FA6 /end MEASUREMENT
/begin MEASUREMENT PMux_au8AddrSet[7] "PMux_au8AddrSet[7]" UBYTE I_1 1 2 0 255 ECU_ADDRESS 0x70013FA7 /end MEASUREMENT
/begin MEASUREMENT PMux_au8AddrSet[8] "PMux_au8AddrSet[8]" UBYTE I_1 1 2 0 255 ECU_ADDRESS 0x70013FA8 /end MEASUREMENT
/begin MEASUREMENT PMux_au8AddrSet[9] "PMux_au8AddrSet[9]" UBYTE I_1 1 2 0 255 ECU_ADDRESS 0x70013FA9 /end MEASUREMENT
/begin MEASUREMENT RC_au16VoltageGain "-" UWORD F_1_p0_2 1 2 0 65535 MATRIX_DIM 25 1 1 ECU_ADDRESS 0x700200BE /end MEASUREMENT
/begin MEASUREMENT RC_au16VoltageGain[0] "RC_au16VoltageGain[0]" UWORD F_1_p0_2 1 2 0 65535 ECU_ADDRESS 0x700200BE /end MEASUREMENT
/begin MEASUREMENT RC_au16VoltageGain[10] "RC_au16VoltageGain[10]" UWORD F_1_p0_2 1 2 0 65535 ECU_ADDRESS 0x700200D2 /end MEASUREMENT
/begin MEASUREMENT RC_au16VoltageGain[11] "RC_au16VoltageGain[11]" UWORD F_1_p0_2 1 2 0 65535 ECU_ADDRESS 0x700200D4 /end MEASUREMENT
/begin MEASUREMENT RC_au16VoltageGain[12] "RC_au16VoltageGain[12]" UWORD F_1_p0_2 1 2 0 65535 ECU_ADDRESS 0x700200D6 /end MEASUREMENT
/begin MEASUREMENT RC_au16VoltageGain[13] "RC_au16VoltageGain[13]" UWORD F_1_p0_2 1 2 0 65535 ECU_ADDRESS 0x700200D8 /end MEASUREMENT
/begin MEASUREMENT RC_au16VoltageGain[14] "RC_au16VoltageGain[14]" UWORD F_1_p0_2 1 2 0 65535 ECU_ADDRESS 0x700200DA /end MEASUREMENT
/begin MEASUREMENT RC_au16VoltageGain[15] "RC_au16VoltageGain[15]" UWORD F_1_p0_2 1 2 0 65535 ECU_ADDRESS 0x700200DC /end MEASUREMENT
/begin MEASUREMENT RC_au16VoltageGain[16] "RC_au16VoltageGain[16]" UWORD F_1_p0_2 1 2 0 65535 ECU_ADDRESS 0x700200DE /end MEASUREMENT
/begin MEASUREMENT RC_au16VoltageGain[17] "RC_au16VoltageGain[17]" UWORD F_1_p0_2 1 2 0 65535 ECU_ADDRESS 0x700200E0 /end MEASUREMENT
/begin MEASUREMENT RC_au16VoltageGain[18] "RC_au16VoltageGain[18]" UWORD F_1_p0_2 1 2 0 65535 ECU_ADDRESS 0x700200E2 /end MEASUREMENT
/begin MEASUREMENT RC_au16VoltageGain[19] "RC_au16VoltageGain[19]" UWORD F_1_p0_2 1 2 0 65535 ECU_ADDRESS 0x700200E4 /end MEASUREMENT
/begin MEASUREMENT RC_au16VoltageGain[1] "RC_au16VoltageGain[1]" UWORD F_1_p0_2 1 2 0 65535 ECU_ADDRESS 0x700200C0 /end MEASUREMENT
/begin MEASUREMENT RC_au16VoltageGain[20] "RC_au16VoltageGain[20]" UWORD F_1_p0_2 1 2 0 65535 ECU_ADDRESS 0x700200E6 /end MEASUREMENT
/begin MEASUREMENT RC_au16VoltageGain[21] "RC_au16VoltageGain[21]" UWORD F_1_p0_2 1 2 0 65535 ECU_ADDRESS 0x700200E8 /end MEASUREMENT
/begin MEASUREMENT RC_au16VoltageGain[22] "RC_au16VoltageGain[22]" UWORD F_1_p0_2 1 2 0 65535 ECU_ADDRESS 0x700200EA /end MEASUREMENT
/begin MEASUREMENT RC_au16VoltageGain[23] "RC_au16VoltageGain[23]" UWORD F_1_p0_2 1 2 0 65535 ECU_ADDRESS 0x700200EC /end MEASUREMENT
/begin MEASUREMENT RC_au16VoltageGain[24] "RC_au16VoltageGain[24]" UWORD F_1_p0_2 1 2 0 65535 ECU_ADDRESS 0x700200EE /end MEASUREMENT
/begin MEASUREMENT RC_au16VoltageGain[2] "RC_au16VoltageGain[2]" UWORD F_1_p0_2 1 2 0 65535 ECU_ADDRESS 0x700200C2 /end MEASUREMENT
/begin MEASUREMENT RC_au16VoltageGain[3] "RC_au16VoltageGain[3]" UWORD F_1_p0_2 1 2 0 65535 ECU_ADDRESS 0x700200C4 /end MEASUREMENT
/begin MEASUREMENT RC_au16VoltageGain[4] "RC_au16VoltageGain[4]" UWORD F_1_p0_2 1 2 0 65535 ECU_ADDRESS 0x700200C6 /end MEASUREMENT
/begin MEASUREMENT RC_au16VoltageGain[5] "RC_au16VoltageGain[5]" UWORD F_1_p0_2 1 2 0 65535 ECU_ADDRESS 0x700200C8 /end MEASUREMENT
/begin MEASUREMENT RC_au16VoltageGain[6] "RC_au16VoltageGain[6]" UWORD F_1_p0_2 1 2 0 65535 ECU_ADDRESS 0x700200CA /end MEASUREMENT
/begin MEASUREMENT RC_au16VoltageGain[7] "RC_au16VoltageGain[7]" UWORD F_1_p0_2 1 2 0 65535 ECU_ADDRESS 0x700200CC /end MEASUREMENT
/begin MEASUREMENT RC_au16VoltageGain[8] "RC_au16VoltageGain[8]" UWORD F_1_p0_2 1 2 0 65535 ECU_ADDRESS 0x700200CE /end MEASUREMENT
/begin MEASUREMENT RC_au16VoltageGain[9] "RC_au16VoltageGain[9]" UWORD F_1_p0_2 1 2 0 65535 ECU_ADDRESS 0x700200D0 /end MEASUREMENT
/begin COMPU_METHOD I_1 "" RAT_FUNC "%9.2" "-" COEFFS 0 1 0 0 0 1 /end COMPU_METHOD
/begin COMPU_METHOD F_1_p0_2 "" RAT_FUNC "%9.2" "-" COEFFS 0 1 0 0 0 1 /end COMPU_METHOD
/begin COMPU_METHOD F_100_p0_3 "" RAT_FUNC "%9.2" "%" COEFFS 0 1 0 0 0 100 /end COMPU_METHOD
/begin COMPU_METHOD F_0v04_p1_5 "" RAT_FUNC "%9.2" "-" COEFFS 0 1 -1 0 0 0.04 /end COMPU_METHOD
/begin COMPU_METHOD F_1_p0_8 "" RAT_FUNC "%9.2" "RPM" COEFFS 0 1 0 0 0 1 /end COMPU_METHOD
/begin COMPU_METHOD F_1_p0_14 "" RAT_FUNC "%9.2" "Hz" COEFFS 0 1 0 0 0 1 /end COMPU_METHOD
/begin COMPU_METHOD F_1_p0_15 "" RAT_FUNC "%9.2" "s" COEFFS 0 1 0 0 0 1 /end COMPU_METHOD
/begin COMPU_METHOD F_1_p0_16 "" RAT_FUNC "%9.2" "A" COEFFS 0 1 0 0 0 1 /end COMPU_METHOD
/begin COMPU_METHOD F_1000000_p0_17 "" RAT_FUNC "%9.2" "us" COEFFS 0 1 0 0 0 1e+006 /end COMPU_METHOD
/begin COMPU_METHOD F_0v1_p0_18 "" RAT_FUNC "%9.2" "ï¿½s" COEFFS 0 1 0 0 0 0.1 /end COMPU_METHOD
/begin COMPU_METHOD F_0v02_p0_24 "" RAT_FUNC "%9.2" "ï¿½s" COEFFS 0 1 0 0 0 0.02 /end COMPU_METHOD
/begin COMPU_METHOD Id_0x00 "" RAT_FUNC "%9.2" "." COEFFS 0 1 0 0 0 1 /end COMPU_METHOD
/begin COMPU_METHOD Bool_ON_OFF "" TAB_VERB "%8.4" "." COMPU_TAB_REF Bool_ON_OFF_table /end COMPU_METHOD
/begin COMPU_VTAB Bool_ON_OFF_table "" TAB_VERB 2 0 "OFF" 1 "ON" /end COMPU_VTAB
/begin FUNCTION MAIN ""
 /begin DEF_CHARACTERISTIC BSW_ku16CCPReinitTriggerC GMAIN_f32UvwOvCurrThdC GMAIN_HARDBenchOnC GMAIN_s32CurHardDelayC GMAIN_s32ResHardDelayC GMAIN_s32SampleDelayC GMAIN_u16OverBhvThdC GMAIN_u32VSICntCkreqESMStartedC GMAIN_u32VSICntCkreqVSIStartedC GMAIN_VSIBenchOnWriteDataC MAIN_b800VsersionSelcetEnC MAIN_bMSGRxToutBenchOnC MAIN_f32PowerdownVoltC MAIN_f32UvwOvCurrThdC MAIN_HARDBenchOnC MAIN_ku16SpdReadyEstConfirmC MAIN_MFC_bCanAEnaC MAIN_MFC_bCanBEnaC MAIN_MFC_bCanCEnaC MAIN_MFC_bCanDEnaC MAIN_MFC_bCanEEnaC MAIN_MFC_bCanFEnaC MAIN_MFC_bDcAcEnaC MAIN_MFC_bTestEnaC MAIN_MFC_u8TempSensorCfgC_ACM MAIN_MFC_u8TempSensorCfgC_EPS MAIN_MFC_u8TempSensorCfgC_MCU1 MAIN_MFC_u8TempSensorCfgC_MCU2 MAIN_MSGbIsulationTxOnC MAIN_MSGRxBenchOnC MAIN_MSGu8PwModFiltCntC MAIN_s32CurHardDelayC MAIN_s32ResHardDelayC MAIN_s32SampleDelayC MAIN_u16OverBhvThdC MAIN_u32VSICntCkreqESMStartedC MAIN_u32VSICntCkreqVSIStartedC MAIN_u8TcuCapPreDrvTypeC MAIN_VSIBenchOnWriteDataC SBC_bServiceDisableC SBC_f32RecoverThresholdC SBC_f32UnderVolHighThresholdC SBC_f32UnderVolLowThresholdC /end DEF_CHARACTERISTIC
 /begin OUT_MEASUREMENT ADCTotalTime ASWNM_bFullComSts ASWNM_u8CurrentState ASWNM_u8CurrentState[0] ASWNM_u8CurrentState[10] ASWNM_u8CurrentState[11] ASWNM_u8CurrentState[12] ASWNM_u8CurrentState[13] ASWNM_u8CurrentState[14] ASWNM_u8CurrentState[15] ASWNM_u8CurrentState[16] ASWNM_u8CurrentState[17] ASWNM_u8CurrentState[18] ASWNM_u8CurrentState[19] ASWNM_u8CurrentState[1] ASWNM_u8CurrentState[20] ASWNM_u8CurrentState[2] ASWNM_u8CurrentState[3] ASWNM_u8CurrentState[4] ASWNM_u8CurrentState[5] ASWNM_u8CurrentState[6] ASWNM_u8CurrentState[7] ASWNM_u8CurrentState[8] ASWNM_u8CurrentState[9] BSW_kau8IntBswLibDate[0] BSW_kau8IntBswLibDate[1] BSW_kau8IntBswLibDate[2] BSW_kau8IntBswLibDate[3] BSW_kau8IntBswLibDate[4] BSW_kau8IntBswLibDate[5] BSW_kau8IntProjectId[0] BSW_kau8IntProjectId[1] BSW_kau8IntProjectId[2] BSW_kau8IntProjectId[3] BSW_kau8IntProjectId[4] BSW_kau8IntProjectId[5] BSW_kau8IntProjectId[6] BSW_kau8IntProjectId[7] Calibration_debut Core0_MaxUserStackUtilization Core1_MaxUserStackUtilization Core2_MaxUserStackUtilization CPU0_MaximumUtilization CPU0_PercentUtilization CPU1_MaximumUtilization CPU1_PercentUtilization CPU2_MaximumUtilization CPU2_PercentUtilization CPU3_MaximumUtilization CPU3_PercentUtilization GMAIN_as32OCTrimNvm GMAIN_as32OCTrimNvm[0] GMAIN_as32OCTrimNvm[1] GMAIN_as32OCTrimNvm[2] GMAIN_as32OCTrimNvm[3] GMAIN_as32OCTrimNvm[4] GMAIN_bAscFlag GMAIN_bBswReadySts GMAIN_bESMStarted GMAIN_bOcFailureFlg GMAIN_bOcFinshFlg GMAIN_bOcModeEna GMAIN_bOcNotRatFlg GMAIN_bOcRdResultFlag GMAIN_bOcStartFlag GMAIN_bOCStoreAswReq GMAIN_bProgConditionOk GMAIN_bResExcFltDetEna GMAIN_bSoftOvBhvFlg GMAIN_bSoftOvCurrPhsUFlg GMAIN_bSoftOvCurrPhsVFlg GMAIN_bSoftOvCurrPhsWFlg GMAIN_bSpdReadyEst GMAIN_bSpeedReadyFlg GMAIN_bVSIStarted GMAIN_ESMGo2StartupIEvent GMAIN_f32ElecSpeedRds GMAIN_f32EmailElecSpeedRds GMAIN_f32EmailErrThetaRdSurPi GMAIN_f32EmailMecaSpeedRds GMAIN_f32EmailMecaSpeedRpm GMAIN_f32EmailThetaElecRdSurPi GMAIN_f32ErrThetaRdSurPi GMAIN_f32IuFrequency GMAIN_f32IuPeriod GMAIN_f32MecaSpeedRds GMAIN_f32MecaSpeedRpm GMAIN_f32MotSpdEst GMAIN_f32PWMDutyUPhys GMAIN_f32PWMDutyVPhys GMAIN_f32PWMDutyWPhys GMAIN_f32ThetaElecRdSurPi GMAIN_f32VsiPwmPeriod GMAIN_s32Email2PosTreqDiff GMAIN_s32PosA2BDeltTime GMAIN_TotalTime GMAIN_u16IuCycleCnt GMAIN_u16IuMiddleCnt GMAIN_u16IuMiddleSum GMAIN_u16IuNegtiveCnt GMAIN_u16IuNegtiveSum GMAIN_u16IuPositiveCnt GMAIN_u16IuPositiveSum GMAIN_u16PWMPeriodVal GMAIN_u16SpdReadyEstCnt GMAIN_u16VadcBhv GMAIN_u32EmailCkreq GMAIN_u32EmailPosATimeStamp GMAIN_u32IuCycleTim GMAIN_u32PosATimeStamp GMAIN_u32PosBTimeStamp GMAIN_u32PosTreatCkreq GMAIN_u32TestVar2 GMAIN_u8DEV_Fault GMAIN_u8DEV_Fault[0] GMAIN_u8DEV_Fault[10] GMAIN_u8DEV_Fault[11] GMAIN_u8DEV_Fault[12] GMAIN_u8DEV_Fault[13] GMAIN_u8DEV_Fault[14] GMAIN_u8DEV_Fault[15] GMAIN_u8DEV_Fault[1] GMAIN_u8DEV_Fault[2] GMAIN_u8DEV_Fault[3] GMAIN_u8DEV_Fault[4] GMAIN_u8DEV_Fault[5] GMAIN_u8DEV_Fault[6] GMAIN_u8DEV_Fault[7] GMAIN_u8DEV_Fault[8] GMAIN_u8DEV_Fault[9] GMAIN_u8OcState GMAIN_u8OcStsRptDelayCnt GMAIN_u8OfsAlCalSts GMAIN_u8TrigOcByUser HARD_bDioWriteTestEna MAIN_as32OCTrimNvm MAIN_as32OCTrimNvm[0] MAIN_as32OCTrimNvm[1] MAIN_as32OCTrimNvm[2] MAIN_as32OCTrimNvm[3] MAIN_as32OCTrimNvm[4] MAIN_au16CalibParamNvm MAIN_au16CalibParamNvm[0][0] MAIN_au16CalibParamNvm[0][10] MAIN_au16CalibParamNvm[0][11] MAIN_au16CalibParamNvm[0][12] MAIN_au16CalibParamNvm[0][13] MAIN_au16CalibParamNvm[0][14] MAIN_au16CalibParamNvm[0][15] MAIN_au16CalibParamNvm[0][1] MAIN_au16CalibParamNvm[0][2] MAIN_au16CalibParamNvm[0][3] MAIN_au16CalibParamNvm[0][4] MAIN_au16CalibParamNvm[0][5] MAIN_au16CalibParamNvm[0][6] MAIN_au16CalibParamNvm[0][7] MAIN_au16CalibParamNvm[0][8] MAIN_au16CalibParamNvm[0][9] MAIN_au16CalibParamNvm[1][0] MAIN_au16CalibParamNvm[1][10] MAIN_au16CalibParamNvm[1][11] MAIN_au16CalibParamNvm[1][12] MAIN_au16CalibParamNvm[1][13] MAIN_au16CalibParamNvm[1][14] MAIN_au16CalibParamNvm[1][15] MAIN_au16CalibParamNvm[1][1] MAIN_au16CalibParamNvm[1][2] MAIN_au16CalibParamNvm[1][3] MAIN_au16CalibParamNvm[1][4] MAIN_au16CalibParamNvm[1][5] MAIN_au16CalibParamNvm[1][6] MAIN_au16CalibParamNvm[1][7] MAIN_au16CalibParamNvm[1][8] MAIN_au16CalibParamNvm[1][9] MAIN_au16CalibParamNvm[2][0] MAIN_au16CalibParamNvm[2][10] MAIN_au16CalibParamNvm[2][11] MAIN_au16CalibParamNvm[2][12] MAIN_au16CalibParamNvm[2][13] MAIN_au16CalibParamNvm[2][14] MAIN_au16CalibParamNvm[2][15] MAIN_au16CalibParamNvm[2][1] MAIN_au16CalibParamNvm[2][2] MAIN_au16CalibParamNvm[2][3] MAIN_au16CalibParamNvm[2][4] MAIN_au16CalibParamNvm[2][5] MAIN_au16CalibParamNvm[2][6] MAIN_au16CalibParamNvm[2][7] MAIN_au16CalibParamNvm[2][8] MAIN_au16CalibParamNvm[2][9] MAIN_au16CalibParamNvm[3][0] MAIN_au16CalibParamNvm[3][10] MAIN_au16CalibParamNvm[3][11] MAIN_au16CalibParamNvm[3][12] MAIN_au16CalibParamNvm[3][13] MAIN_au16CalibParamNvm[3][14] MAIN_au16CalibParamNvm[3][15] MAIN_au16CalibParamNvm[3][1] MAIN_au16CalibParamNvm[3][2] MAIN_au16CalibParamNvm[3][3] MAIN_au16CalibParamNvm[3][4] MAIN_au16CalibParamNvm[3][5] MAIN_au16CalibParamNvm[3][6] MAIN_au16CalibParamNvm[3][7] MAIN_au16CalibParamNvm[3][8] MAIN_au16CalibParamNvm[3][9] MAIN_bAkdAfterAscReq MAIN_bAscFlag MAIN_bBswReadySts MAIN_bCalibStoreEna MAIN_bCalibStoreResult MAIN_bComDisableFlg MAIN_bESMStarted MAIN_bOcDataStoreEna MAIN_bOcFailureFlg MAIN_bOcFinshFlg MAIN_bOcModeEna MAIN_bOcNotRatFlg MAIN_bOcRdResultFlag MAIN_bOcStartFlag MAIN_bOCStoreAswReq MAIN_bOCStoreResult MAIN_bProgConditionOk MAIN_bRcGainStaoreEna MAIN_bResExcFltDetEna MAIN_bSoftOvBhvFlg MAIN_bSoftOvCurrPhsUFlg MAIN_bSoftOvCurrPhsVFlg MAIN_bSoftOvCurrPhsWFlg MAIN_bSpdReadyEst MAIN_bSpeedReadyFlg MAIN_bVSIStarted MAIN_f32ElecSpeedRds MAIN_f32EmailElecSpeedRds MAIN_f32EmailErrThetaRdSurPi MAIN_f32EmailMecaSpeedRds MAIN_f32EmailMecaSpeedRpm MAIN_f32EmailThetaElecRdSurPi MAIN_f32ErrThetaRdSurPi MAIN_f32IuFrequency MAIN_f32IuPeriod MAIN_f32MecaSpeedRds MAIN_f32MecaSpeedRpm MAIN_f32MotSpdEst MAIN_f32PWMDutyUPhys MAIN_f32PWMDutyVPhys MAIN_f32PWMDutyWPhys MAIN_f32ThetaElecRdSurPi MAIN_f32VsiPwmPeriod MAIN_MFC_au8CfgMap MAIN_MFC_au8CfgMap[0] MAIN_MFC_au8CfgMap[1] MAIN_MSGbCan01_Rx01_Auxiliary_Contactor_Enable MAIN_MSGbCan01_Rx01_Batteryheat1_MOS_Switch_Cmd MAIN_MSGbCan01_Rx01_Batteryheat2_MOS_Switch_Cmd MAIN_MSGbCan01_Rx01_Batteryheat3_MOS_Switch_Cmd MAIN_MSGbCan01_Rx01_Batteryheat4_MOS_Switch_Cmd MAIN_MSGbCan01_Rx01_Cab1_PTC_MOS_Switch_Cmd MAIN_MSGbCan01_Rx01_Cab2_PTC_MOS_Switch_Cmd MAIN_MSGbCan01_Rx01_ChargCircuit1_NegContactor_Ctrl_Cmd MAIN_MSGbCan01_Rx01_ChargCircuit1_PosContactor_Ctrl_Cmd MAIN_MSGbCan01_Rx01_ChargCircuit2_NegContactor_Ctrl_Cmd MAIN_MSGbCan01_Rx01_ChargCircuit2_PosContactor_Ctrl_Cmd MAIN_MSGbCan01_Rx01_ChargCircuit3_NegContactor_Ctrl_Cmd MAIN_MSGbCan01_Rx01_ChargCircuit3_PosContactor_Ctrl_Cmd MAIN_MSGbCan01_Rx01_ChargCircuit4_NegContactor_Ctrl_Cmd MAIN_MSGbCan01_Rx01_ChargCircuit4_PosContactor_Ctrl_Cmd MAIN_MSGbCan01_Rx01_Insulationresistance_Ctrl_Cmd MAIN_MSGbCan01_Rx01_Key_Signal MAIN_MSGbCan01_Rx01_Keyon_Signal_Sts MAIN_MSGbCan01_Rx01_NegContactor_Ctrl_Cmd MAIN_MSGbCan01_Rx01_Power_Enable_Signal MAIN_MSGbCan01_Rx01_PTC_Enable_Signal MAIN_MSGbCan01_Rx01_Upper_Enable_Signal MAIN_MSGbCan01_Rx04_Acu_Inhibit_Cmd MAIN_MSGbCan01_Tx01_Enable_signal MAIN_MSGbCan01_Tx01_Highvoltage_of_circuit_positive_contactor MAIN_MSGbCan01_Tx01_Key_signal MAIN_MSGbCan01_Tx01_Positive_contactor_on MAIN_MSGbCan01_Tx01_Positive_contactor_status MAIN_MSGbCan01_Tx01_Poweron_selftest_ok_signal MAIN_MSGbCan01_Tx01_Precharge_contactor_on MAIN_MSGbCan01_Tx01_Voltage_diff_of_positive_contactor MAIN_MSGbCan01_Tx02_AuxiliaryContactor_Status MAIN_MSGbCan01_Tx02_PTC_Contactor_Status MAIN_MSGbCan01_Tx02_UpperCircuit_Contactor_On MAIN_MSGbCan01_Tx02_UpperCircuit_Contactor_Status MAIN_MSGbCan01_Tx02_UpperCircuit_Precharge_Contactor_On MAIN_MSGbCan01_Tx07_Hardwire_Enable_Signal_Sts MAIN_MSGbCan02_Rx01_MCU1_Mor_Cmd MAIN_MSGf32Can01_Rx03_Steerpump_Motor_Targetspeed MAIN_MSGf32Can01_Rx04_Aircompressor_Motor_Targspeed MAIN_MSGf32Can01_Rx05_TCU_MotorTorReq MAIN_MSGf32Can01_Rx05_TCU_MotorWorkModReq MAIN_MSGf32Can01_Rx06_TCU_MotorTorReq MAIN_MSGf32Can01_Rx06_TCU_MotorWorkModReq MAIN_MSGf32Can01_Tx01_Low_input_voltage MAIN_MSGf32Can01_Tx01_Main_pos_contactor_out_voltage MAIN_MSGf32Can01_Tx01_Power_battery_pack_voltage MAIN_MSGf32Can01_Tx01_Precharg_resistor_temp MAIN_MSGf32Can01_Tx01_Precharg_time_consumption MAIN_MSGf32Can01_Tx02_Outputvoltage_of_UpperCircuit_Contactor MAIN_MSGf32Can01_Tx02_Software_Version MAIN_MSGf32Can01_Tx04_Chargingpile_voltage MAIN_MSGf32Can01_Tx04_Negativepole_to_ground_resistance_value MAIN_MSGf32Can01_Tx04_Positivepole_to_ground_resistance_value MAIN_MSGf32Can01_Tx05_Output_Current MAIN_MSGf32Can01_Tx05_Steering_Oil_DCAC_Module_Temp MAIN_MSGf32Can01_Tx06_Input_Voltage MAIN_MSGf32Can01_Tx06_Software_Version MAIN_MSGf32Can01_Tx06_Steer_Motor_Temp MAIN_MSGf32Can01_Tx07_AirCompressor_Temp MAIN_MSGf32Can01_Tx07_Input_Voltage MAIN_MSGf32Can01_Tx07_Output_Voltage MAIN_MSGf32Can01_Tx07_SDCAC_MotorTemp MAIN_MSGf32Can01_Tx08_AirCompressor_Motor_Speed MAIN_MSGf32Can01_Tx08_Software_Version MAIN_MSGf32Can02_Rx01_MC1_Mor_Tgt_Spd MAIN_MSGf32Can02_Rx01_MC1_Mor_Tgt_Trq MAIN_MSGf32Can02_Rx02_HCU1_MCU_LimitLowTrq MAIN_MSGf32Can02_Rx03_HCU_GearNum MAIN_MSGf32Can02_Rx03_HCU_OutputShaftSpeed MAIN_MSGf32Can02_Tx01_TS3_Motor_Out_Current MAIN_MSGf32Can02_Tx02_TS3_Motor_AC_Voltage MAIN_MSGf32Can02_Tx02_TS3_Motor_DC_Current MAIN_MSGf32Can02_Tx02_TS3_Motor_Speed MAIN_MSGf32Can02_Tx03_TS3_Motor_CanVersion MAIN_MSGf32Can02_Tx03_TS3_Motor_MaxBrkiTrqLmt MAIN_MSGf32Can02_Tx03_TS3_Motor_MaxDrviTrqLmt MAIN_MSGf32Can02_Tx03_TS3_Motor_MotControllerTemp MAIN_MSGf32Can02_Tx03_TS3_Motor_MotMaxspdLmt MAIN_MSGf32Can02_Tx03_TS3_Motor_MotTemp MAIN_MSGf32Can02_Tx05_TS3_DC_NTC_Temp MAIN_MSGu16Can01_Tx01_Main_pos_contactor_out_voltageRaw MAIN_MSGu16Can01_Tx01_Power_battery_pack_voltageRaw MAIN_MSGu16Can01_Tx02_Outputvoltage_of_UpperCircuit_ContactorRaw MAIN_MSGu16Can01_Tx04_Chargingpile_voltageRaw MAIN_MSGu16Can01_Tx04_Negativepole_to_ground_resistance_valueRaw MAIN_MSGu16Can01_Tx04_Positivepole_to_ground_resistance_valueRaw MAIN_MSGu16Can01_Tx05_Motor_Speed MAIN_MSGu16Can01_Tx05_Output_CurrentRaw MAIN_MSGu16Can02_Rx01_MC1_Mor_Tgt_SpdRaw MAIN_MSGu16Can02_Rx01_MC1_Mor_Tgt_TrqRaw MAIN_MSGu16Can02_Rx01_MCU1_CycMsg_LimitHigh MAIN_MSGu16Can02_Rx01_MCU1_CycMsg_LimitLow MAIN_MSGu16Can02_Rx02_Allow_Pulse_Charge_Current MAIN_MSGu16Can02_Rx02_Allow_Pulse_Discharge_Current MAIN_MSGu16Can02_Rx02_HCU1_MCU_LimitHighTrq MAIN_MSGu16Can02_Rx02_HCU1_MCU_LimitLowTrqRaw MAIN_MSGu16Can02_Rx03_HCU_OutputShaftSpeedRaw MAIN_MSGu16Can02_Tx01_TS3_Motor_Out_CurrentRaw MAIN_MSGu16Can02_Tx02_TS3_Motor_AC_VoltageRaw MAIN_MSGu16Can02_Tx02_TS3_Motor_DC_CurrentRaw MAIN_MSGu16Can02_Tx02_TS3_Motor_SpeedRaw MAIN_MSGu16Can02_Tx02_TS3_Motor_Torque MAIN_MSGu8Can01_Rx01_Heartbeat_Signal MAIN_MSGu8Can01_Rx01_PDUMC1_buf MAIN_MSGu8Can01_Rx01_PDUMC1_buf[0] MAIN_MSGu8Can01_Rx01_PDUMC1_buf[1] MAIN_MSGu8Can01_Rx01_PDUMC1_buf[2] MAIN_MSGu8Can01_Rx01_PDUMC1_buf[3] MAIN_MSGu8Can01_Rx01_PDUMC1_buf[4] MAIN_MSGu8Can01_Rx01_PDUMC1_buf[5] MAIN_MSGu8Can01_Rx01_PDUMC1_buf[6] MAIN_MSGu8Can01_Rx01_PDUMC1_buf[7] MAIN_MSGu8Can01_Rx02_HSMC1_buf MAIN_MSGu8Can01_Rx02_HSMC1_buf[0] MAIN_MSGu8Can01_Rx02_HSMC1_buf[1] MAIN_MSGu8Can01_Rx02_HSMC1_buf[2] MAIN_MSGu8Can01_Rx02_HSMC1_buf[3] MAIN_MSGu8Can01_Rx02_HSMC1_buf[4] MAIN_MSGu8Can01_Rx02_HSMC1_buf[5] MAIN_MSGu8Can01_Rx02_HSMC1_buf[6] MAIN_MSGu8Can01_Rx02_HSMC1_buf[7] MAIN_MSGu8Can01_Rx03_Heartbeat_Signal MAIN_MSGu8Can01_Rx03_HSSTC_buf MAIN_MSGu8Can01_Rx03_HSSTC_buf[0] MAIN_MSGu8Can01_Rx03_HSSTC_buf[1] MAIN_MSGu8Can01_Rx03_HSSTC_buf[2] MAIN_MSGu8Can01_Rx03_HSSTC_buf[3] MAIN_MSGu8Can01_Rx03_HSSTC_buf[4] MAIN_MSGu8Can01_Rx03_HSSTC_buf[5] MAIN_MSGu8Can01_Rx03_HSSTC_buf[6] MAIN_MSGu8Can01_Rx03_HSSTC_buf[7] MAIN_MSGu8Can01_Rx03_Steerpump_Motor_TargetspeedRaw MAIN_MSGu8Can01_Rx04_ACUMC1_buf MAIN_MSGu8Can01_Rx04_ACUMC1_buf[0] MAIN_MSGu8Can01_Rx04_ACUMC1_buf[1] MAIN_MSGu8Can01_Rx04_ACUMC1_buf[2] MAIN_MSGu8Can01_Rx04_ACUMC1_buf[3] MAIN_MSGu8Can01_Rx04_ACUMC1_buf[4] MAIN_MSGu8Can01_Rx04_ACUMC1_buf[5] MAIN_MSGu8Can01_Rx04_ACUMC1_buf[6] MAIN_MSGu8Can01_Rx04_ACUMC1_buf[7] MAIN_MSGu8Can01_Rx04_Aircompressor_Motor_TargspeedRaw MAIN_MSGu8Can01_Rx04_CtrlMsg_Cycle_Counter MAIN_MSGu8Can01_Rx05_AIR1_buf MAIN_MSGu8Can01_Rx05_AIR1_buf[0] MAIN_MSGu8Can01_Rx05_AIR1_buf[1] MAIN_MSGu8Can01_Rx05_AIR1_buf[2] MAIN_MSGu8Can01_Rx05_AIR1_buf[3] MAIN_MSGu8Can01_Rx05_AIR1_buf[4] MAIN_MSGu8Can01_Rx05_AIR1_buf[5] MAIN_MSGu8Can01_Rx05_AIR1_buf[6] MAIN_MSGu8Can01_Rx05_AIR1_buf[7] MAIN_MSGu8Can01_Rx05_TCU_MotorTorReqRaw MAIN_MSGu8Can01_Rx05_TCU_MotorWorkModReqRaw MAIN_MSGu8Can01_Rx06_AIR1_buf MAIN_MSGu8Can01_Rx06_AIR1_buf[0] MAIN_MSGu8Can01_Rx06_AIR1_buf[1] MAIN_MSGu8Can01_Rx06_AIR1_buf[2] MAIN_MSGu8Can01_Rx06_AIR1_buf[3] MAIN_MSGu8Can01_Rx06_AIR1_buf[4] MAIN_MSGu8Can01_Rx06_AIR1_buf[5] MAIN_MSGu8Can01_Rx06_AIR1_buf[6] MAIN_MSGu8Can01_Rx06_AIR1_buf[7] MAIN_MSGu8Can01_Rx06_TCU_MotorTorReqRaw MAIN_MSGu8Can01_Tx01_Low_input_voltageRaw MAIN_MSGu8Can01_Tx01_PDUST1_buf MAIN_MSGu8Can01_Tx01_PDUST1_buf[0] MAIN_MSGu8Can01_Tx01_PDUST1_buf[1] MAIN_MSGu8Can01_Tx01_PDUST1_buf[2] MAIN_MSGu8Can01_Tx01_PDUST1_buf[3] MAIN_MSGu8Can01_Tx01_PDUST1_buf[4] MAIN_MSGu8Can01_Tx01_PDUST1_buf[5] MAIN_MSGu8Can01_Tx01_PDUST1_buf[6] MAIN_MSGu8Can01_Tx01_PDUST1_buf[7] MAIN_MSGu8Can01_Tx01_Precharg_resistor_tempRaw MAIN_MSGu8Can01_Tx01_Precharg_time_consumptionRaw MAIN_MSGu8Can01_Tx02_1stStage_PTC_MOS_Switch_Command MAIN_MSGu8Can01_Tx02_2stStage_PTC_MOS_Switch_Command MAIN_MSGu8Can01_Tx02_AuxiliaryContactor_On MAIN_MSGu8Can01_Tx02_Heartbeat_Signal MAIN_MSGu8Can01_Tx02_Internal_Trouble_Code MAIN_MSGu8Can01_Tx02_PDUST2_buf MAIN_MSGu8Can01_Tx02_PDUST2_buf[0] MAIN_MSGu8Can01_Tx02_PDUST2_buf[1] MAIN_MSGu8Can01_Tx02_PDUST2_buf[2] MAIN_MSGu8Can01_Tx02_PDUST2_buf[3] MAIN_MSGu8Can01_Tx02_PDUST2_buf[4] MAIN_MSGu8Can01_Tx02_PDUST2_buf[5] MAIN_MSGu8Can01_Tx02_PDUST2_buf[6] MAIN_MSGu8Can01_Tx02_PDUST2_buf[7] MAIN_MSGu8Can01_Tx02_PTCContactor2_On MAIN_MSGu8Can01_Tx02_PTCContactor_On MAIN_MSGu8Can01_Tx02_Software_VersionRaw MAIN_MSGu8Can01_Tx02_Stuck_Status_Feedback MAIN_MSGu8Can01_Tx03_ChargeCircuit1_Negative_Contactor_Sts MAIN_MSGu8Can01_Tx03_ChargeCircuit1_Positive_Contactor_Sts MAIN_MSGu8Can01_Tx03_ChargeCircuit2_Negative_Contactor_Sts MAIN_MSGu8Can01_Tx03_ChargeCircuit2_Positive_Contactor_Sts MAIN_MSGu8Can01_Tx03_ChargeCircuit3_Negative_Contactor_Sts MAIN_MSGu8Can01_Tx03_ChargeCircuit3_Positive_Contactor_Sts MAIN_MSGu8Can01_Tx03_ChargeCircuit4_Negative_Contactor_Sts MAIN_MSGu8Can01_Tx03_ChargeCircuit4_Positive_Contactor_Sts MAIN_MSGu8Can01_Tx03_Insulation_Resistance_Sts MAIN_MSGu8Can01_Tx03_Negative_Contactor_Sts MAIN_MSGu8Can01_Tx03_Number_of_BatteryHeating_PTC_Switch MAIN_MSGu8Can01_Tx03_Number_of_Cab_PTC_Switch MAIN_MSGu8Can01_Tx03_Number_of_Positive_Contactors MAIN_MSGu8Can01_Tx03_OnStatus_of_BatteryHeating1_Switch MAIN_MSGu8Can01_Tx03_OnStatus_of_BatteryHeating2_Switch MAIN_MSGu8Can01_Tx03_OnStatus_of_BatteryHeating3_Switch MAIN_MSGu8Can01_Tx03_OnStatus_of_BatteryHeating4_Switch MAIN_MSGu8Can01_Tx03_OnStatus_of_Cab1_Stage_PTC_Switch MAIN_MSGu8Can01_Tx03_OnStatus_of_Cab2_Stage_PTC_Switch MAIN_MSGu8Can01_Tx03_PDUST3_buf MAIN_MSGu8Can01_Tx03_PDUST3_buf[0] MAIN_MSGu8Can01_Tx03_PDUST3_buf[1] MAIN_MSGu8Can01_Tx03_PDUST3_buf[2] MAIN_MSGu8Can01_Tx03_PDUST3_buf[3] MAIN_MSGu8Can01_Tx03_PDUST3_buf[4] MAIN_MSGu8Can01_Tx03_PDUST3_buf[5] MAIN_MSGu8Can01_Tx03_PDUST3_buf[6] MAIN_MSGu8Can01_Tx03_PDUST3_buf[7] MAIN_MSGu8Can01_Tx03_Positive_Contactor1_Sts MAIN_MSGu8Can01_Tx03_Positive_Contactor2_Sts MAIN_MSGu8Can01_Tx03_Positive_Contactor3_Sts MAIN_MSGu8Can01_Tx03_Positive_Contactor4_Sts MAIN_MSGu8Can01_Tx04_PDUST4_buf MAIN_MSGu8Can01_Tx04_PDUST4_buf[0] MAIN_MSGu8Can01_Tx04_PDUST4_buf[1] MAIN_MSGu8Can01_Tx04_PDUST4_buf[2] MAIN_MSGu8Can01_Tx04_PDUST4_buf[3] MAIN_MSGu8Can01_Tx04_PDUST4_buf[4] MAIN_MSGu8Can01_Tx04_PDUST4_buf[5] MAIN_MSGu8Can01_Tx04_PDUST4_buf[6] MAIN_MSGu8Can01_Tx04_PDUST4_buf[7] MAIN_MSGu8Can01_Tx05_Fault_Level MAIN_MSGu8Can01_Tx05_Heartbeat_Signal MAIN_MSGu8Can01_Tx05_HSST1_buf MAIN_MSGu8Can01_Tx05_HSST1_buf[0] MAIN_MSGu8Can01_Tx05_HSST1_buf[1] MAIN_MSGu8Can01_Tx05_HSST1_buf[2] MAIN_MSGu8Can01_Tx05_HSST1_buf[3] MAIN_MSGu8Can01_Tx05_HSST1_buf[4] MAIN_MSGu8Can01_Tx05_HSST1_buf[5] MAIN_MSGu8Can01_Tx05_HSST1_buf[6] MAIN_MSGu8Can01_Tx05_HSST1_buf[7] MAIN_MSGu8Can01_Tx05_Motor_Sts MAIN_MSGu8Can01_Tx05_Steering_Oil_DCAC_Module_TempRaw MAIN_MSGu8Can01_Tx06_HSST2_buf MAIN_MSGu8Can01_Tx06_HSST2_buf[0] MAIN_MSGu8Can01_Tx06_HSST2_buf[1] MAIN_MSGu8Can01_Tx06_HSST2_buf[2] MAIN_MSGu8Can01_Tx06_HSST2_buf[3] MAIN_MSGu8Can01_Tx06_HSST2_buf[4] MAIN_MSGu8Can01_Tx06_HSST2_buf[5] MAIN_MSGu8Can01_Tx06_HSST2_buf[6] MAIN_MSGu8Can01_Tx06_HSST2_buf[7] MAIN_MSGu8Can01_Tx06_Input_Current MAIN_MSGu8Can01_Tx06_Input_VoltageRaw MAIN_MSGu8Can01_Tx06_Internal_FaultCode MAIN_MSGu8Can01_Tx06_Software_VersionRaw MAIN_MSGu8Can01_Tx06_Steer_Motor_TempRaw MAIN_MSGu8Can01_Tx07_ACUST1_buf MAIN_MSGu8Can01_Tx07_ACUST1_buf[0] MAIN_MSGu8Can01_Tx07_ACUST1_buf[1] MAIN_MSGu8Can01_Tx07_ACUST1_buf[2] MAIN_MSGu8Can01_Tx07_ACUST1_buf[3] MAIN_MSGu8Can01_Tx07_ACUST1_buf[4] MAIN_MSGu8Can01_Tx07_ACUST1_buf[5] MAIN_MSGu8Can01_Tx07_ACUST1_buf[6] MAIN_MSGu8Can01_Tx07_ACUST1_buf[7] MAIN_MSGu8Can01_Tx07_AirCompressor_TempRaw MAIN_MSGu8Can01_Tx07_Controller_Operating_Sts MAIN_MSGu8Can01_Tx07_Heartbeat_Signal MAIN_MSGu8Can01_Tx07_Input_Current MAIN_MSGu8Can01_Tx07_Input_VoltageRaw MAIN_MSGu8Can01_Tx07_Output_Current MAIN_MSGu8Can01_Tx07_Output_VoltageRaw MAIN_MSGu8Can01_Tx07_SDCAC_MotorTempRaw MAIN_MSGu8Can01_Tx08_ACUST2_buf MAIN_MSGu8Can01_Tx08_ACUST2_buf[0] MAIN_MSGu8Can01_Tx08_ACUST2_buf[1] MAIN_MSGu8Can01_Tx08_ACUST2_buf[2] MAIN_MSGu8Can01_Tx08_ACUST2_buf[3] MAIN_MSGu8Can01_Tx08_ACUST2_buf[4] MAIN_MSGu8Can01_Tx08_ACUST2_buf[5] MAIN_MSGu8Can01_Tx08_ACUST2_buf[6] MAIN_MSGu8Can01_Tx08_ACUST2_buf[7] MAIN_MSGu8Can01_Tx08_AirCompressor_Motor_SpeedRaw MAIN_MSGu8Can01_Tx08_Internal_Fault_Code MAIN_MSGu8Can01_Tx08_Software_VersionRaw MAIN_MSGu8Can02_Rx01_MC2_buf MAIN_MSGu8Can02_Rx01_MC2_buf[0] MAIN_MSGu8Can02_Rx01_MC2_buf[1] MAIN_MSGu8Can02_Rx01_MC2_buf[2] MAIN_MSGu8Can02_Rx01_MC2_buf[3] MAIN_MSGu8Can02_Rx01_MC2_buf[4] MAIN_MSGu8Can02_Rx01_MC2_buf[5] MAIN_MSGu8Can02_Rx01_MC2_buf[6] MAIN_MSGu8Can02_Rx01_MC2_buf[7] MAIN_MSGu8Can02_Rx01_MCU1_CycMsg_Num MAIN_MSGu8Can02_Rx01_TCU3_Mor_Con_Mode MAIN_MSGu8Can02_Rx02_CCVS_buf MAIN_MSGu8Can02_Rx02_CCVS_buf[0] MAIN_MSGu8Can02_Rx02_CCVS_buf[1] MAIN_MSGu8Can02_Rx02_CCVS_buf[2] MAIN_MSGu8Can02_Rx02_CCVS_buf[3] MAIN_MSGu8Can02_Rx02_CCVS_buf[4] MAIN_MSGu8Can02_Rx02_CCVS_buf[5] MAIN_MSGu8Can02_Rx02_CCVS_buf[6] MAIN_MSGu8Can02_Rx02_CCVS_buf[7] MAIN_MSGu8Can02_Rx02_HCU1_BrakePed MAIN_MSGu8Can02_Rx02_HCU1_PKB MAIN_MSGu8Can02_Rx03_HCU_GearNumRaw MAIN_MSGu8Can02_Rx03_HCU_Gearshift_State MAIN_MSGu8Can02_Rx03_HCU_HandleShift MAIN_MSGu8Can02_Rx03_HCU_PTOWorkState MAIN_MSGu8Can02_Rx03_HCU_SelfLearningSignal MAIN_MSGu8Can02_Rx03_HCU_Targear_State MAIN_MSGu8Can02_Rx03_TS1_buf MAIN_MSGu8Can02_Rx03_TS1_buf[0] MAIN_MSGu8Can02_Rx03_TS1_buf[1] MAIN_MSGu8Can02_Rx03_TS1_buf[2] MAIN_MSGu8Can02_Rx03_TS1_buf[3] MAIN_MSGu8Can02_Rx03_TS1_buf[4] MAIN_MSGu8Can02_Rx03_TS1_buf[5] MAIN_MSGu8Can02_Rx03_TS1_buf[6] MAIN_MSGu8Can02_Rx03_TS1_buf[7] MAIN_MSGu8Can02_Tx01_MS0_buf MAIN_MSGu8Can02_Tx01_MS0_buf[0] MAIN_MSGu8Can02_Tx01_MS0_buf[1] MAIN_MSGu8Can02_Tx01_MS0_buf[2] MAIN_MSGu8Can02_Tx01_MS0_buf[3] MAIN_MSGu8Can02_Tx01_MS0_buf[4] MAIN_MSGu8Can02_Tx01_MS0_buf[5] MAIN_MSGu8Can02_Tx01_MS0_buf[6] MAIN_MSGu8Can02_Tx01_MS0_buf[7] MAIN_MSGu8Can02_Tx01_TS3_Mor_Con_Mode MAIN_MSGu8Can02_Tx02_MS1_buf MAIN_MSGu8Can02_Tx02_MS1_buf[0] MAIN_MSGu8Can02_Tx02_MS1_buf[1] MAIN_MSGu8Can02_Tx02_MS1_buf[2] MAIN_MSGu8Can02_Tx02_MS1_buf[3] MAIN_MSGu8Can02_Tx02_MS1_buf[4] MAIN_MSGu8Can02_Tx02_MS1_buf[5] MAIN_MSGu8Can02_Tx02_MS1_buf[6] MAIN_MSGu8Can02_Tx02_MS1_buf[7] MAIN_MSGu8Can02_Tx03_MS2_buf MAIN_MSGu8Can02_Tx03_MS2_buf[0] MAIN_MSGu8Can02_Tx03_MS2_buf[1] MAIN_MSGu8Can02_Tx03_MS2_buf[2] MAIN_MSGu8Can02_Tx03_MS2_buf[3] MAIN_MSGu8Can02_Tx03_MS2_buf[4] MAIN_MSGu8Can02_Tx03_MS2_buf[5] MAIN_MSGu8Can02_Tx03_MS2_buf[6] MAIN_MSGu8Can02_Tx03_MS2_buf[7] MAIN_MSGu8Can02_Tx03_TS3_Motor_CanVersionRaw MAIN_MSGu8Can02_Tx03_TS3_Motor_LiveCounter MAIN_MSGu8Can02_Tx03_TS3_Motor_MaxBrkiTrqLmtRaw MAIN_MSGu8Can02_Tx03_TS3_Motor_MaxDrviTrqLmtRaw MAIN_MSGu8Can02_Tx03_TS3_Motor_MotContrlReqInstruction MAIN_MSGu8Can02_Tx03_TS3_Motor_MotControllerTempRaw MAIN_MSGu8Can02_Tx03_TS3_Motor_MotMaxspdLmtRaw MAIN_MSGu8Can02_Tx03_TS3_Motor_MotTempRaw MAIN_MSGu8Can02_Tx03_TS3_Motor_WORKfeed MAIN_MSGu8Can02_Tx03_TS3_Motor_WORKmodefeed MAIN_MSGu8Can02_Tx04_MCU_Err_code MAIN_MSGu8Can02_Tx04_MCU_Err_level MAIN_MSGu8Can02_Tx04_MDM1_buf MAIN_MSGu8Can02_Tx04_MDM1_buf[0] MAIN_MSGu8Can02_Tx04_MDM1_buf[1] MAIN_MSGu8Can02_Tx04_MDM1_buf[2] MAIN_MSGu8Can02_Tx04_MDM1_buf[3] MAIN_MSGu8Can02_Tx04_MDM1_buf[4] MAIN_MSGu8Can02_Tx04_MDM1_buf[5] MAIN_MSGu8Can02_Tx04_MDM1_buf[6] MAIN_MSGu8Can02_Tx04_MDM1_buf[7] MAIN_MSGu8Can02_Tx05_MS3_buf MAIN_MSGu8Can02_Tx05_MS3_buf[0] MAIN_MSGu8Can02_Tx05_MS3_buf[1] MAIN_MSGu8Can02_Tx05_MS3_buf[2] MAIN_MSGu8Can02_Tx05_MS3_buf[3] MAIN_MSGu8Can02_Tx05_MS3_buf[4] MAIN_MSGu8Can02_Tx05_MS3_buf[5] MAIN_MSGu8Can02_Tx05_MS3_buf[6] MAIN_MSGu8Can02_Tx05_MS3_buf[7] MAIN_MSGu8Can02_Tx05_TS3_DC_NTC_TempRaw MAIN_MSGu8PwModOffCnt MAIN_MSGu8PwModOnCnt MAIN_s32Email2PosTreqDiff MAIN_s32PosA2BDeltTime MAIN_TotalTime MAIN_u16AirConditionerCheck MAIN_u16BatHeatPTCCheck MAIN_u16DCACInverterCheck MAIN_u16DCACResevedCheck MAIN_u16HVFanCheck MAIN_u16HVInputCheck MAIN_u16IuCycleCnt MAIN_u16IuMiddleCnt MAIN_u16IuMiddleSum MAIN_u16IuNegtiveCnt MAIN_u16IuNegtiveSum MAIN_u16IuPositiveCnt MAIN_u16IuPositiveSum MAIN_u16PWMPeriodVal MAIN_u16SpdReadyEstCnt MAIN_u16SuperStructureCheck MAIN_u16VadcBhv MAIN_u16WaterCoolingCheck MAIN_u32EmailCkreq MAIN_u32EmailPosATimeStamp MAIN_u32FixOcDataBuf MAIN_u32FixOcDataBuf[0] MAIN_u32FixOcDataBuf[10] MAIN_u32FixOcDataBuf[11] MAIN_u32FixOcDataBuf[12] MAIN_u32FixOcDataBuf[13] MAIN_u32FixOcDataBuf[14] MAIN_u32FixOcDataBuf[15] MAIN_u32FixOcDataBuf[1] MAIN_u32FixOcDataBuf[2] MAIN_u32FixOcDataBuf[3] MAIN_u32FixOcDataBuf[4] MAIN_u32FixOcDataBuf[5] MAIN_u32FixOcDataBuf[6] MAIN_u32FixOcDataBuf[7] MAIN_u32FixOcDataBuf[8] MAIN_u32FixOcDataBuf[9] MAIN_u32IuCycleTim MAIN_u32OCTrimNvmAlignBuf MAIN_u32OCTrimNvmAlignBuf[0] MAIN_u32OCTrimNvmAlignBuf[1] MAIN_u32OCTrimNvmAlignBuf[2] MAIN_u32OCTrimNvmAlignBuf[3] MAIN_u32OCTrimNvmAlignBuf[4] MAIN_u32OCTrimNvmAlignBuf[5] MAIN_u32OCTrimNvmAlignBuf[6] MAIN_u32OCTrimNvmAlignBuf[7] MAIN_u32OCTrimNvmAlignBuf[8] MAIN_u32OCTrimNvmAlignBuf[9] MAIN_u32PosATimeStamp MAIN_u32PosBTimeStamp MAIN_u32PosTreatCkreq MAIN_u32TestVar2 MAIN_u32WaitValueVSITreatment MAIN_u64RunTime_ms MAIN_u64RunTime_ms[0] MAIN_u64RunTime_ms[1] MAIN_u64RunTime_NVM MAIN_u64RunTime_NVM[0] MAIN_u64RunTime_NVM[1] MAIN_u64RunTime_s MAIN_u64RunTime_s[0] MAIN_u64RunTime_s[1] MAIN_u8CalibStoreState MAIN_u8DEV_Fault MAIN_u8DEV_Fault[0] MAIN_u8DEV_Fault[10] MAIN_u8DEV_Fault[11] MAIN_u8DEV_Fault[12] MAIN_u8DEV_Fault[13] MAIN_u8DEV_Fault[14] MAIN_u8DEV_Fault[15] MAIN_u8DEV_Fault[1] MAIN_u8DEV_Fault[2] MAIN_u8DEV_Fault[3] MAIN_u8DEV_Fault[4] MAIN_u8DEV_Fault[5] MAIN_u8DEV_Fault[6] MAIN_u8DEV_Fault[7] MAIN_u8DEV_Fault[8] MAIN_u8DEV_Fault[9] MAIN_u8OcState MAIN_u8OCStoreState MAIN_u8OcStsRptDelayCnt MAIN_u8OfsAlCalSts MAIN_u8TestVar1 MAIN_u8TrigOcByUser MAIN_u8UdsSwVerSup MAIN_u8UdsSwVerSup[0] MAIN_u8UdsSwVerSup[10] MAIN_u8UdsSwVerSup[11] MAIN_u8UdsSwVerSup[12] MAIN_u8UdsSwVerSup[13] MAIN_u8UdsSwVerSup[14] MAIN_u8UdsSwVerSup[15] MAIN_u8UdsSwVerSup[16] MAIN_u8UdsSwVerSup[17] MAIN_u8UdsSwVerSup[18] MAIN_u8UdsSwVerSup[19] MAIN_u8UdsSwVerSup[1] MAIN_u8UdsSwVerSup[20] MAIN_u8UdsSwVerSup[2] MAIN_u8UdsSwVerSup[3] MAIN_u8UdsSwVerSup[4] MAIN_u8UdsSwVerSup[5] MAIN_u8UdsSwVerSup[6] MAIN_u8UdsSwVerSup[7] MAIN_u8UdsSwVerSup[8] MAIN_u8UdsSwVerSup[9] MAIN_u8UdsSwVerVeh MAIN_u8UdsSwVerVeh[0] MAIN_u8UdsSwVerVeh[10] MAIN_u8UdsSwVerVeh[11] MAIN_u8UdsSwVerVeh[12] MAIN_u8UdsSwVerVeh[1] MAIN_u8UdsSwVerVeh[2] MAIN_u8UdsSwVerVeh[3] MAIN_u8UdsSwVerVeh[4] MAIN_u8UdsSwVerVeh[5] MAIN_u8UdsSwVerVeh[6] MAIN_u8UdsSwVerVeh[7] MAIN_u8UdsSwVerVeh[8] MAIN_u8UdsSwVerVeh[9] Os_Task_BackGround_Counter Os_Task_Idle_Counter RC_au16VoltageGain RC_au16VoltageGain[0] RC_au16VoltageGain[10] RC_au16VoltageGain[11] RC_au16VoltageGain[12] RC_au16VoltageGain[13] RC_au16VoltageGain[14] RC_au16VoltageGain[15] RC_au16VoltageGain[16] RC_au16VoltageGain[17] RC_au16VoltageGain[18] RC_au16VoltageGain[19] RC_au16VoltageGain[1] RC_au16VoltageGain[20] RC_au16VoltageGain[21] RC_au16VoltageGain[22] RC_au16VoltageGain[23] RC_au16VoltageGain[24] RC_au16VoltageGain[2] RC_au16VoltageGain[3] RC_au16VoltageGain[4] RC_au16VoltageGain[5] RC_au16VoltageGain[6] RC_au16VoltageGain[7] RC_au16VoltageGain[8] RC_au16VoltageGain[9] /end OUT_MEASUREMENT
/end FUNCTION
/begin FUNCTION OBD "" /begin OUT_MEASUREMENT OBD_u32CalVerifyNum /end OUT_MEASUREMENT /end FUNCTION
/begin FUNCTION OMAIN ""
 /begin DEF_CHARACTERISTIC OMAIN_f32CanSpeedTgtSetC OMAIN_f32OverBhvThdC OMAIN_f32UvwOvCurrThdC OMAIN_HARDBenchOnC OMAIN_u32VSICntCkreqESMStartedC OMAIN_u32VSICntCkreqVSIStartedC OMAIN_VSIBenchOnWriteDataC /end DEF_CHARACTERISTIC
 /begin OUT_MEASUREMENT OMAIN_bBswReadySts OMAIN_bESMStarted OMAIN_bProgConditionOk OMAIN_bSoftOvBhvFlg OMAIN_bSoftOvCurrPhsUFlg OMAIN_bSoftOvCurrPhsVFlg OMAIN_bSoftOvCurrPhsWFlg OMAIN_bVSIStarted OMAIN_EndTime OMAIN_ESMGo2StartupIEvent OMAIN_f32PWMDutyUPhys OMAIN_f32PWMDutyVPhys OMAIN_f32PWMDutyWPhys OMAIN_startTime OMAIN_TotalTime OMAIN_u16Cnt1 OMAIN_u16Cnt10 OMAIN_u16Cnt100 OMAIN_u16Cnt2 OMAIN_u16Cnt200 OMAIN_u16Cnt5 OMAIN_u16VadcPhaseCurU OMAIN_u16VadcPhaseCurV OMAIN_u16VadcPhaseCurW OMAIN_u8DEV_Fault OMAIN_u8DEV_Fault[0] OMAIN_u8DEV_Fault[10] OMAIN_u8DEV_Fault[11] OMAIN_u8DEV_Fault[12] OMAIN_u8DEV_Fault[13] OMAIN_u8DEV_Fault[14] OMAIN_u8DEV_Fault[15] OMAIN_u8DEV_Fault[1] OMAIN_u8DEV_Fault[2] OMAIN_u8DEV_Fault[3] OMAIN_u8DEV_Fault[4] OMAIN_u8DEV_Fault[5] OMAIN_u8DEV_Fault[6] OMAIN_u8DEV_Fault[7] OMAIN_u8DEV_Fault[8] OMAIN_u8DEV_Fault[9] /end OUT_MEASUREMENT
/end FUNCTION
/begin FUNCTION PortMux ""
 /begin OUT_MEASUREMENT PMux_au8AddrSet PMux_au8AddrSet[0] PMux_au8AddrSet[10] PMux_au8AddrSet[11] PMux_au8AddrSet[12] PMux_au8AddrSet[13] PMux_au8AddrSet[14] PMux_au8AddrSet[1] PMux_au8AddrSet[2] PMux_au8AddrSet[3] PMux_au8AddrSet[4] PMux_au8AddrSet[5] PMux_au8AddrSet[6] PMux_au8AddrSet[7] PMux_au8AddrSet[8] PMux_au8AddrSet[9] PMUX_ePMUX_AN_MUX1 PMUX_ePMUX_AN_MUX10 PMUX_ePMUX_AN_MUX10[0] PMUX_ePMUX_AN_MUX10[1] PMUX_ePMUX_AN_MUX10[2] PMUX_ePMUX_AN_MUX10[3] PMUX_ePMUX_AN_MUX10[4] PMUX_ePMUX_AN_MUX10[5] PMUX_ePMUX_AN_MUX10[6] PMUX_ePMUX_AN_MUX10[7] PMUX_ePMUX_AN_MUX11 PMUX_ePMUX_AN_MUX11[0] PMUX_ePMUX_AN_MUX11[1] PMUX_ePMUX_AN_MUX11[2] PMUX_ePMUX_AN_MUX11[3] PMUX_ePMUX_AN_MUX11[4] PMUX_ePMUX_AN_MUX11[5] PMUX_ePMUX_AN_MUX11[6] PMUX_ePMUX_AN_MUX11[7] PMUX_ePMUX_AN_MUX12 PMUX_ePMUX_AN_MUX12[0] PMUX_ePMUX_AN_MUX12[1] PMUX_ePMUX_AN_MUX12[2] PMUX_ePMUX_AN_MUX12[3] PMUX_ePMUX_AN_MUX12[4] PMUX_ePMUX_AN_MUX12[5] PMUX_ePMUX_AN_MUX12[6] PMUX_ePMUX_AN_MUX12[7] PMUX_ePMUX_AN_MUX1[0] PMUX_ePMUX_AN_MUX1[1] PMUX_ePMUX_AN_MUX1[2] PMUX_ePMUX_AN_MUX1[3] PMUX_ePMUX_AN_MUX1[4] PMUX_ePMUX_AN_MUX1[5] PMUX_ePMUX_AN_MUX1[6] PMUX_ePMUX_AN_MUX1[7] PMUX_ePMUX_AN_MUX2 PMUX_ePMUX_AN_MUX2[0] PMUX_ePMUX_AN_MUX2[1] PMUX_ePMUX_AN_MUX2[2] PMUX_ePMUX_AN_MUX2[3] PMUX_ePMUX_AN_MUX2[4] PMUX_ePMUX_AN_MUX2[5] PMUX_ePMUX_AN_MUX2[6] PMUX_ePMUX_AN_MUX2[7] PMUX_ePMUX_AN_MUX3 PMUX_ePMUX_AN_MUX3[0] PMUX_ePMUX_AN_MUX3[1] PMUX_ePMUX_AN_MUX3[2] PMUX_ePMUX_AN_MUX3[3] PMUX_ePMUX_AN_MUX3[4] PMUX_ePMUX_AN_MUX3[5] PMUX_ePMUX_AN_MUX3[6] PMUX_ePMUX_AN_MUX3[7] PMUX_ePMUX_AN_MUX4 PMUX_ePMUX_AN_MUX4[0] PMUX_ePMUX_AN_MUX4[1] PMUX_ePMUX_AN_MUX4[2] PMUX_ePMUX_AN_MUX4[3] PMUX_ePMUX_AN_MUX4[4] PMUX_ePMUX_AN_MUX4[5] PMUX_ePMUX_AN_MUX4[6] PMUX_ePMUX_AN_MUX4[7] PMUX_ePMUX_AN_MUX5 PMUX_ePMUX_AN_MUX5[0] PMUX_ePMUX_AN_MUX5[1] PMUX_ePMUX_AN_MUX5[2] PMUX_ePMUX_AN_MUX5[3] PMUX_ePMUX_AN_MUX5[4] PMUX_ePMUX_AN_MUX5[5] PMUX_ePMUX_AN_MUX5[6] PMUX_ePMUX_AN_MUX5[7] PMUX_ePMUX_AN_MUX6 PMUX_ePMUX_AN_MUX6[0] PMUX_ePMUX_AN_MUX6[1] PMUX_ePMUX_AN_MUX6[2] PMUX_ePMUX_AN_MUX6[3] PMUX_ePMUX_AN_MUX6[4] PMUX_ePMUX_AN_MUX6[5] PMUX_ePMUX_AN_MUX6[6] PMUX_ePMUX_AN_MUX6[7] PMUX_ePMUX_AN_MUX7 PMUX_ePMUX_AN_MUX7[0] PMUX_ePMUX_AN_MUX7[1] PMUX_ePMUX_AN_MUX7[2] PMUX_ePMUX_AN_MUX7[3] PMUX_ePMUX_AN_MUX7[4] PMUX_ePMUX_AN_MUX7[5] PMUX_ePMUX_AN_MUX7[6] PMUX_ePMUX_AN_MUX7[7] PMUX_ePMUX_AN_MUX8 PMUX_ePMUX_AN_MUX8[0] PMUX_ePMUX_AN_MUX8[1] PMUX_ePMUX_AN_MUX8[2] PMUX_ePMUX_AN_MUX8[3] PMUX_ePMUX_AN_MUX8[4] PMUX_ePMUX_AN_MUX8[5] PMUX_ePMUX_AN_MUX8[6] PMUX_ePMUX_AN_MUX8[7] PMUX_ePMUX_AN_MUX9 PMUX_ePMUX_AN_MUX9[0] PMUX_ePMUX_AN_MUX9[1] PMUX_ePMUX_AN_MUX9[2] PMUX_ePMUX_AN_MUX9[3] PMUX_ePMUX_AN_MUX9[4] PMUX_ePMUX_AN_MUX9[5] PMUX_ePMUX_AN_MUX9[6] PMUX_ePMUX_AN_MUX9[7] PMUX_ePMUX_DIO_MUX1 PMUX_ePMUX_DIO_MUX1[0] PMUX_ePMUX_DIO_MUX1[1] PMUX_ePMUX_DIO_MUX1[2] PMUX_ePMUX_DIO_MUX1[3] PMUX_ePMUX_DIO_MUX1[4] PMUX_ePMUX_DIO_MUX1[5] PMUX_ePMUX_DIO_MUX1[6] PMUX_ePMUX_DIO_MUX1[7] PMUX_ePMUX_DIO_MUX2 PMUX_ePMUX_DIO_MUX2[0] PMUX_ePMUX_DIO_MUX2[1] PMUX_ePMUX_DIO_MUX2[2] PMUX_ePMUX_DIO_MUX2[3] PMUX_ePMUX_DIO_MUX2[4] PMUX_ePMUX_DIO_MUX2[5] PMUX_ePMUX_DIO_MUX2[6] PMUX_ePMUX_DIO_MUX2[7] PMUX_ePMUX_DIO_MUX3 PMUX_ePMUX_DIO_MUX3[0] PMUX_ePMUX_DIO_MUX3[1] PMUX_ePMUX_DIO_MUX3[2] PMUX_ePMUX_DIO_MUX3[3] PMUX_ePMUX_DIO_MUX3[4] PMUX_ePMUX_DIO_MUX3[5] PMUX_ePMUX_DIO_MUX3[6] PMUX_ePMUX_DIO_MUX3[7] /end OUT_MEASUREMENT
/end FUNCTION
/end MODULE
/end PROJECT
