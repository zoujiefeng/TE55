/* Genebase version 6.5.0.0 */
ASAP2_VERSION 1 3
/begin PROJECT P_TC387_PLATFORM_0_0 "P_TC387_PLATFORM_0_0"
/begin HEADER "" VERSION "5210.00" PROJECT_NO D0 /end HEADER
/begin MODULE P_TC387_PLATFORM_0_0 "Invt"
/begin MOD_PAR "CCP" USER "P_TC387_PLATFORM_0_0" ECU "P_TC387_PLATFORM_0_0"
 /begin MEMORY_SEGMENT CODE1 "FillMemory1" CODE FLASH INTERN 0x80050000 0x8000 -1 -1 -1 -1 -1 /end MEMORY_SEGMENT
 /begin MEMORY_SEGMENT DATA1 "CalibrationMemoryArea" DATA FLASH INTERN 0x80058000 0x10000 -1 -1 -1 -1 -1 /begin IF_DATA ASAP1B_CCP ADDRESS_MAPPING 0x80058000 0x80058000 0x10000 /end IF_DATA /end MEMORY_SEGMENT
 /begin MEMORY_SEGMENT CODE2 "FillMemory2" CODE FLASH INTERN 0x80068000 0x98000 -1 -1 -1 -1 -1 /end MEMORY_SEGMENT
 /begin MEMORY_SEGMENT CODE3 "CodeMemoryArea" CODE FLASH INTERN 0x80100000 0x180000 -1 -1 -1 -1 -1 /end MEMORY_SEGMENT
 /begin MEMORY_SEGMENT VARIABLES1 "DataMemory" VARIABLES RAM INTERN 0x60000000 0x18000 -1 -1 -1 -1 -1 /end MEMORY_SEGMENT
/end MOD_PAR
/begin MOD_COMMON "" DEPOSIT ABSOLUTE ALIGNMENT_BYTE 1 ALIGNMENT_WORD 2 ALIGNMENT_LONG 4 ALIGNMENT_FLOAT32_IEEE 4 ALIGNMENT_FLOAT64_IEEE 8 BYTE_ORDER MSB_LAST /end MOD_COMMON
/begin IF_DATA ASAP1B_CCP
 /begin SOURCE "1 ms" 3 1 DISPLAY_IDENTIFIER "1 ms" /begin QP_BLOB 0 LENGTH 6 CAN_ID_FIXED 0x200 RASTER 0 FIRST_PID 0x00 /end QP_BLOB /end SOURCE
 /begin SOURCE "10 ms" 4 1 DISPLAY_IDENTIFIER "10 ms" /begin QP_BLOB 1 LENGTH 28 CAN_ID_FIXED 0x201 RASTER 1 FIRST_PID 0x12 /end QP_BLOB /end SOURCE
 /begin SOURCE "5 ms" 3 5 DISPLAY_IDENTIFIER "5 ms" /begin QP_BLOB 2 LENGTH 12 CAN_ID_FIXED 0x1FF RASTER 2 FIRST_PID 0x06 /end QP_BLOB /end SOURCE
 /begin RASTER "Timer 1 ms" "1 ms" 0 3 1 /end RASTER
 /begin RASTER "Timer 10 ms" "10 ms" 1 4 1 /end RASTER
 /begin RASTER "Timer 5 ms" "5 ms" 2 3 5 /end RASTER
 /begin TP_BLOB 0x0201 0x0202 0x301 0x302 0x0209 2 STORE_SUPPORTED BAUDRATE 1000000 SAMPLE_POINT 80 SAMPLE_RATE 1 BTL_CYCLES 20 SJW 3 SYNC_EDGE 0 /begin CHECKSUM_PARAM 0x8001 0x00000200 CHECKSUM_CALCULATION ACTIVE_PAGE /end CHECKSUM_PARAM /begin DEFINED_PAGES 0 "ReferencePage" 0x0000 0x80058000 0x00010000 ROM /end DEFINED_PAGES
  /begin DEFINED_PAGES 1 "WorkingPage" 0x0000 0x60018000 0x00004000 RAM FLASH_BACK RAM_INIT_BY_ECU /end DEFINED_PAGES
  OPTIONAL_CMD 0x0C OPTIONAL_CMD 0x0D OPTIONAL_CMD 0x0E OPTIONAL_CMD 0x23 OPTIONAL_CMD 0x11 OPTIONAL_CMD 0x09 /end TP_BLOB
/end IF_DATA
/begin RECORD_LAYOUT DATA_RECORD_UBYTE FNC_VALUES 1 UBYTE ROW_DIR DIRECT /end RECORD_LAYOUT
/begin RECORD_LAYOUT DATA_RECORD_SBYTE FNC_VALUES 1 SBYTE ROW_DIR DIRECT /end RECORD_LAYOUT
/begin RECORD_LAYOUT DATA_RECORD_UWORD FNC_VALUES 1 UWORD ROW_DIR DIRECT /end RECORD_LAYOUT
/begin RECORD_LAYOUT DATA_RECORD_ULONG FNC_VALUES 1 ULONG ROW_DIR DIRECT /end RECORD_LAYOUT
/begin RECORD_LAYOUT DATA_RECORD_FLOAT32_IEEE FNC_VALUES 1 FLOAT32_IEEE ROW_DIR DIRECT /end RECORD_LAYOUT
/begin CHARACTERISTIC ADS1115_u8UserCfg_DRC "Spare" VALUE 0x80058061 DATA_RECORD_UBYTE 255 F_1_p0_2 0 255 /end CHARACTERISTIC
/begin CHARACTERISTIC ADS1115_u8UserCfg_MUXC "Spare" VALUE 0x80058062 DATA_RECORD_UBYTE 255 F_1_p0_2 0 255 /end CHARACTERISTIC
/begin CHARACTERISTIC ADS1115_u8UserCfg_PGAC "Spare" VALUE 0x80058063 DATA_RECORD_UBYTE 255 F_1_p0_2 0 255 /end CHARACTERISTIC
/begin CHARACTERISTIC AMAIN_HARDBenchOnC "Bench VSI write datas" VALUE 0x8005804E DATA_RECORD_UBYTE 1 Bool_ON_OFF 0 1 BIT_MASK 0x01 /end CHARACTERISTIC
/begin CHARACTERISTIC AMAIN_VSIBenchOnWriteDataC "Bench VSI write datas" VALUE 0x8005804D DATA_RECORD_UBYTE 1 Bool_ON_OFF 0 1 BIT_MASK 0x01 /end CHARACTERISTIC
/begin CHARACTERISTIC AMAIN_f32CanSpeedTgtSetC "..." VALUE 0x80058B24 DATA_RECORD_FLOAT32_IEEE 3.402823466E+038 F_1_p0_2 -3.402823466E+038 3.402823466E+038 /end CHARACTERISTIC
/begin CHARACTERISTIC AMAIN_f32OverBhvThdC "..." VALUE 0x80058B14 DATA_RECORD_FLOAT32_IEEE 3.402823466E+038 F_1_p0_2 -3.402823466E+038 3.402823466E+038 /end CHARACTERISTIC
/begin CHARACTERISTIC AMAIN_f32UvwOvCurrThdC "..." VALUE 0x80058B20 DATA_RECORD_FLOAT32_IEEE 3.402823466E+038 F_1_p0_2 -3.402823466E+038 3.402823466E+038 /end CHARACTERISTIC
/begin CHARACTERISTIC AMAIN_u32VSICntCkreqESMStartedC "Spare" VALUE 0x80058B1C DATA_RECORD_ULONG 4294967295 F_1_p0_2 0 4294967295 /end CHARACTERISTIC
/begin CHARACTERISTIC AMAIN_u32VSICntCkreqVSIStartedC "Spare" VALUE 0x80058B1C DATA_RECORD_ULONG 4294967295 F_1_p0_2 0 4294967295 /end CHARACTERISTIC
/begin CHARACTERISTIC BLDC_bHallInvalidFltTestOnC "..." VALUE 0x80058005 DATA_RECORD_UBYTE 1 Bool_ON_OFF 0 1 BIT_MASK 0x01 /end CHARACTERISTIC
/begin CHARACTERISTIC BLDC_bHallUndefFltTestOnC "..." VALUE 0x80058004 DATA_RECORD_UBYTE 1 Bool_ON_OFF 0 1 BIT_MASK 0x01 /end CHARACTERISTIC
/begin CHARACTERISTIC BLDC_bOilPressShortGndFltTestOnC "..." VALUE 0x80058001 DATA_RECORD_UBYTE 1 Bool_ON_OFF 0 1 BIT_MASK 0x01 /end CHARACTERISTIC
/begin CHARACTERISTIC BLDC_bOilPressShortVccFltTestOnC "..." VALUE 0x80058000 DATA_RECORD_UBYTE 1 Bool_ON_OFF 0 1 BIT_MASK 0x01 /end CHARACTERISTIC
/begin CHARACTERISTIC BLDC_bP5vAD2SOverVolFltTestOnC "..." VALUE 0x80058003 DATA_RECORD_UBYTE 1 Bool_ON_OFF 0 1 BIT_MASK 0x01 /end CHARACTERISTIC
/begin CHARACTERISTIC BLDC_bP5vAD2SUnderVolFltTestOnC "..." VALUE 0x80058002 DATA_RECORD_UBYTE 1 Bool_ON_OFF 0 1 BIT_MASK 0x01 /end CHARACTERISTIC
/begin CHARACTERISTIC BLDC_kf32LVThdHighC "..." VALUE 0x80058BA8 DATA_RECORD_FLOAT32_IEEE 3.402823466E+038 F_1_p0_2 -3.402823466E+038 3.402823466E+038 /end CHARACTERISTIC
/begin CHARACTERISTIC BLDC_kf32LVThdLowC "..." VALUE 0x80058BA4 DATA_RECORD_FLOAT32_IEEE 3.402823466E+038 F_1_p0_2 -3.402823466E+038 3.402823466E+038 /end CHARACTERISTIC
/begin CHARACTERISTIC BLDC_kf32MidPotMaxMonitorDutyC "Spare" VALUE 0x80058B84 DATA_RECORD_FLOAT32_IEEE 3.402823466E+038 F_1_p0_2 -3.402823466E+038 3.402823466E+038 /end CHARACTERISTIC
/begin CHARACTERISTIC BLDC_kf32MidPotMinMonitorDutyC "Spare" VALUE 0x80058B80 DATA_RECORD_FLOAT32_IEEE 3.402823466E+038 F_1_p0_2 -3.402823466E+038 3.402823466E+038 /end CHARACTERISTIC
/begin CHARACTERISTIC BLDC_kf32MidPotShrtGndDutyC "Spare" VALUE 0x80058B98 DATA_RECORD_FLOAT32_IEEE 3.402823466E+038 F_100_p0_3 -3.402823466E+038 3.402823466E+038 /end CHARACTERISTIC
/begin CHARACTERISTIC BLDC_kf32MidPotShrtVccDutyC "Spare" VALUE 0x80058B94 DATA_RECORD_FLOAT32_IEEE 3.402823466E+038 F_100_p0_3 -3.402823466E+038 3.402823466E+038 /end CHARACTERISTIC
/begin CHARACTERISTIC BLDC_kf32MidPotTgtHighC "Spare" VALUE 0x80058B90 DATA_RECORD_FLOAT32_IEEE 3.402823466E+038 F_100_p0_3 -3.402823466E+038 3.402823466E+038 /end CHARACTERISTIC
/begin CHARACTERISTIC BLDC_kf32MidPotTgtLowC "Spare" VALUE 0x80058B8C DATA_RECORD_FLOAT32_IEEE 3.402823466E+038 F_100_p0_3 -3.402823466E+038 3.402823466E+038 /end CHARACTERISTIC
/begin CHARACTERISTIC BLDC_kf32MotorSpeedC "..." VALUE 0x80058B7C DATA_RECORD_FLOAT32_IEEE 3.402823466E+038 F_1_p0_2 -3.402823466E+038 3.402823466E+038 /end CHARACTERISTIC
/begin CHARACTERISTIC BLDC_kf32P5vAD2SOverVolC "Spare" VALUE 0x80058BA0 DATA_RECORD_FLOAT32_IEEE 3.402823466E+038 F_1_p0_2 -3.402823466E+038 3.402823466E+038 /end CHARACTERISTIC
/begin CHARACTERISTIC BLDC_kf32P5vAD2SUnderVolC "Spare" VALUE 0x80058B9C DATA_RECORD_FLOAT32_IEEE 3.402823466E+038 F_1_p0_2 -3.402823466E+038 3.402823466E+038 /end CHARACTERISTIC
/begin CHARACTERISTIC BLDC_kf32TgtDutyDeltMaxC "Spare" VALUE 0x80058B88 DATA_RECORD_FLOAT32_IEEE 3.402823466E+038 F_1_p0_2 -3.402823466E+038 3.402823466E+038 /end CHARACTERISTIC
/begin CHARACTERISTIC BLDC_ku16MidPotFltConfirmC "BLDC_ku16MidPotFltConfirmC" VALUE 0x80058082 DATA_RECORD_UWORD 65535 I_1 0 65535 /end CHARACTERISTIC
/begin CHARACTERISTIC BLDC_ku16MidPotFltIncStepC "BLDC_ku16MidPotFltIncStepC" VALUE 0x80058080 DATA_RECORD_UWORD 65535 I_1 0 65535 /end CHARACTERISTIC
/begin CHARACTERISTIC BLDC_ku16MidPotRcvTimC "Spare" VALUE 0x80058084 DATA_RECORD_UWORD 655350 F_10_p0_4 0 655350 /end CHARACTERISTIC
/begin CHARACTERISTIC BLDC_ku16TgtDutyRisingTimC "BLDC_ku16TgtDutyRisingTimC" VALUE 0x80058086 DATA_RECORD_UWORD 65535 I_1 0 65535 /end CHARACTERISTIC
/begin CHARACTERISTIC BSW_bSPYBenchOnC "SPY activation" VALUE 0x80058007 DATA_RECORD_UBYTE 1 Bool_ON_OFF 0 1 BIT_MASK 0x01 /end CHARACTERISTIC
/begin CHARACTERISTIC BSW_ku16VSIRdyChkTimoutC "BSW_ku16VSIRdyChkTimoutC" VALUE 0x80058090 DATA_RECORD_UWORD 65535 I_1 0 65535 /end CHARACTERISTIC
/begin CHARACTERISTIC BSW_u8E2E_ValidC "..." VALUE 0x80058006 DATA_RECORD_UBYTE 1 Bool_ON_OFF 0 1 BIT_MASK 0x01 /end CHARACTERISTIC
/begin CHARACTERISTIC CCU6_bAlimFreqChgEnaC "..." VALUE 0x80058023 DATA_RECORD_UBYTE 1 Bool_ON_OFF 0 1 BIT_MASK 0x01 /end CHARACTERISTIC
/begin CHARACTERISTIC CCU6_bDualSmpEnaC "..." VALUE 0x80058022 DATA_RECORD_UBYTE 1 Bool_ON_OFF 0 1 BIT_MASK 0x01 /end CHARACTERISTIC
/begin CHARACTERISTIC CCU6_bHwOvcFltDetEnaC "..." VALUE 0x80058021 DATA_RECORD_UBYTE 1 Bool_ON_OFF 0 1 BIT_MASK 0x01 /end CHARACTERISTIC
/begin CHARACTERISTIC CCU6_bHwPinAscEnaC "..." VALUE 0x80058020 DATA_RECORD_UBYTE 1 Bool_ON_OFF 0 1 BIT_MASK 0x01 /end CHARACTERISTIC
/begin CHARACTERISTIC CCU6_f32DrvClkDutyThdHighC "..." VALUE 0x8005801C DATA_RECORD_FLOAT32_IEEE 3.402823466E+038 F_1_p0_2 -3.402823466E+038 3.402823466E+038 /end CHARACTERISTIC
/begin CHARACTERISTIC CCU6_f32DrvClkDutyThdLowC "..." VALUE 0x80058018 DATA_RECORD_FLOAT32_IEEE 3.402823466E+038 F_1_p0_2 -3.402823466E+038 3.402823466E+038 /end CHARACTERISTIC
/begin CHARACTERISTIC CCU6_kbDrvBdClkEnaC "..." VALUE 0x80058009 DATA_RECORD_UBYTE 1 Bool_ON_OFF 0 1 BIT_MASK 0x01 /end CHARACTERISTIC
/begin CHARACTERISTIC CCU6_kf32MidPointDutyHC "..." VALUE 0x80058014 DATA_RECORD_FLOAT32_IEEE 3.402823466E+038 F_1_p0_2 -3.402823466E+038 3.402823466E+038 /end CHARACTERISTIC
/begin CHARACTERISTIC CCU6_kf32MidPointDutyLC "..." VALUE 0x80058010 DATA_RECORD_FLOAT32_IEEE 3.402823466E+038 F_1_p0_2 -3.402823466E+038 3.402823466E+038 /end CHARACTERISTIC
/begin CHARACTERISTIC CCU6_ku16AlimDutyCycRawC "..." VALUE 0x80058092 DATA_RECORD_UWORD 65535 F_1_p0_2 0 65535 /end CHARACTERISTIC
/begin CHARACTERISTIC CCU6_ku32AlimFreqRawC "..." VALUE 0x80058AE0 DATA_RECORD_ULONG 4294967295 F_1_p0_2 0 4294967295 /end CHARACTERISTIC
/begin CHARACTERISTIC CCU6_ku8AscRecoverCntMaxC "..." VALUE 0x8005800D DATA_RECORD_UBYTE 255 F_1_p0_2 0 255 /end CHARACTERISTIC
/begin CHARACTERISTIC CCU6_ku8OvcRcvCntMaxC "..." VALUE 0x8005800C DATA_RECORD_UBYTE 255 F_1_p0_2 0 255 /end CHARACTERISTIC
/begin CHARACTERISTIC CCU6_ku8PwmMidPointFaultC "..." VALUE 0x8005800B DATA_RECORD_UBYTE 255 F_1_p0_2 0 255 /end CHARACTERISTIC
/begin CHARACTERISTIC CalUsr_ku32CalibUpdEnaMskA "..." VALUE 0x80058BB0 DATA_RECORD_ULONG 4294967295 I_1 0 4294967295 /end CHARACTERISTIC
/begin CHARACTERISTIC CalUsr_ku32CalibUpdEnaMskB "..." VALUE 0x80058BAC DATA_RECORD_ULONG 4294967295 I_1 0 4294967295 /end CHARACTERISTIC
/begin CHARACTERISTIC EAS_bDefaultEskPassC "..." VALUE 0x8009AD44 DATA_RECORD_UBYTE 1 Bool_ON_OFF 0 1 BIT_MASK 0x01 /end CHARACTERISTIC
/begin CHARACTERISTIC EAS_bRN32EnaOnC "Enable random number flag" VALUE 0x8009AD43 DATA_RECORD_UBYTE 1 Bool_ON_OFF 0 1 BIT_MASK 0x01 /end CHARACTERISTIC
/begin CHARACTERISTIC EAS_u8Chg1DelayTimoutC "..." VALUE 0x8009AD42 DATA_RECORD_UBYTE 255 I_1 0 255 /end CHARACTERISTIC
/begin CHARACTERISTIC ESM_u16PowerLatchTempoC "ESM_u16PowerLatchTempoC" VALUE 0x8009CA26 DATA_RECORD_UWORD 327675 F_5_p0_12 0 327675 /end CHARACTERISTIC
/begin CHARACTERISTIC ESM_u8RestartDelayCntC "ESM_u8RestartDelayCntC" VALUE 0x8009CA24 DATA_RECORD_UBYTE 1275 F_5_p0_12 0 1275 /end CHARACTERISTIC
/begin CHARACTERISTIC FAIL_bCanErrCheckonC "Check Can Error" VALUE 0x80058BE0 DATA_RECORD_UBYTE 1 Bool_ON_OFF 0 1 BIT_MASK 0x01 /end CHARACTERISTIC
/begin CHARACTERISTIC FaultEraseRequestC "FaultEraseRequestC" VALUE 0x80058094 DATA_RECORD_UWORD 65535 I_1 0 65535 /end CHARACTERISTIC
/begin CHARACTERISTIC GCCU6_ku8OvcRcvCntMaxC "..." VALUE 0x80058027 DATA_RECORD_UBYTE 255 F_1_p0_2 0 255 /end CHARACTERISTIC
/begin MEASUREMENT AMAIN_ESMGo2StartupIEvent "BSW Power on check finish flag." UBYTE Bool_ON_OFF 1 2 0 1 BIT_MASK 0x01 ECU_ADDRESS 0x7001FB41 /end MEASUREMENT
/begin MEASUREMENT AMAIN_EndTime "..." ULONG I_1 1 2 0 4294967295 ECU_ADDRESS 0x7001FB18 /end MEASUREMENT
/begin MEASUREMENT AMAIN_TotalTime "..." ULONG I_1 1 2 0 4294967295 ECU_ADDRESS 0x7001FB14 /end MEASUREMENT
/begin MEASUREMENT AMAIN_bBswReadySts "BSW Power on check finish flag." UBYTE Bool_ON_OFF 1 2 0 1 BIT_MASK 0x01 ECU_ADDRESS 0x7001FB48 /end MEASUREMENT
/begin MEASUREMENT AMAIN_bESMStarted "BSW Power on check finish flag." UBYTE Bool_ON_OFF 1 2 0 1 BIT_MASK 0x01 ECU_ADDRESS 0x7001FB47 /end MEASUREMENT
/begin MEASUREMENT AMAIN_bProgConditionOk "BSW Power on check finish flag." UBYTE Bool_ON_OFF 1 2 0 1 BIT_MASK 0x01 ECU_ADDRESS 0x7001FB40 /end MEASUREMENT
/begin MEASUREMENT AMAIN_bSoftOvBhvFlg "BSW Power on check finish flag." UBYTE Bool_ON_OFF 1 2 0 1 BIT_MASK 0x01 ECU_ADDRESS 0x7001FB46 /end MEASUREMENT
/begin MEASUREMENT AMAIN_bSoftOvCurrPhsUFlg "BSW Power on check finish flag." UBYTE Bool_ON_OFF 1 2 0 1 BIT_MASK 0x01 ECU_ADDRESS 0x7001FB45 /end MEASUREMENT
/begin MEASUREMENT AMAIN_bSoftOvCurrPhsVFlg "BSW Power on check finish flag." UBYTE Bool_ON_OFF 1 2 0 1 BIT_MASK 0x01 ECU_ADDRESS 0x7001FB44 /end MEASUREMENT
/begin MEASUREMENT AMAIN_bSoftOvCurrPhsWFlg "BSW Power on check finish flag." UBYTE Bool_ON_OFF 1 2 0 1 BIT_MASK 0x01 ECU_ADDRESS 0x7001FB43 /end MEASUREMENT
/begin MEASUREMENT AMAIN_bVSIStarted "BSW Power on check finish flag." UBYTE Bool_ON_OFF 1 2 0 1 BIT_MASK 0x01 ECU_ADDRESS 0x7001FB42 /end MEASUREMENT
/begin MEASUREMENT AMAIN_f32PWMDutyUPhys "..." FLOAT32_IEEE F_1_p0_2 1 2 -3.402823466E+038 3.402823466E+038 ECU_ADDRESS 0x7001FB3C /end MEASUREMENT
/begin MEASUREMENT AMAIN_f32PWMDutyVPhys "..." FLOAT32_IEEE F_1_p0_2 1 2 -3.402823466E+038 3.402823466E+038 ECU_ADDRESS 0x7001FB38 /end MEASUREMENT
/begin MEASUREMENT AMAIN_f32PWMDutyWPhys "..." FLOAT32_IEEE F_1_p0_2 1 2 -3.402823466E+038 3.402823466E+038 ECU_ADDRESS 0x7001FB34 /end MEASUREMENT
/begin MEASUREMENT AMAIN_startTime "..." ULONG I_1 1 2 0 4294967295 ECU_ADDRESS 0x7001FB1C /end MEASUREMENT
/begin MEASUREMENT AMAIN_u16ACMASCRecoverCnt "..." UWORD I_1 1 2 0 65535 ECU_ADDRESS 0x7002009E /end MEASUREMENT
/begin MEASUREMENT AMAIN_u16ACMASCStartupChkFaultHighCnt "..." UWORD I_1 1 2 0 65535 ECU_ADDRESS 0x700200A2 /end MEASUREMENT
/begin MEASUREMENT AMAIN_u16ACMASCStartupChkFaultLowCnt "..." UWORD I_1 1 2 0 65535 ECU_ADDRESS 0x700200A4 /end MEASUREMENT
/begin MEASUREMENT AMAIN_u16Cnt1 "..." UWORD I_1 1 2 0 65535 ECU_ADDRESS 0x7001FB30 /end MEASUREMENT
/begin MEASUREMENT AMAIN_u16Cnt10 "..." UWORD I_1 1 2 0 65535 ECU_ADDRESS 0x7001FB2A /end MEASUREMENT
/begin MEASUREMENT AMAIN_u16Cnt100 "..." UWORD I_1 1 2 0 65535 ECU_ADDRESS 0x7001FB28 /end MEASUREMENT
/begin MEASUREMENT AMAIN_u16Cnt2 "..." UWORD I_1 1 2 0 65535 ECU_ADDRESS 0x7001FB2E /end MEASUREMENT
/begin MEASUREMENT AMAIN_u16Cnt200 "..." UWORD I_1 1 2 0 65535 ECU_ADDRESS 0x7001FB26 /end MEASUREMENT
/begin MEASUREMENT AMAIN_u16Cnt5 "..." UWORD I_1 1 2 0 65535 ECU_ADDRESS 0x7001FB2C /end MEASUREMENT
/begin MEASUREMENT AMAIN_u16EPSASCRecoverCnt "..." UWORD I_1 1 2 0 65535 ECU_ADDRESS 0x700200A8 /end MEASUREMENT
/begin MEASUREMENT AMAIN_u16EPSASCStartupChkFaultHighCnt "..." UWORD I_1 1 2 0 65535 ECU_ADDRESS 0x700200AC /end MEASUREMENT
/begin MEASUREMENT AMAIN_u16EPSASCStartupChkFaultLowCnt "..." UWORD I_1 1 2 0 65535 ECU_ADDRESS 0x700200AE /end MEASUREMENT
/begin MEASUREMENT AMAIN_u16VadcPhaseCurU "..." UWORD I_1 1 2 0 65535 ECU_ADDRESS 0x7001FB24 /end MEASUREMENT
/begin MEASUREMENT AMAIN_u16VadcPhaseCurV "..." UWORD I_1 1 2 0 65535 ECU_ADDRESS 0x7001FB22 /end MEASUREMENT
/begin MEASUREMENT AMAIN_u16VadcPhaseCurW "..." UWORD I_1 1 2 0 65535 ECU_ADDRESS 0x7001FB20 /end MEASUREMENT
/begin MEASUREMENT AMAIN_u8ACMASCRecoverTimes "..." UBYTE I_1 1 2 0 255 ECU_ADDRESS 0x700200A0 /end MEASUREMENT
/begin MEASUREMENT AMAIN_u8DEV_Fault "-" UBYTE F_1_p0_2 1 2 0 255 MATRIX_DIM 16 1 1 ECU_ADDRESS 0x7001FB04 /end MEASUREMENT
/begin MEASUREMENT AMAIN_u8DEV_Fault[0] "AMAIN_u8DEV_Fault[0]" UBYTE F_1_p0_2 1 2 0 255 ECU_ADDRESS 0x7001FB04 /end MEASUREMENT
/begin MEASUREMENT AMAIN_u8DEV_Fault[10] "AMAIN_u8DEV_Fault[10]" UBYTE F_1_p0_2 1 2 0 255 ECU_ADDRESS 0x7001FB0E /end MEASUREMENT
/begin MEASUREMENT AMAIN_u8DEV_Fault[11] "AMAIN_u8DEV_Fault[11]" UBYTE F_1_p0_2 1 2 0 255 ECU_ADDRESS 0x7001FB0F /end MEASUREMENT
/begin MEASUREMENT AMAIN_u8DEV_Fault[12] "AMAIN_u8DEV_Fault[12]" UBYTE F_1_p0_2 1 2 0 255 ECU_ADDRESS 0x7001FB10 /end MEASUREMENT
/begin MEASUREMENT AMAIN_u8DEV_Fault[13] "AMAIN_u8DEV_Fault[13]" UBYTE F_1_p0_2 1 2 0 255 ECU_ADDRESS 0x7001FB11 /end MEASUREMENT
/begin MEASUREMENT AMAIN_u8DEV_Fault[14] "AMAIN_u8DEV_Fault[14]" UBYTE F_1_p0_2 1 2 0 255 ECU_ADDRESS 0x7001FB12 /end MEASUREMENT
/begin MEASUREMENT AMAIN_u8DEV_Fault[15] "AMAIN_u8DEV_Fault[15]" UBYTE F_1_p0_2 1 2 0 255 ECU_ADDRESS 0x7001FB13 /end MEASUREMENT
/begin MEASUREMENT AMAIN_u8DEV_Fault[1] "AMAIN_u8DEV_Fault[1]" UBYTE F_1_p0_2 1 2 0 255 ECU_ADDRESS 0x7001FB05 /end MEASUREMENT
/begin MEASUREMENT AMAIN_u8DEV_Fault[2] "AMAIN_u8DEV_Fault[2]" UBYTE F_1_p0_2 1 2 0 255 ECU_ADDRESS 0x7001FB06 /end MEASUREMENT
/begin MEASUREMENT AMAIN_u8DEV_Fault[3] "AMAIN_u8DEV_Fault[3]" UBYTE F_1_p0_2 1 2 0 255 ECU_ADDRESS 0x7001FB07 /end MEASUREMENT
/begin MEASUREMENT AMAIN_u8DEV_Fault[4] "AMAIN_u8DEV_Fault[4]" UBYTE F_1_p0_2 1 2 0 255 ECU_ADDRESS 0x7001FB08 /end MEASUREMENT
/begin MEASUREMENT AMAIN_u8DEV_Fault[5] "AMAIN_u8DEV_Fault[5]" UBYTE F_1_p0_2 1 2 0 255 ECU_ADDRESS 0x7001FB09 /end MEASUREMENT
/begin MEASUREMENT AMAIN_u8DEV_Fault[6] "AMAIN_u8DEV_Fault[6]" UBYTE F_1_p0_2 1 2 0 255 ECU_ADDRESS 0x7001FB0A /end MEASUREMENT
/begin MEASUREMENT AMAIN_u8DEV_Fault[7] "AMAIN_u8DEV_Fault[7]" UBYTE F_1_p0_2 1 2 0 255 ECU_ADDRESS 0x7001FB0B /end MEASUREMENT
/begin MEASUREMENT AMAIN_u8DEV_Fault[8] "AMAIN_u8DEV_Fault[8]" UBYTE F_1_p0_2 1 2 0 255 ECU_ADDRESS 0x7001FB0C /end MEASUREMENT
/begin MEASUREMENT AMAIN_u8DEV_Fault[9] "AMAIN_u8DEV_Fault[9]" UBYTE F_1_p0_2 1 2 0 255 ECU_ADDRESS 0x7001FB0D /end MEASUREMENT
/begin MEASUREMENT AMAIN_u8EPSASCRecoverTimes "..." UBYTE I_1 1 2 0 255 ECU_ADDRESS 0x700200AA /end MEASUREMENT
/begin MEASUREMENT ASWNM_bBusSleep "Shutdown request" UBYTE Bool_ON_OFF 1 2 0 1 BIT_MASK 0x01 ECU_ADDRESS 0x700159C4 /end MEASUREMENT
/begin MEASUREMENT ASWNM_bStayAwake "Shutdown request" UBYTE Bool_ON_OFF 1 2 0 1 BIT_MASK 0x01 ECU_ADDRESS 0x700159C0 /end MEASUREMENT
/begin MEASUREMENT ASWNM_u16AfterRunDelayTimes "ASWNM_u16AfterRunDelayTimes" UWORD I_1 1 2 0 65535 ECU_ADDRESS 0x700159BE /end MEASUREMENT
/begin MEASUREMENT ASWNM_u16Kl15Sts "ASWNM_u16Kl15Sts" UWORD I_1 1 2 0 65535 ECU_ADDRESS 0x700159C2 /end MEASUREMENT
/begin MEASUREMENT BLDC_f32BldcPosDuty "..." FLOAT32_IEEE I_1 1 2 -3.402823466E+038 3.402823466E+038 ECU_ADDRESS 0x700097AC /end MEASUREMENT
/begin MEASUREMENT BLDC_f32CurCycleDuty "..." FLOAT32_IEEE I_1 1 2 -3.402823466E+038 3.402823466E+038 ECU_ADDRESS 0x70009C4C /end MEASUREMENT
/begin MEASUREMENT BLDC_u16DutyDelayCnt "..." UWORD I_1 1 2 0 65535 ECU_ADDRESS 0x70009C44 /end MEASUREMENT
/begin MEASUREMENT BLDC_u32MotPosSigDuty "..." ULONG I_1 1 2 0 4294967295 ECU_ADDRESS 0x700097A4 /end MEASUREMENT
/begin MEASUREMENT BLDC_u32MotPosSigPerd "..." ULONG I_1 1 2 0 4294967295 ECU_ADDRESS 0x700097A8 /end MEASUREMENT
/begin MEASUREMENT BLDC_u8CurDirSts "..." UBYTE I_1 1 2 0 255 ECU_ADDRESS 0x70009C47 /end MEASUREMENT
/begin MEASUREMENT BLDC_u8DutyHoldTicks "..." UBYTE I_1 1 2 0 255 ECU_ADDRESS 0x70009C4A /end MEASUREMENT
/begin MEASUREMENT BLDC_u8DutyModeStt "..." UBYTE I_1 1 2 0 255 ECU_ADDRESS 0x70009C49 /end MEASUREMENT
/begin MEASUREMENT BLDC_u8HallStt "..." UBYTE I_1 1 2 0 255 ECU_ADDRESS 0x70009C48 /end MEASUREMENT
/begin MEASUREMENT BLDC_u8PrevDirSts "..." UBYTE I_1 1 2 0 255 ECU_ADDRESS 0x70009C46 /end MEASUREMENT
/begin MEASUREMENT BSW_bMKeyOnStatus "..." UBYTE Bool_ON_OFF 1 2 0 1 BIT_MASK 0x01 ECU_ADDRESS 0x70009C99 /end MEASUREMENT
/begin MEASUREMENT BSW_bOCDataNotRation "..." UBYTE Bool_ON_OFF 1 2 0 1 BIT_MASK 0x01 ECU_ADDRESS 0x70009C98 /end MEASUREMENT
/begin MEASUREMENT BSW_bRxTOutFlag_Can01_Rx01 "..." UBYTE Bool_ON_OFF 1 2 0 1 BIT_MASK 0x01 ECU_ADDRESS 0x70009D01 /end MEASUREMENT
/begin MEASUREMENT BSW_bRxTOutFlag_Can01_Rx02 "..." UBYTE Bool_ON_OFF 1 2 0 1 BIT_MASK 0x01 ECU_ADDRESS 0x70009D00 /end MEASUREMENT
/begin MEASUREMENT BSW_bRxTOutFlag_Can01_Rx03 "..." UBYTE Bool_ON_OFF 1 2 0 1 BIT_MASK 0x01 ECU_ADDRESS 0x70009CFF /end MEASUREMENT
/begin MEASUREMENT BSW_bRxTOutFlag_Can01_Rx04 "..." UBYTE Bool_ON_OFF 1 2 0 1 BIT_MASK 0x01 ECU_ADDRESS 0x70009CFE /end MEASUREMENT
/begin MEASUREMENT BSW_bRxTOutFlag_Can01_Rx05 "..." UBYTE Bool_ON_OFF 1 2 0 1 BIT_MASK 0x01 ECU_ADDRESS 0x70009CFD /end MEASUREMENT
/begin MEASUREMENT BSW_bRxTOutFlag_Can01_Rx06 "..." UBYTE Bool_ON_OFF 1 2 0 1 BIT_MASK 0x01 ECU_ADDRESS 0x70009CFC /end MEASUREMENT
/begin MEASUREMENT BSW_bRxTOutFlag_Can01_Rx07 "..." UBYTE Bool_ON_OFF 1 2 0 1 BIT_MASK 0x01 ECU_ADDRESS 0x70009CFB /end MEASUREMENT
/begin MEASUREMENT BSW_bRxTOutFlag_Can01_Rx08 "..." UBYTE Bool_ON_OFF 1 2 0 1 BIT_MASK 0x01 ECU_ADDRESS 0x70009CFA /end MEASUREMENT
/begin MEASUREMENT BSW_bRxTOutFlag_Can01_Rx09 "..." UBYTE Bool_ON_OFF 1 2 0 1 BIT_MASK 0x01 ECU_ADDRESS 0x70009CF9 /end MEASUREMENT
/begin MEASUREMENT BSW_bRxTOutFlag_Can01_Rx10 "..." UBYTE Bool_ON_OFF 1 2 0 1 BIT_MASK 0x01 ECU_ADDRESS 0x70009CF8 /end MEASUREMENT
/begin MEASUREMENT BSW_bRxTOutFlag_Can01_Rx11 "..." UBYTE Bool_ON_OFF 1 2 0 1 BIT_MASK 0x01 ECU_ADDRESS 0x70009CF7 /end MEASUREMENT
/begin MEASUREMENT BSW_bRxTOutFlag_Can01_Rx12 "..." UBYTE Bool_ON_OFF 1 2 0 1 BIT_MASK 0x01 ECU_ADDRESS 0x70009CF6 /end MEASUREMENT
/begin MEASUREMENT BSW_bRxTOutFlag_Can01_Rx13 "..." UBYTE Bool_ON_OFF 1 2 0 1 BIT_MASK 0x01 ECU_ADDRESS 0x70009CF5 /end MEASUREMENT
/begin MEASUREMENT BSW_bRxTOutFlag_Can01_Rx14 "..." UBYTE Bool_ON_OFF 1 2 0 1 BIT_MASK 0x01 ECU_ADDRESS 0x70009CF4 /end MEASUREMENT
/begin MEASUREMENT BSW_bRxTOutFlag_Can01_Rx15 "..." UBYTE Bool_ON_OFF 1 2 0 1 BIT_MASK 0x01 ECU_ADDRESS 0x70009CF3 /end MEASUREMENT
/begin MEASUREMENT BSW_bRxTOutFlag_Can01_Rx16 "..." UBYTE Bool_ON_OFF 1 2 0 1 BIT_MASK 0x01 ECU_ADDRESS 0x70009CF2 /end MEASUREMENT
/begin MEASUREMENT BSW_bRxTOutFlag_Can01_Rx17 "..." UBYTE Bool_ON_OFF 1 2 0 1 BIT_MASK 0x01 ECU_ADDRESS 0x70009CF1 /end MEASUREMENT
/begin MEASUREMENT BSW_bRxTOutFlag_Can01_Rx18 "..." UBYTE Bool_ON_OFF 1 2 0 1 BIT_MASK 0x01 ECU_ADDRESS 0x70009CF0 /end MEASUREMENT
/begin MEASUREMENT BSW_bRxTOutFlag_Can01_Rx19 "..." UBYTE Bool_ON_OFF 1 2 0 1 BIT_MASK 0x01 ECU_ADDRESS 0x70009CEF /end MEASUREMENT
/begin MEASUREMENT BSW_bRxTOutFlag_Can01_Rx20 "..." UBYTE Bool_ON_OFF 1 2 0 1 BIT_MASK 0x01 ECU_ADDRESS 0x70009CEE /end MEASUREMENT
/begin MEASUREMENT BSW_bRxTOutFlag_Can01_Rx21 "..." UBYTE Bool_ON_OFF 1 2 0 1 BIT_MASK 0x01 ECU_ADDRESS 0x70009CED /end MEASUREMENT
/begin MEASUREMENT BSW_bRxTOutFlag_Can01_Rx22 "..." UBYTE Bool_ON_OFF 1 2 0 1 BIT_MASK 0x01 ECU_ADDRESS 0x70009CEC /end MEASUREMENT
/begin MEASUREMENT BSW_bRxTOutFlag_Can01_Rx23 "..." UBYTE Bool_ON_OFF 1 2 0 1 BIT_MASK 0x01 ECU_ADDRESS 0x70009CEB /end MEASUREMENT
/begin MEASUREMENT BSW_bRxTOutFlag_Can01_Rx24 "..." UBYTE Bool_ON_OFF 1 2 0 1 BIT_MASK 0x01 ECU_ADDRESS 0x70009CEA /end MEASUREMENT
/begin MEASUREMENT BSW_bRxTOutFlag_Can01_Rx25 "..." UBYTE Bool_ON_OFF 1 2 0 1 BIT_MASK 0x01 ECU_ADDRESS 0x70009CE9 /end MEASUREMENT
/begin MEASUREMENT BSW_bRxTOutFlag_Can01_Rx26 "..." UBYTE Bool_ON_OFF 1 2 0 1 BIT_MASK 0x01 ECU_ADDRESS 0x70009CE8 /end MEASUREMENT
/begin MEASUREMENT BSW_bRxTOutFlag_Can01_Rx27 "..." UBYTE Bool_ON_OFF 1 2 0 1 BIT_MASK 0x01 ECU_ADDRESS 0x70009CE7 /end MEASUREMENT
/begin MEASUREMENT BSW_bRxTOutFlag_Can01_Rx28 "..." UBYTE Bool_ON_OFF 1 2 0 1 BIT_MASK 0x01 ECU_ADDRESS 0x70009CE6 /end MEASUREMENT
/begin MEASUREMENT BSW_bRxTOutFlag_Can01_Rx29 "..." UBYTE Bool_ON_OFF 1 2 0 1 BIT_MASK 0x01 ECU_ADDRESS 0x70009CE5 /end MEASUREMENT
/begin MEASUREMENT BSW_bRxTOutFlag_Can01_Rx30 "..." UBYTE Bool_ON_OFF 1 2 0 1 BIT_MASK 0x01 ECU_ADDRESS 0x70009CE4 /end MEASUREMENT
/begin MEASUREMENT BSW_bRxTOutFlag_Can01_Rx31 "..." UBYTE Bool_ON_OFF 1 2 0 1 BIT_MASK 0x01 ECU_ADDRESS 0x70009CE3 /end MEASUREMENT
/begin MEASUREMENT BSW_bRxTOutFlag_Can01_Rx32 "..." UBYTE Bool_ON_OFF 1 2 0 1 BIT_MASK 0x01 ECU_ADDRESS 0x70009CE2 /end MEASUREMENT
/begin MEASUREMENT BSW_bRxTOutFlag_Can01_Rx33 "..." UBYTE Bool_ON_OFF 1 2 0 1 BIT_MASK 0x01 ECU_ADDRESS 0x70009CE1 /end MEASUREMENT
/begin MEASUREMENT BSW_bRxTOutFlag_Can01_Rx34 "..." UBYTE Bool_ON_OFF 1 2 0 1 BIT_MASK 0x01 ECU_ADDRESS 0x70009CE0 /end MEASUREMENT
/begin MEASUREMENT BSW_bRxTOutFlag_Can01_Rx35 "..." UBYTE Bool_ON_OFF 1 2 0 1 BIT_MASK 0x01 ECU_ADDRESS 0x70009CDF /end MEASUREMENT
/begin MEASUREMENT BSW_bRxTOutFlag_Can01_Rx36 "..." UBYTE Bool_ON_OFF 1 2 0 1 BIT_MASK 0x01 ECU_ADDRESS 0x70009CDE /end MEASUREMENT
/begin MEASUREMENT BSW_bRxTOutFlag_Can01_Rx37 "..." UBYTE Bool_ON_OFF 1 2 0 1 BIT_MASK 0x01 ECU_ADDRESS 0x70009CDD /end MEASUREMENT
/begin MEASUREMENT BSW_bRxTOutFlag_Can01_Rx38 "..." UBYTE Bool_ON_OFF 1 2 0 1 BIT_MASK 0x01 ECU_ADDRESS 0x70009CDC /end MEASUREMENT
/begin MEASUREMENT BSW_bRxTOutFlag_Can01_Rx39 "..." UBYTE Bool_ON_OFF 1 2 0 1 BIT_MASK 0x01 ECU_ADDRESS 0x70009CDB /end MEASUREMENT
/begin MEASUREMENT BSW_bRxTOutFlag_Can01_Rx40 "..." UBYTE Bool_ON_OFF 1 2 0 1 BIT_MASK 0x01 ECU_ADDRESS 0x70009CDA /end MEASUREMENT
/begin MEASUREMENT BSW_bRxTOutFlag_Can02_Rx01 "..." UBYTE Bool_ON_OFF 1 2 0 1 BIT_MASK 0x01 ECU_ADDRESS 0x70009D51 /end MEASUREMENT
/begin MEASUREMENT BSW_bRxTOutFlag_Can02_Rx02 "..." UBYTE Bool_ON_OFF 1 2 0 1 BIT_MASK 0x01 ECU_ADDRESS 0x70009D50 /end MEASUREMENT
/begin MEASUREMENT BSW_bRxTOutFlag_Can02_Rx03 "..." UBYTE Bool_ON_OFF 1 2 0 1 BIT_MASK 0x01 ECU_ADDRESS 0x70009D4F /end MEASUREMENT
/begin MEASUREMENT BSW_bRxTOutFlag_Can02_Rx04 "..." UBYTE Bool_ON_OFF 1 2 0 1 BIT_MASK 0x01 ECU_ADDRESS 0x70009D4E /end MEASUREMENT
/begin MEASUREMENT BSW_bRxTOutFlag_Can02_Rx05 "..." UBYTE Bool_ON_OFF 1 2 0 1 BIT_MASK 0x01 ECU_ADDRESS 0x70009D4D /end MEASUREMENT
/begin MEASUREMENT BSW_bRxTOutFlag_Can02_Rx06 "..." UBYTE Bool_ON_OFF 1 2 0 1 BIT_MASK 0x01 ECU_ADDRESS 0x70009D4C /end MEASUREMENT
/begin MEASUREMENT BSW_bRxTOutFlag_Can02_Rx07 "..." UBYTE Bool_ON_OFF 1 2 0 1 BIT_MASK 0x01 ECU_ADDRESS 0x70009D4B /end MEASUREMENT
/begin MEASUREMENT BSW_bRxTOutFlag_Can02_Rx08 "..." UBYTE Bool_ON_OFF 1 2 0 1 BIT_MASK 0x01 ECU_ADDRESS 0x70009D4A /end MEASUREMENT
/begin MEASUREMENT BSW_bRxTOutFlag_Can02_Rx09 "..." UBYTE Bool_ON_OFF 1 2 0 1 BIT_MASK 0x01 ECU_ADDRESS 0x70009D49 /end MEASUREMENT
/begin MEASUREMENT BSW_bRxTOutFlag_Can02_Rx10 "..." UBYTE Bool_ON_OFF 1 2 0 1 BIT_MASK 0x01 ECU_ADDRESS 0x70009D48 /end MEASUREMENT
/begin MEASUREMENT BSW_bRxTOutFlag_Can02_Rx11 "..." UBYTE Bool_ON_OFF 1 2 0 1 BIT_MASK 0x01 ECU_ADDRESS 0x70009D47 /end MEASUREMENT
/begin MEASUREMENT BSW_bRxTOutFlag_Can02_Rx12 "..." UBYTE Bool_ON_OFF 1 2 0 1 BIT_MASK 0x01 ECU_ADDRESS 0x70009D46 /end MEASUREMENT
/begin MEASUREMENT BSW_bRxTOutFlag_Can02_Rx13 "..." UBYTE Bool_ON_OFF 1 2 0 1 BIT_MASK 0x01 ECU_ADDRESS 0x70009D45 /end MEASUREMENT
/begin MEASUREMENT BSW_bRxTOutFlag_Can02_Rx14 "..." UBYTE Bool_ON_OFF 1 2 0 1 BIT_MASK 0x01 ECU_ADDRESS 0x70009D44 /end MEASUREMENT
/begin MEASUREMENT BSW_bRxTOutFlag_Can02_Rx15 "..." UBYTE Bool_ON_OFF 1 2 0 1 BIT_MASK 0x01 ECU_ADDRESS 0x70009D43 /end MEASUREMENT
/begin MEASUREMENT BSW_bRxTOutFlag_Can02_Rx16 "..." UBYTE Bool_ON_OFF 1 2 0 1 BIT_MASK 0x01 ECU_ADDRESS 0x70009D42 /end MEASUREMENT
/begin MEASUREMENT BSW_bRxTOutFlag_Can02_Rx17 "..." UBYTE Bool_ON_OFF 1 2 0 1 BIT_MASK 0x01 ECU_ADDRESS 0x70009D41 /end MEASUREMENT
/begin MEASUREMENT BSW_bRxTOutFlag_Can02_Rx18 "..." UBYTE Bool_ON_OFF 1 2 0 1 BIT_MASK 0x01 ECU_ADDRESS 0x70009D40 /end MEASUREMENT
/begin MEASUREMENT BSW_bRxTOutFlag_Can02_Rx19 "..." UBYTE Bool_ON_OFF 1 2 0 1 BIT_MASK 0x01 ECU_ADDRESS 0x70009D3F /end MEASUREMENT
/begin MEASUREMENT BSW_bRxTOutFlag_Can02_Rx20 "..." UBYTE Bool_ON_OFF 1 2 0 1 BIT_MASK 0x01 ECU_ADDRESS 0x70009D3E /end MEASUREMENT
/begin MEASUREMENT BSW_bRxTOutFlag_Can02_Rx21 "..." UBYTE Bool_ON_OFF 1 2 0 1 BIT_MASK 0x01 ECU_ADDRESS 0x70009D3D /end MEASUREMENT
/begin MEASUREMENT BSW_bRxTOutFlag_Can02_Rx22 "..." UBYTE Bool_ON_OFF 1 2 0 1 BIT_MASK 0x01 ECU_ADDRESS 0x70009D3C /end MEASUREMENT
/begin MEASUREMENT BSW_bRxTOutFlag_Can02_Rx23 "..." UBYTE Bool_ON_OFF 1 2 0 1 BIT_MASK 0x01 ECU_ADDRESS 0x70009D3B /end MEASUREMENT
/begin MEASUREMENT BSW_bRxTOutFlag_Can02_Rx24 "..." UBYTE Bool_ON_OFF 1 2 0 1 BIT_MASK 0x01 ECU_ADDRESS 0x70009D3A /end MEASUREMENT
/begin MEASUREMENT BSW_bRxTOutFlag_Can02_Rx25 "..." UBYTE Bool_ON_OFF 1 2 0 1 BIT_MASK 0x01 ECU_ADDRESS 0x70009D39 /end MEASUREMENT
/begin MEASUREMENT BSW_bRxTOutFlag_Can02_Rx26 "..." UBYTE Bool_ON_OFF 1 2 0 1 BIT_MASK 0x01 ECU_ADDRESS 0x70009D38 /end MEASUREMENT
/begin MEASUREMENT BSW_bRxTOutFlag_Can02_Rx27 "..." UBYTE Bool_ON_OFF 1 2 0 1 BIT_MASK 0x01 ECU_ADDRESS 0x70009D37 /end MEASUREMENT
/begin MEASUREMENT BSW_bRxTOutFlag_Can02_Rx28 "..." UBYTE Bool_ON_OFF 1 2 0 1 BIT_MASK 0x01 ECU_ADDRESS 0x70009D36 /end MEASUREMENT
/begin MEASUREMENT BSW_bRxTOutFlag_Can02_Rx29 "..." UBYTE Bool_ON_OFF 1 2 0 1 BIT_MASK 0x01 ECU_ADDRESS 0x70009D35 /end MEASUREMENT
/begin MEASUREMENT BSW_bRxTOutFlag_Can02_Rx30 "..." UBYTE Bool_ON_OFF 1 2 0 1 BIT_MASK 0x01 ECU_ADDRESS 0x70009D34 /end MEASUREMENT
/begin MEASUREMENT BSW_bRxTOutFlag_Can02_Rx31 "..." UBYTE Bool_ON_OFF 1 2 0 1 BIT_MASK 0x01 ECU_ADDRESS 0x70009D33 /end MEASUREMENT
/begin MEASUREMENT BSW_bRxTOutFlag_Can02_Rx32 "..." UBYTE Bool_ON_OFF 1 2 0 1 BIT_MASK 0x01 ECU_ADDRESS 0x70009D32 /end MEASUREMENT
/begin MEASUREMENT BSW_bRxTOutFlag_Can02_Rx33 "..." UBYTE Bool_ON_OFF 1 2 0 1 BIT_MASK 0x01 ECU_ADDRESS 0x70009D31 /end MEASUREMENT
/begin MEASUREMENT BSW_bRxTOutFlag_Can02_Rx34 "..." UBYTE Bool_ON_OFF 1 2 0 1 BIT_MASK 0x01 ECU_ADDRESS 0x70009D30 /end MEASUREMENT
/begin MEASUREMENT BSW_bRxTOutFlag_Can02_Rx35 "..." UBYTE Bool_ON_OFF 1 2 0 1 BIT_MASK 0x01 ECU_ADDRESS 0x70009D2F /end MEASUREMENT
/begin MEASUREMENT BSW_bRxTOutFlag_Can02_Rx36 "..." UBYTE Bool_ON_OFF 1 2 0 1 BIT_MASK 0x01 ECU_ADDRESS 0x70009D2E /end MEASUREMENT
/begin MEASUREMENT BSW_bRxTOutFlag_Can02_Rx37 "..." UBYTE Bool_ON_OFF 1 2 0 1 BIT_MASK 0x01 ECU_ADDRESS 0x70009D2D /end MEASUREMENT
/begin MEASUREMENT BSW_bRxTOutFlag_Can02_Rx38 "..." UBYTE Bool_ON_OFF 1 2 0 1 BIT_MASK 0x01 ECU_ADDRESS 0x70009D2C /end MEASUREMENT
/begin MEASUREMENT BSW_bRxTOutFlag_Can02_Rx39 "..." UBYTE Bool_ON_OFF 1 2 0 1 BIT_MASK 0x01 ECU_ADDRESS 0x70009D2B /end MEASUREMENT
/begin MEASUREMENT BSW_bRxTOutFlag_Can02_Rx40 "..." UBYTE Bool_ON_OFF 1 2 0 1 BIT_MASK 0x01 ECU_ADDRESS 0x70009D2A /end MEASUREMENT
/begin MEASUREMENT BSW_bRxTOutFlag_Can03_Rx01 "..." UBYTE Bool_ON_OFF 1 2 0 1 BIT_MASK 0x01 ECU_ADDRESS 0x70009DA1 /end MEASUREMENT
/begin MEASUREMENT BSW_bRxTOutFlag_Can03_Rx02 "..." UBYTE Bool_ON_OFF 1 2 0 1 BIT_MASK 0x01 ECU_ADDRESS 0x70009DA0 /end MEASUREMENT
/begin MEASUREMENT BSW_bRxTOutFlag_Can03_Rx03 "..." UBYTE Bool_ON_OFF 1 2 0 1 BIT_MASK 0x01 ECU_ADDRESS 0x70009D9F /end MEASUREMENT
/begin MEASUREMENT BSW_bRxTOutFlag_Can03_Rx04 "..." UBYTE Bool_ON_OFF 1 2 0 1 BIT_MASK 0x01 ECU_ADDRESS 0x70009D9E /end MEASUREMENT
/begin MEASUREMENT BSW_bRxTOutFlag_Can03_Rx05 "..." UBYTE Bool_ON_OFF 1 2 0 1 BIT_MASK 0x01 ECU_ADDRESS 0x70009D9D /end MEASUREMENT
/begin MEASUREMENT BSW_bRxTOutFlag_Can03_Rx06 "..." UBYTE Bool_ON_OFF 1 2 0 1 BIT_MASK 0x01 ECU_ADDRESS 0x70009D9C /end MEASUREMENT
/begin MEASUREMENT BSW_bRxTOutFlag_Can03_Rx07 "..." UBYTE Bool_ON_OFF 1 2 0 1 BIT_MASK 0x01 ECU_ADDRESS 0x70009D9B /end MEASUREMENT
/begin MEASUREMENT BSW_bRxTOutFlag_Can03_Rx08 "..." UBYTE Bool_ON_OFF 1 2 0 1 BIT_MASK 0x01 ECU_ADDRESS 0x70009D9A /end MEASUREMENT
/begin MEASUREMENT BSW_bRxTOutFlag_Can03_Rx09 "..." UBYTE Bool_ON_OFF 1 2 0 1 BIT_MASK 0x01 ECU_ADDRESS 0x70009D99 /end MEASUREMENT
/begin MEASUREMENT BSW_bRxTOutFlag_Can03_Rx10 "..." UBYTE Bool_ON_OFF 1 2 0 1 BIT_MASK 0x01 ECU_ADDRESS 0x70009D98 /end MEASUREMENT
/begin MEASUREMENT BSW_bRxTOutFlag_Can03_Rx11 "..." UBYTE Bool_ON_OFF 1 2 0 1 BIT_MASK 0x01 ECU_ADDRESS 0x70009D97 /end MEASUREMENT
/begin MEASUREMENT BSW_bRxTOutFlag_Can03_Rx12 "..." UBYTE Bool_ON_OFF 1 2 0 1 BIT_MASK 0x01 ECU_ADDRESS 0x70009D96 /end MEASUREMENT
/begin MEASUREMENT BSW_bRxTOutFlag_Can03_Rx13 "..." UBYTE Bool_ON_OFF 1 2 0 1 BIT_MASK 0x01 ECU_ADDRESS 0x70009D95 /end MEASUREMENT
/begin MEASUREMENT BSW_bRxTOutFlag_Can03_Rx14 "..." UBYTE Bool_ON_OFF 1 2 0 1 BIT_MASK 0x01 ECU_ADDRESS 0x70009D94 /end MEASUREMENT
/begin MEASUREMENT BSW_bRxTOutFlag_Can03_Rx15 "..." UBYTE Bool_ON_OFF 1 2 0 1 BIT_MASK 0x01 ECU_ADDRESS 0x70009D93 /end MEASUREMENT
/begin MEASUREMENT BSW_bRxTOutFlag_Can03_Rx16 "..." UBYTE Bool_ON_OFF 1 2 0 1 BIT_MASK 0x01 ECU_ADDRESS 0x70009D92 /end MEASUREMENT
/begin MEASUREMENT BSW_bRxTOutFlag_Can03_Rx17 "..." UBYTE Bool_ON_OFF 1 2 0 1 BIT_MASK 0x01 ECU_ADDRESS 0x70009D91 /end MEASUREMENT
/begin MEASUREMENT BSW_bRxTOutFlag_Can03_Rx18 "..." UBYTE Bool_ON_OFF 1 2 0 1 BIT_MASK 0x01 ECU_ADDRESS 0x70009D90 /end MEASUREMENT
/begin MEASUREMENT BSW_bRxTOutFlag_Can03_Rx19 "..." UBYTE Bool_ON_OFF 1 2 0 1 BIT_MASK 0x01 ECU_ADDRESS 0x70009D8F /end MEASUREMENT
/begin MEASUREMENT BSW_bRxTOutFlag_Can03_Rx20 "..." UBYTE Bool_ON_OFF 1 2 0 1 BIT_MASK 0x01 ECU_ADDRESS 0x70009D8E /end MEASUREMENT
/begin MEASUREMENT BSW_bRxTOutFlag_Can03_Rx21 "..." UBYTE Bool_ON_OFF 1 2 0 1 BIT_MASK 0x01 ECU_ADDRESS 0x70009D8D /end MEASUREMENT
/begin MEASUREMENT BSW_bRxTOutFlag_Can03_Rx22 "..." UBYTE Bool_ON_OFF 1 2 0 1 BIT_MASK 0x01 ECU_ADDRESS 0x70009D8C /end MEASUREMENT
/begin MEASUREMENT BSW_bRxTOutFlag_Can03_Rx23 "..." UBYTE Bool_ON_OFF 1 2 0 1 BIT_MASK 0x01 ECU_ADDRESS 0x70009D8B /end MEASUREMENT
/begin MEASUREMENT BSW_bRxTOutFlag_Can03_Rx24 "..." UBYTE Bool_ON_OFF 1 2 0 1 BIT_MASK 0x01 ECU_ADDRESS 0x70009D8A /end MEASUREMENT
/begin MEASUREMENT BSW_bRxTOutFlag_Can03_Rx25 "..." UBYTE Bool_ON_OFF 1 2 0 1 BIT_MASK 0x01 ECU_ADDRESS 0x70009D89 /end MEASUREMENT
/begin MEASUREMENT BSW_bRxTOutFlag_Can03_Rx26 "..." UBYTE Bool_ON_OFF 1 2 0 1 BIT_MASK 0x01 ECU_ADDRESS 0x70009D88 /end MEASUREMENT
/begin MEASUREMENT BSW_bRxTOutFlag_Can03_Rx27 "..." UBYTE Bool_ON_OFF 1 2 0 1 BIT_MASK 0x01 ECU_ADDRESS 0x70009D87 /end MEASUREMENT
/begin MEASUREMENT BSW_bRxTOutFlag_Can03_Rx28 "..." UBYTE Bool_ON_OFF 1 2 0 1 BIT_MASK 0x01 ECU_ADDRESS 0x70009D86 /end MEASUREMENT
/begin MEASUREMENT BSW_bRxTOutFlag_Can03_Rx29 "..." UBYTE Bool_ON_OFF 1 2 0 1 BIT_MASK 0x01 ECU_ADDRESS 0x70009D85 /end MEASUREMENT
/begin MEASUREMENT BSW_bRxTOutFlag_Can03_Rx30 "..." UBYTE Bool_ON_OFF 1 2 0 1 BIT_MASK 0x01 ECU_ADDRESS 0x70009D84 /end MEASUREMENT
/begin MEASUREMENT BSW_bRxTOutFlag_Can03_Rx31 "..." UBYTE Bool_ON_OFF 1 2 0 1 BIT_MASK 0x01 ECU_ADDRESS 0x70009D83 /end MEASUREMENT
/begin MEASUREMENT BSW_bRxTOutFlag_Can03_Rx32 "..." UBYTE Bool_ON_OFF 1 2 0 1 BIT_MASK 0x01 ECU_ADDRESS 0x70009D82 /end MEASUREMENT
/begin MEASUREMENT BSW_bRxTOutFlag_Can03_Rx33 "..." UBYTE Bool_ON_OFF 1 2 0 1 BIT_MASK 0x01 ECU_ADDRESS 0x70009D81 /end MEASUREMENT
/begin MEASUREMENT BSW_bRxTOutFlag_Can03_Rx34 "..." UBYTE Bool_ON_OFF 1 2 0 1 BIT_MASK 0x01 ECU_ADDRESS 0x70009D80 /end MEASUREMENT
/begin MEASUREMENT BSW_bRxTOutFlag_Can03_Rx35 "..." UBYTE Bool_ON_OFF 1 2 0 1 BIT_MASK 0x01 ECU_ADDRESS 0x70009D7F /end MEASUREMENT
/begin MEASUREMENT BSW_bRxTOutFlag_Can03_Rx36 "..." UBYTE Bool_ON_OFF 1 2 0 1 BIT_MASK 0x01 ECU_ADDRESS 0x70009D7E /end MEASUREMENT
/begin MEASUREMENT BSW_bRxTOutFlag_Can03_Rx37 "..." UBYTE Bool_ON_OFF 1 2 0 1 BIT_MASK 0x01 ECU_ADDRESS 0x70009D7D /end MEASUREMENT
/begin MEASUREMENT BSW_bRxTOutFlag_Can03_Rx38 "..." UBYTE Bool_ON_OFF 1 2 0 1 BIT_MASK 0x01 ECU_ADDRESS 0x70009D7C /end MEASUREMENT
/begin MEASUREMENT BSW_bRxTOutFlag_Can03_Rx39 "..." UBYTE Bool_ON_OFF 1 2 0 1 BIT_MASK 0x01 ECU_ADDRESS 0x70009D7B /end MEASUREMENT
/begin MEASUREMENT BSW_bRxTOutFlag_Can03_Rx40 "..." UBYTE Bool_ON_OFF 1 2 0 1 BIT_MASK 0x01 ECU_ADDRESS 0x70009D7A /end MEASUREMENT
/begin MEASUREMENT BSW_bVsiReadySts "...." UBYTE Bool_ON_OFF 1 2 0 1 BIT_MASK 0x01 ECU_ADDRESS 0x70009C96 /end MEASUREMENT
/begin MEASUREMENT BSW_u16RawVolP5VBT "BSW_u16RawVolP5VBT" UWORD F_0v0012210012_p0_6 1 2 0 80.01831502 ECU_ADDRESS 0x70009C8C /end MEASUREMENT
/begin MEASUREMENT BSW_u16RawVolP5VCOM "BSW_u16RawVolP5VCOM" UWORD F_0v0012210012_p0_6 1 2 0 80.01831502 ECU_ADDRESS 0x70009C88 /end MEASUREMENT
/begin MEASUREMENT BSW_u16RawVolP5VHS "BSW_u16RawVolP5VHS" UWORD F_0v0012210012_p0_6 1 2 0 80.01831502 ECU_ADDRESS 0x70009C8E /end MEASUREMENT
/begin MEASUREMENT BSW_u16RawVolP5VLS "BSW_u16RawVolP5VLS" UWORD F_0v0012210012_p0_6 1 2 0 80.01831502 ECU_ADDRESS 0x70009C8A /end MEASUREMENT
/begin MEASUREMENT BSW_u16RawVolP5VREF "BSW_u16RawVolP5VREF" UWORD F_0v0012210012_p0_6 1 2 0 80.01831502 ECU_ADDRESS 0x70009C86 /end MEASUREMENT
/begin MEASUREMENT BSW_u16RawVolP9VMulti "BSW_u16RawVolP9VMulti" UWORD F_0v0012210012_p0_6 1 2 0 80.01831502 ECU_ADDRESS 0x70009C90 /end MEASUREMENT
/begin MEASUREMENT BSW_u16RawVolt15VRdc "BSW_u16RawVolt15VRdc" UWORD F_0v0012210012_p0_6 1 2 0 80.01831502 ECU_ADDRESS 0x70009C84 /end MEASUREMENT
/begin MEASUREMENT BSW_u16SelfChkDelay "...." UWORD I_1 1 2 0 65535 ECU_ADDRESS 0x70009C82 /end MEASUREMENT
/begin MEASUREMENT BSW_u16VsiReadyDelay "...." UWORD I_1 1 2 0 65535 ECU_ADDRESS 0x70009C80 /end MEASUREMENT
/begin MEASUREMENT BSW_u32VSICounterCkreq "..." ULONG I_1 1 2 0 4294967295 ECU_ADDRESS 0x70009C78 /end MEASUREMENT
/begin MEASUREMENT BSW_u8CAN0BusOffCounter "..." ULONG I_1 1 2 0 4294967295 ECU_ADDRESS 0x70009C68 /end MEASUREMENT
/begin MEASUREMENT BSW_u8CAN1BusOffCounter "..." ULONG I_1 1 2 0 4294967295 ECU_ADDRESS 0x70009C64 /end MEASUREMENT
/begin MEASUREMENT BSW_u8SelfChkErr "..." UBYTE I_1 1 2 0 255 ECU_ADDRESS 0x70009C93 /end MEASUREMENT
/begin MEASUREMENT CCU6_au32PWMOnTime "." ULONG F_1_p0_2 1 2 0 4294967295 MATRIX_DIM 3 1 1 ECU_ADDRESS 0x70012160 /end MEASUREMENT
/begin MEASUREMENT CCU6_au32PWMOnTime[0] "CCU6_au32PWMOnTime[0]" ULONG F_1_p0_2 1 2 0 4294967295 ECU_ADDRESS 0x70012160 /end MEASUREMENT
/begin MEASUREMENT CCU6_au32PWMOnTime[1] "CCU6_au32PWMOnTime[1]" ULONG F_1_p0_2 1 2 0 4294967295 ECU_ADDRESS 0x70012164 /end MEASUREMENT
/begin MEASUREMENT CCU6_au32PWMOnTime[2] "CCU6_au32PWMOnTime[2]" ULONG F_1_p0_2 1 2 0 4294967295 ECU_ADDRESS 0x70012168 /end MEASUREMENT
/begin MEASUREMENT CCU6_bAkdAfterAscReq "..." UBYTE Bool_ON_OFF 1 2 0 1 BIT_MASK 0x01 ECU_ADDRESS 0x70012191 /end MEASUREMENT
/begin MEASUREMENT CCU6_bClrTrapReq "..." UBYTE Bool_ON_OFF 1 2 0 1 BIT_MASK 0x01 ECU_ADDRESS 0x70012190 /end MEASUREMENT
/begin MEASUREMENT CCU6_bHwFaultDcOvVolt "..." UBYTE Bool_ON_OFF 1 2 0 1 BIT_MASK 0x01 ECU_ADDRESS 0x7001218F /end MEASUREMENT
/begin MEASUREMENT CCU6_bHwFaultIgbtH "..." UBYTE Bool_ON_OFF 1 2 0 1 BIT_MASK 0x01 ECU_ADDRESS 0x7001218E /end MEASUREMENT
/begin MEASUREMENT CCU6_bHwFaultIgbtL "..." UBYTE Bool_ON_OFF 1 2 0 1 BIT_MASK 0x01 ECU_ADDRESS 0x7001218D /end MEASUREMENT
/begin MEASUREMENT CCU6_bHwFaultOvcU "..." UBYTE Bool_ON_OFF 1 2 0 1 BIT_MASK 0x01 ECU_ADDRESS 0x7001218C /end MEASUREMENT
/begin MEASUREMENT CCU6_bHwFaultOvcV "..." UBYTE Bool_ON_OFF 1 2 0 1 BIT_MASK 0x01 ECU_ADDRESS 0x7001218B /end MEASUREMENT
/begin MEASUREMENT CCU6_bHwFaultOvcW "..." UBYTE Bool_ON_OFF 1 2 0 1 BIT_MASK 0x01 ECU_ADDRESS 0x7001218A /end MEASUREMENT
/begin MEASUREMENT CCU6_bIgbtHighSideShort "..." UBYTE Bool_ON_OFF 1 2 0 1 BIT_MASK 0x01 ECU_ADDRESS 0x70012189 /end MEASUREMENT
/begin MEASUREMENT CCU6_bIgbtLowSideShort "..." UBYTE Bool_ON_OFF 1 2 0 1 BIT_MASK 0x01 ECU_ADDRESS 0x70012188 /end MEASUREMENT
/begin MEASUREMENT CCU6_bIsCCU6Start "..." UBYTE Bool_ON_OFF 1 2 0 1 BIT_MASK 0x01 ECU_ADDRESS 0x70012187 /end MEASUREMENT
/begin MEASUREMENT CCU6_bIuvwCompReq "..." UBYTE Bool_ON_OFF 1 2 0 1 BIT_MASK 0x01 ECU_ADDRESS 0x70012186 /end MEASUREMENT
/begin MEASUREMENT CCU6_bMotorSpdRdy "..." UBYTE Bool_ON_OFF 1 2 0 1 BIT_MASK 0x01 ECU_ADDRESS 0x70012185 /end MEASUREMENT
/begin MEASUREMENT CCU6_bP5VDiagReinitCmd "..." UBYTE Bool_ON_OFF 1 2 0 1 BIT_MASK 0x01 ECU_ADDRESS 0x70012184 /end MEASUREMENT
/begin MEASUREMENT CCU6_bP5VHSFltFlg "..." UBYTE Bool_ON_OFF 1 2 0 1 BIT_MASK 0x01 ECU_ADDRESS 0x70012183 /end MEASUREMENT
/begin MEASUREMENT CCU6_bP5VLSFltFlg "..." UBYTE Bool_ON_OFF 1 2 0 1 BIT_MASK 0x01 ECU_ADDRESS 0x70012182 /end MEASUREMENT
/begin MEASUREMENT CCU6_bPwmMidPointU "..." UBYTE Bool_ON_OFF 1 2 0 1 BIT_MASK 0x01 ECU_ADDRESS 0x70012181 /end MEASUREMENT
/begin MEASUREMENT CCU6_bPwmMidPointV "..." UBYTE Bool_ON_OFF 1 2 0 1 BIT_MASK 0x01 ECU_ADDRESS 0x70012180 /end MEASUREMENT
/begin MEASUREMENT CCU6_bPwmMidPointW "..." UBYTE Bool_ON_OFF 1 2 0 1 BIT_MASK 0x01 ECU_ADDRESS 0x7001217F /end MEASUREMENT
/begin MEASUREMENT CCU6_bPwmOnGoingFlg "..." UBYTE Bool_ON_OFF 1 2 0 1 BIT_MASK 0x01 ECU_ADDRESS 0x7001217E /end MEASUREMENT
/begin MEASUREMENT CCU6_bT12ZeroMatchFlg "..." UBYTE Bool_ON_OFF 1 2 0 1 BIT_MASK 0x01 ECU_ADDRESS 0x7001217D /end MEASUREMENT
/begin MEASUREMENT CCU6_bTrapTrigger "..." UBYTE Bool_ON_OFF 1 2 0 1 BIT_MASK 0x01 ECU_ADDRESS 0x7001217C /end MEASUREMENT
/begin MEASUREMENT CCU6_f32HighVolPhys "..." FLOAT32_IEEE I_1 1 2 -3.402823466E+038 3.402823466E+038 ECU_ADDRESS 0x70012178 /end MEASUREMENT
/begin MEASUREMENT CCU6_f32PwmDutyPhysUZ "..." FLOAT32_IEEE I_1 1 2 -3.402823466E+038 3.402823466E+038 ECU_ADDRESS 0x70012174 /end MEASUREMENT
/begin MEASUREMENT CCU6_f32PwmDutyPhysVZ "..." FLOAT32_IEEE I_1 1 2 -3.402823466E+038 3.402823466E+038 ECU_ADDRESS 0x70012170 /end MEASUREMENT
/begin MEASUREMENT CCU6_f32PwmDutyPhysWZ "..." FLOAT32_IEEE I_1 1 2 -3.402823466E+038 3.402823466E+038 ECU_ADDRESS 0x7001216C /end MEASUREMENT
/begin MEASUREMENT CCU6_u16AlimPowerOnDelay "..." UWORD I_1 1 2 0 65535 ECU_ADDRESS 0x7001213C /end MEASUREMENT
/begin MEASUREMENT CCU6_u16CCU6T13CmpVal "PWM duty of CCU6" UWORD I_1 1 2 0 65535 ECU_ADDRESS 0x7000199A /end MEASUREMENT
/begin MEASUREMENT CCU6_u16HighVolAdc "..." UWORD I_1 1 2 0 65535 ECU_ADDRESS 0x7001213A /end MEASUREMENT
/begin MEASUREMENT CCU6_u16McuAscSttDelay "..." UWORD I_1 1 2 0 65535 ECU_ADDRESS 0x70012138 /end MEASUREMENT
/begin MEASUREMENT CCU6_u16P5VHSAdc "..." UWORD I_7 1 2 0 65535 ECU_ADDRESS 0x70012136 /end MEASUREMENT
/begin MEASUREMENT CCU6_u16PowerOnDelay "..." UWORD I_1 1 2 0 65535 ECU_ADDRESS 0x70012134 /end MEASUREMENT
/begin MEASUREMENT CCU6_u16PwmMaxDutyCyc "..." UWORD I_1 1 2 0 65535 ECU_ADDRESS 0x70012132 /end MEASUREMENT
/begin MEASUREMENT CCU6_u16PwmMidPointErrCnt "..." UWORD I_1 1 2 0 65535 ECU_ADDRESS 0x70012130 /end MEASUREMENT
/begin MEASUREMENT CCU6_u16PwmMinDutyCyc "..." UWORD I_1 1 2 0 65535 ECU_ADDRESS 0x7001212E /end MEASUREMENT
/begin MEASUREMENT CCU6_u16PwmModReq "..." UWORD I_1 1 2 0 65535 ECU_ADDRESS 0x7001212C /end MEASUREMENT
/begin MEASUREMENT CCU6_u16T12CntVal "..." UWORD I_1 1 2 0 65535 ECU_ADDRESS 0x7001212A /end MEASUREMENT
/begin MEASUREMENT CCU6_u16T12PeriodVal "..." UWORD I_1 1 2 0 65535 ECU_ADDRESS 0x70001998 /end MEASUREMENT
/begin MEASUREMENT CCU6_u16T13PeriodVal "..." UWORD I_1 1 2 0 65535 ECU_ADDRESS 0x70012128 /end MEASUREMENT
/begin MEASUREMENT CCU6_u32DrvClkHsDutyRaw "..." ULONG I_1 1 2 0 4294967295 ECU_ADDRESS 0x7001215C /end MEASUREMENT
/begin MEASUREMENT CCU6_u32DrvClkHsPerdRaw "..." ULONG I_1 1 2 0 4294967295 ECU_ADDRESS 0x70012158 /end MEASUREMENT
/begin MEASUREMENT CCU6_u32DrvClkLsDutyRaw "..." ULONG I_1 1 2 0 4294967295 ECU_ADDRESS 0x70012154 /end MEASUREMENT
/begin MEASUREMENT CCU6_u32DrvClkLsPerdRaw "..." ULONG I_1 1 2 0 4294967295 ECU_ADDRESS 0x70012150 /end MEASUREMENT
/begin MEASUREMENT CCU6_u32TrapCreq "..." ULONG I_1 1 2 0 4294967295 ECU_ADDRESS 0x7001214C /end MEASUREMENT
/begin MEASUREMENT CCU6_u8AscRecoverCnt "CCU6 State" UBYTE I_1 1 2 0 255 ECU_ADDRESS 0x70012148 /end MEASUREMENT
/begin MEASUREMENT CCU6_u8McuAscSttStep "CCU6 State" UBYTE I_1 1 2 0 255 ECU_ADDRESS 0x70012146 /end MEASUREMENT
/begin MEASUREMENT CCU6_u8McuAscType "CCU6 ASC Type" UBYTE I_1 1 2 0 255 ECU_ADDRESS 0x70012145 /end MEASUREMENT
/begin MEASUREMENT CCU6_u8OvcRcvCnt "..." UBYTE I_1 1 2 0 255 ECU_ADDRESS 0x70012147 /end MEASUREMENT
/begin MEASUREMENT CCU6_u8P5VHSFltCnt "..." UBYTE I_1 1 2 0 255 ECU_ADDRESS 0x70012144 /end MEASUREMENT
/begin MEASUREMENT CCU6_u8P5VLSFltCnt "..." UBYTE I_1 1 2 0 255 ECU_ADDRESS 0x70012143 /end MEASUREMENT
/begin MEASUREMENT CCU6_u8P5VPowerMngStt "..." UBYTE I_1 1 2 0 255 ECU_ADDRESS 0x70012142 /end MEASUREMENT
/begin MEASUREMENT CCU6_u8P5VSelfTstTimCnt "..." UBYTE I_1 1 2 0 255 ECU_ADDRESS 0x70012141 /end MEASUREMENT
/begin MEASUREMENT CCU6_u8PreTestStep "..." UBYTE I_1 1 2 0 255 ECU_ADDRESS 0x7001213F /end MEASUREMENT
/begin MEASUREMENT CCU6_u8PwmState "CCU6 State" UBYTE I_1 1 2 0 255 ECU_ADDRESS 0x7001213E /end MEASUREMENT
/begin MEASUREMENT CalUsr_bIsCalibUpdEna "Check whether OC enabled" UBYTE Bool_ON_OFF 1 2 0 1 BIT_MASK 0x01 ECU_ADDRESS 0x70009DB4 /end MEASUREMENT
/begin MEASUREMENT CalUsr_u32ChkDataCrc "." ULONG I_1 1 2 0 4294967295 ECU_ADDRESS 0x70009DB0 /end MEASUREMENT
/begin MEASUREMENT CalUsr_u32POCalibDnEnaMskA "." ULONG I_1 1 2 0 4294967295 ECU_ADDRESS 0x70009DAC /end MEASUREMENT
/begin MEASUREMENT CalUsr_u32POCalibDnEnaMskB "." ULONG I_1 1 2 0 4294967295 ECU_ADDRESS 0x70009DA8 /end MEASUREMENT
/begin MEASUREMENT CalUsr_u32PODataCRC "." ULONG I_1 1 2 0 4294967295 ECU_ADDRESS 0x70009DA4 /end MEASUREMENT
/begin MEASUREMENT DEVHAL_u8CheckEngineState "DEVHAL_u8CheckEngineState" UBYTE I_1 1 2 0 255 ECU_ADDRESS 0x70009DB5 /end MEASUREMENT
/begin MEASUREMENT DSM_DtcNumber "DSM_DtcNumber" ULONG I_1 1 2 0 4294967295 MATRIX_DIM 10 1 1 ECU_ADDRESS 0x700123C4 /end MEASUREMENT
/begin MEASUREMENT DSM_DtcNumber[0] "DSM_DtcNumber[0]" ULONG I_1 1 2 0 4294967295 ECU_ADDRESS 0x700123C4 /end MEASUREMENT
/begin MEASUREMENT DSM_DtcNumber[1] "DSM_DtcNumber[1]" ULONG I_1 1 2 0 4294967295 ECU_ADDRESS 0x700123C8 /end MEASUREMENT
/begin MEASUREMENT DSM_DtcNumber[2] "DSM_DtcNumber[2]" ULONG I_1 1 2 0 4294967295 ECU_ADDRESS 0x700123CC /end MEASUREMENT
/begin MEASUREMENT DSM_DtcNumber[3] "DSM_DtcNumber[3]" ULONG I_1 1 2 0 4294967295 ECU_ADDRESS 0x700123D0 /end MEASUREMENT
/begin MEASUREMENT DSM_DtcNumber[4] "DSM_DtcNumber[4]" ULONG I_1 1 2 0 4294967295 ECU_ADDRESS 0x700123D4 /end MEASUREMENT
/begin MEASUREMENT DSM_DtcNumber[5] "DSM_DtcNumber[5]" ULONG I_1 1 2 0 4294967295 ECU_ADDRESS 0x700123D8 /end MEASUREMENT
/begin MEASUREMENT DSM_DtcNumber[6] "DSM_DtcNumber[6]" ULONG I_1 1 2 0 4294967295 ECU_ADDRESS 0x700123DC /end MEASUREMENT
/begin MEASUREMENT DSM_DtcNumber[7] "DSM_DtcNumber[7]" ULONG I_1 1 2 0 4294967295 ECU_ADDRESS 0x700123E0 /end MEASUREMENT
/begin MEASUREMENT DSM_DtcNumber[8] "DSM_DtcNumber[8]" ULONG I_1 1 2 0 4294967295 ECU_ADDRESS 0x700123E4 /end MEASUREMENT
/begin MEASUREMENT DSM_DtcNumber[9] "DSM_DtcNumber[9]" ULONG I_1 1 2 0 4294967295 ECU_ADDRESS 0x700123E8 /end MEASUREMENT
/begin MEASUREMENT DSM_DtcStatusNvm "DID 120 -> DTC Setting Control" UBYTE F_1_p0_2 1 2 0 255 MATRIX_DIM 10 1 1 ECU_ADDRESS 0x70012CD4 /end MEASUREMENT
/begin MEASUREMENT DSM_DtcStatusNvm[0] "DSM_DtcStatusNvm[0]" UBYTE F_1_p0_2 1 2 0 255 ECU_ADDRESS 0x70012CD4 /end MEASUREMENT
/begin MEASUREMENT DSM_DtcStatusNvm[1] "DSM_DtcStatusNvm[1]" UBYTE F_1_p0_2 1 2 0 255 ECU_ADDRESS 0x70012CD5 /end MEASUREMENT
/begin MEASUREMENT DSM_DtcStatusNvm[2] "DSM_DtcStatusNvm[2]" UBYTE F_1_p0_2 1 2 0 255 ECU_ADDRESS 0x70012CD6 /end MEASUREMENT
/begin MEASUREMENT DSM_DtcStatusNvm[3] "DSM_DtcStatusNvm[3]" UBYTE F_1_p0_2 1 2 0 255 ECU_ADDRESS 0x70012CD7 /end MEASUREMENT
/begin MEASUREMENT DSM_DtcStatusNvm[4] "DSM_DtcStatusNvm[4]" UBYTE F_1_p0_2 1 2 0 255 ECU_ADDRESS 0x70012CD8 /end MEASUREMENT
/begin MEASUREMENT DSM_DtcStatusNvm[5] "DSM_DtcStatusNvm[5]" UBYTE F_1_p0_2 1 2 0 255 ECU_ADDRESS 0x70012CD9 /end MEASUREMENT
/begin MEASUREMENT DSM_DtcStatusNvm[6] "DSM_DtcStatusNvm[6]" UBYTE F_1_p0_2 1 2 0 255 ECU_ADDRESS 0x70012CDA /end MEASUREMENT
/begin MEASUREMENT DSM_DtcStatusNvm[7] "DSM_DtcStatusNvm[7]" UBYTE F_1_p0_2 1 2 0 255 ECU_ADDRESS 0x70012CDB /end MEASUREMENT
/begin MEASUREMENT DSM_DtcStatusNvm[8] "DSM_DtcStatusNvm[8]" UBYTE F_1_p0_2 1 2 0 255 ECU_ADDRESS 0x70012CDC /end MEASUREMENT
/begin MEASUREMENT DSM_DtcStatusNvm[9] "DSM_DtcStatusNvm[9]" UBYTE F_1_p0_2 1 2 0 255 ECU_ADDRESS 0x70012CDD /end MEASUREMENT
/begin MEASUREMENT DSM_FaultFailureLevel "DSM_FaultFailureLevel" UBYTE I_11 1 2 0 255 MATRIX_DIM 2 1 1 ECU_ADDRESS 0x700123BA /end MEASUREMENT
/begin MEASUREMENT DSM_FaultFailureLevel[0] "DSM_FaultFailureLevel[0]" UBYTE I_11 1 2 0 255 ECU_ADDRESS 0x700123BA /end MEASUREMENT
/begin MEASUREMENT DSM_FaultFailureLevel[1] "DSM_FaultFailureLevel[1]" UBYTE I_11 1 2 0 255 ECU_ADDRESS 0x700123BB /end MEASUREMENT
/begin MEASUREMENT EAS_au32PinESK32 "EAS_au32PinESK32" ULONG I_1 1 2 0 4294967295 MATRIX_DIM 4 1 1 ECU_ADDRESS 0x70013364 /end MEASUREMENT
/begin MEASUREMENT EAS_au32PinESK32[0] "EAS_au32PinESK32[0]" ULONG I_1 1 2 0 4294967295 ECU_ADDRESS 0x70013364 /end MEASUREMENT
/begin MEASUREMENT EAS_au32PinESK32[1] "EAS_au32PinESK32[1]" ULONG I_1 1 2 0 4294967295 ECU_ADDRESS 0x70013368 /end MEASUREMENT
/begin MEASUREMENT EAS_au32PinESK32[2] "EAS_au32PinESK32[2]" ULONG I_1 1 2 0 4294967295 ECU_ADDRESS 0x7001336C /end MEASUREMENT
/begin MEASUREMENT EAS_au32PinESK32[3] "EAS_au32PinESK32[3]" ULONG I_1 1 2 0 4294967295 ECU_ADDRESS 0x70013370 /end MEASUREMENT
/begin MEASUREMENT EAS_au8ComChallengeVal "EAS_au8ComChallengeVal" UBYTE I_1 1 2 0 255 MATRIX_DIM 8 1 1 ECU_ADDRESS 0x7001335B /end MEASUREMENT
/begin MEASUREMENT EAS_au8ComChallengeVal[0] "EAS_au8ComChallengeVal[0]" UBYTE I_1 1 2 0 255 ECU_ADDRESS 0x7001335B /end MEASUREMENT
/begin MEASUREMENT EAS_au8ComChallengeVal[1] "EAS_au8ComChallengeVal[1]" UBYTE I_1 1 2 0 255 ECU_ADDRESS 0x7001335C /end MEASUREMENT
/begin MEASUREMENT EAS_au8ComChallengeVal[2] "EAS_au8ComChallengeVal[2]" UBYTE I_1 1 2 0 255 ECU_ADDRESS 0x7001335D /end MEASUREMENT
/begin MEASUREMENT EAS_au8ComChallengeVal[3] "EAS_au8ComChallengeVal[3]" UBYTE I_1 1 2 0 255 ECU_ADDRESS 0x7001335E /end MEASUREMENT
/begin MEASUREMENT EAS_au8ComChallengeVal[4] "EAS_au8ComChallengeVal[4]" UBYTE I_1 1 2 0 255 ECU_ADDRESS 0x7001335F /end MEASUREMENT
/begin MEASUREMENT EAS_au8ComChallengeVal[5] "EAS_au8ComChallengeVal[5]" UBYTE I_1 1 2 0 255 ECU_ADDRESS 0x70013360 /end MEASUREMENT
/begin MEASUREMENT EAS_au8ComChallengeVal[6] "EAS_au8ComChallengeVal[6]" UBYTE I_1 1 2 0 255 ECU_ADDRESS 0x70013361 /end MEASUREMENT
/begin MEASUREMENT EAS_au8ComChallengeVal[7] "EAS_au8ComChallengeVal[7]" UBYTE I_1 1 2 0 255 ECU_ADDRESS 0x70013362 /end MEASUREMENT
/begin MEASUREMENT EAS_au8ComImmoCode "EAS_au8ComImmoCode" UBYTE I_1 1 2 0 255 MATRIX_DIM 8 1 1 ECU_ADDRESS 0x7001334B /end MEASUREMENT
/begin MEASUREMENT EAS_au8ComImmoCode[0] "EAS_au8ComImmoCode[0]" UBYTE I_1 1 2 0 255 ECU_ADDRESS 0x7001334B /end MEASUREMENT
/begin MEASUREMENT EAS_au8ComImmoCode[1] "EAS_au8ComImmoCode[1]" UBYTE I_1 1 2 0 255 ECU_ADDRESS 0x7001334C /end MEASUREMENT
/begin MEASUREMENT EAS_au8ComImmoCode[2] "EAS_au8ComImmoCode[2]" UBYTE I_1 1 2 0 255 ECU_ADDRESS 0x7001334D /end MEASUREMENT
/begin MEASUREMENT EAS_au8ComImmoCode[3] "EAS_au8ComImmoCode[3]" UBYTE I_1 1 2 0 255 ECU_ADDRESS 0x7001334E /end MEASUREMENT
/begin MEASUREMENT EAS_au8ComImmoCode[4] "EAS_au8ComImmoCode[4]" UBYTE I_1 1 2 0 255 ECU_ADDRESS 0x7001334F /end MEASUREMENT
/begin MEASUREMENT EAS_au8ComImmoCode[5] "EAS_au8ComImmoCode[5]" UBYTE I_1 1 2 0 255 ECU_ADDRESS 0x70013350 /end MEASUREMENT
/begin MEASUREMENT EAS_au8ComImmoCode[6] "EAS_au8ComImmoCode[6]" UBYTE I_1 1 2 0 255 ECU_ADDRESS 0x70013351 /end MEASUREMENT
/begin MEASUREMENT EAS_au8ComImmoCode[7] "EAS_au8ComImmoCode[7]" UBYTE I_1 1 2 0 255 ECU_ADDRESS 0x70013352 /end MEASUREMENT
/begin MEASUREMENT EAS_au8ParmCC64Nvm "EAS_au8ParmCC64Nvm" UBYTE I_1 1 2 0 255 MATRIX_DIM 8 1 1 ECU_ADDRESS 0x70013343 /end MEASUREMENT
/begin MEASUREMENT EAS_au8ParmCC64Nvm[0] "EAS_au8ParmCC64Nvm[0]" UBYTE I_1 1 2 0 255 ECU_ADDRESS 0x70013343 /end MEASUREMENT
/begin MEASUREMENT EAS_au8ParmCC64Nvm[1] "EAS_au8ParmCC64Nvm[1]" UBYTE I_1 1 2 0 255 ECU_ADDRESS 0x70013344 /end MEASUREMENT
/begin MEASUREMENT EAS_au8ParmCC64Nvm[2] "EAS_au8ParmCC64Nvm[2]" UBYTE I_1 1 2 0 255 ECU_ADDRESS 0x70013345 /end MEASUREMENT
/begin MEASUREMENT EAS_au8ParmCC64Nvm[3] "EAS_au8ParmCC64Nvm[3]" UBYTE I_1 1 2 0 255 ECU_ADDRESS 0x70013346 /end MEASUREMENT
/begin MEASUREMENT EAS_au8ParmCC64Nvm[4] "EAS_au8ParmCC64Nvm[4]" UBYTE I_1 1 2 0 255 ECU_ADDRESS 0x70013347 /end MEASUREMENT
/begin MEASUREMENT EAS_au8ParmCC64Nvm[5] "EAS_au8ParmCC64Nvm[5]" UBYTE I_1 1 2 0 255 ECU_ADDRESS 0x70013348 /end MEASUREMENT
/begin MEASUREMENT EAS_au8ParmCC64Nvm[6] "EAS_au8ParmCC64Nvm[6]" UBYTE I_1 1 2 0 255 ECU_ADDRESS 0x70013349 /end MEASUREMENT
/begin MEASUREMENT EAS_au8ParmCC64Nvm[7] "EAS_au8ParmCC64Nvm[7]" UBYTE I_1 1 2 0 255 ECU_ADDRESS 0x7001334A /end MEASUREMENT
/begin MEASUREMENT EAS_au8ParmEacEncr "EAS_au8ParmEacEncr" UBYTE I_1 1 2 0 255 MATRIX_DIM 16 1 1 ECU_ADDRESS 0x70013333 /end MEASUREMENT
/begin MEASUREMENT EAS_au8ParmEacEncr[0] "EAS_au8ParmEacEncr[0]" UBYTE I_1 1 2 0 255 ECU_ADDRESS 0x70013333 /end MEASUREMENT
/begin MEASUREMENT EAS_au8ParmEacEncr[10] "EAS_au8ParmEacEncr[10]" UBYTE I_1 1 2 0 255 ECU_ADDRESS 0x7001333D /end MEASUREMENT
/begin MEASUREMENT EAS_au8ParmEacEncr[11] "EAS_au8ParmEacEncr[11]" UBYTE I_1 1 2 0 255 ECU_ADDRESS 0x7001333E /end MEASUREMENT
/begin MEASUREMENT EAS_au8ParmEacEncr[12] "EAS_au8ParmEacEncr[12]" UBYTE I_1 1 2 0 255 ECU_ADDRESS 0x7001333F /end MEASUREMENT
/begin MEASUREMENT EAS_au8ParmEacEncr[13] "EAS_au8ParmEacEncr[13]" UBYTE I_1 1 2 0 255 ECU_ADDRESS 0x70013340 /end MEASUREMENT
/begin MEASUREMENT EAS_au8ParmEacEncr[14] "EAS_au8ParmEacEncr[14]" UBYTE I_1 1 2 0 255 ECU_ADDRESS 0x70013341 /end MEASUREMENT
/begin MEASUREMENT EAS_au8ParmEacEncr[15] "EAS_au8ParmEacEncr[15]" UBYTE I_1 1 2 0 255 ECU_ADDRESS 0x70013342 /end MEASUREMENT
/begin MEASUREMENT EAS_au8ParmEacEncr[1] "EAS_au8ParmEacEncr[1]" UBYTE I_1 1 2 0 255 ECU_ADDRESS 0x70013334 /end MEASUREMENT
/begin MEASUREMENT EAS_au8ParmEacEncr[2] "EAS_au8ParmEacEncr[2]" UBYTE I_1 1 2 0 255 ECU_ADDRESS 0x70013335 /end MEASUREMENT
/begin MEASUREMENT EAS_au8ParmEacEncr[3] "EAS_au8ParmEacEncr[3]" UBYTE I_1 1 2 0 255 ECU_ADDRESS 0x70013336 /end MEASUREMENT
/begin MEASUREMENT EAS_au8ParmEacEncr[4] "EAS_au8ParmEacEncr[4]" UBYTE I_1 1 2 0 255 ECU_ADDRESS 0x70013337 /end MEASUREMENT
/begin MEASUREMENT EAS_au8ParmEacEncr[5] "EAS_au8ParmEacEncr[5]" UBYTE I_1 1 2 0 255 ECU_ADDRESS 0x70013338 /end MEASUREMENT
/begin MEASUREMENT EAS_au8ParmEacEncr[6] "EAS_au8ParmEacEncr[6]" UBYTE I_1 1 2 0 255 ECU_ADDRESS 0x70013339 /end MEASUREMENT
/begin MEASUREMENT EAS_au8ParmEacEncr[7] "EAS_au8ParmEacEncr[7]" UBYTE I_1 1 2 0 255 ECU_ADDRESS 0x7001333A /end MEASUREMENT
/begin MEASUREMENT EAS_au8ParmEacEncr[8] "EAS_au8ParmEacEncr[8]" UBYTE I_1 1 2 0 255 ECU_ADDRESS 0x7001333B /end MEASUREMENT
/begin MEASUREMENT EAS_au8ParmEacEncr[9] "EAS_au8ParmEacEncr[9]" UBYTE I_1 1 2 0 255 ECU_ADDRESS 0x7001333C /end MEASUREMENT
/begin MEASUREMENT EAS_au8ParmEacSeed "EAS_au8ParmEacSeed" UBYTE I_1 1 2 0 255 MATRIX_DIM 16 1 1 ECU_ADDRESS 0x70013323 /end MEASUREMENT
/begin MEASUREMENT EAS_au8ParmEacSeed[0] "EAS_au8ParmEacSeed[0]" UBYTE I_1 1 2 0 255 ECU_ADDRESS 0x70013323 /end MEASUREMENT
/begin MEASUREMENT EAS_au8ParmEacSeed[10] "EAS_au8ParmEacSeed[10]" UBYTE I_1 1 2 0 255 ECU_ADDRESS 0x7001332D /end MEASUREMENT
/begin MEASUREMENT EAS_au8ParmEacSeed[11] "EAS_au8ParmEacSeed[11]" UBYTE I_1 1 2 0 255 ECU_ADDRESS 0x7001332E /end MEASUREMENT
/begin MEASUREMENT EAS_au8ParmEacSeed[12] "EAS_au8ParmEacSeed[12]" UBYTE I_1 1 2 0 255 ECU_ADDRESS 0x7001332F /end MEASUREMENT
/begin MEASUREMENT EAS_au8ParmEacSeed[13] "EAS_au8ParmEacSeed[13]" UBYTE I_1 1 2 0 255 ECU_ADDRESS 0x70013330 /end MEASUREMENT
/begin MEASUREMENT EAS_au8ParmEacSeed[14] "EAS_au8ParmEacSeed[14]" UBYTE I_1 1 2 0 255 ECU_ADDRESS 0x70013331 /end MEASUREMENT
/begin MEASUREMENT EAS_au8ParmEacSeed[15] "EAS_au8ParmEacSeed[15]" UBYTE I_1 1 2 0 255 ECU_ADDRESS 0x70013332 /end MEASUREMENT
/begin MEASUREMENT EAS_au8ParmEacSeed[1] "EAS_au8ParmEacSeed[1]" UBYTE I_1 1 2 0 255 ECU_ADDRESS 0x70013324 /end MEASUREMENT
/begin MEASUREMENT EAS_au8ParmEacSeed[2] "EAS_au8ParmEacSeed[2]" UBYTE I_1 1 2 0 255 ECU_ADDRESS 0x70013325 /end MEASUREMENT
/begin MEASUREMENT EAS_au8ParmEacSeed[3] "EAS_au8ParmEacSeed[3]" UBYTE I_1 1 2 0 255 ECU_ADDRESS 0x70013326 /end MEASUREMENT
/begin MEASUREMENT EAS_au8ParmEacSeed[4] "EAS_au8ParmEacSeed[4]" UBYTE I_1 1 2 0 255 ECU_ADDRESS 0x70013327 /end MEASUREMENT
/begin MEASUREMENT EAS_au8ParmEacSeed[5] "EAS_au8ParmEacSeed[5]" UBYTE I_1 1 2 0 255 ECU_ADDRESS 0x70013328 /end MEASUREMENT
/begin MEASUREMENT EAS_au8ParmEacSeed[6] "EAS_au8ParmEacSeed[6]" UBYTE I_1 1 2 0 255 ECU_ADDRESS 0x70013329 /end MEASUREMENT
/begin MEASUREMENT EAS_au8ParmEacSeed[7] "EAS_au8ParmEacSeed[7]" UBYTE I_1 1 2 0 255 ECU_ADDRESS 0x7001332A /end MEASUREMENT
/begin MEASUREMENT EAS_au8ParmEacSeed[8] "EAS_au8ParmEacSeed[8]" UBYTE I_1 1 2 0 255 ECU_ADDRESS 0x7001332B /end MEASUREMENT
/begin MEASUREMENT EAS_au8ParmEacSeed[9] "EAS_au8ParmEacSeed[9]" UBYTE I_1 1 2 0 255 ECU_ADDRESS 0x7001332C /end MEASUREMENT
/begin MEASUREMENT EAS_au8ParmEarEncr1 "EAS_au8ParmEarEncr1" UBYTE I_1 1 2 0 255 MATRIX_DIM 16 1 1 ECU_ADDRESS 0x70013313 /end MEASUREMENT
/begin MEASUREMENT EAS_au8ParmEarEncr1[0] "EAS_au8ParmEarEncr1[0]" UBYTE I_1 1 2 0 255 ECU_ADDRESS 0x70013313 /end MEASUREMENT
/begin MEASUREMENT EAS_au8ParmEarEncr1[10] "EAS_au8ParmEarEncr1[10]" UBYTE I_1 1 2 0 255 ECU_ADDRESS 0x7001331D /end MEASUREMENT
/begin MEASUREMENT EAS_au8ParmEarEncr1[11] "EAS_au8ParmEarEncr1[11]" UBYTE I_1 1 2 0 255 ECU_ADDRESS 0x7001331E /end MEASUREMENT
/begin MEASUREMENT EAS_au8ParmEarEncr1[12] "EAS_au8ParmEarEncr1[12]" UBYTE I_1 1 2 0 255 ECU_ADDRESS 0x7001331F /end MEASUREMENT
/begin MEASUREMENT EAS_au8ParmEarEncr1[13] "EAS_au8ParmEarEncr1[13]" UBYTE I_1 1 2 0 255 ECU_ADDRESS 0x70013320 /end MEASUREMENT
/begin MEASUREMENT EAS_au8ParmEarEncr1[14] "EAS_au8ParmEarEncr1[14]" UBYTE I_1 1 2 0 255 ECU_ADDRESS 0x70013321 /end MEASUREMENT
/begin MEASUREMENT EAS_au8ParmEarEncr1[15] "EAS_au8ParmEarEncr1[15]" UBYTE I_1 1 2 0 255 ECU_ADDRESS 0x70013322 /end MEASUREMENT
/begin MEASUREMENT EAS_au8ParmEarEncr1[1] "EAS_au8ParmEarEncr1[1]" UBYTE I_1 1 2 0 255 ECU_ADDRESS 0x70013314 /end MEASUREMENT
/begin MEASUREMENT EAS_au8ParmEarEncr1[2] "EAS_au8ParmEarEncr1[2]" UBYTE I_1 1 2 0 255 ECU_ADDRESS 0x70013315 /end MEASUREMENT
/begin MEASUREMENT EAS_au8ParmEarEncr1[3] "EAS_au8ParmEarEncr1[3]" UBYTE I_1 1 2 0 255 ECU_ADDRESS 0x70013316 /end MEASUREMENT
/begin MEASUREMENT EAS_au8ParmEarEncr1[4] "EAS_au8ParmEarEncr1[4]" UBYTE I_1 1 2 0 255 ECU_ADDRESS 0x70013317 /end MEASUREMENT
/begin MEASUREMENT EAS_au8ParmEarEncr1[5] "EAS_au8ParmEarEncr1[5]" UBYTE I_1 1 2 0 255 ECU_ADDRESS 0x70013318 /end MEASUREMENT
/begin MEASUREMENT EAS_au8ParmEarEncr1[6] "EAS_au8ParmEarEncr1[6]" UBYTE I_1 1 2 0 255 ECU_ADDRESS 0x70013319 /end MEASUREMENT
/begin MEASUREMENT EAS_au8ParmEarEncr1[7] "EAS_au8ParmEarEncr1[7]" UBYTE I_1 1 2 0 255 ECU_ADDRESS 0x7001331A /end MEASUREMENT
/begin MEASUREMENT EAS_au8ParmEarEncr1[8] "EAS_au8ParmEarEncr1[8]" UBYTE I_1 1 2 0 255 ECU_ADDRESS 0x7001331B /end MEASUREMENT
/begin MEASUREMENT EAS_au8ParmEarEncr1[9] "EAS_au8ParmEarEncr1[9]" UBYTE I_1 1 2 0 255 ECU_ADDRESS 0x7001331C /end MEASUREMENT
/begin MEASUREMENT EAS_au8ParmEarEncr2 "EAS_au8ParmEarEncr2" UBYTE I_1 1 2 0 255 MATRIX_DIM 16 1 1 ECU_ADDRESS 0x70013303 /end MEASUREMENT
/begin MEASUREMENT EAS_au8ParmEarEncr2[0] "EAS_au8ParmEarEncr2[0]" UBYTE I_1 1 2 0 255 ECU_ADDRESS 0x70013303 /end MEASUREMENT
/begin MEASUREMENT EAS_au8ParmEarEncr2[10] "EAS_au8ParmEarEncr2[10]" UBYTE I_1 1 2 0 255 ECU_ADDRESS 0x7001330D /end MEASUREMENT
/begin MEASUREMENT EAS_au8ParmEarEncr2[11] "EAS_au8ParmEarEncr2[11]" UBYTE I_1 1 2 0 255 ECU_ADDRESS 0x7001330E /end MEASUREMENT
/begin MEASUREMENT EAS_au8ParmEarEncr2[12] "EAS_au8ParmEarEncr2[12]" UBYTE I_1 1 2 0 255 ECU_ADDRESS 0x7001330F /end MEASUREMENT
/begin MEASUREMENT EAS_au8ParmEarEncr2[13] "EAS_au8ParmEarEncr2[13]" UBYTE I_1 1 2 0 255 ECU_ADDRESS 0x70013310 /end MEASUREMENT
/begin MEASUREMENT EAS_au8ParmEarEncr2[14] "EAS_au8ParmEarEncr2[14]" UBYTE I_1 1 2 0 255 ECU_ADDRESS 0x70013311 /end MEASUREMENT
/begin MEASUREMENT EAS_au8ParmEarEncr2[15] "EAS_au8ParmEarEncr2[15]" UBYTE I_1 1 2 0 255 ECU_ADDRESS 0x70013312 /end MEASUREMENT
/begin MEASUREMENT EAS_au8ParmEarEncr2[1] "EAS_au8ParmEarEncr2[1]" UBYTE I_1 1 2 0 255 ECU_ADDRESS 0x70013304 /end MEASUREMENT
/begin MEASUREMENT EAS_au8ParmEarEncr2[2] "EAS_au8ParmEarEncr2[2]" UBYTE I_1 1 2 0 255 ECU_ADDRESS 0x70013305 /end MEASUREMENT
/begin MEASUREMENT EAS_au8ParmEarEncr2[3] "EAS_au8ParmEarEncr2[3]" UBYTE I_1 1 2 0 255 ECU_ADDRESS 0x70013306 /end MEASUREMENT
/begin MEASUREMENT EAS_au8ParmEarEncr2[4] "EAS_au8ParmEarEncr2[4]" UBYTE I_1 1 2 0 255 ECU_ADDRESS 0x70013307 /end MEASUREMENT
/begin MEASUREMENT EAS_au8ParmEarEncr2[5] "EAS_au8ParmEarEncr2[5]" UBYTE I_1 1 2 0 255 ECU_ADDRESS 0x70013308 /end MEASUREMENT
/begin MEASUREMENT EAS_au8ParmEarEncr2[6] "EAS_au8ParmEarEncr2[6]" UBYTE I_1 1 2 0 255 ECU_ADDRESS 0x70013309 /end MEASUREMENT
/begin MEASUREMENT EAS_au8ParmEarEncr2[7] "EAS_au8ParmEarEncr2[7]" UBYTE I_1 1 2 0 255 ECU_ADDRESS 0x7001330A /end MEASUREMENT
/begin MEASUREMENT EAS_au8ParmEarEncr2[8] "EAS_au8ParmEarEncr2[8]" UBYTE I_1 1 2 0 255 ECU_ADDRESS 0x7001330B /end MEASUREMENT
/begin MEASUREMENT EAS_au8ParmEarEncr2[9] "EAS_au8ParmEarEncr2[9]" UBYTE I_1 1 2 0 255 ECU_ADDRESS 0x7001330C /end MEASUREMENT
/begin MEASUREMENT EAS_au8ParmRN32 "EAS_au8ParmRN32" UBYTE I_1 1 2 0 255 MATRIX_DIM 4 1 1 ECU_ADDRESS 0x700132FF /end MEASUREMENT
/begin MEASUREMENT EAS_au8ParmRN32[0] "EAS_au8ParmRN32[0]" UBYTE I_1 1 2 0 255 ECU_ADDRESS 0x700132FF /end MEASUREMENT
/begin MEASUREMENT EAS_au8ParmRN32[1] "EAS_au8ParmRN32[1]" UBYTE I_1 1 2 0 255 ECU_ADDRESS 0x70013300 /end MEASUREMENT
/begin MEASUREMENT EAS_au8ParmRN32[2] "EAS_au8ParmRN32[2]" UBYTE I_1 1 2 0 255 ECU_ADDRESS 0x70013301 /end MEASUREMENT
/begin MEASUREMENT EAS_au8ParmRN32[3] "EAS_au8ParmRN32[3]" UBYTE I_1 1 2 0 255 ECU_ADDRESS 0x70013302 /end MEASUREMENT
/begin MEASUREMENT EAS_au8ParmSC32Nvm "EAS_au8ParmSC32Nvm" UBYTE I_1 1 2 0 255 MATRIX_DIM 4 1 1 ECU_ADDRESS 0x700132FB /end MEASUREMENT
/begin MEASUREMENT EAS_au8ParmSC32Nvm[0] "EAS_au8ParmSC32Nvm[0]" UBYTE I_1 1 2 0 255 ECU_ADDRESS 0x700132FB /end MEASUREMENT
/begin MEASUREMENT EAS_au8ParmSC32Nvm[1] "EAS_au8ParmSC32Nvm[1]" UBYTE I_1 1 2 0 255 ECU_ADDRESS 0x700132FC /end MEASUREMENT
/begin MEASUREMENT EAS_au8ParmSC32Nvm[2] "EAS_au8ParmSC32Nvm[2]" UBYTE I_1 1 2 0 255 ECU_ADDRESS 0x700132FD /end MEASUREMENT
/begin MEASUREMENT EAS_au8ParmSC32Nvm[3] "EAS_au8ParmSC32Nvm[3]" UBYTE I_1 1 2 0 255 ECU_ADDRESS 0x700132FE /end MEASUREMENT
/begin MEASUREMENT EAS_au8ParmSK128Nvm "EAS_au8ParmSK128Nvm" UBYTE I_1 1 2 0 255 MATRIX_DIM 16 1 1 ECU_ADDRESS 0x700132EB /end MEASUREMENT
/begin MEASUREMENT EAS_au8ParmSK128Nvm[0] "EAS_au8ParmSK128Nvm[0]" UBYTE I_1 1 2 0 255 ECU_ADDRESS 0x700132EB /end MEASUREMENT
/begin MEASUREMENT EAS_au8ParmSK128Nvm[10] "EAS_au8ParmSK128Nvm[10]" UBYTE I_1 1 2 0 255 ECU_ADDRESS 0x700132F5 /end MEASUREMENT
/begin MEASUREMENT EAS_au8ParmSK128Nvm[11] "EAS_au8ParmSK128Nvm[11]" UBYTE I_1 1 2 0 255 ECU_ADDRESS 0x700132F6 /end MEASUREMENT
/begin MEASUREMENT EAS_au8ParmSK128Nvm[12] "EAS_au8ParmSK128Nvm[12]" UBYTE I_1 1 2 0 255 ECU_ADDRESS 0x700132F7 /end MEASUREMENT
/begin MEASUREMENT EAS_au8ParmSK128Nvm[13] "EAS_au8ParmSK128Nvm[13]" UBYTE I_1 1 2 0 255 ECU_ADDRESS 0x700132F8 /end MEASUREMENT
/begin MEASUREMENT EAS_au8ParmSK128Nvm[14] "EAS_au8ParmSK128Nvm[14]" UBYTE I_1 1 2 0 255 ECU_ADDRESS 0x700132F9 /end MEASUREMENT
/begin MEASUREMENT EAS_au8ParmSK128Nvm[15] "EAS_au8ParmSK128Nvm[15]" UBYTE I_1 1 2 0 255 ECU_ADDRESS 0x700132FA /end MEASUREMENT
/begin MEASUREMENT EAS_au8ParmSK128Nvm[1] "EAS_au8ParmSK128Nvm[1]" UBYTE I_1 1 2 0 255 ECU_ADDRESS 0x700132EC /end MEASUREMENT
/begin MEASUREMENT EAS_au8ParmSK128Nvm[2] "EAS_au8ParmSK128Nvm[2]" UBYTE I_1 1 2 0 255 ECU_ADDRESS 0x700132ED /end MEASUREMENT
/begin MEASUREMENT EAS_au8ParmSK128Nvm[3] "EAS_au8ParmSK128Nvm[3]" UBYTE I_1 1 2 0 255 ECU_ADDRESS 0x700132EE /end MEASUREMENT
/begin MEASUREMENT EAS_au8ParmSK128Nvm[4] "EAS_au8ParmSK128Nvm[4]" UBYTE I_1 1 2 0 255 ECU_ADDRESS 0x700132EF /end MEASUREMENT
/begin MEASUREMENT EAS_au8ParmSK128Nvm[5] "EAS_au8ParmSK128Nvm[5]" UBYTE I_1 1 2 0 255 ECU_ADDRESS 0x700132F0 /end MEASUREMENT
/begin MEASUREMENT EAS_au8ParmSK128Nvm[6] "EAS_au8ParmSK128Nvm[6]" UBYTE I_1 1 2 0 255 ECU_ADDRESS 0x700132F1 /end MEASUREMENT
/begin MEASUREMENT EAS_au8ParmSK128Nvm[7] "EAS_au8ParmSK128Nvm[7]" UBYTE I_1 1 2 0 255 ECU_ADDRESS 0x700132F2 /end MEASUREMENT
/begin MEASUREMENT EAS_au8ParmSK128Nvm[8] "EAS_au8ParmSK128Nvm[8]" UBYTE I_1 1 2 0 255 ECU_ADDRESS 0x700132F3 /end MEASUREMENT
/begin MEASUREMENT EAS_au8ParmSK128Nvm[9] "EAS_au8ParmSK128Nvm[9]" UBYTE I_1 1 2 0 255 ECU_ADDRESS 0x700132F4 /end MEASUREMENT
/begin MEASUREMENT EAS_bAesVerifyRes "..." UBYTE Bool_ON_OFF 1 2 0 1 BIT_MASK 0x01 ECU_ADDRESS 0x70013377 /end MEASUREMENT
/begin MEASUREMENT EAS_bDefaultEskFlg "..." UBYTE Bool_ON_OFF 1 2 0 1 BIT_MASK 0x01 ECU_ADDRESS 0x70013376 /end MEASUREMENT
/begin MEASUREMENT EAS_bImmoCodRcvFlg "..." UBYTE Bool_ON_OFF 1 2 0 1 BIT_MASK 0x01 ECU_ADDRESS 0x70013375 /end MEASUREMENT
/begin MEASUREMENT EAS_bSendNewChalgFlg "..." UBYTE Bool_ON_OFF 1 2 0 1 BIT_MASK 0x01 ECU_ADDRESS 0x70013374 /end MEASUREMENT
/begin MEASUREMENT EAS_u8AuthFailedCnt "." UBYTE I_1 1 2 0 255 ECU_ADDRESS 0x700132EA /end MEASUREMENT
/begin MEASUREMENT EAS_u8AuthState "." UBYTE I_1 1 2 0 255 ECU_ADDRESS 0x700132E9 /end MEASUREMENT
/begin MEASUREMENT EAS_u8AuthVerifyCnt "." UBYTE I_1 1 2 0 255 ECU_ADDRESS 0x700132E8 /end MEASUREMENT
/begin MEASUREMENT EAS_u8Chg1DelayCnt "." UBYTE I_1 1 2 0 255 ECU_ADDRESS 0x700132E7 /end MEASUREMENT
/begin MEASUREMENT EAS_u8ImmFailReason "." UBYTE I_1 1 2 0 255 ECU_ADDRESS 0x700132E6 /end MEASUREMENT
/begin MEASUREMENT EAS_u8SttTimerCnt "." UBYTE I_1 1 2 0 255 ECU_ADDRESS 0x700132E5 /end MEASUREMENT
/begin MEASUREMENT EAS_u8TMReleaseSig "..." UBYTE I_1 1 2 0 255 ECU_ADDRESS 0x700132E4 /end MEASUREMENT
/begin MEASUREMENT ESM_EcuState "ESM_EcuState" UBYTE I_1 1 2 0 255 ECU_ADDRESS 0x70013BDA /end MEASUREMENT
/begin MEASUREMENT ESM_OPERATIONAL_MODE "ESM_OPERATIONAL_MODE" UBYTE Bool_ON_OFF 1 2 0 1 BIT_MASK 0x04 ECU_ADDRESS 0x70013BDA /end MEASUREMENT
/begin MEASUREMENT ESM_POWERLATCH_MODE "ESM_POWERLATCH_MODE" UBYTE Bool_ON_OFF 1 2 0 1 BIT_MASK 0x08 ECU_ADDRESS 0x70013BDA /end MEASUREMENT
/begin MEASUREMENT ESM_POWER_OFF_MODE "ESM_POWER_OFF_MODE" UBYTE Bool_ON_OFF 1 2 0 1 BIT_MASK 0x10 ECU_ADDRESS 0x70013BDA /end MEASUREMENT
/begin MEASUREMENT ESM_STARTUP_II_MODE "ESM_STARTUP_II_MODE" UBYTE Bool_ON_OFF 1 2 0 1 BIT_MASK 0x02 ECU_ADDRESS 0x70013BDA /end MEASUREMENT
/begin MEASUREMENT ESM_STARTUP_I_MODE "ESM_STARTUP_I_MODE" UBYTE Bool_ON_OFF 1 2 0 1 BIT_MASK 0x01 ECU_ADDRESS 0x70013BDA /end MEASUREMENT
/begin MEASUREMENT ESM_u16PowerLatchTempo "ESM_u16PowerLatchTempo" UWORD F_5_p0_12 1 2 0 327675 ECU_ADDRESS 0x70013BD8 /end MEASUREMENT
/begin MEASUREMENT FAIL_bCanErrChkDisabled "Indicates if CAN error check is disabled" UBYTE Bool_ON_OFF 1 2 0 1 BIT_MASK 0x01 ECU_ADDRESS 0x70012D62 /end MEASUREMENT
/begin MEASUREMENT FAIL_bComLostDiagTEna "Indicates if external CAN communication started" UBYTE Bool_ON_OFF 1 2 0 1 BIT_MASK 0x01 ECU_ADDRESS 0x70012D61 /end MEASUREMENT
/begin MEASUREMENT FAIL_bComLostDiagVEna "Indicates if external CAN communication started" UBYTE Bool_ON_OFF 1 2 0 1 BIT_MASK 0x01 ECU_ADDRESS 0x70012D60 /end MEASUREMENT
/begin MEASUREMENT FAIL_bComLostDiagVHigh "Indicates if external CAN communication started" UBYTE Bool_ON_OFF 1 2 0 1 BIT_MASK 0x01 ECU_ADDRESS 0x70012D5F /end MEASUREMENT
/begin MEASUREMENT FAIL_bComLostDiagVLow "Indicates if external CAN communication started" UBYTE Bool_ON_OFF 1 2 0 1 BIT_MASK 0x01 ECU_ADDRESS 0x70012D5E /end MEASUREMENT
/begin MEASUREMENT FAIL_bDebug1 "FAIL_bDebug1" UBYTE Bool_ON_OFF 1 2 0 1 BIT_MASK 0x01 ECU_ADDRESS 0x70012D5D /end MEASUREMENT
/begin MEASUREMENT FAIL_bRstHotFlag "Detection power off without OS TASK_POWER_DOWN activation" UBYTE Bool_ON_OFF 1 2 0 1 BIT_MASK 0x01 ECU_ADDRESS 0x70012D5C /end MEASUREMENT
/begin MEASUREMENT FAIL_bRstHotFlagNvm "Flag to detect power off without OS TASK_POWER_DOWN activation (stored into NVM)" UBYTE Bool_ON_OFF 1 2 0 1 BIT_MASK 0x01 ECU_ADDRESS 0x70012D74 /end MEASUREMENT
/begin MEASUREMENT FAIL_u16ComLostDiagEnaCnt "ECU communication lost detection delay count" UWORD F_10_p0_4 1 2 0 655350 ECU_ADDRESS 0x70012D58 /end MEASUREMENT
/begin MEASUREMENT FAIL_u16ComLostDiagVRecCnt "ECU communication lost detection delay count" UWORD F_10_p0_4 1 2 0 655350 ECU_ADDRESS 0x70012D56 /end MEASUREMENT
/begin MEASUREMENT FAIL_u16KeyOnDelay "..." UWORD Id_0x00 1 2 0 65535 ECU_ADDRESS 0x70012D54 /end MEASUREMENT
/begin MEASUREMENT FAIL_u16KeyOnValue "ECU communication lost detection delay count" UWORD I_1 1 2 0 65535 ECU_ADDRESS 0x70012D52 /end MEASUREMENT
/begin MEASUREMENT FAIL_u16LvBatVoltRaw "ECU communication lost detection delay count" UWORD F_0v0128205128_p0_13 1 2 0 840.1923077 ECU_ADDRESS 0x70012D38 /end MEASUREMENT
/begin MEASUREMENT FAIL_u16RstHotCntNvm "Number of detection power off without OS TASK_POWER_DOWN activation (stored into NVM)" UWORD I_1 1 2 0 65535 ECU_ADDRESS 0x70012D76 /end MEASUREMENT
/begin MEASUREMENT FAIL_u16RstStartUpCntNvm "Number of power off detected with OS TASK_POWER_DOWN activation (stored into NVM)" UWORD I_1 1 2 0 65535 ECU_ADDRESS 0x70012D78 /end MEASUREMENT
/begin MEASUREMENT FAIL_u16Test "..." UWORD Id_0x00 1 2 0 65535 ECU_ADDRESS 0x70012D50 /end MEASUREMENT
/begin MEASUREMENT FAIL_u16TimestampIgnNvm "Inverter Ignition time stamp (s)" UWORD I_1 1 2 0 65535 ECU_ADDRESS 0x70012D64 /end MEASUREMENT
/begin MEASUREMENT FAIL_u32TimestampLifeNvm "Inverter life time stamp (s)" ULONG I_1 1 2 0 4294967295 ECU_ADDRESS 0x70012D68 /end MEASUREMENT
/begin MEASUREMENT FAIL_u8CCP_FaultLevel "..." UBYTE I_1 1 2 0 255 ECU_ADDRESS 0x70012D5A /end MEASUREMENT
/begin MEASUREMENT FaultBSW_COM_BusOff_CAN1Aut "FaultBSW_COM_BusOff_CAN1Aut" UBYTE Bool_ON_OFF 1 2 0 1 BIT_MASK 0x01 ECU_ADDRESS 0x70012E4A /end MEASUREMENT
/begin MEASUREMENT FaultBSW_COM_BusOff_CAN1Detected "FaultBSW_COM_BusOff_CAN1Detected" UBYTE Bool_ON_OFF 1 2 0 1 BIT_MASK 0x01 ECU_ADDRESS 0x70012FAE /end MEASUREMENT
/begin MEASUREMENT FaultBSW_COM_BusOff_CAN1Logged "FaultBSW_COM_BusOff_CAN1Logged" UBYTE Bool_ON_OFF 1 2 0 1 BIT_MASK 0x01 ECU_ADDRESS 0x70012EFC /end MEASUREMENT
/begin MEASUREMENT FaultBSW_COM_ChecksumErrVCUAut "FaultBSW_COM_ChecksumErrVCUAut" UBYTE Bool_ON_OFF 1 2 0 1 BIT_MASK 0x02 ECU_ADDRESS 0x70012E4A /end MEASUREMENT
/begin MEASUREMENT FaultBSW_COM_ChecksumErrVCUDetected "FaultBSW_COM_ChecksumErrVCUDetected" UBYTE Bool_ON_OFF 1 2 0 1 BIT_MASK 0x02 ECU_ADDRESS 0x70012FAE /end MEASUREMENT
/begin MEASUREMENT FaultBSW_COM_ChecksumErrVCULogged "FaultBSW_COM_ChecksumErrVCULogged" UBYTE Bool_ON_OFF 1 2 0 1 BIT_MASK 0x02 ECU_ADDRESS 0x70012EFC /end MEASUREMENT
/begin MEASUREMENT FaultBSW_COM_Detected "FaultBSW_COM_Detected" UWORD I_1 1 2 0 65535 ECU_ADDRESS 0x70012FAE /end MEASUREMENT
/begin MEASUREMENT FaultBSW_COM_InterFaultVCUAut "FaultBSW_COM_InterFaultVCUAut" UBYTE Bool_ON_OFF 1 2 0 1 BIT_MASK 0x04 ECU_ADDRESS 0x70012E4A /end MEASUREMENT
/begin MEASUREMENT FaultBSW_COM_InterFaultVCUDetected "FaultBSW_COM_InterFaultVCUDetected" UBYTE Bool_ON_OFF 1 2 0 1 BIT_MASK 0x04 ECU_ADDRESS 0x70012FAE /end MEASUREMENT
/begin MEASUREMENT FaultBSW_COM_InterFaultVCULogged "FaultBSW_COM_InterFaultVCULogged" UBYTE Bool_ON_OFF 1 2 0 1 BIT_MASK 0x04 ECU_ADDRESS 0x70012EFC /end MEASUREMENT
/begin MEASUREMENT FaultBSW_COM_Logged "FaultBSW_COM_Logged" UWORD I_1 1 2 0 65535 ECU_ADDRESS 0x70012EFC /end MEASUREMENT
/begin MEASUREMENT FaultBSW_COM_RollCntErrVCUAut "FaultBSW_COM_RollCntErrVCUAut" UBYTE Bool_ON_OFF 1 2 0 1 BIT_MASK 0x08 ECU_ADDRESS 0x70012E4A /end MEASUREMENT
/begin MEASUREMENT FaultBSW_COM_RollCntErrVCUDetected "FaultBSW_COM_RollCntErrVCUDetected" UBYTE Bool_ON_OFF 1 2 0 1 BIT_MASK 0x08 ECU_ADDRESS 0x70012FAE /end MEASUREMENT
/begin MEASUREMENT FaultBSW_COM_RollCntErrVCULogged "FaultBSW_COM_RollCntErrVCULogged" UBYTE Bool_ON_OFF 1 2 0 1 BIT_MASK 0x08 ECU_ADDRESS 0x70012EFC /end MEASUREMENT
/begin MEASUREMENT FaultBSW_COM_TimoutRxBCMAut "FaultBSW_COM_TimoutRxBCMAut" UBYTE Bool_ON_OFF 1 2 0 1 BIT_MASK 0x10 ECU_ADDRESS 0x70012E4A /end MEASUREMENT
/begin MEASUREMENT FaultBSW_COM_TimoutRxBCMDetected "FaultBSW_COM_TimoutRxBCMDetected" UBYTE Bool_ON_OFF 1 2 0 1 BIT_MASK 0x10 ECU_ADDRESS 0x70012FAE /end MEASUREMENT
/begin MEASUREMENT FaultBSW_COM_TimoutRxBCMLogged "FaultBSW_COM_TimoutRxBCMLogged" UBYTE Bool_ON_OFF 1 2 0 1 BIT_MASK 0x10 ECU_ADDRESS 0x70012EFC /end MEASUREMENT
/begin MEASUREMENT FaultBSW_COM_TimoutRxBMSHAut "FaultBSW_COM_TimoutRxBMSHAut" UBYTE Bool_ON_OFF 1 2 0 1 BIT_MASK 0x20 ECU_ADDRESS 0x70012E4A /end MEASUREMENT
/begin MEASUREMENT FaultBSW_COM_TimoutRxBMSHDetected "FaultBSW_COM_TimoutRxBMSHDetected" UBYTE Bool_ON_OFF 1 2 0 1 BIT_MASK 0x20 ECU_ADDRESS 0x70012FAE /end MEASUREMENT
/begin MEASUREMENT FaultBSW_COM_TimoutRxBMSHLogged "FaultBSW_COM_TimoutRxBMSHLogged" UBYTE Bool_ON_OFF 1 2 0 1 BIT_MASK 0x20 ECU_ADDRESS 0x70012EFC /end MEASUREMENT
/begin MEASUREMENT FaultBSW_COM_TimoutRxEMSAut "FaultBSW_COM_TimoutRxEMSAut" UBYTE Bool_ON_OFF 1 2 0 1 BIT_MASK 0x40 ECU_ADDRESS 0x70012E4A /end MEASUREMENT
/begin MEASUREMENT FaultBSW_COM_TimoutRxEMSDetected "FaultBSW_COM_TimoutRxEMSDetected" UBYTE Bool_ON_OFF 1 2 0 1 BIT_MASK 0x40 ECU_ADDRESS 0x70012FAE /end MEASUREMENT
/begin MEASUREMENT FaultBSW_COM_TimoutRxEMSLogged "FaultBSW_COM_TimoutRxEMSLogged" UBYTE Bool_ON_OFF 1 2 0 1 BIT_MASK 0x40 ECU_ADDRESS 0x70012EFC /end MEASUREMENT
/begin MEASUREMENT FaultBSW_COM_TimoutRxGCUAut "FaultBSW_COM_TimoutRxGCUAut" UBYTE Bool_ON_OFF 1 2 0 1 BIT_MASK 0x80 ECU_ADDRESS 0x70012E4A /end MEASUREMENT
/begin MEASUREMENT FaultBSW_COM_TimoutRxGCUDetected "FaultBSW_COM_TimoutRxGCUDetected" UBYTE Bool_ON_OFF 1 2 0 1 BIT_MASK 0x80 ECU_ADDRESS 0x70012FAE /end MEASUREMENT
/begin MEASUREMENT FaultBSW_COM_TimoutRxGCULogged "FaultBSW_COM_TimoutRxGCULogged" UBYTE Bool_ON_OFF 1 2 0 1 BIT_MASK 0x80 ECU_ADDRESS 0x70012EFC /end MEASUREMENT
/begin MEASUREMENT FaultBSW_COM_TimoutRxIPCAut "FaultBSW_COM_TimoutRxIPCAut" UBYTE Bool_ON_OFF 1 2 0 1 BIT_MASK 0x01 ECU_ADDRESS 0x70012E4B /end MEASUREMENT
/begin MEASUREMENT FaultBSW_COM_TimoutRxIPCDetected "FaultBSW_COM_TimoutRxIPCDetected" UBYTE Bool_ON_OFF 1 2 0 1 BIT_MASK 0x01 ECU_ADDRESS 0x70012FAF /end MEASUREMENT
/begin MEASUREMENT FaultBSW_COM_TimoutRxIPCLogged "FaultBSW_COM_TimoutRxIPCLogged" UBYTE Bool_ON_OFF 1 2 0 1 BIT_MASK 0x01 ECU_ADDRESS 0x70012EFD /end MEASUREMENT
/begin MEASUREMENT FaultBSW_COM_TimoutRxTBOXAut "FaultBSW_COM_TimoutRxTBOXAut" UBYTE Bool_ON_OFF 1 2 0 1 BIT_MASK 0x02 ECU_ADDRESS 0x70012E4B /end MEASUREMENT
/begin MEASUREMENT FaultBSW_COM_TimoutRxTBOXDetected "FaultBSW_COM_TimoutRxTBOXDetected" UBYTE Bool_ON_OFF 1 2 0 1 BIT_MASK 0x02 ECU_ADDRESS 0x70012FAF /end MEASUREMENT
/begin MEASUREMENT FaultBSW_COM_TimoutRxTBOXLogged "FaultBSW_COM_TimoutRxTBOXLogged" UBYTE Bool_ON_OFF 1 2 0 1 BIT_MASK 0x02 ECU_ADDRESS 0x70012EFD /end MEASUREMENT
/begin MEASUREMENT FaultBSW_COM_TimoutRxVCUAut "FaultBSW_COM_TimoutRxVCUAut" UBYTE Bool_ON_OFF 1 2 0 1 BIT_MASK 0x04 ECU_ADDRESS 0x70012E4B /end MEASUREMENT
/begin MEASUREMENT FaultBSW_COM_TimoutRxVCUDetected "FaultBSW_COM_TimoutRxVCUDetected" UBYTE Bool_ON_OFF 1 2 0 1 BIT_MASK 0x04 ECU_ADDRESS 0x70012FAF /end MEASUREMENT
/begin MEASUREMENT FaultBSW_COM_TimoutRxVCULogged "FaultBSW_COM_TimoutRxVCULogged" UBYTE Bool_ON_OFF 1 2 0 1 BIT_MASK 0x04 ECU_ADDRESS 0x70012EFD /end MEASUREMENT
/begin MEASUREMENT FaultBSW_HW2_Detected "FaultBSW_HW2_Detected" UWORD I_1 1 2 0 65535 ECU_ADDRESS 0x70012FB0 /end MEASUREMENT
/begin MEASUREMENT FaultBSW_HW2_FPGA_OverVoltVBatAut "FaultBSW_HW2_FPGA_OverVoltVBatAut" UBYTE Bool_ON_OFF 1 2 0 1 BIT_MASK 0x01 ECU_ADDRESS 0x70012E4C /end MEASUREMENT
/begin MEASUREMENT FaultBSW_HW2_FPGA_OverVoltVBatDetected "FaultBSW_HW2_FPGA_OverVoltVBatDetected" UBYTE Bool_ON_OFF 1 2 0 1 BIT_MASK 0x01 ECU_ADDRESS 0x70012FB0 /end MEASUREMENT
/begin MEASUREMENT FaultBSW_HW2_FPGA_OverVoltVBatLogged "FaultBSW_HW2_FPGA_OverVoltVBatLogged" UBYTE Bool_ON_OFF 1 2 0 1 BIT_MASK 0x01 ECU_ADDRESS 0x70012EFE /end MEASUREMENT
/begin MEASUREMENT FaultBSW_HW2_Logged "FaultBSW_HW2_Logged" UWORD I_1 1 2 0 65535 ECU_ADDRESS 0x70012EFE /end MEASUREMENT
/begin MEASUREMENT FaultBSW_HW2_SafeTlib_PreRunAut "FaultBSW_HW2_SafeTlib_PreRunAut" UBYTE Bool_ON_OFF 1 2 0 1 BIT_MASK 0x02 ECU_ADDRESS 0x70012E4C /end MEASUREMENT
/begin MEASUREMENT FaultBSW_HW2_SafeTlib_PreRunDetected "FaultBSW_HW2_SafeTlib_PreRunDetected" UBYTE Bool_ON_OFF 1 2 0 1 BIT_MASK 0x02 ECU_ADDRESS 0x70012FB0 /end MEASUREMENT
/begin MEASUREMENT FaultBSW_HW2_SafeTlib_PreRunLogged "FaultBSW_HW2_SafeTlib_PreRunLogged" UBYTE Bool_ON_OFF 1 2 0 1 BIT_MASK 0x02 ECU_ADDRESS 0x70012EFE /end MEASUREMENT
/begin MEASUREMENT FaultBSW_HW_Detected "FaultBSW_HW_Detected" UWORD I_1 1 2 0 65535 ECU_ADDRESS 0x70012FB2 /end MEASUREMENT
/begin MEASUREMENT FaultBSW_HW_EasAckFailAut "FaultBSW_HW_EasAckFailAut" UBYTE Bool_ON_OFF 1 2 0 1 BIT_MASK 0x01 ECU_ADDRESS 0x70012E4E /end MEASUREMENT
/begin MEASUREMENT FaultBSW_HW_EasAckFailDetected "FaultBSW_HW_EasAckFailDetected" UBYTE Bool_ON_OFF 1 2 0 1 BIT_MASK 0x01 ECU_ADDRESS 0x70012FB2 /end MEASUREMENT
/begin MEASUREMENT FaultBSW_HW_EasAckFailLogged "FaultBSW_HW_EasAckFailLogged" UBYTE Bool_ON_OFF 1 2 0 1 BIT_MASK 0x01 ECU_ADDRESS 0x70012F00 /end MEASUREMENT
/begin MEASUREMENT FaultBSW_HW_FPGA_IGBT_HAut "FaultBSW_HW_FPGA_IGBT_HAut" UBYTE Bool_ON_OFF 1 2 0 1 BIT_MASK 0x02 ECU_ADDRESS 0x70012E4E /end MEASUREMENT
/begin MEASUREMENT FaultBSW_HW_FPGA_IGBT_HDetected "FaultBSW_HW_FPGA_IGBT_HDetected" UBYTE Bool_ON_OFF 1 2 0 1 BIT_MASK 0x02 ECU_ADDRESS 0x70012FB2 /end MEASUREMENT
/begin MEASUREMENT FaultBSW_HW_FPGA_IGBT_HLogged "FaultBSW_HW_FPGA_IGBT_HLogged" UBYTE Bool_ON_OFF 1 2 0 1 BIT_MASK 0x02 ECU_ADDRESS 0x70012F00 /end MEASUREMENT
/begin MEASUREMENT FaultBSW_HW_FPGA_IGBT_LAut "FaultBSW_HW_FPGA_IGBT_LAut" UBYTE Bool_ON_OFF 1 2 0 1 BIT_MASK 0x04 ECU_ADDRESS 0x70012E4E /end MEASUREMENT
/begin MEASUREMENT FaultBSW_HW_FPGA_IGBT_LDetected "FaultBSW_HW_FPGA_IGBT_LDetected" UBYTE Bool_ON_OFF 1 2 0 1 BIT_MASK 0x04 ECU_ADDRESS 0x70012FB2 /end MEASUREMENT
/begin MEASUREMENT FaultBSW_HW_FPGA_IGBT_LLogged "FaultBSW_HW_FPGA_IGBT_LLogged" UBYTE Bool_ON_OFF 1 2 0 1 BIT_MASK 0x04 ECU_ADDRESS 0x70012F00 /end MEASUREMENT
/begin MEASUREMENT FaultBSW_HW_FPGA_OverUnderCurUIAut "FaultBSW_HW_FPGA_OverUnderCurUIAut" UBYTE Bool_ON_OFF 1 2 0 1 BIT_MASK 0x08 ECU_ADDRESS 0x70012E4E /end MEASUREMENT
/begin MEASUREMENT FaultBSW_HW_FPGA_OverUnderCurUIDetected "FaultBSW_HW_FPGA_OverUnderCurUIDetected" UBYTE Bool_ON_OFF 1 2 0 1 BIT_MASK 0x08 ECU_ADDRESS 0x70012FB2 /end MEASUREMENT
/begin MEASUREMENT FaultBSW_HW_FPGA_OverUnderCurUILogged "FaultBSW_HW_FPGA_OverUnderCurUILogged" UBYTE Bool_ON_OFF 1 2 0 1 BIT_MASK 0x08 ECU_ADDRESS 0x70012F00 /end MEASUREMENT
/begin MEASUREMENT FaultBSW_HW_FPGA_OverUnderCurVIAut "FaultBSW_HW_FPGA_OverUnderCurVIAut" UBYTE Bool_ON_OFF 1 2 0 1 BIT_MASK 0x10 ECU_ADDRESS 0x70012E4E /end MEASUREMENT
/begin MEASUREMENT FaultBSW_HW_FPGA_OverUnderCurVIDetected "FaultBSW_HW_FPGA_OverUnderCurVIDetected" UBYTE Bool_ON_OFF 1 2 0 1 BIT_MASK 0x10 ECU_ADDRESS 0x70012FB2 /end MEASUREMENT
/begin MEASUREMENT FaultBSW_HW_FPGA_OverUnderCurVILogged "FaultBSW_HW_FPGA_OverUnderCurVILogged" UBYTE Bool_ON_OFF 1 2 0 1 BIT_MASK 0x10 ECU_ADDRESS 0x70012F00 /end MEASUREMENT
/begin MEASUREMENT FaultBSW_HW_FPGA_OverUnderCurWIAut "FaultBSW_HW_FPGA_OverUnderCurWIAut" UBYTE Bool_ON_OFF 1 2 0 1 BIT_MASK 0x20 ECU_ADDRESS 0x70012E4E /end MEASUREMENT
/begin MEASUREMENT FaultBSW_HW_FPGA_OverUnderCurWIDetected "FaultBSW_HW_FPGA_OverUnderCurWIDetected" UBYTE Bool_ON_OFF 1 2 0 1 BIT_MASK 0x20 ECU_ADDRESS 0x70012FB2 /end MEASUREMENT
/begin MEASUREMENT FaultBSW_HW_FPGA_OverUnderCurWILogged "FaultBSW_HW_FPGA_OverUnderCurWILogged" UBYTE Bool_ON_OFF 1 2 0 1 BIT_MASK 0x20 ECU_ADDRESS 0x70012F00 /end MEASUREMENT
/begin MEASUREMENT FaultBSW_HW_Logged "FaultBSW_HW_Logged" UWORD I_1 1 2 0 65535 ECU_ADDRESS 0x70012F00 /end MEASUREMENT
/begin MEASUREMENT FaultBSW_HW_OCDataNotRationalAut "FaultBSW_HW_OCDataNotRationalAut" UBYTE Bool_ON_OFF 1 2 0 1 BIT_MASK 0x40 ECU_ADDRESS 0x70012E4E /end MEASUREMENT
/begin MEASUREMENT FaultBSW_HW_OCDataNotRationalDetected "FaultBSW_HW_OCDataNotRationalDetected" UBYTE Bool_ON_OFF 1 2 0 1 BIT_MASK 0x40 ECU_ADDRESS 0x70012FB2 /end MEASUREMENT
/begin MEASUREMENT FaultBSW_HW_OCDataNotRationalLogged "FaultBSW_HW_OCDataNotRationalLogged" UBYTE Bool_ON_OFF 1 2 0 1 BIT_MASK 0x40 ECU_ADDRESS 0x70012F00 /end MEASUREMENT
/begin MEASUREMENT FaultBSW_SYS_Detected "FaultBSW_SYS_Detected" UWORD I_1 1 2 0 65535 ECU_ADDRESS 0x70012FB4 /end MEASUREMENT
/begin MEASUREMENT FaultBSW_SYS_Logged "FaultBSW_SYS_Logged" UWORD I_1 1 2 0 65535 ECU_ADDRESS 0x70012F02 /end MEASUREMENT
/begin MEASUREMENT FaultBSW_SYS_RstHotAut "FaultBSW_SYS_RstHotAut" UBYTE Bool_ON_OFF 1 2 0 1 BIT_MASK 0x01 ECU_ADDRESS 0x70012E50 /end MEASUREMENT
/begin MEASUREMENT FaultBSW_SYS_RstHotDetected "FaultBSW_SYS_RstHotDetected" UBYTE Bool_ON_OFF 1 2 0 1 BIT_MASK 0x01 ECU_ADDRESS 0x70012FB4 /end MEASUREMENT
/begin MEASUREMENT FaultBSW_SYS_RstHotLogged "FaultBSW_SYS_RstHotLogged" UBYTE Bool_ON_OFF 1 2 0 1 BIT_MASK 0x01 ECU_ADDRESS 0x70012F02 /end MEASUREMENT
/begin MEASUREMENT FaultBSW_SYS_StackOverflowAut "FaultBSW_SYS_StackOverflowAut" UBYTE Bool_ON_OFF 1 2 0 1 BIT_MASK 0x02 ECU_ADDRESS 0x70012E50 /end MEASUREMENT
/begin MEASUREMENT FaultBSW_SYS_StackOverflowDetected "FaultBSW_SYS_StackOverflowDetected" UBYTE Bool_ON_OFF 1 2 0 1 BIT_MASK 0x02 ECU_ADDRESS 0x70012FB4 /end MEASUREMENT
/begin MEASUREMENT FaultBSW_SYS_StackOverflowLogged "FaultBSW_SYS_StackOverflowLogged" UBYTE Bool_ON_OFF 1 2 0 1 BIT_MASK 0x02 ECU_ADDRESS 0x70012F02 /end MEASUREMENT
/begin MEASUREMENT FaultBSW_VSI_Detected "FaultBSW_VSI_Detected" UWORD I_1 1 2 0 65535 ECU_ADDRESS 0x70012FB6 /end MEASUREMENT
/begin MEASUREMENT FaultBSW_VSI_Logged "FaultBSW_VSI_Logged" UWORD I_1 1 2 0 65535 ECU_ADDRESS 0x70012F04 /end MEASUREMENT
/begin MEASUREMENT FaultBSW_VSI_TimeoutTCalcAut "FaultBSW_VSI_TimeoutTCalcAut" UBYTE Bool_ON_OFF 1 2 0 1 BIT_MASK 0x01 ECU_ADDRESS 0x70012E52 /end MEASUREMENT
/begin MEASUREMENT FaultBSW_VSI_TimeoutTCalcDetected "FaultBSW_VSI_TimeoutTCalcDetected" UBYTE Bool_ON_OFF 1 2 0 1 BIT_MASK 0x01 ECU_ADDRESS 0x70012FB6 /end MEASUREMENT
/begin MEASUREMENT FaultBSW_VSI_TimeoutTCalcLogged "FaultBSW_VSI_TimeoutTCalcLogged" UBYTE Bool_ON_OFF 1 2 0 1 BIT_MASK 0x01 ECU_ADDRESS 0x70012F04 /end MEASUREMENT
/begin MEASUREMENT FaultEraseRequest "FaultEraseRequest" UWORD I_1 1 2 0 65535 ECU_ADDRESS 0x700123B8 /end MEASUREMENT
/begin MEASUREMENT FaultFSEVBHV_Detected "FaultFSEVBHV_Detected" UWORD I_1 1 2 0 65535 ECU_ADDRESS 0x70012FB8 /end MEASUREMENT
/begin MEASUREMENT FaultFSEVBHV_Logged "FaultFSEVBHV_Logged" UWORD I_1 1 2 0 65535 ECU_ADDRESS 0x70012F06 /end MEASUREMENT
/begin MEASUREMENT FaultFSEVBHV_OverVoltageAut "FaultFSEVBHV_OverVoltageAut" UBYTE Bool_ON_OFF 1 2 0 1 BIT_MASK 0x01 ECU_ADDRESS 0x70012E54 /end MEASUREMENT
/begin MEASUREMENT FaultFSEVBHV_OverVoltageDetected "FaultFSEVBHV_OverVoltageDetected" UBYTE Bool_ON_OFF 1 2 0 1 BIT_MASK 0x01 ECU_ADDRESS 0x70012FB8 /end MEASUREMENT
/begin MEASUREMENT FaultFSEVBHV_OverVoltageLogged "FaultFSEVBHV_OverVoltageLogged" UBYTE Bool_ON_OFF 1 2 0 1 BIT_MASK 0x01 ECU_ADDRESS 0x70012F06 /end MEASUREMENT
/begin MEASUREMENT FaultFSEVBHV_SampleVolOutRngHAut "FaultFSEVBHV_SampleVolOutRngHAut" UBYTE Bool_ON_OFF 1 2 0 1 BIT_MASK 0x02 ECU_ADDRESS 0x70012E54 /end MEASUREMENT
/begin MEASUREMENT FaultFSEVBHV_SampleVolOutRngHDetected "FaultFSEVBHV_SampleVolOutRngHDetected" UBYTE Bool_ON_OFF 1 2 0 1 BIT_MASK 0x02 ECU_ADDRESS 0x70012FB8 /end MEASUREMENT
/begin MEASUREMENT FaultFSEVBHV_SampleVolOutRngHLogged "FaultFSEVBHV_SampleVolOutRngHLogged" UBYTE Bool_ON_OFF 1 2 0 1 BIT_MASK 0x02 ECU_ADDRESS 0x70012F06 /end MEASUREMENT
/begin MEASUREMENT FaultFSEVBHV_SampleVolOutRngLAut "FaultFSEVBHV_SampleVolOutRngLAut" UBYTE Bool_ON_OFF 1 2 0 1 BIT_MASK 0x04 ECU_ADDRESS 0x70012E54 /end MEASUREMENT
/begin MEASUREMENT FaultFSEVBHV_SampleVolOutRngLDetected "FaultFSEVBHV_SampleVolOutRngLDetected" UBYTE Bool_ON_OFF 1 2 0 1 BIT_MASK 0x04 ECU_ADDRESS 0x70012FB8 /end MEASUREMENT
/begin MEASUREMENT FaultFSEVBHV_SampleVolOutRngLLogged "FaultFSEVBHV_SampleVolOutRngLLogged" UBYTE Bool_ON_OFF 1 2 0 1 BIT_MASK 0x04 ECU_ADDRESS 0x70012F06 /end MEASUREMENT
/begin MEASUREMENT FaultFSEVBHV_UnderDetected "FaultFSEVBHV_UnderDetected" UWORD I_1 1 2 0 65535 ECU_ADDRESS 0x70012FBA /end MEASUREMENT
/begin MEASUREMENT FaultFSEVBHV_UnderLogged "FaultFSEVBHV_UnderLogged" UWORD I_1 1 2 0 65535 ECU_ADDRESS 0x70012F08 /end MEASUREMENT
/begin MEASUREMENT FaultFSEVBHV_UnderVoltageAut "FaultFSEVBHV_UnderVoltageAut" UBYTE Bool_ON_OFF 1 2 0 1 BIT_MASK 0x08 ECU_ADDRESS 0x70012E54 /end MEASUREMENT
/begin MEASUREMENT FaultFSEVBHV_UnderVoltageDetected "FaultFSEVBHV_UnderVoltageDetected" UBYTE Bool_ON_OFF 1 2 0 1 BIT_MASK 0x08 ECU_ADDRESS 0x70012FB8 /end MEASUREMENT
/begin MEASUREMENT FaultFSEVBHV_UnderVoltageLogged "FaultFSEVBHV_UnderVoltageLogged" UBYTE Bool_ON_OFF 1 2 0 1 BIT_MASK 0x08 ECU_ADDRESS 0x70012F06 /end MEASUREMENT
/begin MEASUREMENT FaultFSEVBHV_UnderVoltageWarnAut "FaultFSEVBHV_UnderVoltageWarnAut" UBYTE Bool_ON_OFF 1 2 0 1 BIT_MASK 0x01 ECU_ADDRESS 0x70012E56 /end MEASUREMENT
/begin MEASUREMENT FaultFSEVBHV_UnderVoltageWarnDetected "FaultFSEVBHV_UnderVoltageWarnDetected" UBYTE Bool_ON_OFF 1 2 0 1 BIT_MASK 0x01 ECU_ADDRESS 0x70012FBA /end MEASUREMENT
/begin MEASUREMENT FaultFSEVBHV_UnderVoltageWarnLogged "FaultFSEVBHV_UnderVoltageWarnLogged" UBYTE Bool_ON_OFF 1 2 0 1 BIT_MASK 0x01 ECU_ADDRESS 0x70012F08 /end MEASUREMENT
/begin MEASUREMENT FaultFSEVBHV_VolNotRationalAut "FaultFSEVBHV_VolNotRationalAut" UBYTE Bool_ON_OFF 1 2 0 1 BIT_MASK 0x10 ECU_ADDRESS 0x70012E54 /end MEASUREMENT
/begin MEASUREMENT FaultFSEVBHV_VolNotRationalDetected "FaultFSEVBHV_VolNotRationalDetected" UBYTE Bool_ON_OFF 1 2 0 1 BIT_MASK 0x10 ECU_ADDRESS 0x70012FB8 /end MEASUREMENT
/begin MEASUREMENT FaultFSEVBHV_VolNotRationalLogged "FaultFSEVBHV_VolNotRationalLogged" UBYTE Bool_ON_OFF 1 2 0 1 BIT_MASK 0x10 ECU_ADDRESS 0x70012F06 /end MEASUREMENT
/begin MEASUREMENT FaultFSEVBHV_VoltageGndAut "FaultFSEVBHV_VoltageGndAut" UBYTE Bool_ON_OFF 1 2 0 1 BIT_MASK 0x20 ECU_ADDRESS 0x70012E54 /end MEASUREMENT
/begin MEASUREMENT FaultFSEVBHV_VoltageGndDetected "FaultFSEVBHV_VoltageGndDetected" UBYTE Bool_ON_OFF 1 2 0 1 BIT_MASK 0x20 ECU_ADDRESS 0x70012FB8 /end MEASUREMENT
/begin MEASUREMENT FaultFSEVBHV_VoltageGndLogged "FaultFSEVBHV_VoltageGndLogged" UBYTE Bool_ON_OFF 1 2 0 1 BIT_MASK 0x20 ECU_ADDRESS 0x70012F06 /end MEASUREMENT
/begin MEASUREMENT FaultFSEVBHV_VoltageVccAut "FaultFSEVBHV_VoltageVccAut" UBYTE Bool_ON_OFF 1 2 0 1 BIT_MASK 0x40 ECU_ADDRESS 0x70012E54 /end MEASUREMENT
/begin MEASUREMENT FaultFSEVBHV_VoltageVccDetected "FaultFSEVBHV_VoltageVccDetected" UBYTE Bool_ON_OFF 1 2 0 1 BIT_MASK 0x40 ECU_ADDRESS 0x70012FB8 /end MEASUREMENT
/begin MEASUREMENT FaultFSEVBHV_VoltageVccLogged "FaultFSEVBHV_VoltageVccLogged" UBYTE Bool_ON_OFF 1 2 0 1 BIT_MASK 0x40 ECU_ADDRESS 0x70012F06 /end MEASUREMENT
/begin MEASUREMENT FaultFSEVBLV_Detected "FaultFSEVBLV_Detected" UWORD I_1 1 2 0 65535 ECU_ADDRESS 0x70012FBC /end MEASUREMENT
/begin MEASUREMENT FaultFSEVBLV_Logged "FaultFSEVBLV_Logged" UWORD I_1 1 2 0 65535 ECU_ADDRESS 0x70012F0A /end MEASUREMENT
/begin MEASUREMENT FaultFSEVBLV_OverVoltageAut "FaultFSEVBLV_OverVoltageAut" UBYTE Bool_ON_OFF 1 2 0 1 BIT_MASK 0x01 ECU_ADDRESS 0x70012E58 /end MEASUREMENT
/begin MEASUREMENT FaultFSEVBLV_OverVoltageDetected "FaultFSEVBLV_OverVoltageDetected" UBYTE Bool_ON_OFF 1 2 0 1 BIT_MASK 0x01 ECU_ADDRESS 0x70012FBC /end MEASUREMENT
/begin MEASUREMENT FaultFSEVBLV_OverVoltageLogged "FaultFSEVBLV_OverVoltageLogged" UBYTE Bool_ON_OFF 1 2 0 1 BIT_MASK 0x01 ECU_ADDRESS 0x70012F0A /end MEASUREMENT
/begin MEASUREMENT FaultFSEVBLV_P5VRefADCFltAut "FaultFSEVBLV_P5VRefADCFltAut" UBYTE Bool_ON_OFF 1 2 0 1 BIT_MASK 0x02 ECU_ADDRESS 0x70012E58 /end MEASUREMENT
/begin MEASUREMENT FaultFSEVBLV_P5VRefADCFltDetected "FaultFSEVBLV_P5VRefADCFltDetected" UBYTE Bool_ON_OFF 1 2 0 1 BIT_MASK 0x02 ECU_ADDRESS 0x70012FBC /end MEASUREMENT
/begin MEASUREMENT FaultFSEVBLV_P5VRefADCFltLogged "FaultFSEVBLV_P5VRefADCFltLogged" UBYTE Bool_ON_OFF 1 2 0 1 BIT_MASK 0x02 ECU_ADDRESS 0x70012F0A /end MEASUREMENT
/begin MEASUREMENT FaultFSEVBLV_UnderDetected "FaultFSEVBLV_UnderDetected" UWORD I_1 1 2 0 65535 ECU_ADDRESS 0x70012FBE /end MEASUREMENT
/begin MEASUREMENT FaultFSEVBLV_UnderLogged "FaultFSEVBLV_UnderLogged" UWORD I_1 1 2 0 65535 ECU_ADDRESS 0x70012F0C /end MEASUREMENT
/begin MEASUREMENT FaultFSEVBLV_UnderVoltageAut "FaultFSEVBLV_UnderVoltageAut" UBYTE Bool_ON_OFF 1 2 0 1 BIT_MASK 0x04 ECU_ADDRESS 0x70012E58 /end MEASUREMENT
/begin MEASUREMENT FaultFSEVBLV_UnderVoltageDetected "FaultFSEVBLV_UnderVoltageDetected" UBYTE Bool_ON_OFF 1 2 0 1 BIT_MASK 0x04 ECU_ADDRESS 0x70012FBC /end MEASUREMENT
/begin MEASUREMENT FaultFSEVBLV_UnderVoltageLogged "FaultFSEVBLV_UnderVoltageLogged" UBYTE Bool_ON_OFF 1 2 0 1 BIT_MASK 0x04 ECU_ADDRESS 0x70012F0A /end MEASUREMENT
/begin MEASUREMENT FaultFSEVBLV_UnderVoltageWarnAut "FaultFSEVBLV_UnderVoltageWarnAut" UBYTE Bool_ON_OFF 1 2 0 1 BIT_MASK 0x01 ECU_ADDRESS 0x70012E5A /end MEASUREMENT
/begin MEASUREMENT FaultFSEVBLV_UnderVoltageWarnDetected "FaultFSEVBLV_UnderVoltageWarnDetected" UBYTE Bool_ON_OFF 1 2 0 1 BIT_MASK 0x01 ECU_ADDRESS 0x70012FBE /end MEASUREMENT
/begin MEASUREMENT FaultFSEVBLV_UnderVoltageWarnLogged "FaultFSEVBLV_UnderVoltageWarnLogged" UBYTE Bool_ON_OFF 1 2 0 1 BIT_MASK 0x01 ECU_ADDRESS 0x70012F0C /end MEASUREMENT
/begin MEASUREMENT FaultFSEVBLV_VoltageGndAut "FaultFSEVBLV_VoltageGndAut" UBYTE Bool_ON_OFF 1 2 0 1 BIT_MASK 0x08 ECU_ADDRESS 0x70012E58 /end MEASUREMENT
/begin MEASUREMENT FaultFSEVBLV_VoltageGndDetected "FaultFSEVBLV_VoltageGndDetected" UBYTE Bool_ON_OFF 1 2 0 1 BIT_MASK 0x08 ECU_ADDRESS 0x70012FBC /end MEASUREMENT
/begin MEASUREMENT FaultFSEVBLV_VoltageGndLogged "FaultFSEVBLV_VoltageGndLogged" UBYTE Bool_ON_OFF 1 2 0 1 BIT_MASK 0x08 ECU_ADDRESS 0x70012F0A /end MEASUREMENT
/begin MEASUREMENT FaultFSEVBLV_VoltageVccAut "FaultFSEVBLV_VoltageVccAut" UBYTE Bool_ON_OFF 1 2 0 1 BIT_MASK 0x10 ECU_ADDRESS 0x70012E58 /end MEASUREMENT
/begin MEASUREMENT FaultFSEVBLV_VoltageVccDetected "FaultFSEVBLV_VoltageVccDetected" UBYTE Bool_ON_OFF 1 2 0 1 BIT_MASK 0x10 ECU_ADDRESS 0x70012FBC /end MEASUREMENT
/begin MEASUREMENT FaultFSEVBLV_VoltageVccLogged "FaultFSEVBLV_VoltageVccLogged" UBYTE Bool_ON_OFF 1 2 0 1 BIT_MASK 0x10 ECU_ADDRESS 0x70012F0A /end MEASUREMENT
/begin MEASUREMENT FaultFSEVETA_Detected "FaultFSEVETA_Detected" UWORD I_1 1 2 0 65535 ECU_ADDRESS 0x70012FC0 /end MEASUREMENT
/begin MEASUREMENT FaultFSEVETA_DrvTempRationAut "FaultFSEVETA_DrvTempRationAut" UBYTE Bool_ON_OFF 1 2 0 1 BIT_MASK 0x01 ECU_ADDRESS 0x70012E5C /end MEASUREMENT
/begin MEASUREMENT FaultFSEVETA_DrvTempRationDetected "FaultFSEVETA_DrvTempRationDetected" UBYTE Bool_ON_OFF 1 2 0 1 BIT_MASK 0x01 ECU_ADDRESS 0x70012FC0 /end MEASUREMENT
/begin MEASUREMENT FaultFSEVETA_DrvTempRationLogged "FaultFSEVETA_DrvTempRationLogged" UBYTE Bool_ON_OFF 1 2 0 1 BIT_MASK 0x01 ECU_ADDRESS 0x70012F0E /end MEASUREMENT
/begin MEASUREMENT FaultFSEVETA_IgbtTempRationalAut "FaultFSEVETA_IgbtTempRationalAut" UBYTE Bool_ON_OFF 1 2 0 1 BIT_MASK 0x02 ECU_ADDRESS 0x70012E5C /end MEASUREMENT
/begin MEASUREMENT FaultFSEVETA_IgbtTempRationalDetected "FaultFSEVETA_IgbtTempRationalDetected" UBYTE Bool_ON_OFF 1 2 0 1 BIT_MASK 0x02 ECU_ADDRESS 0x70012FC0 /end MEASUREMENT
/begin MEASUREMENT FaultFSEVETA_IgbtTempRationalLogged "FaultFSEVETA_IgbtTempRationalLogged" UBYTE Bool_ON_OFF 1 2 0 1 BIT_MASK 0x02 ECU_ADDRESS 0x70012F0E /end MEASUREMENT
/begin MEASUREMENT FaultFSEVETA_Logged "FaultFSEVETA_Logged" UWORD I_1 1 2 0 65535 ECU_ADDRESS 0x70012F0E /end MEASUREMENT
/begin MEASUREMENT FaultFSEVETA_OverDetected "FaultFSEVETA_OverDetected" UWORD I_1 1 2 0 65535 ECU_ADDRESS 0x70012FC2 /end MEASUREMENT
/begin MEASUREMENT FaultFSEVETA_OverLogged "FaultFSEVETA_OverLogged" UWORD I_1 1 2 0 65535 ECU_ADDRESS 0x70012F10 /end MEASUREMENT
/begin MEASUREMENT FaultFSEVETA_OverTempDrvLeftAut "FaultFSEVETA_OverTempDrvLeftAut" UBYTE Bool_ON_OFF 1 2 0 1 BIT_MASK 0x01 ECU_ADDRESS 0x70012E5E /end MEASUREMENT
/begin MEASUREMENT FaultFSEVETA_OverTempDrvLeftDetected "FaultFSEVETA_OverTempDrvLeftDetected" UBYTE Bool_ON_OFF 1 2 0 1 BIT_MASK 0x01 ECU_ADDRESS 0x70012FC2 /end MEASUREMENT
/begin MEASUREMENT FaultFSEVETA_OverTempDrvLeftLogged "FaultFSEVETA_OverTempDrvLeftLogged" UBYTE Bool_ON_OFF 1 2 0 1 BIT_MASK 0x01 ECU_ADDRESS 0x70012F10 /end MEASUREMENT
/begin MEASUREMENT FaultFSEVETA_OverTempIgbtLeftAut "FaultFSEVETA_OverTempIgbtLeftAut" UBYTE Bool_ON_OFF 1 2 0 1 BIT_MASK 0x02 ECU_ADDRESS 0x70012E5E /end MEASUREMENT
/begin MEASUREMENT FaultFSEVETA_OverTempIgbtLeftDetected "FaultFSEVETA_OverTempIgbtLeftDetected" UBYTE Bool_ON_OFF 1 2 0 1 BIT_MASK 0x02 ECU_ADDRESS 0x70012FC2 /end MEASUREMENT
/begin MEASUREMENT FaultFSEVETA_OverTempIgbtLeftLogged "FaultFSEVETA_OverTempIgbtLeftLogged" UBYTE Bool_ON_OFF 1 2 0 1 BIT_MASK 0x02 ECU_ADDRESS 0x70012F10 /end MEASUREMENT
/begin MEASUREMENT FaultFSEVETA_OverTempNTC1CmdBoardAut "FaultFSEVETA_OverTempNTC1CmdBoardAut" UBYTE Bool_ON_OFF 1 2 0 1 BIT_MASK 0x04 ECU_ADDRESS 0x70012E5E /end MEASUREMENT
/begin MEASUREMENT FaultFSEVETA_OverTempNTC1CmdBoardDetected "FaultFSEVETA_OverTempNTC1CmdBoardDetected" UBYTE Bool_ON_OFF 1 2 0 1 BIT_MASK 0x04 ECU_ADDRESS 0x70012FC2 /end MEASUREMENT
/begin MEASUREMENT FaultFSEVETA_OverTempNTC1CmdBoardLogged "FaultFSEVETA_OverTempNTC1CmdBoardLogged" UBYTE Bool_ON_OFF 1 2 0 1 BIT_MASK 0x04 ECU_ADDRESS 0x70012F10 /end MEASUREMENT
/begin MEASUREMENT FaultFSEVETA_SampleIgbtTempOutRngHAut "FaultFSEVETA_SampleIgbtTempOutRngHAut" UBYTE Bool_ON_OFF 1 2 0 1 BIT_MASK 0x04 ECU_ADDRESS 0x70012E5C /end MEASUREMENT
/begin MEASUREMENT FaultFSEVETA_SampleIgbtTempOutRngHDetected "FaultFSEVETA_SampleIgbtTempOutRngHDetected" UBYTE Bool_ON_OFF 1 2 0 1 BIT_MASK 0x04 ECU_ADDRESS 0x70012FC0 /end MEASUREMENT
/begin MEASUREMENT FaultFSEVETA_SampleIgbtTempOutRngHLogged "FaultFSEVETA_SampleIgbtTempOutRngHLogged" UBYTE Bool_ON_OFF 1 2 0 1 BIT_MASK 0x04 ECU_ADDRESS 0x70012F0E /end MEASUREMENT
/begin MEASUREMENT FaultFSEVETA_SampleIgbtTempOutRngLAut "FaultFSEVETA_SampleIgbtTempOutRngLAut" UBYTE Bool_ON_OFF 1 2 0 1 BIT_MASK 0x08 ECU_ADDRESS 0x70012E5C /end MEASUREMENT
/begin MEASUREMENT FaultFSEVETA_SampleIgbtTempOutRngLDetected "FaultFSEVETA_SampleIgbtTempOutRngLDetected" UBYTE Bool_ON_OFF 1 2 0 1 BIT_MASK 0x08 ECU_ADDRESS 0x70012FC0 /end MEASUREMENT
/begin MEASUREMENT FaultFSEVETA_SampleIgbtTempOutRngLLogged "FaultFSEVETA_SampleIgbtTempOutRngLLogged" UBYTE Bool_ON_OFF 1 2 0 1 BIT_MASK 0x08 ECU_ADDRESS 0x70012F0E /end MEASUREMENT
/begin MEASUREMENT FaultFSEVETA_TempDetected "FaultFSEVETA_TempDetected" UWORD I_1 1 2 0 65535 ECU_ADDRESS 0x70012FC4 /end MEASUREMENT
/begin MEASUREMENT FaultFSEVETA_TempDrvBoardLeftGndAut "FaultFSEVETA_TempDrvBoardLeftGndAut" UBYTE Bool_ON_OFF 1 2 0 1 BIT_MASK 0x01 ECU_ADDRESS 0x70012E60 /end MEASUREMENT
/begin MEASUREMENT FaultFSEVETA_TempDrvBoardLeftGndDetected "FaultFSEVETA_TempDrvBoardLeftGndDetected" UBYTE Bool_ON_OFF 1 2 0 1 BIT_MASK 0x01 ECU_ADDRESS 0x70012FC4 /end MEASUREMENT
/begin MEASUREMENT FaultFSEVETA_TempDrvBoardLeftGndLogged "FaultFSEVETA_TempDrvBoardLeftGndLogged" UBYTE Bool_ON_OFF 1 2 0 1 BIT_MASK 0x01 ECU_ADDRESS 0x70012F12 /end MEASUREMENT
/begin MEASUREMENT FaultFSEVETA_TempDrvBoardLeftVccAut "FaultFSEVETA_TempDrvBoardLeftVccAut" UBYTE Bool_ON_OFF 1 2 0 1 BIT_MASK 0x02 ECU_ADDRESS 0x70012E60 /end MEASUREMENT
/begin MEASUREMENT FaultFSEVETA_TempDrvBoardLeftVccDetected "FaultFSEVETA_TempDrvBoardLeftVccDetected" UBYTE Bool_ON_OFF 1 2 0 1 BIT_MASK 0x02 ECU_ADDRESS 0x70012FC4 /end MEASUREMENT
/begin MEASUREMENT FaultFSEVETA_TempDrvBoardLeftVccLogged "FaultFSEVETA_TempDrvBoardLeftVccLogged" UBYTE Bool_ON_OFF 1 2 0 1 BIT_MASK 0x02 ECU_ADDRESS 0x70012F12 /end MEASUREMENT
/begin MEASUREMENT FaultFSEVETA_TempIgbtLeftGndAut "FaultFSEVETA_TempIgbtLeftGndAut" UBYTE Bool_ON_OFF 1 2 0 1 BIT_MASK 0x04 ECU_ADDRESS 0x70012E60 /end MEASUREMENT
/begin MEASUREMENT FaultFSEVETA_TempIgbtLeftGndDetected "FaultFSEVETA_TempIgbtLeftGndDetected" UBYTE Bool_ON_OFF 1 2 0 1 BIT_MASK 0x04 ECU_ADDRESS 0x70012FC4 /end MEASUREMENT
/begin MEASUREMENT FaultFSEVETA_TempIgbtLeftGndLogged "FaultFSEVETA_TempIgbtLeftGndLogged" UBYTE Bool_ON_OFF 1 2 0 1 BIT_MASK 0x04 ECU_ADDRESS 0x70012F12 /end MEASUREMENT
/begin MEASUREMENT FaultFSEVETA_TempIgbtLeftVccAut "FaultFSEVETA_TempIgbtLeftVccAut" UBYTE Bool_ON_OFF 1 2 0 1 BIT_MASK 0x08 ECU_ADDRESS 0x70012E60 /end MEASUREMENT
/begin MEASUREMENT FaultFSEVETA_TempIgbtLeftVccDetected "FaultFSEVETA_TempIgbtLeftVccDetected" UBYTE Bool_ON_OFF 1 2 0 1 BIT_MASK 0x08 ECU_ADDRESS 0x70012FC4 /end MEASUREMENT
/begin MEASUREMENT FaultFSEVETA_TempIgbtLeftVccLogged "FaultFSEVETA_TempIgbtLeftVccLogged" UBYTE Bool_ON_OFF 1 2 0 1 BIT_MASK 0x08 ECU_ADDRESS 0x70012F12 /end MEASUREMENT
/begin MEASUREMENT FaultFSEVETA_TempLogged "FaultFSEVETA_TempLogged" UWORD I_1 1 2 0 65535 ECU_ADDRESS 0x70012F12 /end MEASUREMENT
/begin MEASUREMENT FaultFSEVETA_TempNTC1CmdBoardGndAut "FaultFSEVETA_TempNTC1CmdBoardGndAut" UBYTE Bool_ON_OFF 1 2 0 1 BIT_MASK 0x10 ECU_ADDRESS 0x70012E60 /end MEASUREMENT
/begin MEASUREMENT FaultFSEVETA_TempNTC1CmdBoardGndDetected "FaultFSEVETA_TempNTC1CmdBoardGndDetected" UBYTE Bool_ON_OFF 1 2 0 1 BIT_MASK 0x10 ECU_ADDRESS 0x70012FC4 /end MEASUREMENT
/begin MEASUREMENT FaultFSEVETA_TempNTC1CmdBoardGndLogged "FaultFSEVETA_TempNTC1CmdBoardGndLogged" UBYTE Bool_ON_OFF 1 2 0 1 BIT_MASK 0x10 ECU_ADDRESS 0x70012F12 /end MEASUREMENT
/begin MEASUREMENT FaultFSEVETA_TempNTC1CmdBoardVccAut "FaultFSEVETA_TempNTC1CmdBoardVccAut" UBYTE Bool_ON_OFF 1 2 0 1 BIT_MASK 0x20 ECU_ADDRESS 0x70012E60 /end MEASUREMENT
/begin MEASUREMENT FaultFSEVETA_TempNTC1CmdBoardVccDetected "FaultFSEVETA_TempNTC1CmdBoardVccDetected" UBYTE Bool_ON_OFF 1 2 0 1 BIT_MASK 0x20 ECU_ADDRESS 0x70012FC4 /end MEASUREMENT
/begin MEASUREMENT FaultFSEVETA_TempNTC1CmdBoardVccLogged "FaultFSEVETA_TempNTC1CmdBoardVccLogged" UBYTE Bool_ON_OFF 1 2 0 1 BIT_MASK 0x20 ECU_ADDRESS 0x70012F12 /end MEASUREMENT
/begin MEASUREMENT FaultFSEVETA_UnderDetected "FaultFSEVETA_UnderDetected" UWORD I_1 1 2 0 65535 ECU_ADDRESS 0x70012FC6 /end MEASUREMENT
/begin MEASUREMENT FaultFSEVETA_UnderLogged "FaultFSEVETA_UnderLogged" UWORD I_1 1 2 0 65535 ECU_ADDRESS 0x70012F14 /end MEASUREMENT
/begin MEASUREMENT FaultFSEVETA_UnderTempDrvLeftAut "FaultFSEVETA_UnderTempDrvLeftAut" UBYTE Bool_ON_OFF 1 2 0 1 BIT_MASK 0x01 ECU_ADDRESS 0x70012E62 /end MEASUREMENT
/begin MEASUREMENT FaultFSEVETA_UnderTempDrvLeftDetected "FaultFSEVETA_UnderTempDrvLeftDetected" UBYTE Bool_ON_OFF 1 2 0 1 BIT_MASK 0x01 ECU_ADDRESS 0x70012FC6 /end MEASUREMENT
/begin MEASUREMENT FaultFSEVETA_UnderTempDrvLeftLogged "FaultFSEVETA_UnderTempDrvLeftLogged" UBYTE Bool_ON_OFF 1 2 0 1 BIT_MASK 0x01 ECU_ADDRESS 0x70012F14 /end MEASUREMENT
/begin MEASUREMENT FaultFSEVETA_UnderTempIgbtLeftAut "FaultFSEVETA_UnderTempIgbtLeftAut" UBYTE Bool_ON_OFF 1 2 0 1 BIT_MASK 0x02 ECU_ADDRESS 0x70012E62 /end MEASUREMENT
/begin MEASUREMENT FaultFSEVETA_UnderTempIgbtLeftDetected "FaultFSEVETA_UnderTempIgbtLeftDetected" UBYTE Bool_ON_OFF 1 2 0 1 BIT_MASK 0x02 ECU_ADDRESS 0x70012FC6 /end MEASUREMENT
/begin MEASUREMENT FaultFSEVETA_UnderTempIgbtLeftLogged "FaultFSEVETA_UnderTempIgbtLeftLogged" UBYTE Bool_ON_OFF 1 2 0 1 BIT_MASK 0x02 ECU_ADDRESS 0x70012F14 /end MEASUREMENT
/begin MEASUREMENT FaultFSEVETA_UnderTempNTC1CmdBoardAut "FaultFSEVETA_UnderTempNTC1CmdBoardAut" UBYTE Bool_ON_OFF 1 2 0 1 BIT_MASK 0x04 ECU_ADDRESS 0x70012E62 /end MEASUREMENT
/begin MEASUREMENT FaultFSEVETA_UnderTempNTC1CmdBoardDetected "FaultFSEVETA_UnderTempNTC1CmdBoardDetected" UBYTE Bool_ON_OFF 1 2 0 1 BIT_MASK 0x04 ECU_ADDRESS 0x70012FC6 /end MEASUREMENT
/begin MEASUREMENT FaultFSEVETA_UnderTempNTC1CmdBoardLogged "FaultFSEVETA_UnderTempNTC1CmdBoardLogged" UBYTE Bool_ON_OFF 1 2 0 1 BIT_MASK 0x04 ECU_ADDRESS 0x70012F14 /end MEASUREMENT
/begin MEASUREMENT FaultFSMTMTA_OverDetected "FaultFSMTMTA_OverDetected" UWORD I_1 1 2 0 65535 ECU_ADDRESS 0x70012FC8 /end MEASUREMENT
/begin MEASUREMENT FaultFSMTMTA_OverLogged "FaultFSMTMTA_OverLogged" UWORD I_1 1 2 0 65535 ECU_ADDRESS 0x70012F16 /end MEASUREMENT
/begin MEASUREMENT FaultFSMTMTA_OverTempWdgHead1Aut "FaultFSMTMTA_OverTempWdgHead1Aut" UBYTE Bool_ON_OFF 1 2 0 1 BIT_MASK 0x01 ECU_ADDRESS 0x70012E64 /end MEASUREMENT
/begin MEASUREMENT FaultFSMTMTA_OverTempWdgHead1Detected "FaultFSMTMTA_OverTempWdgHead1Detected" UBYTE Bool_ON_OFF 1 2 0 1 BIT_MASK 0x01 ECU_ADDRESS 0x70012FC8 /end MEASUREMENT
/begin MEASUREMENT FaultFSMTMTA_OverTempWdgHead1Logged "FaultFSMTMTA_OverTempWdgHead1Logged" UBYTE Bool_ON_OFF 1 2 0 1 BIT_MASK 0x01 ECU_ADDRESS 0x70012F16 /end MEASUREMENT
/begin MEASUREMENT FaultFSMTMTA_TempDetected "FaultFSMTMTA_TempDetected" UWORD I_1 1 2 0 65535 ECU_ADDRESS 0x70012FCA /end MEASUREMENT
/begin MEASUREMENT FaultFSMTMTA_TempLogged "FaultFSMTMTA_TempLogged" UWORD I_1 1 2 0 65535 ECU_ADDRESS 0x70012F18 /end MEASUREMENT
/begin MEASUREMENT FaultFSMTMTA_TempWindHead1OutRngHAut "FaultFSMTMTA_TempWindHead1OutRngHAut" UBYTE Bool_ON_OFF 1 2 0 1 BIT_MASK 0x01 ECU_ADDRESS 0x70012E66 /end MEASUREMENT
/begin MEASUREMENT FaultFSMTMTA_TempWindHead1OutRngHDetected "FaultFSMTMTA_TempWindHead1OutRngHDetected" UBYTE Bool_ON_OFF 1 2 0 1 BIT_MASK 0x01 ECU_ADDRESS 0x70012FCA /end MEASUREMENT
/begin MEASUREMENT FaultFSMTMTA_TempWindHead1OutRngHLogged "FaultFSMTMTA_TempWindHead1OutRngHLogged" UBYTE Bool_ON_OFF 1 2 0 1 BIT_MASK 0x01 ECU_ADDRESS 0x70012F18 /end MEASUREMENT
/begin MEASUREMENT FaultFSMTMTA_TempWindHead1OutRngLAut "FaultFSMTMTA_TempWindHead1OutRngLAut" UBYTE Bool_ON_OFF 1 2 0 1 BIT_MASK 0x02 ECU_ADDRESS 0x70012E66 /end MEASUREMENT
/begin MEASUREMENT FaultFSMTMTA_TempWindHead1OutRngLDetected "FaultFSMTMTA_TempWindHead1OutRngLDetected" UBYTE Bool_ON_OFF 1 2 0 1 BIT_MASK 0x02 ECU_ADDRESS 0x70012FCA /end MEASUREMENT
/begin MEASUREMENT FaultFSMTMTA_TempWindHead1OutRngLLogged "FaultFSMTMTA_TempWindHead1OutRngLLogged" UBYTE Bool_ON_OFF 1 2 0 1 BIT_MASK 0x02 ECU_ADDRESS 0x70012F18 /end MEASUREMENT
/begin MEASUREMENT FaultFSMTMTA_TempWindingHead1GndAut "FaultFSMTMTA_TempWindingHead1GndAut" UBYTE Bool_ON_OFF 1 2 0 1 BIT_MASK 0x04 ECU_ADDRESS 0x70012E66 /end MEASUREMENT
/begin MEASUREMENT FaultFSMTMTA_TempWindingHead1GndDetected "FaultFSMTMTA_TempWindingHead1GndDetected" UBYTE Bool_ON_OFF 1 2 0 1 BIT_MASK 0x04 ECU_ADDRESS 0x70012FCA /end MEASUREMENT
/begin MEASUREMENT FaultFSMTMTA_TempWindingHead1GndLogged "FaultFSMTMTA_TempWindingHead1GndLogged" UBYTE Bool_ON_OFF 1 2 0 1 BIT_MASK 0x04 ECU_ADDRESS 0x70012F18 /end MEASUREMENT
/begin MEASUREMENT FaultFSMTMTA_TempWindingHead1VccAut "FaultFSMTMTA_TempWindingHead1VccAut" UBYTE Bool_ON_OFF 1 2 0 1 BIT_MASK 0x08 ECU_ADDRESS 0x70012E66 /end MEASUREMENT
/begin MEASUREMENT FaultFSMTMTA_TempWindingHead1VccDetected "FaultFSMTMTA_TempWindingHead1VccDetected" UBYTE Bool_ON_OFF 1 2 0 1 BIT_MASK 0x08 ECU_ADDRESS 0x70012FCA /end MEASUREMENT
/begin MEASUREMENT FaultFSMTMTA_TempWindingHead1VccLogged "FaultFSMTMTA_TempWindingHead1VccLogged" UBYTE Bool_ON_OFF 1 2 0 1 BIT_MASK 0x08 ECU_ADDRESS 0x70012F18 /end MEASUREMENT
/begin MEASUREMENT FaultFSMTMTA_UnderDetected "FaultFSMTMTA_UnderDetected" UWORD I_1 1 2 0 65535 ECU_ADDRESS 0x70012FCC /end MEASUREMENT
/begin MEASUREMENT FaultFSMTMTA_UnderLogged "FaultFSMTMTA_UnderLogged" UWORD I_1 1 2 0 65535 ECU_ADDRESS 0x70012F1A /end MEASUREMENT
/begin MEASUREMENT FaultFSMTMTA_UnderTempWdgHead1Aut "FaultFSMTMTA_UnderTempWdgHead1Aut" UBYTE Bool_ON_OFF 1 2 0 1 BIT_MASK 0x01 ECU_ADDRESS 0x70012E68 /end MEASUREMENT
/begin MEASUREMENT FaultFSMTMTA_UnderTempWdgHead1Detected "FaultFSMTMTA_UnderTempWdgHead1Detected" UBYTE Bool_ON_OFF 1 2 0 1 BIT_MASK 0x01 ECU_ADDRESS 0x70012FCC /end MEASUREMENT
/begin MEASUREMENT FaultFSMTMTA_UnderTempWdgHead1Logged "FaultFSMTMTA_UnderTempWdgHead1Logged" UBYTE Bool_ON_OFF 1 2 0 1 BIT_MASK 0x01 ECU_ADDRESS 0x70012F1A /end MEASUREMENT
/begin MEASUREMENT FaultFSMTRDG_Detected "FaultFSMTRDG_Detected" UWORD I_1 1 2 0 65535 ECU_ADDRESS 0x70012FCE /end MEASUREMENT
/begin MEASUREMENT FaultFSMTRDG_ExcGenerationAut "FaultFSMTRDG_ExcGenerationAut" UBYTE Bool_ON_OFF 1 2 0 1 BIT_MASK 0x01 ECU_ADDRESS 0x70012E6A /end MEASUREMENT
/begin MEASUREMENT FaultFSMTRDG_ExcGenerationDetected "FaultFSMTRDG_ExcGenerationDetected" UBYTE Bool_ON_OFF 1 2 0 1 BIT_MASK 0x01 ECU_ADDRESS 0x70012FCE /end MEASUREMENT
/begin MEASUREMENT FaultFSMTRDG_ExcGenerationLogged "FaultFSMTRDG_ExcGenerationLogged" UBYTE Bool_ON_OFF 1 2 0 1 BIT_MASK 0x01 ECU_ADDRESS 0x70012F1C /end MEASUREMENT
/begin MEASUREMENT FaultFSMTRDG_ExcSignalGNDAut "FaultFSMTRDG_ExcSignalGNDAut" UBYTE Bool_ON_OFF 1 2 0 1 BIT_MASK 0x02 ECU_ADDRESS 0x70012E6A /end MEASUREMENT
/begin MEASUREMENT FaultFSMTRDG_ExcSignalGNDDetected "FaultFSMTRDG_ExcSignalGNDDetected" UBYTE Bool_ON_OFF 1 2 0 1 BIT_MASK 0x02 ECU_ADDRESS 0x70012FCE /end MEASUREMENT
/begin MEASUREMENT FaultFSMTRDG_ExcSignalGNDLogged "FaultFSMTRDG_ExcSignalGNDLogged" UBYTE Bool_ON_OFF 1 2 0 1 BIT_MASK 0x02 ECU_ADDRESS 0x70012F1C /end MEASUREMENT
/begin MEASUREMENT FaultFSMTRDG_ExcSignalVCCAut "FaultFSMTRDG_ExcSignalVCCAut" UBYTE Bool_ON_OFF 1 2 0 1 BIT_MASK 0x04 ECU_ADDRESS 0x70012E6A /end MEASUREMENT
/begin MEASUREMENT FaultFSMTRDG_ExcSignalVCCDetected "FaultFSMTRDG_ExcSignalVCCDetected" UBYTE Bool_ON_OFF 1 2 0 1 BIT_MASK 0x04 ECU_ADDRESS 0x70012FCE /end MEASUREMENT
/begin MEASUREMENT FaultFSMTRDG_ExcSignalVCCLogged "FaultFSMTRDG_ExcSignalVCCLogged" UBYTE Bool_ON_OFF 1 2 0 1 BIT_MASK 0x04 ECU_ADDRESS 0x70012F1C /end MEASUREMENT
/begin MEASUREMENT FaultFSMTRDG_Logged "FaultFSMTRDG_Logged" UWORD I_1 1 2 0 65535 ECU_ADDRESS 0x70012F1C /end MEASUREMENT
/begin MEASUREMENT FaultFSMTRDG_SinCosHLGndAut "FaultFSMTRDG_SinCosHLGndAut" UBYTE Bool_ON_OFF 1 2 0 1 BIT_MASK 0x08 ECU_ADDRESS 0x70012E6A /end MEASUREMENT
/begin MEASUREMENT FaultFSMTRDG_SinCosHLGndDetected "FaultFSMTRDG_SinCosHLGndDetected" UBYTE Bool_ON_OFF 1 2 0 1 BIT_MASK 0x08 ECU_ADDRESS 0x70012FCE /end MEASUREMENT
/begin MEASUREMENT FaultFSMTRDG_SinCosHLGndLogged "FaultFSMTRDG_SinCosHLGndLogged" UBYTE Bool_ON_OFF 1 2 0 1 BIT_MASK 0x08 ECU_ADDRESS 0x70012F1C /end MEASUREMENT
/begin MEASUREMENT FaultFSMTRDG_SinCosHLOpenAut "FaultFSMTRDG_SinCosHLOpenAut" UBYTE Bool_ON_OFF 1 2 0 1 BIT_MASK 0x10 ECU_ADDRESS 0x70012E6A /end MEASUREMENT
/begin MEASUREMENT FaultFSMTRDG_SinCosHLOpenDetected "FaultFSMTRDG_SinCosHLOpenDetected" UBYTE Bool_ON_OFF 1 2 0 1 BIT_MASK 0x10 ECU_ADDRESS 0x70012FCE /end MEASUREMENT
/begin MEASUREMENT FaultFSMTRDG_SinCosHLOpenLogged "FaultFSMTRDG_SinCosHLOpenLogged" UBYTE Bool_ON_OFF 1 2 0 1 BIT_MASK 0x10 ECU_ADDRESS 0x70012F1C /end MEASUREMENT
/begin MEASUREMENT FaultFSMTRDG_SinCosHLVccAut "FaultFSMTRDG_SinCosHLVccAut" UBYTE Bool_ON_OFF 1 2 0 1 BIT_MASK 0x20 ECU_ADDRESS 0x70012E6A /end MEASUREMENT
/begin MEASUREMENT FaultFSMTRDG_SinCosHLVccDetected "FaultFSMTRDG_SinCosHLVccDetected" UBYTE Bool_ON_OFF 1 2 0 1 BIT_MASK 0x20 ECU_ADDRESS 0x70012FCE /end MEASUREMENT
/begin MEASUREMENT FaultFSMTRDG_SinCosHLVccLogged "FaultFSMTRDG_SinCosHLVccLogged" UBYTE Bool_ON_OFF 1 2 0 1 BIT_MASK 0x20 ECU_ADDRESS 0x70012F1C /end MEASUREMENT
/begin MEASUREMENT FaultFSSMACS_AkdFailFlagAut "FaultFSSMACS_AkdFailFlagAut" UBYTE Bool_ON_OFF 1 2 0 1 BIT_MASK 0x01 ECU_ADDRESS 0x70012E6C /end MEASUREMENT
/begin MEASUREMENT FaultFSSMACS_AkdFailFlagDetected "FaultFSSMACS_AkdFailFlagDetected" UBYTE Bool_ON_OFF 1 2 0 1 BIT_MASK 0x01 ECU_ADDRESS 0x70012FD0 /end MEASUREMENT
/begin MEASUREMENT FaultFSSMACS_AkdFailFlagLogged "FaultFSSMACS_AkdFailFlagLogged" UBYTE Bool_ON_OFF 1 2 0 1 BIT_MASK 0x01 ECU_ADDRESS 0x70012F1E /end MEASUREMENT
/begin MEASUREMENT FaultFSSMACS_Detected "FaultFSSMACS_Detected" UWORD I_1 1 2 0 65535 ECU_ADDRESS 0x70012FD0 /end MEASUREMENT
/begin MEASUREMENT FaultFSSMACS_Logged "FaultFSSMACS_Logged" UWORD I_1 1 2 0 65535 ECU_ADDRESS 0x70012F1E /end MEASUREMENT
/begin MEASUREMENT FaultFTASBDS_BattVoltDeratingActAut "FaultFTASBDS_BattVoltDeratingActAut" UBYTE Bool_ON_OFF 1 2 0 1 BIT_MASK 0x01 ECU_ADDRESS 0x70012E6E /end MEASUREMENT
/begin MEASUREMENT FaultFTASBDS_BattVoltDeratingActDetected "FaultFTASBDS_BattVoltDeratingActDetected" UBYTE Bool_ON_OFF 1 2 0 1 BIT_MASK 0x01 ECU_ADDRESS 0x70012FD2 /end MEASUREMENT
/begin MEASUREMENT FaultFTASBDS_BattVoltDeratingActLogged "FaultFTASBDS_BattVoltDeratingActLogged" UBYTE Bool_ON_OFF 1 2 0 1 BIT_MASK 0x01 ECU_ADDRESS 0x70012F20 /end MEASUREMENT
/begin MEASUREMENT FaultFTASBDS_Detected "FaultFTASBDS_Detected" UWORD I_1 1 2 0 65535 ECU_ADDRESS 0x70012FD2 /end MEASUREMENT
/begin MEASUREMENT FaultFTASBDS_Logged "FaultFTASBDS_Logged" UWORD I_1 1 2 0 65535 ECU_ADDRESS 0x70012F20 /end MEASUREMENT
/begin MEASUREMENT FaultFTASETP_Detected "FaultFTASETP_Detected" UWORD I_1 1 2 0 65535 ECU_ADDRESS 0x70012FD4 /end MEASUREMENT
/begin MEASUREMENT FaultFTASETP_EstPmDeratingActAut "FaultFTASETP_EstPmDeratingActAut" UBYTE Bool_ON_OFF 1 2 0 1 BIT_MASK 0x01 ECU_ADDRESS 0x70012E70 /end MEASUREMENT
/begin MEASUREMENT FaultFTASETP_EstPmDeratingActDetected "FaultFTASETP_EstPmDeratingActDetected" UBYTE Bool_ON_OFF 1 2 0 1 BIT_MASK 0x01 ECU_ADDRESS 0x70012FD4 /end MEASUREMENT
/begin MEASUREMENT FaultFTASETP_EstPmDeratingActLogged "FaultFTASETP_EstPmDeratingActLogged" UBYTE Bool_ON_OFF 1 2 0 1 BIT_MASK 0x01 ECU_ADDRESS 0x70012F22 /end MEASUREMENT
/begin MEASUREMENT FaultFTASETP_Logged "FaultFTASETP_Logged" UWORD I_1 1 2 0 65535 ECU_ADDRESS 0x70012F22 /end MEASUREMENT
/begin MEASUREMENT FaultFTASETP_PmDeratingActAut "FaultFTASETP_PmDeratingActAut" UBYTE Bool_ON_OFF 1 2 0 1 BIT_MASK 0x02 ECU_ADDRESS 0x70012E70 /end MEASUREMENT
/begin MEASUREMENT FaultFTASETP_PmDeratingActDetected "FaultFTASETP_PmDeratingActDetected" UBYTE Bool_ON_OFF 1 2 0 1 BIT_MASK 0x02 ECU_ADDRESS 0x70012FD4 /end MEASUREMENT
/begin MEASUREMENT FaultFTASETP_PmDeratingActLogged "FaultFTASETP_PmDeratingActLogged" UBYTE Bool_ON_OFF 1 2 0 1 BIT_MASK 0x02 ECU_ADDRESS 0x70012F22 /end MEASUREMENT
/begin MEASUREMENT FaultFTASMTP_Detected "FaultFTASMTP_Detected" UWORD I_1 1 2 0 65535 ECU_ADDRESS 0x70012FD6 /end MEASUREMENT
/begin MEASUREMENT FaultFTASMTP_Logged "FaultFTASMTP_Logged" UWORD I_1 1 2 0 65535 ECU_ADDRESS 0x70012F24 /end MEASUREMENT
/begin MEASUREMENT FaultFTASMTP_Wndg1DeratingActAut "FaultFTASMTP_Wndg1DeratingActAut" UBYTE Bool_ON_OFF 1 2 0 1 BIT_MASK 0x01 ECU_ADDRESS 0x70012E72 /end MEASUREMENT
/begin MEASUREMENT FaultFTASMTP_Wndg1DeratingActDetected "FaultFTASMTP_Wndg1DeratingActDetected" UBYTE Bool_ON_OFF 1 2 0 1 BIT_MASK 0x01 ECU_ADDRESS 0x70012FD6 /end MEASUREMENT
/begin MEASUREMENT FaultFTASMTP_Wndg1DeratingActLogged "FaultFTASMTP_Wndg1DeratingActLogged" UBYTE Bool_ON_OFF 1 2 0 1 BIT_MASK 0x01 ECU_ADDRESS 0x70012F24 /end MEASUREMENT
/begin MEASUREMENT FaultFTASOSP_Detected "FaultFTASOSP_Detected" UWORD I_1 1 2 0 65535 ECU_ADDRESS 0x70012FD8 /end MEASUREMENT
/begin MEASUREMENT FaultFTASOSP_Logged "FaultFTASOSP_Logged" UWORD I_1 1 2 0 65535 ECU_ADDRESS 0x70012F26 /end MEASUREMENT
/begin MEASUREMENT FaultFTASOSP_MotorSpdDeratingActAut "FaultFTASOSP_MotorSpdDeratingActAut" UBYTE Bool_ON_OFF 1 2 0 1 BIT_MASK 0x01 ECU_ADDRESS 0x70012E74 /end MEASUREMENT
/begin MEASUREMENT FaultFTASOSP_MotorSpdDeratingActDetected "FaultFTASOSP_MotorSpdDeratingActDetected" UBYTE Bool_ON_OFF 1 2 0 1 BIT_MASK 0x01 ECU_ADDRESS 0x70012FD8 /end MEASUREMENT
/begin MEASUREMENT FaultFTASOSP_MotorSpdDeratingActLogged "FaultFTASOSP_MotorSpdDeratingActLogged" UBYTE Bool_ON_OFF 1 2 0 1 BIT_MASK 0x01 ECU_ADDRESS 0x70012F26 /end MEASUREMENT
/begin MEASUREMENT FaultFTCMSCS_CtrlSatTimoutAut "FaultFTCMSCS_CtrlSatTimoutAut" UBYTE Bool_ON_OFF 1 2 0 1 BIT_MASK 0x01 ECU_ADDRESS 0x70012E76 /end MEASUREMENT
/begin MEASUREMENT FaultFTCMSCS_CtrlSatTimoutDetected "FaultFTCMSCS_CtrlSatTimoutDetected" UBYTE Bool_ON_OFF 1 2 0 1 BIT_MASK 0x01 ECU_ADDRESS 0x70012FDA /end MEASUREMENT
/begin MEASUREMENT FaultFTCMSCS_CtrlSatTimoutLogged "FaultFTCMSCS_CtrlSatTimoutLogged" UBYTE Bool_ON_OFF 1 2 0 1 BIT_MASK 0x01 ECU_ADDRESS 0x70012F28 /end MEASUREMENT
/begin MEASUREMENT FaultFTCMSCS_Detected "FaultFTCMSCS_Detected" UWORD I_1 1 2 0 65535 ECU_ADDRESS 0x70012FDA /end MEASUREMENT
/begin MEASUREMENT FaultFTCMSCS_Logged "FaultFTCMSCS_Logged" UWORD I_1 1 2 0 65535 ECU_ADDRESS 0x70012F28 /end MEASUREMENT
/begin MEASUREMENT FaultFTCMSCS_SpdOvershootAut "FaultFTCMSCS_SpdOvershootAut" UBYTE Bool_ON_OFF 1 2 0 1 BIT_MASK 0x02 ECU_ADDRESS 0x70012E76 /end MEASUREMENT
/begin MEASUREMENT FaultFTCMSCS_SpdOvershootDetected "FaultFTCMSCS_SpdOvershootDetected" UBYTE Bool_ON_OFF 1 2 0 1 BIT_MASK 0x02 ECU_ADDRESS 0x70012FDA /end MEASUREMENT
/begin MEASUREMENT FaultFTCMSCS_SpdOvershootLogged "FaultFTCMSCS_SpdOvershootLogged" UBYTE Bool_ON_OFF 1 2 0 1 BIT_MASK 0x02 ECU_ADDRESS 0x70012F28 /end MEASUREMENT
/begin MEASUREMENT FaultFTCMSCS_ZeroSpeedTimoutAut "FaultFTCMSCS_ZeroSpeedTimoutAut" UBYTE Bool_ON_OFF 1 2 0 1 BIT_MASK 0x04 ECU_ADDRESS 0x70012E76 /end MEASUREMENT
/begin MEASUREMENT FaultFTCMSCS_ZeroSpeedTimoutDetected "FaultFTCMSCS_ZeroSpeedTimoutDetected" UBYTE Bool_ON_OFF 1 2 0 1 BIT_MASK 0x04 ECU_ADDRESS 0x70012FDA /end MEASUREMENT
/begin MEASUREMENT FaultFTCMSCS_ZeroSpeedTimoutLogged "FaultFTCMSCS_ZeroSpeedTimoutLogged" UBYTE Bool_ON_OFF 1 2 0 1 BIT_MASK 0x04 ECU_ADDRESS 0x70012F28 /end MEASUREMENT
/begin MEASUREMENT FaultFTCMTCS_Detected "FaultFTCMTCS_Detected" UWORD I_1 1 2 0 65535 ECU_ADDRESS 0x70012FDC /end MEASUREMENT
/begin MEASUREMENT FaultFTCMTCS_Logged "FaultFTCMTCS_Logged" UWORD I_1 1 2 0 65535 ECU_ADDRESS 0x70012F2A /end MEASUREMENT
/begin MEASUREMENT FaultFTCMTCS_VoltageMarginLowAut "FaultFTCMTCS_VoltageMarginLowAut" UBYTE Bool_ON_OFF 1 2 0 1 BIT_MASK 0x01 ECU_ADDRESS 0x70012E78 /end MEASUREMENT
/begin MEASUREMENT FaultFTCMTCS_VoltageMarginLowDetected "FaultFTCMTCS_VoltageMarginLowDetected" UBYTE Bool_ON_OFF 1 2 0 1 BIT_MASK 0x01 ECU_ADDRESS 0x70012FDC /end MEASUREMENT
/begin MEASUREMENT FaultFTCMTCS_VoltageMarginLowLogged "FaultFTCMTCS_VoltageMarginLowLogged" UBYTE Bool_ON_OFF 1 2 0 1 BIT_MASK 0x01 ECU_ADDRESS 0x70012F2A /end MEASUREMENT
/begin MEASUREMENT FaultFTEVEIT_Detected "FaultFTEVEIT_Detected" UWORD I_1 1 2 0 65535 ECU_ADDRESS 0x70012FDE /end MEASUREMENT
/begin MEASUREMENT FaultFTEVEIT_EstOverTempAut "FaultFTEVEIT_EstOverTempAut" UBYTE Bool_ON_OFF 1 2 0 1 BIT_MASK 0x01 ECU_ADDRESS 0x70012E7A /end MEASUREMENT
/begin MEASUREMENT FaultFTEVEIT_EstOverTempDetected "FaultFTEVEIT_EstOverTempDetected" UBYTE Bool_ON_OFF 1 2 0 1 BIT_MASK 0x01 ECU_ADDRESS 0x70012FDE /end MEASUREMENT
/begin MEASUREMENT FaultFTEVEIT_EstOverTempLogged "FaultFTEVEIT_EstOverTempLogged" UBYTE Bool_ON_OFF 1 2 0 1 BIT_MASK 0x01 ECU_ADDRESS 0x70012F2C /end MEASUREMENT
/begin MEASUREMENT FaultFTEVEIT_Logged "FaultFTEVEIT_Logged" UWORD I_1 1 2 0 65535 ECU_ADDRESS 0x70012F2C /end MEASUREMENT
/begin MEASUREMENT FaultFTMTLCS_CurSenrPhaU_GNDAut "FaultFTMTLCS_CurSenrPhaU_GNDAut" UBYTE Bool_ON_OFF 1 2 0 1 BIT_MASK 0x02 ECU_ADDRESS 0x70012E7C /end MEASUREMENT
/begin MEASUREMENT FaultFTMTLCS_CurSenrPhaU_GNDDetected "FaultFTMTLCS_CurSenrPhaU_GNDDetected" UBYTE Bool_ON_OFF 1 2 0 1 BIT_MASK 0x02 ECU_ADDRESS 0x70012FE0 /end MEASUREMENT
/begin MEASUREMENT FaultFTMTLCS_CurSenrPhaU_GNDLogged "FaultFTMTLCS_CurSenrPhaU_GNDLogged" UBYTE Bool_ON_OFF 1 2 0 1 BIT_MASK 0x02 ECU_ADDRESS 0x70012F2E /end MEASUREMENT
/begin MEASUREMENT FaultFTMTLCS_CurSenrPhaU_OutRngHAut "FaultFTMTLCS_CurSenrPhaU_OutRngHAut" UBYTE Bool_ON_OFF 1 2 0 1 BIT_MASK 0x04 ECU_ADDRESS 0x70012E7C /end MEASUREMENT
/begin MEASUREMENT FaultFTMTLCS_CurSenrPhaU_OutRngHDetected "FaultFTMTLCS_CurSenrPhaU_OutRngHDetected" UBYTE Bool_ON_OFF 1 2 0 1 BIT_MASK 0x04 ECU_ADDRESS 0x70012FE0 /end MEASUREMENT
/begin MEASUREMENT FaultFTMTLCS_CurSenrPhaU_OutRngHLogged "FaultFTMTLCS_CurSenrPhaU_OutRngHLogged" UBYTE Bool_ON_OFF 1 2 0 1 BIT_MASK 0x04 ECU_ADDRESS 0x70012F2E /end MEASUREMENT
/begin MEASUREMENT FaultFTMTLCS_CurSenrPhaU_OutRngLAut "FaultFTMTLCS_CurSenrPhaU_OutRngLAut" UBYTE Bool_ON_OFF 1 2 0 1 BIT_MASK 0x08 ECU_ADDRESS 0x70012E7C /end MEASUREMENT
/begin MEASUREMENT FaultFTMTLCS_CurSenrPhaU_OutRngLDetected "FaultFTMTLCS_CurSenrPhaU_OutRngLDetected" UBYTE Bool_ON_OFF 1 2 0 1 BIT_MASK 0x08 ECU_ADDRESS 0x70012FE0 /end MEASUREMENT
/begin MEASUREMENT FaultFTMTLCS_CurSenrPhaU_OutRngLLogged "FaultFTMTLCS_CurSenrPhaU_OutRngLLogged" UBYTE Bool_ON_OFF 1 2 0 1 BIT_MASK 0x08 ECU_ADDRESS 0x70012F2E /end MEASUREMENT
/begin MEASUREMENT FaultFTMTLCS_CurSenrPhaU_VCCAut "FaultFTMTLCS_CurSenrPhaU_VCCAut" UBYTE Bool_ON_OFF 1 2 0 1 BIT_MASK 0x10 ECU_ADDRESS 0x70012E7C /end MEASUREMENT
/begin MEASUREMENT FaultFTMTLCS_CurSenrPhaU_VCCDetected "FaultFTMTLCS_CurSenrPhaU_VCCDetected" UBYTE Bool_ON_OFF 1 2 0 1 BIT_MASK 0x10 ECU_ADDRESS 0x70012FE0 /end MEASUREMENT
/begin MEASUREMENT FaultFTMTLCS_CurSenrPhaU_VCCLogged "FaultFTMTLCS_CurSenrPhaU_VCCLogged" UBYTE Bool_ON_OFF 1 2 0 1 BIT_MASK 0x10 ECU_ADDRESS 0x70012F2E /end MEASUREMENT
/begin MEASUREMENT FaultFTMTLCS_CurSenrPhaV_GNDAut "FaultFTMTLCS_CurSenrPhaV_GNDAut" UBYTE Bool_ON_OFF 1 2 0 1 BIT_MASK 0x20 ECU_ADDRESS 0x70012E7C /end MEASUREMENT
/begin MEASUREMENT FaultFTMTLCS_CurSenrPhaV_GNDDetected "FaultFTMTLCS_CurSenrPhaV_GNDDetected" UBYTE Bool_ON_OFF 1 2 0 1 BIT_MASK 0x20 ECU_ADDRESS 0x70012FE0 /end MEASUREMENT
/begin MEASUREMENT FaultFTMTLCS_CurSenrPhaV_GNDLogged "FaultFTMTLCS_CurSenrPhaV_GNDLogged" UBYTE Bool_ON_OFF 1 2 0 1 BIT_MASK 0x20 ECU_ADDRESS 0x70012F2E /end MEASUREMENT
/begin MEASUREMENT FaultFTMTLCS_CurSenrPhaV_OutRngHAut "FaultFTMTLCS_CurSenrPhaV_OutRngHAut" UBYTE Bool_ON_OFF 1 2 0 1 BIT_MASK 0x40 ECU_ADDRESS 0x70012E7C /end MEASUREMENT
/begin MEASUREMENT FaultFTMTLCS_CurSenrPhaV_OutRngHDetected "FaultFTMTLCS_CurSenrPhaV_OutRngHDetected" UBYTE Bool_ON_OFF 1 2 0 1 BIT_MASK 0x40 ECU_ADDRESS 0x70012FE0 /end MEASUREMENT
/begin MEASUREMENT FaultFTMTLCS_CurSenrPhaV_OutRngHLogged "FaultFTMTLCS_CurSenrPhaV_OutRngHLogged" UBYTE Bool_ON_OFF 1 2 0 1 BIT_MASK 0x40 ECU_ADDRESS 0x70012F2E /end MEASUREMENT
/begin MEASUREMENT FaultFTMTLCS_CurSenrPhaV_OutRngLAut "FaultFTMTLCS_CurSenrPhaV_OutRngLAut" UBYTE Bool_ON_OFF 1 2 0 1 BIT_MASK 0x80 ECU_ADDRESS 0x70012E7C /end MEASUREMENT
/begin MEASUREMENT FaultFTMTLCS_CurSenrPhaV_OutRngLDetected "FaultFTMTLCS_CurSenrPhaV_OutRngLDetected" UBYTE Bool_ON_OFF 1 2 0 1 BIT_MASK 0x80 ECU_ADDRESS 0x70012FE0 /end MEASUREMENT
/begin MEASUREMENT FaultFTMTLCS_CurSenrPhaV_OutRngLLogged "FaultFTMTLCS_CurSenrPhaV_OutRngLLogged" UBYTE Bool_ON_OFF 1 2 0 1 BIT_MASK 0x80 ECU_ADDRESS 0x70012F2E /end MEASUREMENT
/begin MEASUREMENT FaultFTMTLCS_CurSenrPhaV_VCCAut "FaultFTMTLCS_CurSenrPhaV_VCCAut" UBYTE Bool_ON_OFF 1 2 0 1 BIT_MASK 0x01 ECU_ADDRESS 0x70012E7D /end MEASUREMENT
/begin MEASUREMENT FaultFTMTLCS_CurSenrPhaV_VCCDetected "FaultFTMTLCS_CurSenrPhaV_VCCDetected" UBYTE Bool_ON_OFF 1 2 0 1 BIT_MASK 0x01 ECU_ADDRESS 0x70012FE1 /end MEASUREMENT
/begin MEASUREMENT FaultFTMTLCS_CurSenrPhaV_VCCLogged "FaultFTMTLCS_CurSenrPhaV_VCCLogged" UBYTE Bool_ON_OFF 1 2 0 1 BIT_MASK 0x01 ECU_ADDRESS 0x70012F2F /end MEASUREMENT
/begin MEASUREMENT FaultFTMTLCS_CurSenrPhaW_GNDAut "FaultFTMTLCS_CurSenrPhaW_GNDAut" UBYTE Bool_ON_OFF 1 2 0 1 BIT_MASK 0x02 ECU_ADDRESS 0x70012E7D /end MEASUREMENT
/begin MEASUREMENT FaultFTMTLCS_CurSenrPhaW_GNDDetected "FaultFTMTLCS_CurSenrPhaW_GNDDetected" UBYTE Bool_ON_OFF 1 2 0 1 BIT_MASK 0x02 ECU_ADDRESS 0x70012FE1 /end MEASUREMENT
/begin MEASUREMENT FaultFTMTLCS_CurSenrPhaW_GNDLogged "FaultFTMTLCS_CurSenrPhaW_GNDLogged" UBYTE Bool_ON_OFF 1 2 0 1 BIT_MASK 0x02 ECU_ADDRESS 0x70012F2F /end MEASUREMENT
/begin MEASUREMENT FaultFTMTLCS_CurSenrPhaW_OutRngHAut "FaultFTMTLCS_CurSenrPhaW_OutRngHAut" UBYTE Bool_ON_OFF 1 2 0 1 BIT_MASK 0x04 ECU_ADDRESS 0x70012E7D /end MEASUREMENT
/begin MEASUREMENT FaultFTMTLCS_CurSenrPhaW_OutRngHDetected "FaultFTMTLCS_CurSenrPhaW_OutRngHDetected" UBYTE Bool_ON_OFF 1 2 0 1 BIT_MASK 0x04 ECU_ADDRESS 0x70012FE1 /end MEASUREMENT
/begin MEASUREMENT FaultFTMTLCS_CurSenrPhaW_OutRngHLogged "FaultFTMTLCS_CurSenrPhaW_OutRngHLogged" UBYTE Bool_ON_OFF 1 2 0 1 BIT_MASK 0x04 ECU_ADDRESS 0x70012F2F /end MEASUREMENT
/begin MEASUREMENT FaultFTMTLCS_CurSenrPhaW_OutRngLAut "FaultFTMTLCS_CurSenrPhaW_OutRngLAut" UBYTE Bool_ON_OFF 1 2 0 1 BIT_MASK 0x08 ECU_ADDRESS 0x70012E7D /end MEASUREMENT
/begin MEASUREMENT FaultFTMTLCS_CurSenrPhaW_OutRngLDetected "FaultFTMTLCS_CurSenrPhaW_OutRngLDetected" UBYTE Bool_ON_OFF 1 2 0 1 BIT_MASK 0x08 ECU_ADDRESS 0x70012FE1 /end MEASUREMENT
/begin MEASUREMENT FaultFTMTLCS_CurSenrPhaW_OutRngLLogged "FaultFTMTLCS_CurSenrPhaW_OutRngLLogged" UBYTE Bool_ON_OFF 1 2 0 1 BIT_MASK 0x08 ECU_ADDRESS 0x70012F2F /end MEASUREMENT
/begin MEASUREMENT FaultFTMTLCS_CurSenrPhaW_VCCAut "FaultFTMTLCS_CurSenrPhaW_VCCAut" UBYTE Bool_ON_OFF 1 2 0 1 BIT_MASK 0x10 ECU_ADDRESS 0x70012E7D /end MEASUREMENT
/begin MEASUREMENT FaultFTMTLCS_CurSenrPhaW_VCCDetected "FaultFTMTLCS_CurSenrPhaW_VCCDetected" UBYTE Bool_ON_OFF 1 2 0 1 BIT_MASK 0x10 ECU_ADDRESS 0x70012FE1 /end MEASUREMENT
/begin MEASUREMENT FaultFTMTLCS_CurSenrPhaW_VCCLogged "FaultFTMTLCS_CurSenrPhaW_VCCLogged" UBYTE Bool_ON_OFF 1 2 0 1 BIT_MASK 0x10 ECU_ADDRESS 0x70012F2F /end MEASUREMENT
/begin MEASUREMENT FaultFTMTLCS_CurrentSumErrorAut "FaultFTMTLCS_CurrentSumErrorAut" UBYTE Bool_ON_OFF 1 2 0 1 BIT_MASK 0x01 ECU_ADDRESS 0x70012E7C /end MEASUREMENT
/begin MEASUREMENT FaultFTMTLCS_CurrentSumErrorDetected "FaultFTMTLCS_CurrentSumErrorDetected" UBYTE Bool_ON_OFF 1 2 0 1 BIT_MASK 0x01 ECU_ADDRESS 0x70012FE0 /end MEASUREMENT
/begin MEASUREMENT FaultFTMTLCS_CurrentSumErrorLogged "FaultFTMTLCS_CurrentSumErrorLogged" UBYTE Bool_ON_OFF 1 2 0 1 BIT_MASK 0x01 ECU_ADDRESS 0x70012F2E /end MEASUREMENT
/begin MEASUREMENT FaultFTMTLCS_Detected "FaultFTMTLCS_Detected" UWORD I_1 1 2 0 65535 ECU_ADDRESS 0x70012FE0 /end MEASUREMENT
/begin MEASUREMENT FaultFTMTLCS_Logged "FaultFTMTLCS_Logged" UWORD I_1 1 2 0 65535 ECU_ADDRESS 0x70012F2E /end MEASUREMENT
/begin MEASUREMENT FaultFailureLevel "FaultFailureLevel" UBYTE I_1 1 2 0 255 ECU_ADDRESS 0x700123C0 /end MEASUREMENT
/begin MEASUREMENT FaultFunctionTypeDetectedArray "FaultFunctionTypeDetectedArray" UWORD I_1 1 2 0 65535 MATRIX_DIM 30 1 1 ECU_ADDRESS 0x70012FAE /end MEASUREMENT
/begin MEASUREMENT FaultFunctionTypeDetectedArray[0] "FaultFunctionTypeDetectedArray[0]" UWORD I_1 1 2 0 65535 ECU_ADDRESS 0x70012FAE /end MEASUREMENT
/begin MEASUREMENT FaultFunctionTypeDetectedArray[10] "FaultFunctionTypeDetectedArray[10]" UWORD I_1 1 2 0 65535 ECU_ADDRESS 0x70012FC2 /end MEASUREMENT
/begin MEASUREMENT FaultFunctionTypeDetectedArray[11] "FaultFunctionTypeDetectedArray[11]" UWORD I_1 1 2 0 65535 ECU_ADDRESS 0x70012FC4 /end MEASUREMENT
/begin MEASUREMENT FaultFunctionTypeDetectedArray[12] "FaultFunctionTypeDetectedArray[12]" UWORD I_1 1 2 0 65535 ECU_ADDRESS 0x70012FC6 /end MEASUREMENT
/begin MEASUREMENT FaultFunctionTypeDetectedArray[13] "FaultFunctionTypeDetectedArray[13]" UWORD I_1 1 2 0 65535 ECU_ADDRESS 0x70012FC8 /end MEASUREMENT
/begin MEASUREMENT FaultFunctionTypeDetectedArray[14] "FaultFunctionTypeDetectedArray[14]" UWORD I_1 1 2 0 65535 ECU_ADDRESS 0x70012FCA /end MEASUREMENT
/begin MEASUREMENT FaultFunctionTypeDetectedArray[15] "FaultFunctionTypeDetectedArray[15]" UWORD I_1 1 2 0 65535 ECU_ADDRESS 0x70012FCC /end MEASUREMENT
/begin MEASUREMENT FaultFunctionTypeDetectedArray[16] "FaultFunctionTypeDetectedArray[16]" UWORD I_1 1 2 0 65535 ECU_ADDRESS 0x70012FCE /end MEASUREMENT
/begin MEASUREMENT FaultFunctionTypeDetectedArray[17] "FaultFunctionTypeDetectedArray[17]" UWORD I_1 1 2 0 65535 ECU_ADDRESS 0x70012FD0 /end MEASUREMENT
/begin MEASUREMENT FaultFunctionTypeDetectedArray[18] "FaultFunctionTypeDetectedArray[18]" UWORD I_1 1 2 0 65535 ECU_ADDRESS 0x70012FD2 /end MEASUREMENT
/begin MEASUREMENT FaultFunctionTypeDetectedArray[19] "FaultFunctionTypeDetectedArray[19]" UWORD I_1 1 2 0 65535 ECU_ADDRESS 0x70012FD4 /end MEASUREMENT
/begin MEASUREMENT FaultFunctionTypeDetectedArray[1] "FaultFunctionTypeDetectedArray[1]" UWORD I_1 1 2 0 65535 ECU_ADDRESS 0x70012FB0 /end MEASUREMENT
/begin MEASUREMENT FaultFunctionTypeDetectedArray[20] "FaultFunctionTypeDetectedArray[20]" UWORD I_1 1 2 0 65535 ECU_ADDRESS 0x70012FD6 /end MEASUREMENT
/begin MEASUREMENT FaultFunctionTypeDetectedArray[21] "FaultFunctionTypeDetectedArray[21]" UWORD I_1 1 2 0 65535 ECU_ADDRESS 0x70012FD8 /end MEASUREMENT
/begin MEASUREMENT FaultFunctionTypeDetectedArray[22] "FaultFunctionTypeDetectedArray[22]" UWORD I_1 1 2 0 65535 ECU_ADDRESS 0x70012FDA /end MEASUREMENT
/begin MEASUREMENT FaultFunctionTypeDetectedArray[23] "FaultFunctionTypeDetectedArray[23]" UWORD I_1 1 2 0 65535 ECU_ADDRESS 0x70012FDC /end MEASUREMENT
/begin MEASUREMENT FaultFunctionTypeDetectedArray[24] "FaultFunctionTypeDetectedArray[24]" UWORD I_1 1 2 0 65535 ECU_ADDRESS 0x70012FDE /end MEASUREMENT
/begin MEASUREMENT FaultFunctionTypeDetectedArray[25] "FaultFunctionTypeDetectedArray[25]" UWORD I_1 1 2 0 65535 ECU_ADDRESS 0x70012FE0 /end MEASUREMENT
/begin MEASUREMENT FaultFunctionTypeDetectedArray[26] "FaultFunctionTypeDetectedArray[26]" UWORD I_1 1 2 0 65535 ECU_ADDRESS 0x70012FE2 /end MEASUREMENT
/begin MEASUREMENT FaultFunctionTypeDetectedArray[27] "FaultFunctionTypeDetectedArray[27]" UWORD I_1 1 2 0 65535 ECU_ADDRESS 0x70012FE4 /end MEASUREMENT
/begin MEASUREMENT FaultFunctionTypeDetectedArray[28] "FaultFunctionTypeDetectedArray[28]" UWORD I_1 1 2 0 65535 ECU_ADDRESS 0x70012FE6 /end MEASUREMENT
/begin MEASUREMENT FaultFunctionTypeDetectedArray[29] "FaultFunctionTypeDetectedArray[29]" UWORD I_1 1 2 0 65535 ECU_ADDRESS 0x70012FE8 /end MEASUREMENT
/begin MEASUREMENT FaultFunctionTypeDetectedArray[2] "FaultFunctionTypeDetectedArray[2]" UWORD I_1 1 2 0 65535 ECU_ADDRESS 0x70012FB2 /end MEASUREMENT
/begin MEASUREMENT FaultFunctionTypeDetectedArray[3] "FaultFunctionTypeDetectedArray[3]" UWORD I_1 1 2 0 65535 ECU_ADDRESS 0x70012FB4 /end MEASUREMENT
/begin MEASUREMENT FaultFunctionTypeDetectedArray[4] "FaultFunctionTypeDetectedArray[4]" UWORD I_1 1 2 0 65535 ECU_ADDRESS 0x70012FB6 /end MEASUREMENT
/begin MEASUREMENT FaultFunctionTypeDetectedArray[5] "FaultFunctionTypeDetectedArray[5]" UWORD I_1 1 2 0 65535 ECU_ADDRESS 0x70012FB8 /end MEASUREMENT
/begin MEASUREMENT FaultFunctionTypeDetectedArray[6] "FaultFunctionTypeDetectedArray[6]" UWORD I_1 1 2 0 65535 ECU_ADDRESS 0x70012FBA /end MEASUREMENT
/begin MEASUREMENT FaultFunctionTypeDetectedArray[7] "FaultFunctionTypeDetectedArray[7]" UWORD I_1 1 2 0 65535 ECU_ADDRESS 0x70012FBC /end MEASUREMENT
/begin MEASUREMENT FaultFunctionTypeDetectedArray[8] "FaultFunctionTypeDetectedArray[8]" UWORD I_1 1 2 0 65535 ECU_ADDRESS 0x70012FBE /end MEASUREMENT
/begin MEASUREMENT FaultFunctionTypeDetectedArray[9] "FaultFunctionTypeDetectedArray[9]" UWORD I_1 1 2 0 65535 ECU_ADDRESS 0x70012FC0 /end MEASUREMENT
/begin MEASUREMENT FaultFunctionTypeLoggedArray "FaultFunctionTypeLoggedArray" UWORD I_1 1 2 0 65535 MATRIX_DIM 30 1 1 ECU_ADDRESS 0x70012EFC /end MEASUREMENT
/begin MEASUREMENT FaultFunctionTypeLoggedArray[0] "FaultFunctionTypeLoggedArray[0]" UWORD I_1 1 2 0 65535 ECU_ADDRESS 0x70012EFC /end MEASUREMENT
/begin MEASUREMENT FaultFunctionTypeLoggedArray[10] "FaultFunctionTypeLoggedArray[10]" UWORD I_1 1 2 0 65535 ECU_ADDRESS 0x70012F10 /end MEASUREMENT
/begin MEASUREMENT FaultFunctionTypeLoggedArray[11] "FaultFunctionTypeLoggedArray[11]" UWORD I_1 1 2 0 65535 ECU_ADDRESS 0x70012F12 /end MEASUREMENT
/begin MEASUREMENT FaultFunctionTypeLoggedArray[12] "FaultFunctionTypeLoggedArray[12]" UWORD I_1 1 2 0 65535 ECU_ADDRESS 0x70012F14 /end MEASUREMENT
/begin MEASUREMENT FaultFunctionTypeLoggedArray[13] "FaultFunctionTypeLoggedArray[13]" UWORD I_1 1 2 0 65535 ECU_ADDRESS 0x70012F16 /end MEASUREMENT
/begin MEASUREMENT FaultFunctionTypeLoggedArray[14] "FaultFunctionTypeLoggedArray[14]" UWORD I_1 1 2 0 65535 ECU_ADDRESS 0x70012F18 /end MEASUREMENT
/begin MEASUREMENT FaultFunctionTypeLoggedArray[15] "FaultFunctionTypeLoggedArray[15]" UWORD I_1 1 2 0 65535 ECU_ADDRESS 0x70012F1A /end MEASUREMENT
/begin MEASUREMENT FaultFunctionTypeLoggedArray[16] "FaultFunctionTypeLoggedArray[16]" UWORD I_1 1 2 0 65535 ECU_ADDRESS 0x70012F1C /end MEASUREMENT
/begin MEASUREMENT FaultFunctionTypeLoggedArray[17] "FaultFunctionTypeLoggedArray[17]" UWORD I_1 1 2 0 65535 ECU_ADDRESS 0x70012F1E /end MEASUREMENT
/begin MEASUREMENT FaultFunctionTypeLoggedArray[18] "FaultFunctionTypeLoggedArray[18]" UWORD I_1 1 2 0 65535 ECU_ADDRESS 0x70012F20 /end MEASUREMENT
/begin MEASUREMENT FaultFunctionTypeLoggedArray[19] "FaultFunctionTypeLoggedArray[19]" UWORD I_1 1 2 0 65535 ECU_ADDRESS 0x70012F22 /end MEASUREMENT
/begin MEASUREMENT FaultFunctionTypeLoggedArray[1] "FaultFunctionTypeLoggedArray[1]" UWORD I_1 1 2 0 65535 ECU_ADDRESS 0x70012EFE /end MEASUREMENT
/begin MEASUREMENT FaultFunctionTypeLoggedArray[20] "FaultFunctionTypeLoggedArray[20]" UWORD I_1 1 2 0 65535 ECU_ADDRESS 0x70012F24 /end MEASUREMENT
/begin MEASUREMENT FaultFunctionTypeLoggedArray[21] "FaultFunctionTypeLoggedArray[21]" UWORD I_1 1 2 0 65535 ECU_ADDRESS 0x70012F26 /end MEASUREMENT
/begin MEASUREMENT FaultFunctionTypeLoggedArray[22] "FaultFunctionTypeLoggedArray[22]" UWORD I_1 1 2 0 65535 ECU_ADDRESS 0x70012F28 /end MEASUREMENT
/begin MEASUREMENT FaultFunctionTypeLoggedArray[23] "FaultFunctionTypeLoggedArray[23]" UWORD I_1 1 2 0 65535 ECU_ADDRESS 0x70012F2A /end MEASUREMENT
/begin MEASUREMENT FaultFunctionTypeLoggedArray[24] "FaultFunctionTypeLoggedArray[24]" UWORD I_1 1 2 0 65535 ECU_ADDRESS 0x70012F2C /end MEASUREMENT
/begin MEASUREMENT FaultFunctionTypeLoggedArray[25] "FaultFunctionTypeLoggedArray[25]" UWORD I_1 1 2 0 65535 ECU_ADDRESS 0x70012F2E /end MEASUREMENT
/begin MEASUREMENT FaultFunctionTypeLoggedArray[26] "FaultFunctionTypeLoggedArray[26]" UWORD I_1 1 2 0 65535 ECU_ADDRESS 0x70012F30 /end MEASUREMENT
/begin MEASUREMENT FaultFunctionTypeLoggedArray[27] "FaultFunctionTypeLoggedArray[27]" UWORD I_1 1 2 0 65535 ECU_ADDRESS 0x70012F32 /end MEASUREMENT
/begin MEASUREMENT FaultFunctionTypeLoggedArray[28] "FaultFunctionTypeLoggedArray[28]" UWORD I_1 1 2 0 65535 ECU_ADDRESS 0x70012F34 /end MEASUREMENT
/begin MEASUREMENT FaultFunctionTypeLoggedArray[29] "FaultFunctionTypeLoggedArray[29]" UWORD I_1 1 2 0 65535 ECU_ADDRESS 0x70012F36 /end MEASUREMENT
/begin MEASUREMENT FaultFunctionTypeLoggedArray[2] "FaultFunctionTypeLoggedArray[2]" UWORD I_1 1 2 0 65535 ECU_ADDRESS 0x70012F00 /end MEASUREMENT
/begin MEASUREMENT FaultFunctionTypeLoggedArray[3] "FaultFunctionTypeLoggedArray[3]" UWORD I_1 1 2 0 65535 ECU_ADDRESS 0x70012F02 /end MEASUREMENT
/begin MEASUREMENT FaultFunctionTypeLoggedArray[4] "FaultFunctionTypeLoggedArray[4]" UWORD I_1 1 2 0 65535 ECU_ADDRESS 0x70012F04 /end MEASUREMENT
/begin MEASUREMENT FaultFunctionTypeLoggedArray[5] "FaultFunctionTypeLoggedArray[5]" UWORD I_1 1 2 0 65535 ECU_ADDRESS 0x70012F06 /end MEASUREMENT
/begin MEASUREMENT FaultFunctionTypeLoggedArray[6] "FaultFunctionTypeLoggedArray[6]" UWORD I_1 1 2 0 65535 ECU_ADDRESS 0x70012F08 /end MEASUREMENT
/begin MEASUREMENT FaultFunctionTypeLoggedArray[7] "FaultFunctionTypeLoggedArray[7]" UWORD I_1 1 2 0 65535 ECU_ADDRESS 0x70012F0A /end MEASUREMENT
/begin MEASUREMENT FaultFunctionTypeLoggedArray[8] "FaultFunctionTypeLoggedArray[8]" UWORD I_1 1 2 0 65535 ECU_ADDRESS 0x70012F0C /end MEASUREMENT
/begin MEASUREMENT FaultFunctionTypeLoggedArray[9] "FaultFunctionTypeLoggedArray[9]" UWORD I_1 1 2 0 65535 ECU_ADDRESS 0x70012F0E /end MEASUREMENT
/begin MEASUREMENT FaultSDMTMEP_CosGndAut "FaultSDMTMEP_CosGndAut" UBYTE Bool_ON_OFF 1 2 0 1 BIT_MASK 0x01 ECU_ADDRESS 0x70012E7E /end MEASUREMENT
/begin MEASUREMENT FaultSDMTMEP_CosGndDetected "FaultSDMTMEP_CosGndDetected" UBYTE Bool_ON_OFF 1 2 0 1 BIT_MASK 0x01 ECU_ADDRESS 0x70012FE2 /end MEASUREMENT
/begin MEASUREMENT FaultSDMTMEP_CosGndLogged "FaultSDMTMEP_CosGndLogged" UBYTE Bool_ON_OFF 1 2 0 1 BIT_MASK 0x01 ECU_ADDRESS 0x70012F30 /end MEASUREMENT
/begin MEASUREMENT FaultSDMTMEP_CosOutRangeHighAut "FaultSDMTMEP_CosOutRangeHighAut" UBYTE Bool_ON_OFF 1 2 0 1 BIT_MASK 0x02 ECU_ADDRESS 0x70012E7E /end MEASUREMENT
/begin MEASUREMENT FaultSDMTMEP_CosOutRangeHighDetected "FaultSDMTMEP_CosOutRangeHighDetected" UBYTE Bool_ON_OFF 1 2 0 1 BIT_MASK 0x02 ECU_ADDRESS 0x70012FE2 /end MEASUREMENT
/begin MEASUREMENT FaultSDMTMEP_CosOutRangeHighLogged "FaultSDMTMEP_CosOutRangeHighLogged" UBYTE Bool_ON_OFF 1 2 0 1 BIT_MASK 0x02 ECU_ADDRESS 0x70012F30 /end MEASUREMENT
/begin MEASUREMENT FaultSDMTMEP_CosOutRangeLowAut "FaultSDMTMEP_CosOutRangeLowAut" UBYTE Bool_ON_OFF 1 2 0 1 BIT_MASK 0x04 ECU_ADDRESS 0x70012E7E /end MEASUREMENT
/begin MEASUREMENT FaultSDMTMEP_CosOutRangeLowDetected "FaultSDMTMEP_CosOutRangeLowDetected" UBYTE Bool_ON_OFF 1 2 0 1 BIT_MASK 0x04 ECU_ADDRESS 0x70012FE2 /end MEASUREMENT
/begin MEASUREMENT FaultSDMTMEP_CosOutRangeLowLogged "FaultSDMTMEP_CosOutRangeLowLogged" UBYTE Bool_ON_OFF 1 2 0 1 BIT_MASK 0x04 ECU_ADDRESS 0x70012F30 /end MEASUREMENT
/begin MEASUREMENT FaultSDMTMEP_CosVccAut "FaultSDMTMEP_CosVccAut" UBYTE Bool_ON_OFF 1 2 0 1 BIT_MASK 0x08 ECU_ADDRESS 0x70012E7E /end MEASUREMENT
/begin MEASUREMENT FaultSDMTMEP_CosVccDetected "FaultSDMTMEP_CosVccDetected" UBYTE Bool_ON_OFF 1 2 0 1 BIT_MASK 0x08 ECU_ADDRESS 0x70012FE2 /end MEASUREMENT
/begin MEASUREMENT FaultSDMTMEP_CosVccLogged "FaultSDMTMEP_CosVccLogged" UBYTE Bool_ON_OFF 1 2 0 1 BIT_MASK 0x08 ECU_ADDRESS 0x70012F30 /end MEASUREMENT
/begin MEASUREMENT FaultSDMTMEP_Detected "FaultSDMTMEP_Detected" UWORD I_1 1 2 0 65535 ECU_ADDRESS 0x70012FE2 /end MEASUREMENT
/begin MEASUREMENT FaultSDMTMEP_Logged "FaultSDMTMEP_Logged" UWORD I_1 1 2 0 65535 ECU_ADDRESS 0x70012F30 /end MEASUREMENT
/begin MEASUREMENT FaultSDMTMEP_OverSpeedAut "FaultSDMTMEP_OverSpeedAut" UBYTE Bool_ON_OFF 1 2 0 1 BIT_MASK 0x10 ECU_ADDRESS 0x70012E7E /end MEASUREMENT
/begin MEASUREMENT FaultSDMTMEP_OverSpeedDetected "FaultSDMTMEP_OverSpeedDetected" UBYTE Bool_ON_OFF 1 2 0 1 BIT_MASK 0x10 ECU_ADDRESS 0x70012FE2 /end MEASUREMENT
/begin MEASUREMENT FaultSDMTMEP_OverSpeedLogged "FaultSDMTMEP_OverSpeedLogged" UBYTE Bool_ON_OFF 1 2 0 1 BIT_MASK 0x10 ECU_ADDRESS 0x70012F30 /end MEASUREMENT
/begin MEASUREMENT FaultSDMTMEP_ResSquaSumErrByFTAut "FaultSDMTMEP_ResSquaSumErrByFTAut" UBYTE Bool_ON_OFF 1 2 0 1 BIT_MASK 0x20 ECU_ADDRESS 0x70012E7E /end MEASUREMENT
/begin MEASUREMENT FaultSDMTMEP_ResSquaSumErrByFTDetected "FaultSDMTMEP_ResSquaSumErrByFTDetected" UBYTE Bool_ON_OFF 1 2 0 1 BIT_MASK 0x20 ECU_ADDRESS 0x70012FE2 /end MEASUREMENT
/begin MEASUREMENT FaultSDMTMEP_ResSquaSumErrByFTLogged "FaultSDMTMEP_ResSquaSumErrByFTLogged" UBYTE Bool_ON_OFF 1 2 0 1 BIT_MASK 0x20 ECU_ADDRESS 0x70012F30 /end MEASUREMENT
/begin MEASUREMENT FaultSDMTMEP_SinGndAut "FaultSDMTMEP_SinGndAut" UBYTE Bool_ON_OFF 1 2 0 1 BIT_MASK 0x40 ECU_ADDRESS 0x70012E7E /end MEASUREMENT
/begin MEASUREMENT FaultSDMTMEP_SinGndDetected "FaultSDMTMEP_SinGndDetected" UBYTE Bool_ON_OFF 1 2 0 1 BIT_MASK 0x40 ECU_ADDRESS 0x70012FE2 /end MEASUREMENT
/begin MEASUREMENT FaultSDMTMEP_SinGndLogged "FaultSDMTMEP_SinGndLogged" UBYTE Bool_ON_OFF 1 2 0 1 BIT_MASK 0x40 ECU_ADDRESS 0x70012F30 /end MEASUREMENT
/begin MEASUREMENT FaultSDMTMEP_SinOutRangeHighAut "FaultSDMTMEP_SinOutRangeHighAut" UBYTE Bool_ON_OFF 1 2 0 1 BIT_MASK 0x80 ECU_ADDRESS 0x70012E7E /end MEASUREMENT
/begin MEASUREMENT FaultSDMTMEP_SinOutRangeHighDetected "FaultSDMTMEP_SinOutRangeHighDetected" UBYTE Bool_ON_OFF 1 2 0 1 BIT_MASK 0x80 ECU_ADDRESS 0x70012FE2 /end MEASUREMENT
/begin MEASUREMENT FaultSDMTMEP_SinOutRangeHighLogged "FaultSDMTMEP_SinOutRangeHighLogged" UBYTE Bool_ON_OFF 1 2 0 1 BIT_MASK 0x80 ECU_ADDRESS 0x70012F30 /end MEASUREMENT
/begin MEASUREMENT FaultSDMTMEP_SinOutRangeLowAut "FaultSDMTMEP_SinOutRangeLowAut" UBYTE Bool_ON_OFF 1 2 0 1 BIT_MASK 0x01 ECU_ADDRESS 0x70012E7F /end MEASUREMENT
/begin MEASUREMENT FaultSDMTMEP_SinOutRangeLowDetected "FaultSDMTMEP_SinOutRangeLowDetected" UBYTE Bool_ON_OFF 1 2 0 1 BIT_MASK 0x01 ECU_ADDRESS 0x70012FE3 /end MEASUREMENT
/begin MEASUREMENT FaultSDMTMEP_SinOutRangeLowLogged "FaultSDMTMEP_SinOutRangeLowLogged" UBYTE Bool_ON_OFF 1 2 0 1 BIT_MASK 0x01 ECU_ADDRESS 0x70012F31 /end MEASUREMENT
/begin MEASUREMENT FaultSDMTMEP_SinVccAut "FaultSDMTMEP_SinVccAut" UBYTE Bool_ON_OFF 1 2 0 1 BIT_MASK 0x02 ECU_ADDRESS 0x70012E7F /end MEASUREMENT
/begin MEASUREMENT FaultSDMTMEP_SinVccDetected "FaultSDMTMEP_SinVccDetected" UBYTE Bool_ON_OFF 1 2 0 1 BIT_MASK 0x02 ECU_ADDRESS 0x70012FE3 /end MEASUREMENT
/begin MEASUREMENT FaultSDMTMEP_SinVccLogged "FaultSDMTMEP_SinVccLogged" UBYTE Bool_ON_OFF 1 2 0 1 BIT_MASK 0x02 ECU_ADDRESS 0x70012F31 /end MEASUREMENT
/begin MEASUREMENT FaultSDMTMEP_UnderSpeedAut "FaultSDMTMEP_UnderSpeedAut" UBYTE Bool_ON_OFF 1 2 0 1 BIT_MASK 0x04 ECU_ADDRESS 0x70012E7F /end MEASUREMENT
/begin MEASUREMENT FaultSDMTMEP_UnderSpeedDetected "FaultSDMTMEP_UnderSpeedDetected" UBYTE Bool_ON_OFF 1 2 0 1 BIT_MASK 0x04 ECU_ADDRESS 0x70012FE3 /end MEASUREMENT
/begin MEASUREMENT FaultSDMTMEP_UnderSpeedLogged "FaultSDMTMEP_UnderSpeedLogged" UBYTE Bool_ON_OFF 1 2 0 1 BIT_MASK 0x04 ECU_ADDRESS 0x70012F31 /end MEASUREMENT
/begin MEASUREMENT FaultTableFuncTypeCounter1 "FaultTableFuncTypeCounter1" UBYTE I_1 1 2 0 255 MATRIX_DIM 133 1 1 ECU_ADDRESS 0x70013060 /end MEASUREMENT
/begin MEASUREMENT FaultTableFuncTypeCounter1[0] "FaultTableFuncTypeCounter1[0]" UBYTE I_1 1 2 0 255 ECU_ADDRESS 0x70013060 /end MEASUREMENT
/begin MEASUREMENT FaultTableFuncTypeCounter1[100] "FaultTableFuncTypeCounter1[100]" UBYTE I_1 1 2 0 255 ECU_ADDRESS 0x700130C4 /end MEASUREMENT
/begin MEASUREMENT FaultTableFuncTypeCounter1[101] "FaultTableFuncTypeCounter1[101]" UBYTE I_1 1 2 0 255 ECU_ADDRESS 0x700130C5 /end MEASUREMENT
/begin MEASUREMENT FaultTableFuncTypeCounter1[102] "FaultTableFuncTypeCounter1[102]" UBYTE I_1 1 2 0 255 ECU_ADDRESS 0x700130C6 /end MEASUREMENT
/begin MEASUREMENT FaultTableFuncTypeCounter1[103] "FaultTableFuncTypeCounter1[103]" UBYTE I_1 1 2 0 255 ECU_ADDRESS 0x700130C7 /end MEASUREMENT
/begin MEASUREMENT FaultTableFuncTypeCounter1[104] "FaultTableFuncTypeCounter1[104]" UBYTE I_1 1 2 0 255 ECU_ADDRESS 0x700130C8 /end MEASUREMENT
/begin MEASUREMENT FaultTableFuncTypeCounter1[105] "FaultTableFuncTypeCounter1[105]" UBYTE I_1 1 2 0 255 ECU_ADDRESS 0x700130C9 /end MEASUREMENT
/begin MEASUREMENT FaultTableFuncTypeCounter1[106] "FaultTableFuncTypeCounter1[106]" UBYTE I_1 1 2 0 255 ECU_ADDRESS 0x700130CA /end MEASUREMENT
/begin MEASUREMENT FaultTableFuncTypeCounter1[107] "FaultTableFuncTypeCounter1[107]" UBYTE I_1 1 2 0 255 ECU_ADDRESS 0x700130CB /end MEASUREMENT
/begin MEASUREMENT FaultTableFuncTypeCounter1[108] "FaultTableFuncTypeCounter1[108]" UBYTE I_1 1 2 0 255 ECU_ADDRESS 0x700130CC /end MEASUREMENT
/begin MEASUREMENT FaultTableFuncTypeCounter1[109] "FaultTableFuncTypeCounter1[109]" UBYTE I_1 1 2 0 255 ECU_ADDRESS 0x700130CD /end MEASUREMENT
/begin MEASUREMENT FaultTableFuncTypeCounter1[10] "FaultTableFuncTypeCounter1[10]" UBYTE I_1 1 2 0 255 ECU_ADDRESS 0x7001306A /end MEASUREMENT
/begin MEASUREMENT FaultTableFuncTypeCounter1[110] "FaultTableFuncTypeCounter1[110]" UBYTE I_1 1 2 0 255 ECU_ADDRESS 0x700130CE /end MEASUREMENT
/begin MEASUREMENT FaultTableFuncTypeCounter1[111] "FaultTableFuncTypeCounter1[111]" UBYTE I_1 1 2 0 255 ECU_ADDRESS 0x700130CF /end MEASUREMENT
/begin MEASUREMENT FaultTableFuncTypeCounter1[112] "FaultTableFuncTypeCounter1[112]" UBYTE I_1 1 2 0 255 ECU_ADDRESS 0x700130D0 /end MEASUREMENT
/begin MEASUREMENT FaultTableFuncTypeCounter1[113] "FaultTableFuncTypeCounter1[113]" UBYTE I_1 1 2 0 255 ECU_ADDRESS 0x700130D1 /end MEASUREMENT
/begin MEASUREMENT FaultTableFuncTypeCounter1[114] "FaultTableFuncTypeCounter1[114]" UBYTE I_1 1 2 0 255 ECU_ADDRESS 0x700130D2 /end MEASUREMENT
/begin MEASUREMENT FaultTableFuncTypeCounter1[115] "FaultTableFuncTypeCounter1[115]" UBYTE I_1 1 2 0 255 ECU_ADDRESS 0x700130D3 /end MEASUREMENT
/begin MEASUREMENT FaultTableFuncTypeCounter1[116] "FaultTableFuncTypeCounter1[116]" UBYTE I_1 1 2 0 255 ECU_ADDRESS 0x700130D4 /end MEASUREMENT
/begin MEASUREMENT FaultTableFuncTypeCounter1[117] "FaultTableFuncTypeCounter1[117]" UBYTE I_1 1 2 0 255 ECU_ADDRESS 0x700130D5 /end MEASUREMENT
/begin MEASUREMENT FaultTableFuncTypeCounter1[118] "FaultTableFuncTypeCounter1[118]" UBYTE I_1 1 2 0 255 ECU_ADDRESS 0x700130D6 /end MEASUREMENT
/begin MEASUREMENT FaultTableFuncTypeCounter1[119] "FaultTableFuncTypeCounter1[119]" UBYTE I_1 1 2 0 255 ECU_ADDRESS 0x700130D7 /end MEASUREMENT
/begin MEASUREMENT FaultTableFuncTypeCounter1[11] "FaultTableFuncTypeCounter1[11]" UBYTE I_1 1 2 0 255 ECU_ADDRESS 0x7001306B /end MEASUREMENT
/begin MEASUREMENT FaultTableFuncTypeCounter1[120] "FaultTableFuncTypeCounter1[120]" UBYTE I_1 1 2 0 255 ECU_ADDRESS 0x700130D8 /end MEASUREMENT
/begin MEASUREMENT FaultTableFuncTypeCounter1[121] "FaultTableFuncTypeCounter1[121]" UBYTE I_1 1 2 0 255 ECU_ADDRESS 0x700130D9 /end MEASUREMENT
/begin MEASUREMENT FaultTableFuncTypeCounter1[122] "FaultTableFuncTypeCounter1[122]" UBYTE I_1 1 2 0 255 ECU_ADDRESS 0x700130DA /end MEASUREMENT
/begin MEASUREMENT FaultTableFuncTypeCounter1[123] "FaultTableFuncTypeCounter1[123]" UBYTE I_1 1 2 0 255 ECU_ADDRESS 0x700130DB /end MEASUREMENT
/begin MEASUREMENT FaultTableFuncTypeCounter1[124] "FaultTableFuncTypeCounter1[124]" UBYTE I_1 1 2 0 255 ECU_ADDRESS 0x700130DC /end MEASUREMENT
/begin MEASUREMENT FaultTableFuncTypeCounter1[125] "FaultTableFuncTypeCounter1[125]" UBYTE I_1 1 2 0 255 ECU_ADDRESS 0x700130DD /end MEASUREMENT
/begin MEASUREMENT FaultTableFuncTypeCounter1[126] "FaultTableFuncTypeCounter1[126]" UBYTE I_1 1 2 0 255 ECU_ADDRESS 0x700130DE /end MEASUREMENT
/begin MEASUREMENT FaultTableFuncTypeCounter1[127] "FaultTableFuncTypeCounter1[127]" UBYTE I_1 1 2 0 255 ECU_ADDRESS 0x700130DF /end MEASUREMENT
/begin MEASUREMENT FaultTableFuncTypeCounter1[128] "FaultTableFuncTypeCounter1[128]" UBYTE I_1 1 2 0 255 ECU_ADDRESS 0x700130E0 /end MEASUREMENT
/begin MEASUREMENT FaultTableFuncTypeCounter1[129] "FaultTableFuncTypeCounter1[129]" UBYTE I_1 1 2 0 255 ECU_ADDRESS 0x700130E1 /end MEASUREMENT
/begin MEASUREMENT FaultTableFuncTypeCounter1[12] "FaultTableFuncTypeCounter1[12]" UBYTE I_1 1 2 0 255 ECU_ADDRESS 0x7001306C /end MEASUREMENT
/begin MEASUREMENT FaultTableFuncTypeCounter1[130] "FaultTableFuncTypeCounter1[130]" UBYTE I_1 1 2 0 255 ECU_ADDRESS 0x700130E2 /end MEASUREMENT
/begin MEASUREMENT FaultTableFuncTypeCounter1[131] "FaultTableFuncTypeCounter1[131]" UBYTE I_1 1 2 0 255 ECU_ADDRESS 0x700130E3 /end MEASUREMENT
/begin MEASUREMENT FaultTableFuncTypeCounter1[132] "FaultTableFuncTypeCounter1[132]" UBYTE I_1 1 2 0 255 ECU_ADDRESS 0x700130E4 /end MEASUREMENT
/begin MEASUREMENT FaultTableFuncTypeCounter1[13] "FaultTableFuncTypeCounter1[13]" UBYTE I_1 1 2 0 255 ECU_ADDRESS 0x7001306D /end MEASUREMENT
/begin MEASUREMENT FaultTableFuncTypeCounter1[14] "FaultTableFuncTypeCounter1[14]" UBYTE I_1 1 2 0 255 ECU_ADDRESS 0x7001306E /end MEASUREMENT
/begin MEASUREMENT FaultTableFuncTypeCounter1[15] "FaultTableFuncTypeCounter1[15]" UBYTE I_1 1 2 0 255 ECU_ADDRESS 0x7001306F /end MEASUREMENT
/begin MEASUREMENT FaultTableFuncTypeCounter1[16] "FaultTableFuncTypeCounter1[16]" UBYTE I_1 1 2 0 255 ECU_ADDRESS 0x70013070 /end MEASUREMENT
/begin MEASUREMENT FaultTableFuncTypeCounter1[17] "FaultTableFuncTypeCounter1[17]" UBYTE I_1 1 2 0 255 ECU_ADDRESS 0x70013071 /end MEASUREMENT
/begin MEASUREMENT FaultTableFuncTypeCounter1[18] "FaultTableFuncTypeCounter1[18]" UBYTE I_1 1 2 0 255 ECU_ADDRESS 0x70013072 /end MEASUREMENT
/begin MEASUREMENT FaultTableFuncTypeCounter1[19] "FaultTableFuncTypeCounter1[19]" UBYTE I_1 1 2 0 255 ECU_ADDRESS 0x70013073 /end MEASUREMENT
/begin MEASUREMENT FaultTableFuncTypeCounter1[1] "FaultTableFuncTypeCounter1[1]" UBYTE I_1 1 2 0 255 ECU_ADDRESS 0x70013061 /end MEASUREMENT
/begin MEASUREMENT FaultTableFuncTypeCounter1[20] "FaultTableFuncTypeCounter1[20]" UBYTE I_1 1 2 0 255 ECU_ADDRESS 0x70013074 /end MEASUREMENT
/begin MEASUREMENT FaultTableFuncTypeCounter1[21] "FaultTableFuncTypeCounter1[21]" UBYTE I_1 1 2 0 255 ECU_ADDRESS 0x70013075 /end MEASUREMENT
/begin MEASUREMENT FaultTableFuncTypeCounter1[22] "FaultTableFuncTypeCounter1[22]" UBYTE I_1 1 2 0 255 ECU_ADDRESS 0x70013076 /end MEASUREMENT
/begin MEASUREMENT FaultTableFuncTypeCounter1[23] "FaultTableFuncTypeCounter1[23]" UBYTE I_1 1 2 0 255 ECU_ADDRESS 0x70013077 /end MEASUREMENT
/begin MEASUREMENT FaultTableFuncTypeCounter1[24] "FaultTableFuncTypeCounter1[24]" UBYTE I_1 1 2 0 255 ECU_ADDRESS 0x70013078 /end MEASUREMENT
/begin MEASUREMENT FaultTableFuncTypeCounter1[25] "FaultTableFuncTypeCounter1[25]" UBYTE I_1 1 2 0 255 ECU_ADDRESS 0x70013079 /end MEASUREMENT
/begin MEASUREMENT FaultTableFuncTypeCounter1[26] "FaultTableFuncTypeCounter1[26]" UBYTE I_1 1 2 0 255 ECU_ADDRESS 0x7001307A /end MEASUREMENT
/begin MEASUREMENT FaultTableFuncTypeCounter1[27] "FaultTableFuncTypeCounter1[27]" UBYTE I_1 1 2 0 255 ECU_ADDRESS 0x7001307B /end MEASUREMENT
/begin MEASUREMENT FaultTableFuncTypeCounter1[28] "FaultTableFuncTypeCounter1[28]" UBYTE I_1 1 2 0 255 ECU_ADDRESS 0x7001307C /end MEASUREMENT
/begin MEASUREMENT FaultTableFuncTypeCounter1[29] "FaultTableFuncTypeCounter1[29]" UBYTE I_1 1 2 0 255 ECU_ADDRESS 0x7001307D /end MEASUREMENT
/begin MEASUREMENT FaultTableFuncTypeCounter1[2] "FaultTableFuncTypeCounter1[2]" UBYTE I_1 1 2 0 255 ECU_ADDRESS 0x70013062 /end MEASUREMENT
/begin MEASUREMENT FaultTableFuncTypeCounter1[30] "FaultTableFuncTypeCounter1[30]" UBYTE I_1 1 2 0 255 ECU_ADDRESS 0x7001307E /end MEASUREMENT
/begin MEASUREMENT FaultTableFuncTypeCounter1[31] "FaultTableFuncTypeCounter1[31]" UBYTE I_1 1 2 0 255 ECU_ADDRESS 0x7001307F /end MEASUREMENT
/begin MEASUREMENT FaultTableFuncTypeCounter1[32] "FaultTableFuncTypeCounter1[32]" UBYTE I_1 1 2 0 255 ECU_ADDRESS 0x70013080 /end MEASUREMENT
/begin MEASUREMENT FaultTableFuncTypeCounter1[33] "FaultTableFuncTypeCounter1[33]" UBYTE I_1 1 2 0 255 ECU_ADDRESS 0x70013081 /end MEASUREMENT
/begin MEASUREMENT FaultTableFuncTypeCounter1[34] "FaultTableFuncTypeCounter1[34]" UBYTE I_1 1 2 0 255 ECU_ADDRESS 0x70013082 /end MEASUREMENT
/begin MEASUREMENT FaultTableFuncTypeCounter1[35] "FaultTableFuncTypeCounter1[35]" UBYTE I_1 1 2 0 255 ECU_ADDRESS 0x70013083 /end MEASUREMENT
/begin MEASUREMENT FaultTableFuncTypeCounter1[36] "FaultTableFuncTypeCounter1[36]" UBYTE I_1 1 2 0 255 ECU_ADDRESS 0x70013084 /end MEASUREMENT
/begin MEASUREMENT FaultTableFuncTypeCounter1[37] "FaultTableFuncTypeCounter1[37]" UBYTE I_1 1 2 0 255 ECU_ADDRESS 0x70013085 /end MEASUREMENT
/begin MEASUREMENT FaultTableFuncTypeCounter1[38] "FaultTableFuncTypeCounter1[38]" UBYTE I_1 1 2 0 255 ECU_ADDRESS 0x70013086 /end MEASUREMENT
/begin MEASUREMENT FaultTableFuncTypeCounter1[39] "FaultTableFuncTypeCounter1[39]" UBYTE I_1 1 2 0 255 ECU_ADDRESS 0x70013087 /end MEASUREMENT
/begin MEASUREMENT FaultTableFuncTypeCounter1[3] "FaultTableFuncTypeCounter1[3]" UBYTE I_1 1 2 0 255 ECU_ADDRESS 0x70013063 /end MEASUREMENT
/begin MEASUREMENT FaultTableFuncTypeCounter1[40] "FaultTableFuncTypeCounter1[40]" UBYTE I_1 1 2 0 255 ECU_ADDRESS 0x70013088 /end MEASUREMENT
/begin MEASUREMENT FaultTableFuncTypeCounter1[41] "FaultTableFuncTypeCounter1[41]" UBYTE I_1 1 2 0 255 ECU_ADDRESS 0x70013089 /end MEASUREMENT
/begin MEASUREMENT FaultTableFuncTypeCounter1[42] "FaultTableFuncTypeCounter1[42]" UBYTE I_1 1 2 0 255 ECU_ADDRESS 0x7001308A /end MEASUREMENT
/begin MEASUREMENT FaultTableFuncTypeCounter1[43] "FaultTableFuncTypeCounter1[43]" UBYTE I_1 1 2 0 255 ECU_ADDRESS 0x7001308B /end MEASUREMENT
/begin MEASUREMENT FaultTableFuncTypeCounter1[44] "FaultTableFuncTypeCounter1[44]" UBYTE I_1 1 2 0 255 ECU_ADDRESS 0x7001308C /end MEASUREMENT
/begin MEASUREMENT FaultTableFuncTypeCounter1[45] "FaultTableFuncTypeCounter1[45]" UBYTE I_1 1 2 0 255 ECU_ADDRESS 0x7001308D /end MEASUREMENT
/begin MEASUREMENT FaultTableFuncTypeCounter1[46] "FaultTableFuncTypeCounter1[46]" UBYTE I_1 1 2 0 255 ECU_ADDRESS 0x7001308E /end MEASUREMENT
/begin MEASUREMENT FaultTableFuncTypeCounter1[47] "FaultTableFuncTypeCounter1[47]" UBYTE I_1 1 2 0 255 ECU_ADDRESS 0x7001308F /end MEASUREMENT
/begin MEASUREMENT FaultTableFuncTypeCounter1[48] "FaultTableFuncTypeCounter1[48]" UBYTE I_1 1 2 0 255 ECU_ADDRESS 0x70013090 /end MEASUREMENT
/begin MEASUREMENT FaultTableFuncTypeCounter1[49] "FaultTableFuncTypeCounter1[49]" UBYTE I_1 1 2 0 255 ECU_ADDRESS 0x70013091 /end MEASUREMENT
/begin MEASUREMENT FaultTableFuncTypeCounter1[4] "FaultTableFuncTypeCounter1[4]" UBYTE I_1 1 2 0 255 ECU_ADDRESS 0x70013064 /end MEASUREMENT
/begin MEASUREMENT FaultTableFuncTypeCounter1[50] "FaultTableFuncTypeCounter1[50]" UBYTE I_1 1 2 0 255 ECU_ADDRESS 0x70013092 /end MEASUREMENT
/begin MEASUREMENT FaultTableFuncTypeCounter1[51] "FaultTableFuncTypeCounter1[51]" UBYTE I_1 1 2 0 255 ECU_ADDRESS 0x70013093 /end MEASUREMENT
/begin MEASUREMENT FaultTableFuncTypeCounter1[52] "FaultTableFuncTypeCounter1[52]" UBYTE I_1 1 2 0 255 ECU_ADDRESS 0x70013094 /end MEASUREMENT
/begin MEASUREMENT FaultTableFuncTypeCounter1[53] "FaultTableFuncTypeCounter1[53]" UBYTE I_1 1 2 0 255 ECU_ADDRESS 0x70013095 /end MEASUREMENT
/begin MEASUREMENT GBSW_bOCDataNotRation "..." UBYTE Bool_ON_OFF 1 2 0 1 BIT_MASK 0x01 ECU_ADDRESS 0x70009C97 /end MEASUREMENT
/begin MEASUREMENT GCCU6_u8OvcRcvCnt "..." UBYTE I_1 1 2 0 255 ECU_ADDRESS 0x70013CDF /end MEASUREMENT
/begin MEASUREMENT MAIN_u16ADS1115Result "..." UWORD I_1 1 2 0 65535 ECU_ADDRESS 0x70015968 /end MEASUREMENT
/begin MEASUREMENT TPPC_u8ACMASCStep "ACM State" UBYTE I_1 1 2 0 255 ECU_ADDRESS 0x7002009D /end MEASUREMENT
/begin MEASUREMENT TPPC_u8EPSASCStep "EPS State" UBYTE I_1 1 2 0 255 ECU_ADDRESS 0x700200A7 /end MEASUREMENT
/begin COMPU_METHOD I_1 "" RAT_FUNC "%9.2" "-" COEFFS 0 1 0 0 0 1 /end COMPU_METHOD
/begin COMPU_METHOD F_1_p0_2 "" RAT_FUNC "%9.2" "-" COEFFS 0 1 0 0 0 1 /end COMPU_METHOD
/begin COMPU_METHOD F_100_p0_3 "" RAT_FUNC "%9.2" "%" COEFFS 0 1 0 0 0 100 /end COMPU_METHOD
/begin COMPU_METHOD F_10_p0_4 "" RAT_FUNC "%9.2" "ms" COEFFS 0 1 0 0 0 10 /end COMPU_METHOD
/begin COMPU_METHOD F_0v0012210012_p0_6 "" RAT_FUNC "%9.3" "V" COEFFS 0 1 0 0 0 0.001221 /end COMPU_METHOD
/begin COMPU_METHOD I_7 "" RAT_FUNC "%9.2" "V" COEFFS 0 1 0 0 0 1 /end COMPU_METHOD
/begin COMPU_METHOD I_11 "" RAT_FUNC "%9.2" "uint8" COEFFS 0 1 0 0 0 1 /end COMPU_METHOD
/begin COMPU_METHOD F_5_p0_12 "" RAT_FUNC "%9.2" "ms" COEFFS 0 1 0 0 0 5 /end COMPU_METHOD
/begin COMPU_METHOD F_0v0128205128_p0_13 "" RAT_FUNC "%9.2" "V" COEFFS 0 1 0 0 0 0.0128205 /end COMPU_METHOD
/begin COMPU_METHOD Id_0x00 "" RAT_FUNC "%9.2" "." COEFFS 0 1 0 0 0 1 /end COMPU_METHOD
/begin COMPU_METHOD Bool_ON_OFF "" TAB_VERB "%8.4" "." COMPU_TAB_REF Bool_ON_OFF_table /end COMPU_METHOD
/begin COMPU_VTAB Bool_ON_OFF_table "" TAB_VERB 2 0 "OFF" 1 "ON" /end COMPU_VTAB
/begin FUNCTION ADS1115 ""
 /begin DEF_CHARACTERISTIC ADS1115_u8UserCfg_DRC ADS1115_u8UserCfg_MUXC ADS1115_u8UserCfg_PGAC /end DEF_CHARACTERISTIC
 /begin OUT_MEASUREMENT MAIN_u16ADS1115Result /end OUT_MEASUREMENT
/end FUNCTION
/begin FUNCTION AMAIN ""
 /begin DEF_CHARACTERISTIC AMAIN_f32CanSpeedTgtSetC AMAIN_f32OverBhvThdC AMAIN_f32UvwOvCurrThdC AMAIN_HARDBenchOnC AMAIN_u32VSICntCkreqESMStartedC AMAIN_u32VSICntCkreqVSIStartedC AMAIN_VSIBenchOnWriteDataC /end DEF_CHARACTERISTIC
 /begin OUT_MEASUREMENT AMAIN_bBswReadySts AMAIN_bESMStarted AMAIN_bProgConditionOk AMAIN_bSoftOvBhvFlg AMAIN_bSoftOvCurrPhsUFlg AMAIN_bSoftOvCurrPhsVFlg AMAIN_bSoftOvCurrPhsWFlg AMAIN_bVSIStarted AMAIN_EndTime AMAIN_ESMGo2StartupIEvent AMAIN_f32PWMDutyUPhys AMAIN_f32PWMDutyVPhys AMAIN_f32PWMDutyWPhys AMAIN_startTime AMAIN_TotalTime AMAIN_u16ACMASCRecoverCnt AMAIN_u16ACMASCStartupChkFaultHighCnt AMAIN_u16ACMASCStartupChkFaultLowCnt AMAIN_u16Cnt1 AMAIN_u16Cnt10 AMAIN_u16Cnt100 AMAIN_u16Cnt2 AMAIN_u16Cnt200 AMAIN_u16Cnt5 AMAIN_u16EPSASCRecoverCnt AMAIN_u16EPSASCStartupChkFaultHighCnt AMAIN_u16EPSASCStartupChkFaultLowCnt AMAIN_u16VadcPhaseCurU AMAIN_u16VadcPhaseCurV AMAIN_u16VadcPhaseCurW AMAIN_u8ACMASCRecoverTimes AMAIN_u8DEV_Fault AMAIN_u8DEV_Fault[0] AMAIN_u8DEV_Fault[10] AMAIN_u8DEV_Fault[11] AMAIN_u8DEV_Fault[12] AMAIN_u8DEV_Fault[13] AMAIN_u8DEV_Fault[14] AMAIN_u8DEV_Fault[15] AMAIN_u8DEV_Fault[1] AMAIN_u8DEV_Fault[2] AMAIN_u8DEV_Fault[3] AMAIN_u8DEV_Fault[4] AMAIN_u8DEV_Fault[5] AMAIN_u8DEV_Fault[6] AMAIN_u8DEV_Fault[7] AMAIN_u8DEV_Fault[8] AMAIN_u8DEV_Fault[9] AMAIN_u8EPSASCRecoverTimes TPPC_u8ACMASCStep TPPC_u8EPSASCStep /end OUT_MEASUREMENT
/end FUNCTION
/begin FUNCTION BLDC ""
 /begin DEF_CHARACTERISTIC BLDC_bHallInvalidFltTestOnC BLDC_bHallUndefFltTestOnC BLDC_bOilPressShortGndFltTestOnC BLDC_bOilPressShortVccFltTestOnC BLDC_bP5vAD2SOverVolFltTestOnC BLDC_bP5vAD2SUnderVolFltTestOnC BLDC_kf32LVThdHighC BLDC_kf32LVThdLowC BLDC_kf32MidPotMaxMonitorDutyC BLDC_kf32MidPotMinMonitorDutyC BLDC_kf32MidPotShrtGndDutyC BLDC_kf32MidPotShrtVccDutyC BLDC_kf32MidPotTgtHighC BLDC_kf32MidPotTgtLowC BLDC_kf32MotorSpeedC BLDC_kf32P5vAD2SOverVolC BLDC_kf32P5vAD2SUnderVolC BLDC_kf32TgtDutyDeltMaxC BLDC_ku16MidPotFltConfirmC BLDC_ku16MidPotFltIncStepC BLDC_ku16MidPotRcvTimC BLDC_ku16TgtDutyRisingTimC /end DEF_CHARACTERISTIC
 /begin OUT_MEASUREMENT BLDC_f32BldcPosDuty BLDC_f32CurCycleDuty BLDC_u16DutyDelayCnt BLDC_u32MotPosSigDuty BLDC_u32MotPosSigPerd BLDC_u8CurDirSts BLDC_u8DutyHoldTicks BLDC_u8DutyModeStt BLDC_u8HallStt BLDC_u8PrevDirSts /end OUT_MEASUREMENT
/end FUNCTION
/begin FUNCTION BSW "" /begin DEF_CHARACTERISTIC BSW_bSPYBenchOnC BSW_ku16VSIRdyChkTimoutC BSW_u8E2E_ValidC /end DEF_CHARACTERISTIC
 /begin OUT_MEASUREMENT BSW_bMKeyOnStatus BSW_bOCDataNotRation BSW_bRxTOutFlag_Can01_Rx01 BSW_bRxTOutFlag_Can01_Rx02 BSW_bRxTOutFlag_Can01_Rx03 BSW_bRxTOutFlag_Can01_Rx04 BSW_bRxTOutFlag_Can01_Rx05 BSW_bRxTOutFlag_Can01_Rx06 BSW_bRxTOutFlag_Can01_Rx07 BSW_bRxTOutFlag_Can01_Rx08 BSW_bRxTOutFlag_Can01_Rx09 BSW_bRxTOutFlag_Can01_Rx10 BSW_bRxTOutFlag_Can01_Rx11 BSW_bRxTOutFlag_Can01_Rx12 BSW_bRxTOutFlag_Can01_Rx13 BSW_bRxTOutFlag_Can01_Rx14 BSW_bRxTOutFlag_Can01_Rx15 BSW_bRxTOutFlag_Can01_Rx16 BSW_bRxTOutFlag_Can01_Rx17 BSW_bRxTOutFlag_Can01_Rx18 BSW_bRxTOutFlag_Can01_Rx19 BSW_bRxTOutFlag_Can01_Rx20 BSW_bRxTOutFlag_Can01_Rx21 BSW_bRxTOutFlag_Can01_Rx22 BSW_bRxTOutFlag_Can01_Rx23 BSW_bRxTOutFlag_Can01_Rx24 BSW_bRxTOutFlag_Can01_Rx25 BSW_bRxTOutFlag_Can01_Rx26 BSW_bRxTOutFlag_Can01_Rx27 BSW_bRxTOutFlag_Can01_Rx28 BSW_bRxTOutFlag_Can01_Rx29 BSW_bRxTOutFlag_Can01_Rx30 BSW_bRxTOutFlag_Can01_Rx31 BSW_bRxTOutFlag_Can01_Rx32 BSW_bRxTOutFlag_Can01_Rx33 BSW_bRxTOutFlag_Can01_Rx34 BSW_bRxTOutFlag_Can01_Rx35 BSW_bRxTOutFlag_Can01_Rx36 BSW_bRxTOutFlag_Can01_Rx37 BSW_bRxTOutFlag_Can01_Rx38 BSW_bRxTOutFlag_Can01_Rx39 BSW_bRxTOutFlag_Can01_Rx40 BSW_bRxTOutFlag_Can02_Rx01 BSW_bRxTOutFlag_Can02_Rx02 BSW_bRxTOutFlag_Can02_Rx03 BSW_bRxTOutFlag_Can02_Rx04 BSW_bRxTOutFlag_Can02_Rx05 BSW_bRxTOutFlag_Can02_Rx06 BSW_bRxTOutFlag_Can02_Rx07 BSW_bRxTOutFlag_Can02_Rx08 BSW_bRxTOutFlag_Can02_Rx09 BSW_bRxTOutFlag_Can02_Rx10 BSW_bRxTOutFlag_Can02_Rx11 BSW_bRxTOutFlag_Can02_Rx12 BSW_bRxTOutFlag_Can02_Rx13 BSW_bRxTOutFlag_Can02_Rx14 BSW_bRxTOutFlag_Can02_Rx15 BSW_bRxTOutFlag_Can02_Rx16 BSW_bRxTOutFlag_Can02_Rx17 BSW_bRxTOutFlag_Can02_Rx18 BSW_bRxTOutFlag_Can02_Rx19 BSW_bRxTOutFlag_Can02_Rx20 BSW_bRxTOutFlag_Can02_Rx21 BSW_bRxTOutFlag_Can02_Rx22 BSW_bRxTOutFlag_Can02_Rx23 BSW_bRxTOutFlag_Can02_Rx24 BSW_bRxTOutFlag_Can02_Rx25 BSW_bRxTOutFlag_Can02_Rx26 BSW_bRxTOutFlag_Can02_Rx27 BSW_bRxTOutFlag_Can02_Rx28 BSW_bRxTOutFlag_Can02_Rx29 BSW_bRxTOutFlag_Can02_Rx30 BSW_bRxTOutFlag_Can02_Rx31 BSW_bRxTOutFlag_Can02_Rx32 BSW_bRxTOutFlag_Can02_Rx33 BSW_bRxTOutFlag_Can02_Rx34 BSW_bRxTOutFlag_Can02_Rx35 BSW_bRxTOutFlag_Can02_Rx36 BSW_bRxTOutFlag_Can02_Rx37 BSW_bRxTOutFlag_Can02_Rx38 BSW_bRxTOutFlag_Can02_Rx39 BSW_bRxTOutFlag_Can02_Rx40 BSW_bRxTOutFlag_Can03_Rx01 BSW_bRxTOutFlag_Can03_Rx02 BSW_bRxTOutFlag_Can03_Rx03 BSW_bRxTOutFlag_Can03_Rx04 BSW_bRxTOutFlag_Can03_Rx05 BSW_bRxTOutFlag_Can03_Rx06 BSW_bRxTOutFlag_Can03_Rx07 BSW_bRxTOutFlag_Can03_Rx08 BSW_bRxTOutFlag_Can03_Rx09 BSW_bRxTOutFlag_Can03_Rx10 BSW_bRxTOutFlag_Can03_Rx11 BSW_bRxTOutFlag_Can03_Rx12 BSW_bRxTOutFlag_Can03_Rx13 BSW_bRxTOutFlag_Can03_Rx14 BSW_bRxTOutFlag_Can03_Rx15 BSW_bRxTOutFlag_Can03_Rx16 BSW_bRxTOutFlag_Can03_Rx17 BSW_bRxTOutFlag_Can03_Rx18 BSW_bRxTOutFlag_Can03_Rx19 BSW_bRxTOutFlag_Can03_Rx20 BSW_bRxTOutFlag_Can03_Rx21 BSW_bRxTOutFlag_Can03_Rx22 BSW_bRxTOutFlag_Can03_Rx23 BSW_bRxTOutFlag_Can03_Rx24 BSW_bRxTOutFlag_Can03_Rx25 BSW_bRxTOutFlag_Can03_Rx26 BSW_bRxTOutFlag_Can03_Rx27 BSW_bRxTOutFlag_Can03_Rx28 BSW_bRxTOutFlag_Can03_Rx29 BSW_bRxTOutFlag_Can03_Rx30 BSW_bRxTOutFlag_Can03_Rx31 BSW_bRxTOutFlag_Can03_Rx32 BSW_bRxTOutFlag_Can03_Rx33 BSW_bRxTOutFlag_Can03_Rx34 BSW_bRxTOutFlag_Can03_Rx35 BSW_bRxTOutFlag_Can03_Rx36 BSW_bRxTOutFlag_Can03_Rx37 BSW_bRxTOutFlag_Can03_Rx38 BSW_bRxTOutFlag_Can03_Rx39 BSW_bRxTOutFlag_Can03_Rx40 BSW_bVsiReadySts BSW_u16RawVolP5VBT BSW_u16RawVolP5VCOM BSW_u16RawVolP5VHS BSW_u16RawVolP5VLS BSW_u16RawVolP5VREF BSW_u16RawVolP9VMulti BSW_u16RawVolt15VRdc BSW_u16SelfChkDelay BSW_u16VsiReadyDelay BSW_u32VSICounterCkreq BSW_u8CAN0BusOffCounter BSW_u8CAN1BusOffCounter BSW_u8SelfChkErr GBSW_bOCDataNotRation /end OUT_MEASUREMENT
/end FUNCTION
/begin FUNCTION CALUSR "" /begin DEF_CHARACTERISTIC CalUsr_ku32CalibUpdEnaMskA CalUsr_ku32CalibUpdEnaMskB /end DEF_CHARACTERISTIC
 /begin OUT_MEASUREMENT CalUsr_bIsCalibUpdEna CalUsr_u32ChkDataCrc CalUsr_u32POCalibDnEnaMskA CalUsr_u32POCalibDnEnaMskB CalUsr_u32PODataCRC /end OUT_MEASUREMENT
/end FUNCTION
/begin FUNCTION CCU6 ""
 /begin DEF_CHARACTERISTIC CCU6_bAlimFreqChgEnaC CCU6_bDualSmpEnaC CCU6_bHwOvcFltDetEnaC CCU6_bHwPinAscEnaC CCU6_f32DrvClkDutyThdHighC CCU6_f32DrvClkDutyThdLowC CCU6_kbDrvBdClkEnaC CCU6_kf32MidPointDutyHC CCU6_kf32MidPointDutyLC CCU6_ku16AlimDutyCycRawC CCU6_ku32AlimFreqRawC CCU6_ku8AscRecoverCntMaxC CCU6_ku8OvcRcvCntMaxC CCU6_ku8PwmMidPointFaultC GCCU6_ku8OvcRcvCntMaxC /end DEF_CHARACTERISTIC
 /begin OUT_MEASUREMENT CCU6_au32PWMOnTime CCU6_au32PWMOnTime[0] CCU6_au32PWMOnTime[1] CCU6_au32PWMOnTime[2] CCU6_bAkdAfterAscReq CCU6_bClrTrapReq CCU6_bHwFaultDcOvVolt CCU6_bHwFaultIgbtH CCU6_bHwFaultIgbtL CCU6_bHwFaultOvcU CCU6_bHwFaultOvcV CCU6_bHwFaultOvcW CCU6_bIgbtHighSideShort CCU6_bIgbtLowSideShort CCU6_bIsCCU6Start CCU6_bIuvwCompReq CCU6_bMotorSpdRdy CCU6_bP5VDiagReinitCmd CCU6_bP5VHSFltFlg CCU6_bP5VLSFltFlg CCU6_bPwmMidPointU CCU6_bPwmMidPointV CCU6_bPwmMidPointW CCU6_bPwmOnGoingFlg CCU6_bT12ZeroMatchFlg CCU6_bTrapTrigger CCU6_f32HighVolPhys CCU6_f32PwmDutyPhysUZ CCU6_f32PwmDutyPhysVZ CCU6_f32PwmDutyPhysWZ CCU6_u16AlimPowerOnDelay CCU6_u16CCU6T13CmpVal CCU6_u16HighVolAdc CCU6_u16McuAscSttDelay CCU6_u16P5VHSAdc CCU6_u16PowerOnDelay CCU6_u16PwmMaxDutyCyc CCU6_u16PwmMidPointErrCnt CCU6_u16PwmMinDutyCyc CCU6_u16PwmModReq CCU6_u16T12CntVal CCU6_u16T12PeriodVal CCU6_u16T13PeriodVal CCU6_u32DrvClkHsDutyRaw CCU6_u32DrvClkHsPerdRaw CCU6_u32DrvClkLsDutyRaw CCU6_u32DrvClkLsPerdRaw CCU6_u32TrapCreq CCU6_u8AscRecoverCnt CCU6_u8McuAscSttStep CCU6_u8McuAscType CCU6_u8OvcRcvCnt CCU6_u8P5VHSFltCnt CCU6_u8P5VLSFltCnt CCU6_u8P5VPowerMngStt CCU6_u8P5VSelfTstTimCnt CCU6_u8PreTestStep CCU6_u8PwmState GCCU6_u8OvcRcvCnt /end OUT_MEASUREMENT
/end FUNCTION
/begin FUNCTION COMMUSR ""
 /begin OUT_MEASUREMENT ASWNM_bBusSleep ASWNM_bStayAwake ASWNM_u16AfterRunDelayTimes ASWNM_u16Kl15Sts /end OUT_MEASUREMENT
/end FUNCTION
/begin FUNCTION DEVHAL "" /begin OUT_MEASUREMENT DEVHAL_u8CheckEngineState /end OUT_MEASUREMENT /end FUNCTION
/begin FUNCTION DSM "" /begin DEF_CHARACTERISTIC FaultEraseRequestC /end DEF_CHARACTERISTIC
 /begin OUT_MEASUREMENT DSM_DtcNumber DSM_DtcNumber[0] DSM_DtcNumber[1] DSM_DtcNumber[2] DSM_DtcNumber[3] DSM_DtcNumber[4] DSM_DtcNumber[5] DSM_DtcNumber[6] DSM_DtcNumber[7] DSM_DtcNumber[8] DSM_DtcNumber[9] DSM_DtcStatusNvm DSM_DtcStatusNvm[0] DSM_DtcStatusNvm[1] DSM_DtcStatusNvm[2] DSM_DtcStatusNvm[3] DSM_DtcStatusNvm[4] DSM_DtcStatusNvm[5] DSM_DtcStatusNvm[6] DSM_DtcStatusNvm[7] DSM_DtcStatusNvm[8] DSM_DtcStatusNvm[9] DSM_FaultFailureLevel DSM_FaultFailureLevel[0] DSM_FaultFailureLevel[1] FaultEraseRequest FaultFailureLevel /end OUT_MEASUREMENT
/end FUNCTION
/begin FUNCTION EAS ""
 /begin DEF_CHARACTERISTIC EAS_bDefaultEskPassC EAS_bRN32EnaOnC EAS_u8Chg1DelayTimoutC /end DEF_CHARACTERISTIC
 /begin OUT_MEASUREMENT EAS_au32PinESK32 EAS_au32PinESK32[0] EAS_au32PinESK32[1] EAS_au32PinESK32[2] EAS_au32PinESK32[3] EAS_au8ComChallengeVal EAS_au8ComChallengeVal[0] EAS_au8ComChallengeVal[1] EAS_au8ComChallengeVal[2] EAS_au8ComChallengeVal[3] EAS_au8ComChallengeVal[4] EAS_au8ComChallengeVal[5] EAS_au8ComChallengeVal[6] EAS_au8ComChallengeVal[7] EAS_au8ComImmoCode EAS_au8ComImmoCode[0] EAS_au8ComImmoCode[1] EAS_au8ComImmoCode[2] EAS_au8ComImmoCode[3] EAS_au8ComImmoCode[4] EAS_au8ComImmoCode[5] EAS_au8ComImmoCode[6] EAS_au8ComImmoCode[7] EAS_au8ParmCC64Nvm EAS_au8ParmCC64Nvm[0] EAS_au8ParmCC64Nvm[1] EAS_au8ParmCC64Nvm[2] EAS_au8ParmCC64Nvm[3] EAS_au8ParmCC64Nvm[4] EAS_au8ParmCC64Nvm[5] EAS_au8ParmCC64Nvm[6] EAS_au8ParmCC64Nvm[7] EAS_au8ParmEacEncr EAS_au8ParmEacEncr[0] EAS_au8ParmEacEncr[10] EAS_au8ParmEacEncr[11] EAS_au8ParmEacEncr[12] EAS_au8ParmEacEncr[13] EAS_au8ParmEacEncr[14] EAS_au8ParmEacEncr[15] EAS_au8ParmEacEncr[1] EAS_au8ParmEacEncr[2] EAS_au8ParmEacEncr[3] EAS_au8ParmEacEncr[4] EAS_au8ParmEacEncr[5] EAS_au8ParmEacEncr[6] EAS_au8ParmEacEncr[7] EAS_au8ParmEacEncr[8] EAS_au8ParmEacEncr[9] EAS_au8ParmEacSeed EAS_au8ParmEacSeed[0] EAS_au8ParmEacSeed[10] EAS_au8ParmEacSeed[11] EAS_au8ParmEacSeed[12] EAS_au8ParmEacSeed[13] EAS_au8ParmEacSeed[14] EAS_au8ParmEacSeed[15] EAS_au8ParmEacSeed[1] EAS_au8ParmEacSeed[2] EAS_au8ParmEacSeed[3] EAS_au8ParmEacSeed[4] EAS_au8ParmEacSeed[5] EAS_au8ParmEacSeed[6] EAS_au8ParmEacSeed[7] EAS_au8ParmEacSeed[8] EAS_au8ParmEacSeed[9] EAS_au8ParmEarEncr1 EAS_au8ParmEarEncr1[0] EAS_au8ParmEarEncr1[10] EAS_au8ParmEarEncr1[11] EAS_au8ParmEarEncr1[12] EAS_au8ParmEarEncr1[13] EAS_au8ParmEarEncr1[14] EAS_au8ParmEarEncr1[15] EAS_au8ParmEarEncr1[1] EAS_au8ParmEarEncr1[2] EAS_au8ParmEarEncr1[3] EAS_au8ParmEarEncr1[4] EAS_au8ParmEarEncr1[5] EAS_au8ParmEarEncr1[6] EAS_au8ParmEarEncr1[7] EAS_au8ParmEarEncr1[8] EAS_au8ParmEarEncr1[9] EAS_au8ParmEarEncr2 EAS_au8ParmEarEncr2[0] EAS_au8ParmEarEncr2[10] EAS_au8ParmEarEncr2[11] EAS_au8ParmEarEncr2[12] EAS_au8ParmEarEncr2[13] EAS_au8ParmEarEncr2[14] EAS_au8ParmEarEncr2[15] EAS_au8ParmEarEncr2[1] EAS_au8ParmEarEncr2[2] EAS_au8ParmEarEncr2[3] EAS_au8ParmEarEncr2[4] EAS_au8ParmEarEncr2[5] EAS_au8ParmEarEncr2[6] EAS_au8ParmEarEncr2[7] EAS_au8ParmEarEncr2[8] EAS_au8ParmEarEncr2[9] EAS_au8ParmRN32 EAS_au8ParmRN32[0] EAS_au8ParmRN32[1] EAS_au8ParmRN32[2] EAS_au8ParmRN32[3] EAS_au8ParmSC32Nvm EAS_au8ParmSC32Nvm[0] EAS_au8ParmSC32Nvm[1] EAS_au8ParmSC32Nvm[2] EAS_au8ParmSC32Nvm[3] EAS_au8ParmSK128Nvm EAS_au8ParmSK128Nvm[0] EAS_au8ParmSK128Nvm[10] EAS_au8ParmSK128Nvm[11] EAS_au8ParmSK128Nvm[12] EAS_au8ParmSK128Nvm[13] EAS_au8ParmSK128Nvm[14] EAS_au8ParmSK128Nvm[15] EAS_au8ParmSK128Nvm[1] EAS_au8ParmSK128Nvm[2] EAS_au8ParmSK128Nvm[3] EAS_au8ParmSK128Nvm[4] EAS_au8ParmSK128Nvm[5] EAS_au8ParmSK128Nvm[6] EAS_au8ParmSK128Nvm[7] EAS_au8ParmSK128Nvm[8] EAS_au8ParmSK128Nvm[9] EAS_bAesVerifyRes EAS_bDefaultEskFlg EAS_bImmoCodRcvFlg EAS_bSendNewChalgFlg EAS_u8AuthFailedCnt EAS_u8AuthState EAS_u8AuthVerifyCnt EAS_u8Chg1DelayCnt EAS_u8ImmFailReason EAS_u8SttTimerCnt EAS_u8TMReleaseSig /end OUT_MEASUREMENT
/end FUNCTION
/begin FUNCTION ESM "" /begin DEF_CHARACTERISTIC ESM_u16PowerLatchTempoC ESM_u8RestartDelayCntC /end DEF_CHARACTERISTIC
 /begin OUT_MEASUREMENT ESM_EcuState ESM_OPERATIONAL_MODE ESM_POWER_OFF_MODE ESM_POWERLATCH_MODE ESM_STARTUP_I_MODE ESM_STARTUP_II_MODE ESM_u16PowerLatchTempo /end OUT_MEASUREMENT
/end FUNCTION
/begin FUNCTION FAIL "" /begin DEF_CHARACTERISTIC FAIL_bCanErrCheckonC /end DEF_CHARACTERISTIC
 /begin OUT_MEASUREMENT FAIL_bCanErrChkDisabled FAIL_bComLostDiagTEna FAIL_bComLostDiagVEna FAIL_bComLostDiagVHigh FAIL_bComLostDiagVLow FAIL_bDebug1 FAIL_bRstHotFlag FAIL_bRstHotFlagNvm FAIL_u16ComLostDiagEnaCnt FAIL_u16ComLostDiagVRecCnt FAIL_u16KeyOnDelay FAIL_u16KeyOnValue FAIL_u16LvBatVoltRaw FAIL_u16RstHotCntNvm FAIL_u16RstStartUpCntNvm FAIL_u16Test FAIL_u16TimestampIgnNvm FAIL_u32TimestampLifeNvm FAIL_u8CCP_FaultLevel /end OUT_MEASUREMENT
/end FUNCTION
/begin FUNCTION FAULT ""
 /begin OUT_MEASUREMENT FaultBSW_COM_BusOff_CAN1Aut FaultBSW_COM_BusOff_CAN1Detected FaultBSW_COM_BusOff_CAN1Logged FaultBSW_COM_ChecksumErrVCUAut FaultBSW_COM_ChecksumErrVCUDetected FaultBSW_COM_ChecksumErrVCULogged FaultBSW_COM_Detected FaultBSW_COM_InterFaultVCUAut FaultBSW_COM_InterFaultVCUDetected FaultBSW_COM_InterFaultVCULogged FaultBSW_COM_Logged FaultBSW_COM_RollCntErrVCUAut FaultBSW_COM_RollCntErrVCUDetected FaultBSW_COM_RollCntErrVCULogged FaultBSW_COM_TimoutRxBCMAut FaultBSW_COM_TimoutRxBCMDetected FaultBSW_COM_TimoutRxBCMLogged FaultBSW_COM_TimoutRxBMSHAut FaultBSW_COM_TimoutRxBMSHDetected FaultBSW_COM_TimoutRxBMSHLogged FaultBSW_COM_TimoutRxEMSAut FaultBSW_COM_TimoutRxEMSDetected FaultBSW_COM_TimoutRxEMSLogged FaultBSW_COM_TimoutRxGCUAut FaultBSW_COM_TimoutRxGCUDetected FaultBSW_COM_TimoutRxGCULogged FaultBSW_COM_TimoutRxIPCAut FaultBSW_COM_TimoutRxIPCDetected FaultBSW_COM_TimoutRxIPCLogged FaultBSW_COM_TimoutRxTBOXAut FaultBSW_COM_TimoutRxTBOXDetected FaultBSW_COM_TimoutRxTBOXLogged FaultBSW_COM_TimoutRxVCUAut FaultBSW_COM_TimoutRxVCUDetected FaultBSW_COM_TimoutRxVCULogged FaultBSW_HW2_Detected FaultBSW_HW2_FPGA_OverVoltVBatAut FaultBSW_HW2_FPGA_OverVoltVBatDetected FaultBSW_HW2_FPGA_OverVoltVBatLogged FaultBSW_HW2_Logged FaultBSW_HW2_SafeTlib_PreRunAut FaultBSW_HW2_SafeTlib_PreRunDetected FaultBSW_HW2_SafeTlib_PreRunLogged FaultBSW_HW_Detected FaultBSW_HW_EasAckFailAut FaultBSW_HW_EasAckFailDetected FaultBSW_HW_EasAckFailLogged FaultBSW_HW_FPGA_IGBT_HAut FaultBSW_HW_FPGA_IGBT_HDetected FaultBSW_HW_FPGA_IGBT_HLogged FaultBSW_HW_FPGA_IGBT_LAut FaultBSW_HW_FPGA_IGBT_LDetected FaultBSW_HW_FPGA_IGBT_LLogged FaultBSW_HW_FPGA_OverUnderCurUIAut FaultBSW_HW_FPGA_OverUnderCurUIDetected FaultBSW_HW_FPGA_OverUnderCurUILogged FaultBSW_HW_FPGA_OverUnderCurVIAut FaultBSW_HW_FPGA_OverUnderCurVIDetected FaultBSW_HW_FPGA_OverUnderCurVILogged FaultBSW_HW_FPGA_OverUnderCurWIAut FaultBSW_HW_FPGA_OverUnderCurWIDetected FaultBSW_HW_FPGA_OverUnderCurWILogged FaultBSW_HW_Logged FaultBSW_HW_OCDataNotRationalAut FaultBSW_HW_OCDataNotRationalDetected FaultBSW_HW_OCDataNotRationalLogged FaultBSW_SYS_Detected FaultBSW_SYS_Logged FaultBSW_SYS_RstHotAut FaultBSW_SYS_RstHotDetected FaultBSW_SYS_RstHotLogged FaultBSW_SYS_StackOverflowAut FaultBSW_SYS_StackOverflowDetected FaultBSW_SYS_StackOverflowLogged FaultBSW_VSI_Detected FaultBSW_VSI_Logged FaultBSW_VSI_TimeoutTCalcAut FaultBSW_VSI_TimeoutTCalcDetected FaultBSW_VSI_TimeoutTCalcLogged FaultFSEVBHV_Detected FaultFSEVBHV_Logged FaultFSEVBHV_OverVoltageAut FaultFSEVBHV_OverVoltageDetected FaultFSEVBHV_OverVoltageLogged FaultFSEVBHV_SampleVolOutRngHAut FaultFSEVBHV_SampleVolOutRngHDetected FaultFSEVBHV_SampleVolOutRngHLogged FaultFSEVBHV_SampleVolOutRngLAut FaultFSEVBHV_SampleVolOutRngLDetected FaultFSEVBHV_SampleVolOutRngLLogged FaultFSEVBHV_UnderDetected FaultFSEVBHV_UnderLogged FaultFSEVBHV_UnderVoltageAut FaultFSEVBHV_UnderVoltageDetected FaultFSEVBHV_UnderVoltageLogged FaultFSEVBHV_UnderVoltageWarnAut FaultFSEVBHV_UnderVoltageWarnDetected FaultFSEVBHV_UnderVoltageWarnLogged FaultFSEVBHV_VolNotRationalAut FaultFSEVBHV_VolNotRationalDetected FaultFSEVBHV_VolNotRationalLogged FaultFSEVBHV_VoltageGndAut FaultFSEVBHV_VoltageGndDetected FaultFSEVBHV_VoltageGndLogged FaultFSEVBHV_VoltageVccAut FaultFSEVBHV_VoltageVccDetected FaultFSEVBHV_VoltageVccLogged FaultFSEVBLV_Detected FaultFSEVBLV_Logged FaultFSEVBLV_OverVoltageAut FaultFSEVBLV_OverVoltageDetected FaultFSEVBLV_OverVoltageLogged FaultFSEVBLV_P5VRefADCFltAut FaultFSEVBLV_P5VRefADCFltDetected FaultFSEVBLV_P5VRefADCFltLogged FaultFSEVBLV_UnderDetected FaultFSEVBLV_UnderLogged FaultFSEVBLV_UnderVoltageAut FaultFSEVBLV_UnderVoltageDetected FaultFSEVBLV_UnderVoltageLogged FaultFSEVBLV_UnderVoltageWarnAut FaultFSEVBLV_UnderVoltageWarnDetected FaultFSEVBLV_UnderVoltageWarnLogged FaultFSEVBLV_VoltageGndAut FaultFSEVBLV_VoltageGndDetected FaultFSEVBLV_VoltageGndLogged FaultFSEVBLV_VoltageVccAut FaultFSEVBLV_VoltageVccDetected FaultFSEVBLV_VoltageVccLogged FaultFSEVETA_Detected FaultFSEVETA_DrvTempRationAut FaultFSEVETA_DrvTempRationDetected FaultFSEVETA_DrvTempRationLogged FaultFSEVETA_IgbtTempRationalAut FaultFSEVETA_IgbtTempRationalDetected FaultFSEVETA_IgbtTempRationalLogged FaultFSEVETA_Logged FaultFSEVETA_OverDetected FaultFSEVETA_OverLogged FaultFSEVETA_OverTempDrvLeftAut FaultFSEVETA_OverTempDrvLeftDetected FaultFSEVETA_OverTempDrvLeftLogged FaultFSEVETA_OverTempIgbtLeftAut FaultFSEVETA_OverTempIgbtLeftDetected FaultFSEVETA_OverTempIgbtLeftLogged FaultFSEVETA_OverTempNTC1CmdBoardAut FaultFSEVETA_OverTempNTC1CmdBoardDetected FaultFSEVETA_OverTempNTC1CmdBoardLogged FaultFSEVETA_SampleIgbtTempOutRngHAut FaultFSEVETA_SampleIgbtTempOutRngHDetected FaultFSEVETA_SampleIgbtTempOutRngHLogged FaultFSEVETA_SampleIgbtTempOutRngLAut FaultFSEVETA_SampleIgbtTempOutRngLDetected FaultFSEVETA_SampleIgbtTempOutRngLLogged FaultFSEVETA_TempDetected FaultFSEVETA_TempDrvBoardLeftGndAut FaultFSEVETA_TempDrvBoardLeftGndDetected FaultFSEVETA_TempDrvBoardLeftGndLogged FaultFSEVETA_TempDrvBoardLeftVccAut FaultFSEVETA_TempDrvBoardLeftVccDetected FaultFSEVETA_TempDrvBoardLeftVccLogged FaultFSEVETA_TempIgbtLeftGndAut FaultFSEVETA_TempIgbtLeftGndDetected FaultFSEVETA_TempIgbtLeftGndLogged FaultFSEVETA_TempIgbtLeftVccAut FaultFSEVETA_TempIgbtLeftVccDetected FaultFSEVETA_TempIgbtLeftVccLogged FaultFSEVETA_TempLogged FaultFSEVETA_TempNTC1CmdBoardGndAut FaultFSEVETA_TempNTC1CmdBoardGndDetected FaultFSEVETA_TempNTC1CmdBoardGndLogged FaultFSEVETA_TempNTC1CmdBoardVccAut FaultFSEVETA_TempNTC1CmdBoardVccDetected FaultFSEVETA_TempNTC1CmdBoardVccLogged FaultFSEVETA_UnderDetected FaultFSEVETA_UnderLogged FaultFSEVETA_UnderTempDrvLeftAut FaultFSEVETA_UnderTempDrvLeftDetected FaultFSEVETA_UnderTempDrvLeftLogged FaultFSEVETA_UnderTempIgbtLeftAut FaultFSEVETA_UnderTempIgbtLeftDetected FaultFSEVETA_UnderTempIgbtLeftLogged FaultFSEVETA_UnderTempNTC1CmdBoardAut FaultFSEVETA_UnderTempNTC1CmdBoardDetected FaultFSEVETA_UnderTempNTC1CmdBoardLogged FaultFSMTMTA_OverDetected FaultFSMTMTA_OverLogged FaultFSMTMTA_OverTempWdgHead1Aut FaultFSMTMTA_OverTempWdgHead1Detected FaultFSMTMTA_OverTempWdgHead1Logged FaultFSMTMTA_TempDetected FaultFSMTMTA_TempLogged FaultFSMTMTA_TempWindHead1OutRngHAut FaultFSMTMTA_TempWindHead1OutRngHDetected FaultFSMTMTA_TempWindHead1OutRngHLogged FaultFSMTMTA_TempWindHead1OutRngLAut FaultFSMTMTA_TempWindHead1OutRngLDetected FaultFSMTMTA_TempWindHead1OutRngLLogged FaultFSMTMTA_TempWindingHead1GndAut FaultFSMTMTA_TempWindingHead1GndDetected FaultFSMTMTA_TempWindingHead1GndLogged FaultFSMTMTA_TempWindingHead1VccAut FaultFSMTMTA_TempWindingHead1VccDetected FaultFSMTMTA_TempWindingHead1VccLogged FaultFSMTMTA_UnderDetected FaultFSMTMTA_UnderLogged FaultFSMTMTA_UnderTempWdgHead1Aut FaultFSMTMTA_UnderTempWdgHead1Detected FaultFSMTMTA_UnderTempWdgHead1Logged FaultFSMTRDG_Detected FaultFSMTRDG_ExcGenerationAut FaultFSMTRDG_ExcGenerationDetected FaultFSMTRDG_ExcGenerationLogged FaultFSMTRDG_ExcSignalGNDAut FaultFSMTRDG_ExcSignalGNDDetected FaultFSMTRDG_ExcSignalGNDLogged FaultFSMTRDG_ExcSignalVCCAut FaultFSMTRDG_ExcSignalVCCDetected FaultFSMTRDG_ExcSignalVCCLogged FaultFSMTRDG_Logged FaultFSMTRDG_SinCosHLGndAut FaultFSMTRDG_SinCosHLGndDetected FaultFSMTRDG_SinCosHLGndLogged FaultFSMTRDG_SinCosHLOpenAut FaultFSMTRDG_SinCosHLOpenDetected FaultFSMTRDG_SinCosHLOpenLogged FaultFSMTRDG_SinCosHLVccAut FaultFSMTRDG_SinCosHLVccDetected FaultFSMTRDG_SinCosHLVccLogged FaultFSSMACS_AkdFailFlagAut FaultFSSMACS_AkdFailFlagDetected FaultFSSMACS_AkdFailFlagLogged FaultFSSMACS_Detected FaultFSSMACS_Logged FaultFTASBDS_BattVoltDeratingActAut FaultFTASBDS_BattVoltDeratingActDetected FaultFTASBDS_BattVoltDeratingActLogged FaultFTASBDS_Detected FaultFTASBDS_Logged FaultFTASETP_Detected FaultFTASETP_EstPmDeratingActAut FaultFTASETP_EstPmDeratingActDetected FaultFTASETP_EstPmDeratingActLogged FaultFTASETP_Logged FaultFTASETP_PmDeratingActAut FaultFTASETP_PmDeratingActDetected FaultFTASETP_PmDeratingActLogged FaultFTASMTP_Detected FaultFTASMTP_Logged FaultFTASMTP_Wndg1DeratingActAut FaultFTASMTP_Wndg1DeratingActDetected FaultFTASMTP_Wndg1DeratingActLogged FaultFTASOSP_Detected FaultFTASOSP_Logged FaultFTASOSP_MotorSpdDeratingActAut FaultFTASOSP_MotorSpdDeratingActDetected FaultFTASOSP_MotorSpdDeratingActLogged FaultFTCMSCS_CtrlSatTimoutAut FaultFTCMSCS_CtrlSatTimoutDetected FaultFTCMSCS_CtrlSatTimoutLogged FaultFTCMSCS_Detected FaultFTCMSCS_Logged FaultFTCMSCS_SpdOvershootAut FaultFTCMSCS_SpdOvershootDetected FaultFTCMSCS_SpdOvershootLogged FaultFTCMSCS_ZeroSpeedTimoutAut FaultFTCMSCS_ZeroSpeedTimoutDetected FaultFTCMSCS_ZeroSpeedTimoutLogged FaultFTCMTCS_Detected FaultFTCMTCS_Logged FaultFTCMTCS_VoltageMarginLowAut FaultFTCMTCS_VoltageMarginLowDetected FaultFTCMTCS_VoltageMarginLowLogged FaultFTEVEIT_Detected FaultFTEVEIT_EstOverTempAut FaultFTEVEIT_EstOverTempDetected FaultFTEVEIT_EstOverTempLogged FaultFTEVEIT_Logged FaultFTMTLCS_CurrentSumErrorAut FaultFTMTLCS_CurrentSumErrorDetected FaultFTMTLCS_CurrentSumErrorLogged FaultFTMTLCS_CurSenrPhaU_GNDAut FaultFTMTLCS_CurSenrPhaU_GNDDetected FaultFTMTLCS_CurSenrPhaU_GNDLogged FaultFTMTLCS_CurSenrPhaU_OutRngHAut FaultFTMTLCS_CurSenrPhaU_OutRngHDetected FaultFTMTLCS_CurSenrPhaU_OutRngHLogged FaultFTMTLCS_CurSenrPhaU_OutRngLAut FaultFTMTLCS_CurSenrPhaU_OutRngLDetected FaultFTMTLCS_CurSenrPhaU_OutRngLLogged FaultFTMTLCS_CurSenrPhaU_VCCAut FaultFTMTLCS_CurSenrPhaU_VCCDetected FaultFTMTLCS_CurSenrPhaU_VCCLogged FaultFTMTLCS_CurSenrPhaV_GNDAut FaultFTMTLCS_CurSenrPhaV_GNDDetected FaultFTMTLCS_CurSenrPhaV_GNDLogged FaultFTMTLCS_CurSenrPhaV_OutRngHAut FaultFTMTLCS_CurSenrPhaV_OutRngHDetected FaultFTMTLCS_CurSenrPhaV_OutRngHLogged FaultFTMTLCS_CurSenrPhaV_OutRngLAut FaultFTMTLCS_CurSenrPhaV_OutRngLDetected FaultFTMTLCS_CurSenrPhaV_OutRngLLogged FaultFTMTLCS_CurSenrPhaV_VCCAut FaultFTMTLCS_CurSenrPhaV_VCCDetected FaultFTMTLCS_CurSenrPhaV_VCCLogged FaultFTMTLCS_CurSenrPhaW_GNDAut FaultFTMTLCS_CurSenrPhaW_GNDDetected FaultFTMTLCS_CurSenrPhaW_GNDLogged FaultFTMTLCS_CurSenrPhaW_OutRngHAut FaultFTMTLCS_CurSenrPhaW_OutRngHDetected FaultFTMTLCS_CurSenrPhaW_OutRngHLogged FaultFTMTLCS_CurSenrPhaW_OutRngLAut FaultFTMTLCS_CurSenrPhaW_OutRngLDetected FaultFTMTLCS_CurSenrPhaW_OutRngLLogged FaultFTMTLCS_CurSenrPhaW_VCCAut FaultFTMTLCS_CurSenrPhaW_VCCDetected FaultFTMTLCS_CurSenrPhaW_VCCLogged FaultFTMTLCS_Detected FaultFTMTLCS_Logged FaultFunctionTypeDetectedArray FaultFunctionTypeDetectedArray[0] FaultFunctionTypeDetectedArray[10] FaultFunctionTypeDetectedArray[11] FaultFunctionTypeDetectedArray[12] FaultFunctionTypeDetectedArray[13] FaultFunctionTypeDetectedArray[14] FaultFunctionTypeDetectedArray[15] FaultFunctionTypeDetectedArray[16] FaultFunctionTypeDetectedArray[17] FaultFunctionTypeDetectedArray[18] FaultFunctionTypeDetectedArray[19] FaultFunctionTypeDetectedArray[1] FaultFunctionTypeDetectedArray[20] FaultFunctionTypeDetectedArray[21] FaultFunctionTypeDetectedArray[22] FaultFunctionTypeDetectedArray[23] FaultFunctionTypeDetectedArray[24] FaultFunctionTypeDetectedArray[25] FaultFunctionTypeDetectedArray[26] FaultFunctionTypeDetectedArray[27] FaultFunctionTypeDetectedArray[28] FaultFunctionTypeDetectedArray[29] FaultFunctionTypeDetectedArray[2] FaultFunctionTypeDetectedArray[3] FaultFunctionTypeDetectedArray[4] FaultFunctionTypeDetectedArray[5] FaultFunctionTypeDetectedArray[6] FaultFunctionTypeDetectedArray[7] FaultFunctionTypeDetectedArray[8] FaultFunctionTypeDetectedArray[9] FaultFunctionTypeLoggedArray FaultFunctionTypeLoggedArray[0] FaultFunctionTypeLoggedArray[10] FaultFunctionTypeLoggedArray[11] FaultFunctionTypeLoggedArray[12] FaultFunctionTypeLoggedArray[13] FaultFunctionTypeLoggedArray[14] FaultFunctionTypeLoggedArray[15] FaultFunctionTypeLoggedArray[16] FaultFunctionTypeLoggedArray[17] FaultFunctionTypeLoggedArray[18] FaultFunctionTypeLoggedArray[19] FaultFunctionTypeLoggedArray[1] FaultFunctionTypeLoggedArray[20] FaultFunctionTypeLoggedArray[21] FaultFunctionTypeLoggedArray[22] FaultFunctionTypeLoggedArray[23] FaultFunctionTypeLoggedArray[24] FaultFunctionTypeLoggedArray[25] FaultFunctionTypeLoggedArray[26] FaultFunctionTypeLoggedArray[27] FaultFunctionTypeLoggedArray[28] FaultFunctionTypeLoggedArray[29] FaultFunctionTypeLoggedArray[2] FaultFunctionTypeLoggedArray[3] FaultFunctionTypeLoggedArray[4] FaultFunctionTypeLoggedArray[5] FaultFunctionTypeLoggedArray[6] FaultFunctionTypeLoggedArray[7] FaultFunctionTypeLoggedArray[8] FaultFunctionTypeLoggedArray[9] FaultSDMTMEP_CosGndAut FaultSDMTMEP_CosGndDetected FaultSDMTMEP_CosGndLogged FaultSDMTMEP_CosOutRangeHighAut FaultSDMTMEP_CosOutRangeHighDetected FaultSDMTMEP_CosOutRangeHighLogged FaultSDMTMEP_CosOutRangeLowAut FaultSDMTMEP_CosOutRangeLowDetected FaultSDMTMEP_CosOutRangeLowLogged FaultSDMTMEP_CosVccAut FaultSDMTMEP_CosVccDetected FaultSDMTMEP_CosVccLogged FaultSDMTMEP_Detected FaultSDMTMEP_Logged FaultSDMTMEP_OverSpeedAut FaultSDMTMEP_OverSpeedDetected FaultSDMTMEP_OverSpeedLogged FaultSDMTMEP_ResSquaSumErrByFTAut FaultSDMTMEP_ResSquaSumErrByFTDetected FaultSDMTMEP_ResSquaSumErrByFTLogged FaultSDMTMEP_SinGndAut FaultSDMTMEP_SinGndDetected FaultSDMTMEP_SinGndLogged FaultSDMTMEP_SinOutRangeHighAut FaultSDMTMEP_SinOutRangeHighDetected FaultSDMTMEP_SinOutRangeHighLogged FaultSDMTMEP_SinOutRangeLowAut FaultSDMTMEP_SinOutRangeLowDetected FaultSDMTMEP_SinOutRangeLowLogged FaultSDMTMEP_SinVccAut FaultSDMTMEP_SinVccDetected FaultSDMTMEP_SinVccLogged FaultSDMTMEP_UnderSpeedAut FaultSDMTMEP_UnderSpeedDetected FaultSDMTMEP_UnderSpeedLogged FaultTableFuncTypeCounter1 FaultTableFuncTypeCounter1[0] FaultTableFuncTypeCounter1[100] FaultTableFuncTypeCounter1[101] FaultTableFuncTypeCounter1[102] FaultTableFuncTypeCounter1[103] FaultTableFuncTypeCounter1[104] FaultTableFuncTypeCounter1[105] FaultTableFuncTypeCounter1[106] FaultTableFuncTypeCounter1[107] FaultTableFuncTypeCounter1[108] FaultTableFuncTypeCounter1[109] FaultTableFuncTypeCounter1[10] FaultTableFuncTypeCounter1[110] FaultTableFuncTypeCounter1[111] FaultTableFuncTypeCounter1[112] FaultTableFuncTypeCounter1[113] FaultTableFuncTypeCounter1[114] FaultTableFuncTypeCounter1[115] FaultTableFuncTypeCounter1[116] FaultTableFuncTypeCounter1[117] FaultTableFuncTypeCounter1[118] FaultTableFuncTypeCounter1[119] FaultTableFuncTypeCounter1[11] FaultTableFuncTypeCounter1[120] FaultTableFuncTypeCounter1[121] FaultTableFuncTypeCounter1[122] FaultTableFuncTypeCounter1[123] FaultTableFuncTypeCounter1[124] FaultTableFuncTypeCounter1[125] FaultTableFuncTypeCounter1[126] FaultTableFuncTypeCounter1[127] FaultTableFuncTypeCounter1[128] FaultTableFuncTypeCounter1[129] FaultTableFuncTypeCounter1[12] FaultTableFuncTypeCounter1[130] FaultTableFuncTypeCounter1[131] FaultTableFuncTypeCounter1[132] FaultTableFuncTypeCounter1[13] FaultTableFuncTypeCounter1[14] FaultTableFuncTypeCounter1[15] FaultTableFuncTypeCounter1[16] FaultTableFuncTypeCounter1[17] FaultTableFuncTypeCounter1[18] FaultTableFuncTypeCounter1[19] FaultTableFuncTypeCounter1[1] FaultTableFuncTypeCounter1[20] FaultTableFuncTypeCounter1[21] FaultTableFuncTypeCounter1[22] FaultTableFuncTypeCounter1[23] FaultTableFuncTypeCounter1[24] FaultTableFuncTypeCounter1[25] FaultTableFuncTypeCounter1[26] FaultTableFuncTypeCounter1[27] FaultTableFuncTypeCounter1[28] FaultTableFuncTypeCounter1[29] FaultTableFuncTypeCounter1[2] FaultTableFuncTypeCounter1[30] FaultTableFuncTypeCounter1[31] FaultTableFuncTypeCounter1[32] FaultTableFuncTypeCounter1[33] FaultTableFuncTypeCounter1[34] FaultTableFuncTypeCounter1[35] FaultTableFuncTypeCounter1[36] FaultTableFuncTypeCounter1[37] FaultTableFuncTypeCounter1[38] FaultTableFuncTypeCounter1[39] FaultTableFuncTypeCounter1[3] FaultTableFuncTypeCounter1[40] FaultTableFuncTypeCounter1[41] FaultTableFuncTypeCounter1[42] FaultTableFuncTypeCounter1[43] FaultTableFuncTypeCounter1[44] FaultTableFuncTypeCounter1[45] FaultTableFuncTypeCounter1[46] FaultTableFuncTypeCounter1[47] FaultTableFuncTypeCounter1[48] FaultTableFuncTypeCounter1[49] FaultTableFuncTypeCounter1[4] FaultTableFuncTypeCounter1[50] FaultTableFuncTypeCounter1[51] FaultTableFuncTypeCounter1[52] FaultTableFuncTypeCounter1[53] /end OUT_MEASUREMENT
/end FUNCTION
/end MODULE
/end PROJECT
