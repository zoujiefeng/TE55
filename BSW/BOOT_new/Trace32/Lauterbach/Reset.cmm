SYSTEM.down

SYSTEM.MEMACCESS CPU
SYSTEM.CPUACCESS ENABLE
SYSTEM.OPTION PERSTOP ON
SYSTEM.OPTION DUALPORT ON
SYSTEM.OPTION HEARTBEAT OFF
SYSTEM.OPTION ICFLUSH ON
SYSTEM.OPTION RESETBEHAVIOR HALT
SYSTEM.CONFIG TRISTATE OFF
SYSTEM.CONFIG SLAVE OFF

SYSTEM.up

PER.Set.simple D:0xF00010E8 %LONG 0x12000000
PER.Set.simple D:0xF00011E8 %Long 0x12000000
WAIT 1s
ENDDO