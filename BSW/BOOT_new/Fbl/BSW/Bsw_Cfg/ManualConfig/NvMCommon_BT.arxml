AUTOSAR XML (schema 00047)
package /INVT_Project/EcucModuleConfigurationValuess
  module config NvM: implementation-config-variant=VARIANT-PRE-COMPILE
    NvMCommon:
      NvMRbSetWriteAllTriggerApi = true
      NvMApiConfigClass = NVM_API_CONFIG_CLASS_3
      NvMBswMMultiBlockJobStatusInformation = false
      NvMCompiledConfigId = 0
      NvMCrcNumOfBytes = 1
      NvMDevErrorDetect = false
      NvMDrvModeSwitch = false
      NvMDynamicConfiguration = false
      NvMJobPrioritization = false
      NvMMainFunctionCycleTime = 0.01
      NvMMultiBlockCallback = Fbl_DataM_MultiBlockJobEndNotification
      NvMPollingMode = true
      NvMSetRamBlockStatusApi = true
      NvMSizeStandardJobQueue = 20
      NvMVersionInfoApi = false
      NvMMainFunctionPeriod = 0.001
