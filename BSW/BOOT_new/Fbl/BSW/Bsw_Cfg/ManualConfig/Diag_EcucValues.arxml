AUTOSAR XML (schema 00047)
package /INVT_Project
  module config Crc
    CrcGeneral:
      Crc8H2F = 0
      Crc8H2FMode = CRC_8H2F_TABLE
      Crc8 = 0
      Crc8Mode = CRC_8_TABLE
      Crc16 = 1
      Crc16Mode = CRC_16_TABLE
      Crc32 = 1
      Crc32Mode = CRC_32_TABLE
      Crc64 = 0
      Crc64Mode = CRC_64_TABLE
      CrcVersionInfoApi = 1
      Crc32P4 = false
    CrcRbRevision: CrcRbRev=Revision_2
package /INVT_Project/EcucModuleConfigurationValuess
  module config CanTp: implementation-config-variant=VARIANT-PRE-COMPILE
    CanTpConfig_0 (CanTpConfig): CanTpMainFunctionPeriod=0.001
      CanTpChannel_UDS_CAN01 (CanTpChannel): CanTpChannelMode=CANTP_MODE_FULL_DUPLEX
        UdsOnCan_Rx_Func_CAN01 (CanTpRxNSdu):
          CanTpBs = 0
          CanTpNar = 0.1
          CanTpNbr = 0.0
          CanTpNcr = 1.0
          CanTpRxAddressingFormat = CANTP_STANDARD
          CanTpRxPaddingActivation = CANTP_ON
          CanTpRxTaType = CANTP_FUNCTIONAL
          CanTpSTmin = 0.0
          CanTpRbRxFcDisabled = false
          CanTpRxNSduId = 0
          CanTpRxNSduRef = UDS_Rx_Func_CANNODE_01_CanTp2PduR
          Func_CanIf2CanTP_CAN01 (CanTpRxNPdu): CanTpRxNPduRef=UDS_Rx_Func_CANNODE_01_CanIf2CanTp
        UdsOnCan_Rx_Phys_CAN01 (CanTpRxNSdu):
          CanTpBs = 0
          CanTpNar = 0.1
          CanTpNbr = 0.0
          CanTpNcr = 1.0
          CanTpRxAddressingFormat = CANTP_STANDARD
          CanTpRxPaddingActivation = CANTP_ON
          CanTpRxTaType = CANTP_PHYSICAL
          CanTpSTmin = 0.0
          CanTpRbRxFcDisabled = false
          CanTpRxNSduId = 1
          CanTpRxNSduRef = UDS_Rx_Phys_CANNODE_01_CanTp2PduR
          Phys_CanIf2CanTp_CAN01 (CanTpRxNPdu): CanTpRxNPduRef=UDS_Rx_Phys_CANNODE_01_CanIf2CanTp
          Phys_CanTp2CanIf_CAN01 (CanTpTxFcNPdu): CanTpTxFcNPduRef=UDS_Tx_Phys_CANNODE_01_CanTp2CanIf
        UdsOnCan_Tx_Phy_CAN01 (CanTpTxNSdu):
          CanTpNas = 0.1
          CanTpNbs = 1.0
          CanTpNcs = 0.0
          CanTpTc = 1
          CanTpTxAddressingFormat = CANTP_STANDARD
          CanTpTxNSduId = 0
          CanTpTxPaddingActivation = CANTP_ON
          CanTpTxTaType = CANTP_PHYSICAL
          CanTpRbTxFcDisabled = false
          CanTpTxNSduRef = UDS_Tx_Phys_CANNODE_01_PduR2CanTp
          Phys_CanIf2CanTp_CAN01 (CanTpRxFcNPdu): CanTpRxFcNPduRef=UDS_Rx_Phys_CANNODE_01_CanIf2CanTp
          Phys_CanTp2CanIf_CAN01 (CanTpTxNPdu): CanTpTxNPduRef=UDS_Tx_Phys_CANNODE_01_CanTp2CanIf
      CanTpChannel_UDS_CAN03 (CanTpChannel): CanTpChannelMode=CANTP_MODE_FULL_DUPLEX
        UdsOnCan_Rx_Func_CAN03 (CanTpRxNSdu):
          CanTpBs = 0
          CanTpNar = 0.1
          CanTpNbr = 0.0
          CanTpNcr = 1.0
          CanTpRxAddressingFormat = CANTP_STANDARD
          CanTpRxPaddingActivation = CANTP_ON
          CanTpRxTaType = CANTP_FUNCTIONAL
          CanTpSTmin = 0.0
          CanTpRbRxFcDisabled = false
          CanTpRxNSduId = 2
          CanTpRxNSduRef = UDS_Rx_Func_CANNODE_03_CanTp2PduR
          Func_CanIf2CanTP (CanTpRxNPdu): CanTpRxNPduRef=UDS_Rx_Func_CANNODE_03_CanIf2CanTp
        UdsOnCan_Rx_Phys_CAN03 (CanTpRxNSdu):
          CanTpBs = 0
          CanTpNar = 0.1
          CanTpNbr = 0
          CanTpNcr = 1.0
          CanTpRxAddressingFormat = CANTP_STANDARD
          CanTpRxPaddingActivation = CANTP_ON
          CanTpRxTaType = CANTP_PHYSICAL
          CanTpSTmin = 0.0
          CanTpRbRxFcDisabled = false
          CanTpRxNSduId = 3
          CanTpRxNSduRef = UDS_Rx_Phys_CANNODE_03_CanTp2PduR
          Phys_CanIf2CanTp (CanTpRxNPdu): CanTpRxNPduRef=UDS_Rx_Phys_CANNODE_03_CanIf2CanTp
          Phys_CanTp2CanIf (CanTpTxFcNPdu): CanTpTxFcNPduRef=UDS_Tx_Phys_CANNODE_03_CanTp2CanIf
        UdsOnCan_Tx_Phy_CAN03 (CanTpTxNSdu):
          CanTpNas = 0.1
          CanTpNbs = 1.0
          CanTpNcs = 0.0
          CanTpTc = 1
          CanTpTxAddressingFormat = CANTP_STANDARD
          CanTpTxNSduId = 1
          CanTpTxPaddingActivation = CANTP_ON
          CanTpTxTaType = CANTP_PHYSICAL
          CanTpRbTxFcDisabled = false
          CanTpTxNSduRef = UDS_Tx_Phys_CANNODE_03_PduR2CanTp
          Phys_CanIf2CanTp_CAN03 (CanTpRxFcNPdu): CanTpRxFcNPduRef=UDS_Rx_Phys_CANNODE_03_CanIf2CanTp
          Phys_CanTp2CanIf_CAN03 (CanTpTxNPdu): CanTpTxNPduRef=UDS_Tx_Phys_CANNODE_03_CanTp2CanIf
    CanTpGeneral:
      CanTpChangeParameterApi = false
      CanTpDevErrorDetect = true
      CanTpPaddingByte = 255
      CanTpRbValidationDone = true
      CanTpReadParameterApi = 0
      CanTpVersionInfoApi = true
      CanTpRbLiteSupport = false
      CanTpRbBurstQsize = 8
      CanTpRbDynamicFlowControlSupport = false
      CanTpRbExternalCounterSecondsPerTick = 1.25E-8
      CanTpRbPageConfirmation = false
  module config Dcm: implementation-config-variant=VARIANT-PRE-COMPILE
    DcmConfigSet
      DcmDsd: DcmDsdRequestManufacturerNotificationEnabled=false, DcmDsdRequestSupplierNotificationEnabled=false
        DcmDsdServiceTable_UDS (DcmDsdServiceTable): DcmDsdSidTabId=0, DcmRbNRCForService=127
          12 x DcmDsdService, all with DcmRbDsdSidTabScheduler=DcmMainScheduler:
            TesterPresent: DcmDsdSidTabFnc=Dcm_DcmTesterPresent, DcmDsdSidTabServiceId=62, DcmDsdSidTabSubfuncAvail=true, DcmRbDsdSidTabSidInitFunction=NULL_PTR, DcmDsdSidTabSessionLevelRef=DcmDspSession/DEFAULT_SESSION, DcmDsdSidTabSessionLevelRef=DcmDspSession/PROGRAMMING_SESSION, DcmDsdSidTabSessionLevelRef=DcmDspSession/EXTENDED_DIAGNOSTIC_SESSION
              zeroSubFunction (DcmDsdSubService):
                DcmDsdSubServiceId = 0
                DcmDsdSubServiceSessionLevelRef = DcmDspSession/DEFAULT_SESSION
                DcmDsdSubServiceSessionLevelRef = DcmDspSession/EXTENDED_DIAGNOSTIC_SESSION
                DcmDsdSubServiceSessionLevelRef = DcmDspSession/PROGRAMMING_SESSION
            DiagnosticSessionControl: DcmDsdSidTabFnc=Dcm_DcmDiagnosticSessionControl, DcmDsdSidTabServiceId=16, DcmDsdSidTabSubfuncAvail=true, DcmRbDsdSidTabSidInitFunction=Dcm_Dsp_DscIni, DcmDsdSidTabSessionLevelRef=DcmDspSession/DEFAULT_SESSION, DcmDsdSidTabSessionLevelRef=DcmDspSession/EXTENDED_DIAGNOSTIC_SESSION, DcmDsdSidTabSessionLevelRef=DcmDspSession/PROGRAMMING_SESSION
              3 x DcmDsdSubService, all with DcmDsdSubServiceSessionLevelRef=DcmDspSession/EXTENDED_DIAGNOSTIC_SESSION, DcmDsdSubServiceSessionLevelRef=DcmDspSession/DEFAULT_SESSION:
                DEFAULT_SESSION: DcmDsdSubServiceId=1, DcmDsdSubServiceSessionLevelRef=DcmDspSession/PROGRAMMING_SESSION
                PROGRAMMING_SESSION: DcmDsdSubServiceId=2, DcmDsdSubServiceSessionLevelRef=DcmDspSession/PROGRAMMING_SESSION
                EXTENDED_DIAGNOSTIC_SESSION: DcmDsdSubServiceId=3
            SecurityAccess: DcmDsdSidTabFnc=Dcm_DcmSecurityAccess, DcmDsdSidTabServiceId=39, DcmDsdSidTabSubfuncAvail=true, DcmRbDsdSidTabSidInitFunction=Dcm_Dsp_SecaIni, DcmDsdSidTabSessionLevelRef=DcmDspSession/PROGRAMMING_SESSION, DcmDsdSidTabSessionLevelRef=DcmDspSession/EXTENDED_DIAGNOSTIC_SESSION
              4 x DcmDsdSubService, all with DcmDsdSubServiceSessionLevelRef=DcmDspSession/PROGRAMMING_SESSION:
                DcmDsdSubService_requestSeed_FBL: DcmDsdSubServiceId=5
                DcmDsdSubService_sendKey_FBL: DcmDsdSubServiceId=6
                DcmDsdSubService_requestSeed_FBL_INVT: DcmDsdSubServiceId=55, DcmRbDsdSubServiceUserModeRuleFnc=DcmRbDsdSubServiceUserModeRuleFnc_requestSeed_FBL_INVT
                DcmDsdSubService_sendKey_FBL_INVT: DcmDsdSubServiceId=56, DcmRbDsdSubServiceUserModeRuleFnc=DcmRbDsdSubServiceUserModeRuleFnc_sendKey_FBL_INVT
            WriteDataByIdentifier: DcmDsdSidTabFnc=Dcm_DcmWriteDataByIdentifier, DcmDsdSidTabServiceId=46, DcmDsdSidTabSubfuncAvail=false, DcmRbDsdSidTabSidInitFunction=Dcm_Dcm_WDBIInit, DcmDsdSidTabSessionLevelRef=DcmDspSession/PROGRAMMING_SESSION, DcmDsdSidTabSecurityLevelRef=DSP_SEC_FBL, DcmDsdSidTabSessionLevelRef=DcmDspSession/EXTENDED_DIAGNOSTIC_SESSION, DcmDsdSidTabSecurityLevelRef=DSP_SEC_FBL_INVT
            ReadDataByIdentifier: DcmDsdSidTabFnc=Dcm_DcmReadDataByIdentifier, DcmDsdSidTabServiceId=34, DcmDsdSidTabSubfuncAvail=false, DcmRbDsdSidTabSidInitFunction=Dcm_Dsp_RdbiIni, DcmDsdSidTabSessionLevelRef=DcmDspSession/DEFAULT_SESSION, DcmDsdSidTabSessionLevelRef=DcmDspSession/EXTENDED_DIAGNOSTIC_SESSION
            Ecu_Reset: DcmDsdSidTabFnc=Dcm_DcmEcuReset, DcmDsdSidTabServiceId=17, DcmDsdSidTabSubfuncAvail=1, DcmRbDsdSidTabSidInitFunction=Dcm_Dsp_EcuReset_Ini, DcmDsdSidTabSessionLevelRef=DcmDspSession/PROGRAMMING_SESSION, DcmDsdSidTabSessionLevelRef=DcmDspSession/EXTENDED_DIAGNOSTIC_SESSION
              HARD (DcmDsdSubService):
                DcmDsdSubServiceId = 1
                DcmDsdSubServiceSessionLevelRef = DcmDspSession/PROGRAMMING_SESSION
                DcmDsdSubServiceSessionLevelRef = DcmDspSession/EXTENDED_DIAGNOSTIC_SESSION
            RoutineControl: DcmDsdSidTabFnc=Dcm_DcmRoutineControl, DcmDsdSidTabServiceId=49, DcmDsdSidTabSubfuncAvail=1, DcmRbDsdSidTabSidInitFunction=Dcm_Dsp_RC_Ini, DcmDsdSidTabSessionLevelRef=DcmDspSession/PROGRAMMING_SESSION, DcmDsdSidTabSessionLevelRef=DcmDspSession/EXTENDED_DIAGNOSTIC_SESSION, DcmDsdSidTabSessionLevelRef=DcmDspSession/DEFAULT_SESSION
              DcmDsdSubStartRoutineControl (DcmDsdSubService):
                DcmDsdSubServiceId = 1
                DcmDsdSubServiceSessionLevelRef = DcmDspSession/PROGRAMMING_SESSION
                DcmDsdSubServiceSessionLevelRef = DcmDspSession/EXTENDED_DIAGNOSTIC_SESSION
            RequestDownload: DcmRbDsdSidTabSidInitFunction=Dcm_Dsp_RequestDownload_Ini, DcmDsdSidTabServiceId=52, DcmDsdSidTabSubfuncAvail=0, DcmDsdSidTabFnc=Dcm_DcmRequestDownload, DcmDsdSidTabSessionLevelRef=DcmDspSession/PROGRAMMING_SESSION, DcmDsdSidTabSecurityLevelRef=DSP_SEC_FBL, DcmDsdSidTabSecurityLevelRef=DSP_SEC_FBL_INVT
            TransferData: DcmDsdSidTabFnc=Dcm_DcmTransferData, DcmDsdSidTabServiceId=54, DcmDsdSidTabSubfuncAvail=0, DcmRbDsdSidTabSidInitFunction=Dcm_Dsp_TransferDataIni, DcmDsdSidTabSessionLevelRef=DcmDspSession/PROGRAMMING_SESSION, DcmDsdSidTabSecurityLevelRef=DSP_SEC_FBL, DcmDsdSidTabSecurityLevelRef=DSP_SEC_FBL_INVT
            RequestTransferExit: DcmRbDsdSidTabSidInitFunction=Dcm_Dsp_RequestTransferExit_Ini, DcmDsdSidTabServiceId=55, DcmDsdSidTabFnc=Dcm_DcmRequestTransferExit, DcmDsdSidTabSubfuncAvail=0, DcmRbDsdSidTabUserModeRuleFnc=Dcm_UserModeRule_Sid37, DcmDsdSidTabSessionLevelRef=DcmDspSession/PROGRAMMING_SESSION, DcmDsdSidTabSecurityLevelRef=DSP_SEC_FBL, DcmDsdSidTabSecurityLevelRef=DSP_SEC_FBL_INVT
            ControlDtcSettings: DcmDsdSidTabFnc=Dcm_DcmControlDTCSetting, DcmRbDsdSidTabSidInitFunction=Dcm_Dsp_CDTCSIni, DcmDsdSidTabServiceId=133, DcmDsdSidTabSubfuncAvail=1, DcmDsdSidTabSessionLevelRef=DcmDspSession/EXTENDED_DIAGNOSTIC_SESSION
              Off (DcmDsdSubService):
                DcmDsdSubServiceId = 2
                DcmRbDsdSubFuncServHandler = 
                DcmRbDsdSubServiceUserModeRuleFnc = Fbl_ProgM_DisableDtc
                DcmDsdSubServiceSessionLevelRef = DcmDspSession/EXTENDED_DIAGNOSTIC_SESSION
              On (DcmDsdSubService):
                DcmRbDsdSubServiceUserModeRuleFnc = Fbl_ProgM_EnableDtc
                DcmDsdSubServiceId = 1
                DcmDsdSubServiceSessionLevelRef = DcmDspSession/EXTENDED_DIAGNOSTIC_SESSION
            CommunicationControl: DcmDsdSidTabFnc=Dcm_DcmCommunicationControl, DcmDsdSidTabServiceId=40, DcmDsdSidTabSubfuncAvail=1, DcmRbDsdSidTabSidInitFunction=Dcm_Dsp_CCIni, DcmDsdSidTabSessionLevelRef=DcmDspSession/EXTENDED_DIAGNOSTIC_SESSION
              disableRxAndTx (DcmDsdSubService):
                DcmDsdSubServiceId = 3
                DcmRbDsdSubServiceUserModeRuleFnc = Fbl_ProgM_DisableRxAndTx
                DcmDsdSubServiceSessionLevelRef = DcmDspSession/EXTENDED_DIAGNOSTIC_SESSION
              enableRxAndTx (DcmDsdSubService):
                DcmDsdSubServiceId = 0
                DcmRbDsdSubServiceUserModeRuleFnc = Fbl_ProgM_EnableRxAndTx
                DcmDsdSubServiceSessionLevelRef = DcmDspSession/EXTENDED_DIAGNOSTIC_SESSION
      DcmDsl
        DcmDslBuffer_UDS_Tx (DcmDslBuffer): DcmDslBufferSize=2052
        DcmDslBuffer_UDS_Rx (DcmDslBuffer): DcmDslBufferSize=4100
        DcmDslDiagResp: DcmDslDiagRespMaxNumRespPend=50
        DcmDslProtocol
          DcmDslProtocolRow_UDS (DcmDslProtocolRow):
            DcmDslProtocolID = DCM_UDS_ON_CAN
            DcmDslProtocolMaximumResponseSize = 4095
            DcmDslProtocolPriority = 0
            DcmRbDslProtocolNRC21OnPriorityAssessmentReject = false
            DcmSendRespPendOnTransToBoot = true
            DcmTimStrP2ServerAdjust = 0.01
            DcmTimStrP2StarServerAdjust = 0.01
            DcmDslProtocolRxBufferRef = DcmDslBuffer_UDS_Rx
            DcmDslProtocolSIDTable = DcmDsdServiceTable_UDS
            DcmDslProtocolTxBufferRef = DcmDslBuffer_UDS_Tx
            DcmDslConnection_CAN01 (DcmDslConnection)
              DcmDslMainConnection: DcmDslProtocolRxTesterSourceAddr=0, DcmDslProtocolComMChannelRef=ComMChannel_Can_Network_Channel_01
                UDS_Rx_Func_CANNODE_01_Func_PduR2Dcm (DcmDslProtocolRx): DcmDslProtocolRxAddrType=DCM_FUNCTIONAL_TYPE, DcmDslProtocolRxPduRef=UDS_Rx_Func_CANNODE_01_PduR2Dcm
                UDS_Tx_Phys_CANNODE_01_Phys_Dcm2PduR (DcmDslProtocolTx): DcmDslTxConfirmationPduId=0, DcmDslProtocolTxPduRef=UDS_Tx_Phys_CANNODE_01_Dcm2PduR
                UDS_Rx_Phys_CANNODE_01_Phys_PduR2Dcm (DcmDslProtocolRx): DcmDslProtocolRxAddrType=DCM_PHYSICAL_TYPE, DcmDslProtocolRxPduRef=UDS_Rx_Phys_CANNODE_01_PduR2Dcm
            DcmDslConnection_CAN03 (DcmDslConnection)
              DcmDslMainConnection: DcmDslProtocolRxTesterSourceAddr=0, DcmDslProtocolComMChannelRef=ComMChannel_Can_Network_Channel_03
                UDS_Rx_Func_CANNODE_03_Func_PduR2Dcm (DcmDslProtocolRx): DcmDslProtocolRxAddrType=DCM_FUNCTIONAL_TYPE, DcmDslProtocolRxPduRef=UDS_Rx_Func_CANNODE_03_PduR2Dcm
                UDS_Tx_Phys_CANNODE_03_Phys_Dcm2PduR (DcmDslProtocolTx): DcmDslTxConfirmationPduId=1, DcmDslProtocolTxPduRef=UDS_Tx_Phys_CANNODE_03_Dcm2PduR
                UDS_Rx_Phys_CANNODE_03_Phys_PduR2Dcm (DcmDslProtocolRx): DcmDslProtocolRxAddrType=DCM_PHYSICAL_TYPE, DcmDslProtocolRxPduRef=UDS_Rx_Phys_CANNODE_03_PduR2Dcm
      DcmDsp:
        DcmDspDataDefaultEndianness = BIG_ENDIAN
        DcmDspMaxDidToRead = 4
        DcmDspMaxPeriodicDidToRead = 1
        DcmRbDspSesSecUsedInProtocol = UDS
        DcmRbDspTransferDataMaxLenChkRequired = 0
        DcmDspSecurity:
          DcmRbDspSecurityDelayTimerMonitor = REQUEST_SEED
          DcmRbDspSecurityNRCExceedNoOfAttempt = NumAttDelayAndNumAttLock
          DcmRbDspSecurityStoreSeed = false
          DcmDspSecurityMaxAttemptCounterReadoutTime = 0.5
          DSP_SEC_FBL (DcmDspSecurityRow):
            DcmDspSecurityAttemptCounterEnabled = true
            DcmDspSecurityDelayTime = 10.0
            DcmDspSecurityDelayTimeOnBoot = 0.0
            DcmDspSecurityKeySize = 16
            DcmDspSecurityLevel = 3
            DcmDspSecurityNumAttDelay = 3
            DcmDspSecuritySeedSize = 16
            DcmDspSecurityUsePort = USE_ASYNCH_FNC
            DcmRbDspSecurityNumAttLock = 0
            DcmDspSecurityGetSeedFnc = DcmGetSeedDSP_Fbl_ProgM_GetSeedCallback
            DcmDspSecurityCompareKeyFnc = DcmCompareKeyDSP_Fbl_ProgM_CompareKeyCallback
            DcmDspSecurityGetAttemptCounterFnc = DcmGetAttemptCounter_L3_Fbl_ProgM
            DcmDspSecuritySetAttemptCounterFnc = DcmSetAttemptCounter_L3_Fbl_ProgM
          DSP_SEC_FBL_INVT (DcmDspSecurityRow):
            DcmDspSecurityAttemptCounterEnabled = false
            DcmDspSecurityDelayTime = 0.0
            DcmDspSecurityDelayTimeOnBoot = 0.0
            DcmDspSecurityKeySize = 4
            DcmDspSecurityLevel = 28
            DcmDspSecurityNumAttDelay = 3
            DcmDspSecuritySeedSize = 4
            DcmDspSecurityUsePort = USE_ASYNCH_FNC
            DcmRbDspSecurityNumAttLock = 0
            DcmDspSecurityGetSeedFnc = DcmGetSeedDSP_Fbl_ProgM_GetSeedCallback_INVT
            DcmDspSecurityCompareKeyFnc = DcmCompareKeyDSP_Fbl_ProgM_CompareKeyCallback_INVT
            DcmDspSecurityGetAttemptCounterFnc = 
            DcmDspSecuritySetAttemptCounterFnc = 
        DcmDspSession: DcmRbDspSessionParamRecordEnabled=true
          3 x DcmDspSessionRow, all with DcmDspSessionForBoot=DCM_NO_BOOT, DcmDspSessionP2ServerMax=0.05, DcmDspSessionP2StarServerMax=5.0:
            DEFAULT_SESSION: DcmDspSessionLevel=1
            PROGRAMMING_SESSION: DcmDspSessionLevel=2
            EXTENDED_DIAGNOSTIC_SESSION: DcmDspSessionLevel=3
        DcmDspReadDTC (DcmRbDspReadDTC): DcmRbDspReadDTCMaxNumDTCRead=1, DcmRbDspReadDTCMaxNumRecordRead=1
        DcmDspControlDTCSetting: DcmSupportDTCSettingControlOptionRecord=false
        DcmDspComControl
          DcmDspComControlAllChannel_CAN01 (DcmDspComControlAllChannel): DcmDspAllComMChannelRef=ComMChannel_Can_Network_Channel_01
          DcmDspComControlAllChannel_CAN03 (DcmDspComControlAllChannel): DcmDspAllComMChannelRef=ComMChannel_Can_Network_Channel_03
        DcmDspDid_Fingerprint (DcmDspDid):
          DcmDspDidIdentifier = 61706
          DcmDspDidUsePort = USE_DATA_ELEMENT_SPECIFIC_INTERFACES
          DcmRbAtomicSenderReceiverCommunication = false
          DcmDspDidInfoRef = DcmDspDidInfo_Fingerprint
          DcmDspDidSignal_ReadFingerprint (DcmDspDidSignal): DcmDspDidDataPos=0, DcmDspDidDataRef=DcmDspData_Fingerprint
        DcmDspData_Fingerprint (DcmDspData):
          DcmDspDataUsePort = USE_DATA_ASYNCH_FNC
          DcmDspDataType = UINT8_N
          DcmDspDataSize = 80
          DcmDspDataReadFnc = DcmDspData_Fingerprint_ReadFunc
          DcmDspDataEndianness = BIG_ENDIAN
          DcmDspDataWriteFnc = DcmDspData_Fingerprint_WriteFunc
        DcmDspDidInfo_Fingerprint (DcmDspDidInfo): DcmDspDidDynamicallyDefined=false
          DcmDspDidRead:
            DcmDspDidReadSessionRef = DcmDspSession/PROGRAMMING_SESSION
            DcmDspDidReadSessionRef = DcmDspSession/EXTENDED_DIAGNOSTIC_SESSION
            DcmDspDidReadSessionRef = DcmDspSession/DEFAULT_SESSION
          DcmDspDidWrite:
            DcmDspDidWriteSecurityLevelRef = DSP_SEC_FBL
            DcmDspDidWriteSessionRef = DcmDspSession/PROGRAMMING_SESSION
            DcmDspDidWriteSecurityLevelRef = DSP_SEC_FBL_INVT
        DcmDspRoutine_CheckProgrammingPreconditions (DcmDspRoutine):
          DcmRbDspRoutineUseAsynchronousServerCallPoint = 0
          DcmRbDspReqSequenceErrorEnabled = 1
          DcmRbDspStopRoutineOnSessionChange = 0
          DcmDspRoutineIdentifier = 515
          DcmDspRoutineUsePort = false
          DcmDspStartRoutine_CheckProgrammingPreconditions (DcmDspStartRoutine):
            DcmDspStartRoutineFnc = Fbl_ProgM_CheckProgrammingPreconditionsCallback
            DcmDspStartRoutineCommonAuthorizationRef = DcmDspCA_EXTENDED_DIAGNOSTIC_SESSION
            DcmDspStartRoutineOut
              DcmDspStartRoutineOutSignal_0 (DcmDspStartRoutineOutSignal): DcmDspRoutineSignalEndianness=BIG_ENDIAN, DcmDspRoutineSignalType=UINT8, DcmDspRoutineSignalPos=0, DcmDspRoutineSignalLength=1
        DcmDspCA_EXTENDED_DIAGNOSTIC_SESSION (DcmDspCommonAuthorization): DcmDspCommonAuthorizationSessionRef=DcmDspSession/EXTENDED_DIAGNOSTIC_SESSION
        DcmDspRoutine_StartCheckRoutine (DcmDspRoutine):
          DcmRbDspRoutineUseAsynchronousServerCallPoint = 0
          DcmRbDspReqSequenceErrorEnabled = 1
          DcmRbDspStopRoutineOnSessionChange = 0
          DcmDspRoutineIdentifier = 514
          DcmDspRoutineUsePort = false
          DcmDspStartRoutine_StartCheckRoutine (DcmDspStartRoutine): DcmDspStartRoutineFnc=Fbl_ProgM_StartCheckRoutineCallback, DcmDspStartRoutineCommonAuthorizationRef=DcmDspCA_PROGRAMMING_SESSION
            DcmDspStartRoutineIn_0 (DcmDspStartRoutineIn)
              3 x DcmDspStartRoutineInSignal, all with DcmDspRoutineSignalType=UINT32, DcmDspRoutineSignalEndianness=BIG_ENDIAN:
                DcmDspStartRoutineInSignal_CrcTest: DcmDspRoutineSignalPos=64
                StartAddress: DcmDspRoutineSignalPos=0
                Length: DcmDspRoutineSignalPos=32
            DcmDspStartRoutineOut_0 (DcmDspStartRoutineOut)
              DcmDspStartRoutineOutSignal_StatusRecord (DcmDspStartRoutineOutSignal): DcmDspRoutineSignalEndianness=BIG_ENDIAN, DcmDspRoutineSignalType=UINT8, DcmDspRoutineSignalPos=0
        DcmDspCA_PROGRAMMING_SESSION (DcmDspCommonAuthorization):
          DcmDspCommonAuthorizationSessionRef = DcmDspSession/PROGRAMMING_SESSION
          DcmDspCommonAuthorizationSecurityLevelRef = DSP_SEC_FBL
          DcmDspCommonAuthorizationSecurityLevelRef = DSP_SEC_FBL_INVT
        3 x DcmDspRoutine, all with DcmRbDspRoutineUseAsynchronousServerCallPoint=0, DcmRbDspReqSequenceErrorEnabled=1, DcmRbDspStopRoutineOnSessionChange=0, DcmDspRoutineUsePort=false:
          DcmDspRoutine_CheckProgrammingDependencies: DcmDspRoutineIdentifier=65281
            DcmDspStartRoutine_CheckProgrammingDependencies (DcmDspStartRoutine): DcmDspStartRoutineFnc=Fbl_ProgM_CheckProgrammingDependenciesCallback, DcmDspStartRoutineCommonAuthorizationRef=DcmDspCA_PROGRAMMING_SESSION
              DcmDspStartRoutineOut
                DcmDspStartRoutineOutSignal_0 (DcmDspStartRoutineOutSignal): DcmDspRoutineSignalType=UINT8, DcmDspRoutineSignalPos=0, DcmDspRoutineSignalEndianness=BIG_ENDIAN
          DcmDspRoutine_StayInBoot: DcmDspRoutineIdentifier=62744
            DcmDspStartRoutine_StayInBoot (DcmDspStartRoutine): DcmDspStartRoutineFnc=Fbl_BLSM_StayInBootCallback
              DcmDspStartRoutineIn
                DcmDspStartRoutineInSignal_0 (DcmDspStartRoutineInSignal): DcmDspRoutineSignalEndianness=BIG_ENDIAN, DcmDspRoutineSignalPos=0, DcmDspRoutineSignalType=VARIABLE_LENGTH, DcmDspRoutineSignalLength=24
          DcmDspRoutine_StartEraseMemory: DcmDspRoutineIdentifier=65280
            DcmDspStartRoutine: DcmDspStartRoutineFnc=Fbl_ProgM_StartEraseMemoryCallback, DcmDspStartRoutineCommonAuthorizationRef=DcmDspCA_PROGRAMMING_SESSION
              DcmDspStartRoutineIn_0 (DcmDspStartRoutineIn)
                StartAddress (DcmDspStartRoutineInSignal): DcmDspRoutineSignalType=UINT32, DcmDspRoutineSignalPos=0, DcmDspRoutineSignalEndianness=BIG_ENDIAN
                Length (DcmDspStartRoutineInSignal): DcmDspRoutineSignalEndianness=BIG_ENDIAN, DcmDspRoutineSignalType=UINT32, DcmDspRoutineSignalPos=32
              DcmDspStartRoutineOut_0 (DcmDspStartRoutineOut)
                DcmDspStartRoutineOutSignal_0 (DcmDspStartRoutineOutSignal): DcmDspRoutineSignalEndianness=BIG_ENDIAN, DcmDspRoutineSignalType=UINT8, DcmDspRoutineSignalPos=0
        DcmDspMemory_0 (DcmDspMemory)
          DcmDspMemoryIdInfo_all (DcmDspMemoryIdInfo)
            DcmRbDspDownloadMemoryRangeInfo: DcmRbDspDownloadMemoryRangeLow=0, DcmRbDspDownloadMemoryRangeHigh=4294967294
        DcmDspData_ReadBootVersion (DcmDspData):
          DcmDspDataEndianness = BIG_ENDIAN
          DcmDspDataReadFnc = DcmDspData_BootVersion_ReadFunc
          DcmDspDataSize = 80
          DcmDspDataType = UINT8_N
          DcmDspDataUsePort = USE_DATA_ASYNCH_FNC
        DcmDspDidInfo_ReadBootVersion (DcmDspDidInfo): DcmDspDidDynamicallyDefined=false
          DcmDspDidRead:
            DcmDspDidReadSessionRef = DcmDspSession/PROGRAMMING_SESSION
            DcmDspDidReadSessionRef = DcmDspSession/EXTENDED_DIAGNOSTIC_SESSION
            DcmDspDidReadSessionRef = DcmDspSession/DEFAULT_SESSION
        DcmDspDid_ReadBootVersion (DcmDspDid):
          DcmDspDidUsePort = USE_DATA_ELEMENT_SPECIFIC_INTERFACES
          DcmRbAtomicSenderReceiverCommunication = 0
          DcmDspDidIdentifier = 61866
          DcmDspDidInfoRef = DcmDspDidInfo_ReadBootVersion
          DcmDspDidSignal: DcmDspDidDataPos=0, DcmDspDidDataRef=DcmDspData_ReadBootVersion
        DcmDspRoutine_StartSwap_INVT (DcmDspRoutine):
          DcmRbDspRoutineUseAsynchronousServerCallPoint = 0
          DcmRbDspReqSequenceErrorEnabled = 1
          DcmRbDspStopRoutineOnSessionChange = 0
          DcmDspRoutineUsePort = false
          DcmDspRoutineIdentifier = 33119
          DcmDspStartRoutine: DcmDspStartRoutineFnc=Fbl_ProgM_StartSwapCallback_INVT, DcmDspStartRoutineCommonAuthorizationRef=DcmDspCA_EXTENDED_DIAGNOSTIC_SESSION
        DcmDspData_ReadBootCompileTime (DcmDspData):
          DcmDspDataEndianness = BIG_ENDIAN
          DcmDspDataReadFnc = DcmDspData_BootTime_ReadFunc
          DcmDspDataSize = 48
          DcmDspDataType = UINT8_N
          DcmDspDataUsePort = USE_DATA_ASYNCH_FNC
        DcmDspData_ReadActiveBank (DcmDspData):
          DcmDspDataEndianness = BIG_ENDIAN
          DcmDspDataReadFnc = DcmDspData_ActiveBank_ReadFunc
          DcmDspDataSize = 8
          DcmDspDataType = UINT8_N
          DcmDspDataUsePort = USE_DATA_ASYNCH_FNC
        4 x DcmDspDid, all with DcmDspDidUsePort=USE_DATA_ELEMENT_SPECIFIC_INTERFACES, DcmRbAtomicSenderReceiverCommunication=0, DcmDspDidInfoRef=DcmDspDidInfo_ReadOnlyInAllSession:
          DcmDspDid_ReadBootCompileTime: DcmDspDidIdentifier=1024
            DcmDspDidSignal: DcmDspDidDataPos=0, DcmDspDidDataRef=DcmDspData_ReadBootCompileTime
          DcmDspDid_ReadActiveBank: DcmDspDidIdentifier=1025
            DcmDspDidSignal: DcmDspDidDataPos=0, DcmDspDidDataRef=DcmDspData_ReadActiveBank
          DcmDspDid_ReadReqCanId: DcmDspDidIdentifier=1026
            DcmDspDidSignal: DcmDspDidDataPos=0, DcmDspDidDataRef=DcmDspData_ReadReqCanId
          DcmDspDid_ReadRspCanId: DcmDspDidIdentifier=1027
            DcmDspDidSignal: DcmDspDidDataPos=0, DcmDspDidDataRef=DcmDspData_ReadRspCanId
        DcmDspDidInfo_ReadOnlyInAllSession (DcmDspDidInfo): DcmDspDidDynamicallyDefined=false
          DcmDspDidRead:
            DcmDspDidReadSessionRef = DcmDspSession/PROGRAMMING_SESSION
            DcmDspDidReadSessionRef = DcmDspSession/EXTENDED_DIAGNOSTIC_SESSION
            DcmDspDidReadSessionRef = DcmDspSession/DEFAULT_SESSION
        DcmDspData_ReadReqCanId (DcmDspData):
          DcmDspDataEndianness = BIG_ENDIAN
          DcmDspDataReadFnc = DcmDspData_ReqCanId_ReadFunc
          DcmDspDataSize = 32
          DcmDspDataType = UINT8_N
          DcmDspDataUsePort = USE_DATA_ASYNCH_FNC
        DcmDspData_ReadRspCanId (DcmDspData):
          DcmDspDataEndianness = BIG_ENDIAN
          DcmDspDataReadFnc = DcmDspData_RspCanId_ReadFunc
          DcmDspDataSize = 32
          DcmDspDataType = UINT8_N
          DcmDspDataUsePort = USE_DATA_ASYNCH_FNC
        4 x DcmDspRoutine, all with DcmRbDspRoutineUseAsynchronousServerCallPoint=0, DcmRbDspReqSequenceErrorEnabled=1, DcmRbDspStopRoutineOnSessionChange=0, DcmDspRoutineUsePort=false:
          DcmDspRoutine_StartCheckRoutine_INVT: DcmDspRoutineIdentifier=63369
            DcmDspStartRoutine_StartCheckRoutine (DcmDspStartRoutine): DcmDspStartRoutineFnc=Fbl_ProgM_StartCheckRoutineCallback_INVT, DcmDspStartRoutineCommonAuthorizationRef=DcmDspCA_PROGRAMMING_INVTProcess
              DcmDspStartRoutineIn_0 (DcmDspStartRoutineIn)
                3 x DcmDspStartRoutineInSignal, all with DcmDspRoutineSignalEndianness=BIG_ENDIAN, DcmDspRoutineSignalType=UINT32:
                  DcmDspStartRoutineInSignal_Address: DcmDspRoutineSignalPos=0
                  DcmDspStartRoutineInSignal_Length: DcmDspRoutineSignalPos=32
                  DcmDspStartRoutineInSignal_CrcTest: DcmDspRoutineSignalPos=64
              DcmDspStartRoutineOut_0 (DcmDspStartRoutineOut)
                DcmDspStartRoutineOutSignal_StatusRecord (DcmDspStartRoutineOutSignal): DcmDspRoutineSignalEndianness=BIG_ENDIAN, DcmDspRoutineSignalType=UINT8, DcmDspRoutineSignalPos=0
          DcmDspRoutine_StartEraseMemory_INVT: DcmDspRoutineIdentifier=61680
            DcmDspStartRoutine: DcmDspStartRoutineFnc=Fbl_ProgM_StartEraseMemoryCallback_INVT, DcmDspStartRoutineCommonAuthorizationRef=DcmDspCA_PROGRAMMING_INVTProcess
              DcmDspStartRoutineIn_0 (DcmDspStartRoutineIn)
                StartAddress (DcmDspStartRoutineInSignal): DcmDspRoutineSignalType=UINT32, DcmDspRoutineSignalPos=0, DcmDspRoutineSignalEndianness=BIG_ENDIAN
                Length (DcmDspStartRoutineInSignal): DcmDspRoutineSignalEndianness=BIG_ENDIAN, DcmDspRoutineSignalType=UINT32, DcmDspRoutineSignalPos=32
              DcmDspStartRoutineOut_0 (DcmDspStartRoutineOut)
                DcmDspStartRoutineOutSignal_0 (DcmDspStartRoutineOutSignal): DcmDspRoutineSignalEndianness=BIG_ENDIAN, DcmDspRoutineSignalType=UINT8, DcmDspRoutineSignalPos=0
          DcmDspRoutine_CheckProgrammingDependencies_INVT: DcmDspRoutineIdentifier=61937
            DcmDspStartRoutine_CheckProgrammingDependencies (DcmDspStartRoutine):
              DcmDspStartRoutineFnc = Fbl_ProgM_CheckProgrammingDependenciesCallback_INVT
              DcmDspStartRoutineCommonAuthorizationRef = DcmDspCA_PROGRAMMING_INVTProcess
              DcmDspStartRoutineOut
                DcmDspStartRoutineOutSignal_0 (DcmDspStartRoutineOutSignal): DcmDspRoutineSignalType=UINT8, DcmDspRoutineSignalPos=0, DcmDspRoutineSignalEndianness=BIG_ENDIAN
          DcmDspRoutine_CheckProgrammingPreconditions_INVT: DcmDspRoutineIdentifier=61731
            DcmDspStartRoutine_StartCheckRoutine (DcmDspStartRoutine):
              DcmDspStartRoutineFnc = Fbl_ProgM_CheckProgrammingPreconditionsCallback_INVT
              DcmDspStartRoutineCommonAuthorizationRef = DcmDspCA_EXTENDED_DIAGNOSTIC_SESSION
              DcmDspStartRoutineOut_0 (DcmDspStartRoutineOut)
                DcmDspStartRoutineOutSignal_StatusRecord (DcmDspStartRoutineOutSignal): DcmDspRoutineSignalEndianness=BIG_ENDIAN, DcmDspRoutineSignalType=UINT8, DcmDspRoutineSignalPos=0
        DcmDspCA_PROGRAMMING_INVTProcess (DcmDspCommonAuthorization): DcmDspCommonAuthorizationSessionRef=DcmDspSession/PROGRAMMING_SESSION, DcmDspCommonAuthorizationSecurityLevelRef=DSP_SEC_FBL_INVT
        DcmDspDid_R_F187 (DcmDspDid):
          DcmDspDidUsePort = USE_DATA_ELEMENT_SPECIFIC_INTERFACES
          DcmRbAtomicSenderReceiverCommunication = 0
          DcmDspDidIdentifier = 61831
          DcmDspDidInfoRef = DcmDspDidInfo_ReadOnlyInAllSession
          DcmDspDidSignal: DcmDspDidDataPos=0, DcmDspDidDataRef=DcmDspData_R_F187
        DcmDspData_R_F187 (DcmDspData):
          DcmRbDspDataUseAsynchronousServerCallPoint = 0
          DcmDspDataEndianness = BIG_ENDIAN
          DcmDspDataReadFnc = DataServices_R_F187_ReadData
          DcmDspDataType = UINT8_N
          DcmDspDataUsePort = USE_DATA_ASYNCH_FNC
          DcmDspDataSize = 104
        6 x DcmDspDid, all with DcmDspDidUsePort=USE_DATA_ELEMENT_SPECIFIC_INTERFACES, DcmRbAtomicSenderReceiverCommunication=0, DcmDspDidInfoRef=DcmDspDidInfo_ReadOnlyInAllSession:
          DcmDspDid_R_F18A: DcmDspDidIdentifier=61834
            DcmDspDidSignal: DcmDspDidDataPos=0, DcmDspDidDataRef=DcmDspData_R_F18A
          DcmDspDid_R_F18B: DcmDspDidIdentifier=61835
            DcmDspDidSignal: DcmDspDidDataPos=0, DcmDspDidDataRef=DcmDspData_R_F18B
          DcmDspDid_R_F18C: DcmDspDidIdentifier=61836
            DcmDspDidSignal: DcmDspDidDataPos=0, DcmDspDidDataRef=DcmDspData_R_F18C
          DcmDspDid_R_F190: DcmDspDidIdentifier=61840
            DcmDspDidSignal: DcmDspDidDataPos=0, DcmDspDidDataRef=DcmDspData_R_F190
          DcmDspDid_R_F193: DcmDspDidIdentifier=61843
            DcmDspDidSignal: DcmDspDidDataPos=0, DcmDspDidDataRef=DcmDspData_R_F193
          DcmDspDid_R_F195: DcmDspDidIdentifier=61845
            DcmDspDidSignal: DcmDspDidDataPos=0, DcmDspDidDataRef=DcmDspData_R_F195
        DcmDspData_R_F18A (DcmDspData):
          DcmRbDspDataUseAsynchronousServerCallPoint = 0
          DcmDspDataEndianness = BIG_ENDIAN
          DcmDspDataReadFnc = DataServices_R_F18A_ReadData
          DcmDspDataType = UINT8_N
          DcmDspDataUsePort = USE_DATA_ASYNCH_FNC
          DcmDspDataSize = 80
        DcmDspDid_R_F19A (DcmDspDid):
          DcmDspDidUsePort = USE_DATA_ELEMENT_SPECIFIC_INTERFACES
          DcmRbAtomicSenderReceiverCommunication = 0
          DcmDspDidIdentifier = 61850
          DcmDspDidInfoRef = DcmDspDidInfo_ReadOnlyInAllSession
          DcmDspDidSignal: DcmDspDidDataPos=0, DcmDspDidDataRef=DcmDspData_R_F19A
        DcmDspDid_R_F1B7 (DcmDspDid):
          DcmDspDidUsePort = USE_DATA_ELEMENT_SPECIFIC_INTERFACES
          DcmRbAtomicSenderReceiverCommunication = 0
          DcmDspDidIdentifier = 61879
          DcmDspDidInfoRef = DcmDspDidInfo_ReadOnlyInAllSession
          DcmDspDidSignal: DcmDspDidDataPos=0, DcmDspDidDataRef=DcmDspData_R_F1B7
        7 x DcmDspData, all with DcmRbDspDataUseAsynchronousServerCallPoint=0, DcmDspDataEndianness=BIG_ENDIAN, DcmDspDataType=UINT8_N, DcmDspDataUsePort=USE_DATA_ASYNCH_FNC:
          DcmDspData_R_F18B: DcmDspDataReadFnc=DataServices_R_F18B_ReadData, DcmDspDataSize=32
          DcmDspData_R_F18C: DcmDspDataReadFnc=DataServices_R_F18C_ReadData, DcmDspDataSize=112
          DcmDspData_R_F190: DcmDspDataReadFnc=DataServices_R_F190_ReadData, DcmDspDataSize=136
          DcmDspData_R_F193: DcmDspDataReadFnc=DataServices_R_F193_ReadData, DcmDspDataSize=48
          DcmDspData_R_F195: DcmDspDataReadFnc=DataServices_R_F195_ReadData, DcmDspDataSize=48
          DcmDspData_R_F19A: DcmDspDataReadFnc=DataServices_R_F19A_ReadData, DcmDspDataSize=64
          DcmDspData_R_F1B7: DcmDspDataReadFnc=DataServices_R_F1B7_ReadData, DcmDspDataSize=56
        DcmDspRoutine_StartSwap (DcmDspRoutine):
          DcmRbDspRoutineUseAsynchronousServerCallPoint = 0
          DcmRbDspReqSequenceErrorEnabled = 1
          DcmRbDspStopRoutineOnSessionChange = 0
          DcmDspRoutineUsePort = false
          DcmDspRoutineIdentifier = 57097
          DcmDspStartRoutine: DcmDspStartRoutineFnc=Fbl_ProgM_StartSwapCallback, DcmDspStartRoutineCommonAuthorizationRef=DcmDspCA_PROGRAMMING_SESSION
        DcmDspDid_R_DFEB (DcmDspDid):
          DcmDspDidUsePort = USE_DATA_ELEMENT_SPECIFIC_INTERFACES
          DcmRbAtomicSenderReceiverCommunication = 0
          DcmDspDidIdentifier = 57323
          DcmDspDidInfoRef = DcmDspDidInfo_ReadOnlyInAllSession
          DcmDspDidSignal: DcmDspDidDataPos=0, DcmDspDidDataRef=DcmDspData_R_DFEB
        DcmDspDid_R_DFEC (DcmDspDid):
          DcmDspDidUsePort = USE_DATA_ELEMENT_SPECIFIC_INTERFACES
          DcmRbAtomicSenderReceiverCommunication = 0
          DcmDspDidIdentifier = 57324
          DcmDspDidInfoRef = DcmDspDidInfo_ReadOnlyInAllSession
          DcmDspDidSignal: DcmDspDidDataPos=0, DcmDspDidDataRef=DcmDspData_R_DFEC
        3 x DcmDspData, all with DcmDspDataEndianness=BIG_ENDIAN, DcmDspDataType=UINT8_N, DcmDspDataUsePort=USE_DATA_ASYNCH_FNC:
          DcmDspData_R_DFEB: DcmRbDspDataUseAsynchronousServerCallPoint=0, DcmDspDataSize=512, DcmDspDataReadFnc=DcmDspData_INVTBootVersion_ReadFunc
          DcmDspData_R_DFEC: DcmRbDspDataUseAsynchronousServerCallPoint=0, DcmDspDataSize=512, DcmDspDataReadFnc=DcmDspData_INVTAppVersion_ReadFunc
          DcmDspData_RW_F15A: DcmDspDataSize=128, DcmDspDataReadFnc=DataServices_R_F15A_ReadData, DcmDspDataWriteFnc=DataServices_R_F15A_WriteFunc
        DcmDspDid_RW_F15A (DcmDspDid):
          DcmDspDidIdentifier = 61786
          DcmDspDidUsePort = USE_DATA_ELEMENT_SPECIFIC_INTERFACES
          DcmRbAtomicSenderReceiverCommunication = false
          DcmDspDidInfoRef = DcmDspDidInfo_Fingerprint
          DcmDspDidSignal: DcmDspDidDataPos=0, DcmDspDidDataRef=DcmDspData_RW_F15A
      DcmPageBufferCfg: DcmPagedBufferEnabled=false
      DcmProcessingConditions
        DcmModeCondition_0 (DcmModeCondition): DcmConditionType=DCM_EQUALS, DcmSwcModeRef=Mode1
        DcmModeRule_0 (DcmModeRule): DcmLogicalOperator=DCM_AND, DcmModeRuleNrcValue=1, DcmArgumentRef=DcmModeCondition_0
    DcmGeneral: DcmDevErrorDetect=false, DcmRespondAllRequest=false, DcmTaskTime=0.005, DcmVersionInfoApi=true
      DcmRbGeneral:
        DcmRbApplCallRequiredOnReqReception = true
        DcmRbApplTxConfirmationRequiredAlways = false
        DcmRbConfirmForDSDGeneratedNegRes = false
        DcmRbDiagAdaptSupport = false
        DcmRbOSTimerUse = ProjectSpecific
        DcmRbRestoringEnabled = true
        DcmRbRTEsupport = 0
        DcmRbSignalDefaultValue = 0
        DcmRbStoringEnabled = true
        DcmRbOSCounterMacro = OS_GET_SYSTEM_COUNTER_US
        DcmRbOSCounterId = 1
        DcmRbRTEsupportsPRportFunctionality = false
