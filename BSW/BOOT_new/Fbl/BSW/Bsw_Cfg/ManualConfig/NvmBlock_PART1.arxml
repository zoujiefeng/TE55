AUTOSAR XML (schema 00047)
package /INVT_Project/EcucModuleConfigurationValuess
  module config NvM: implementation-config-variant=VARIANT-PRE-COMPILE
    17 x NvMBlockDescriptor, all with NvMBlockCrcType=NVM_CRC16, NvMBlockManagementType=NVM_BLOCK_NATIVE, NvMBlockUseCrc=true, NvMMaxNumOfReadRetries=0, NvMMaxNumOfWriteRetries=0, NvMNvBlockNum=1, NvMNvramDeviceId=0, NvMRomBlockNum=1, NvMStaticBlockIDCheck=false, NvMWriteVerificationDataSize=0, NvMInitBlockCallback=NULL_PTR, NvMBlockJobPriority=1, NvMBlockWriteProt=false, NvMSelectBlockForWriteAll=true, NvMSelectBlockForReadAll=true, NvMWriteBlockOnce=false, NvMResistantToChangedSw=false, NvMWriteVerification=false:
      NV_ExternalReprogrammingRequestFlagBlock: NvMBlockUseSyncMechanism=false, NvMCalcRamBlockCrc=false, NvMNvBlockLength=1, NvMRamBlockDataAddress=Fbl_DataM_RamMirrorNV_ReprogrammingRequestFlagBlock, NvMRomBlockDataAddress=Fbl_DataM_RomDataNV_ReprogrammingRequestFlagBlock, NvMRbGenRteAdminPort=0, NvMRbGenRteServicePort=0, NvMSingleBlockCallback=Fbl_DataM_NV_ReprogrammingRequestFlagBlockCallbackFunction, NvMRbFirstReadDataMigration=false, NvMRbInitBlockAtLayoutChange=false, NvMRbNoFallback=false, NvMRbSelectBlockForFirstInitAll=false, NvMRbResistantToLayoutRemoval=false, NvMBlockUseAutoValidation=false, NvMNvramBlockIdentifier=2
      NV_ValidityFlagsBlock: NvMBlockUseAutoValidation=0, NvMBlockUseSyncMechanism=0, NvMCalcRamBlockCrc=false, NvMRbFirstReadDataMigration=0, NvMRbGenRteAdminPort=0, NvMRbGenRteServicePort=false, NvMRbInitBlockAtLayoutChange=0, NvMRbNoFallback=0, NvMRbResistantToLayoutRemoval=0, NvMRbSelectBlockForFirstInitAll=0, NvMNvBlockLength=1, NvMRamBlockDataAddress=Fbl_DataM_RamMirrorNV_ValidityFlagsBlock, NvMRomBlockDataAddress=Fbl_DataM_RomDataNV_ValidityFlagsBlock, NvMSingleBlockCallback=Fbl_DataM_NV_ValidityFlagsBlockCallbackFunction, NvMNvramBlockIdentifier=3
      NV_ResetResponseFlagBlock: NvMBlockUseSyncMechanism=false, NvMNvBlockLength=1, NvMRamBlockDataAddress=Fbl_DataM_RamMirrorNV_ResetResponseBlock, NvMRbGenRteAdminPort=false, NvMRbGenRteServicePort=false, NvMRomBlockDataAddress=Fbl_DataM_RomDataNV_ResetResponseBlock, NvMSingleBlockCallback=Fbl_DataM_NV_ResetResponseBlockCallbackFunction, NvMNvramBlockIdentifier=4
      NV_FingerprintBlock: NvMBlockUseSyncMechanism=false, NvMNvBlockLength=10, NvMRamBlockDataAddress=Fbl_DataM_RamMirrorNV_FingerprintBlock, NvMRomBlockDataAddress=Fbl_DataM_RomDataNV_FingerprintBlock, NvMSingleBlockCallback=Fbl_DataM_NV_FingerprintBlockCallbackFunction, NvMRbFirstReadDataMigration=false, NvMRbGenRteAdminPort=false, NvMRbGenRteServicePort=false, NvMRbInitBlockAtLayoutChange=false, NvMRbNoFallback=false, NvMRbResistantToLayoutRemoval=false, NvMRbSelectBlockForFirstInitAll=false, NvMNvramBlockIdentifier=5
      NV_CrcBlock: NvMBlockUseSyncMechanism=false, NvMNvBlockLength=8, NvMRamBlockDataAddress=Fbl_DataM_RamMirrorNV_CrcBlock, NvMRomBlockDataAddress=Fbl_DataM_RomDataNV_CrcBlock, NvMSingleBlockCallback=Fbl_DataM_NV_CrcBlockCallbackFunction, NvMRbGenRteAdminPort=false, NvMRbGenRteServicePort=false, NvMNvramBlockIdentifier=6
      NV_ProgrammingAttemptCounterBlock: NvMBlockUseSyncMechanism=0, NvMCalcRamBlockCrc=0, NvMRbFirstReadDataMigration=0, NvMRbGenRteAdminPort=0, NvMRbGenRteServicePort=false, NvMRbInitBlockAtLayoutChange=0, NvMRbNoFallback=0, NvMRbRamInitUnconditional=0, NvMRbResistantToLayoutRemoval=0, NvMRbSelectBlockForFirstInitAll=0, NvMNvBlockLength=4, NvMRamBlockDataAddress=Fbl_DataM_RamMirrorNV_ProgrammingAttemptCounterBlock, NvMRomBlockDataAddress=Fbl_DataM_RomDataNV_ProgrammingAttemptCounterBlock, NvMSingleBlockCallback=Fbl_DataM_NV_ProgrammingAttemptCounterBlockCallbackFunction, NvMNvramBlockIdentifier=7
      NV_ProgrammingCounterBlock: NvMBlockUseAutoValidation=0, NvMBlockUseSyncMechanism=0, NvMCalcRamBlockCrc=0, NvMRbFirstReadDataMigration=0, NvMRbGenRteAdminPort=0, NvMRbGenRteServicePort=false, NvMRbInitBlockAtLayoutChange=0, NvMRbNoFallback=0, NvMRbRamInitUnconditional=0, NvMRbResistantToLayoutRemoval=0, NvMRbSelectBlockForFirstInitAll=0, NvMNvBlockLength=4, NvMRamBlockDataAddress=Fbl_DataM_RamMirrorNV_ProgrammingCounterBlock, NvMRomBlockDataAddress=Fbl_DataM_RomDataNV_ProgrammingCounterBlock, NvMSingleBlockCallback=Fbl_DataM_NV_ProgrammingCounterBlockCallbackFunction, NvMNvramBlockIdentifier=8
      NV_ReserveForBoot_00_FailureAttemptCnt_L1: NvMBlockUseSyncMechanism=false, NvMNvBlockLength=1, NvMRamBlockDataAddress=Fbl_DataM_RamMirrorNV_Reserve00_FACBlock, NvMRomBlockDataAddress=Fbl_DataM_RomDataNV_Reserve00_FACBlock, NvMSingleBlockCallback=Fbl_DataM_NV_Reserve00_FACBlockCallbackFunction, NvMRbFirstReadDataMigration=false, NvMRbGenRteAdminPort=false, NvMRbGenRteServicePort=false, NvMRbInitBlockAtLayoutChange=false, NvMRbNoFallback=false, NvMRbResistantToLayoutRemoval=false, NvMRbSelectBlockForFirstInitAll=false, NvMNvramBlockIdentifier=9
      NV_ReserveForBoot_01: NvMBlockUseSyncMechanism=false, NvMNvBlockLength=200, NvMRamBlockDataAddress=Fbl_DataM_RamMirrorNV_Reserve01_Block, NvMRomBlockDataAddress=Fbl_DataM_RomDataNV_Reserve01_Block, NvMSingleBlockCallback=Fbl_DataM_NV_Reserve01_BlockCallbackFunction, NvMRbFirstReadDataMigration=false, NvMRbGenRteAdminPort=false, NvMRbGenRteServicePort=false, NvMRbInitBlockAtLayoutChange=false, NvMRbNoFallback=false, NvMRbResistantToLayoutRemoval=false, NvMRbSelectBlockForFirstInitAll=false, NvMNvramBlockIdentifier=10
      NV_ReserveForBoot_02: NvMBlockUseSyncMechanism=false, NvMNvBlockLength=1, NvMRamBlockDataAddress=Fbl_DataM_RamMirrorNV_Reserve02_Block, NvMRomBlockDataAddress=Fbl_DataM_RomDataNV_Reserve02_Block, NvMSingleBlockCallback=Fbl_DataM_NV_Reserve02_BlockCallbackFunction, NvMRbFirstReadDataMigration=false, NvMRbGenRteAdminPort=false, NvMRbGenRteServicePort=false, NvMRbInitBlockAtLayoutChange=false, NvMRbNoFallback=false, NvMRbResistantToLayoutRemoval=false, NvMRbSelectBlockForFirstInitAll=false, NvMNvramBlockIdentifier=11
      NV_ReserveForBoot_03: NvMBlockUseSyncMechanism=false, NvMNvBlockLength=1, NvMRamBlockDataAddress=Fbl_DataM_RamMirrorNV_Reserve03_Block, NvMRomBlockDataAddress=Fbl_DataM_RomDataNV_Reserve03_Block, NvMSingleBlockCallback=Fbl_DataM_NV_Reserve03_BlockCallbackFunction, NvMRbFirstReadDataMigration=false, NvMRbGenRteAdminPort=false, NvMRbGenRteServicePort=false, NvMRbInitBlockAtLayoutChange=false, NvMRbNoFallback=false, NvMRbResistantToLayoutRemoval=false, NvMRbSelectBlockForFirstInitAll=false, NvMNvramBlockIdentifier=12
      NV_ReserveForBoot_04: NvMBlockUseSyncMechanism=false, NvMNvBlockLength=1, NvMRamBlockDataAddress=Fbl_DataM_RamMirrorNV_Reserve04_Block, NvMRomBlockDataAddress=Fbl_DataM_RomDataNV_Reserve04_Block, NvMSingleBlockCallback=Fbl_DataM_NV_Reserve04_BlockCallbackFunction, NvMRbFirstReadDataMigration=false, NvMRbGenRteAdminPort=false, NvMRbGenRteServicePort=false, NvMRbInitBlockAtLayoutChange=false, NvMRbNoFallback=false, NvMRbResistantToLayoutRemoval=false, NvMRbSelectBlockForFirstInitAll=false, NvMNvramBlockIdentifier=13
      NV_ReserveForBoot_05: NvMBlockUseSyncMechanism=false, NvMNvBlockLength=1, NvMRamBlockDataAddress=Fbl_DataM_RamMirrorNV_Reserve05_Block, NvMRomBlockDataAddress=Fbl_DataM_RomDataNV_Reserve05_Block, NvMSingleBlockCallback=Fbl_DataM_NV_Reserve05_BlockCallbackFunction, NvMRbFirstReadDataMigration=false, NvMRbGenRteAdminPort=false, NvMRbGenRteServicePort=false, NvMRbInitBlockAtLayoutChange=false, NvMRbNoFallback=false, NvMRbResistantToLayoutRemoval=false, NvMRbSelectBlockForFirstInitAll=false, NvMNvramBlockIdentifier=14
      NV_ReserveForBoot_06: NvMBlockUseSyncMechanism=false, NvMNvBlockLength=1, NvMRamBlockDataAddress=Fbl_DataM_RamMirrorNV_Reserve06_Block, NvMRomBlockDataAddress=Fbl_DataM_RomDataNV_Reserve06_Block, NvMSingleBlockCallback=Fbl_DataM_NV_Reserve06_BlockCallbackFunction, NvMRbFirstReadDataMigration=false, NvMRbGenRteAdminPort=false, NvMRbGenRteServicePort=false, NvMRbInitBlockAtLayoutChange=false, NvMRbNoFallback=false, NvMRbResistantToLayoutRemoval=false, NvMRbSelectBlockForFirstInitAll=false, NvMNvramBlockIdentifier=15
      NV_ReserveForBoot_07: NvMBlockUseSyncMechanism=false, NvMNvBlockLength=1, NvMRamBlockDataAddress=Fbl_DataM_RamMirrorNV_Reserve07_Block, NvMRomBlockDataAddress=Fbl_DataM_RomDataNV_Reserve07_Block, NvMSingleBlockCallback=Fbl_DataM_NV_Reserve07_BlockCallbackFunction, NvMRbFirstReadDataMigration=false, NvMRbGenRteAdminPort=false, NvMRbGenRteServicePort=false, NvMRbInitBlockAtLayoutChange=false, NvMRbNoFallback=false, NvMRbResistantToLayoutRemoval=false, NvMRbSelectBlockForFirstInitAll=false, NvMNvramBlockIdentifier=16
      NV_ReserveForBoot_08: NvMBlockUseSyncMechanism=false, NvMNvBlockLength=1, NvMRamBlockDataAddress=Fbl_DataM_RamMirrorNV_Reserve08_Block, NvMRomBlockDataAddress=Fbl_DataM_RomDataNV_Reserve08_Block, NvMSingleBlockCallback=Fbl_DataM_NV_Reserve08_BlockCallbackFunction, NvMRbFirstReadDataMigration=false, NvMRbGenRteAdminPort=false, NvMRbGenRteServicePort=false, NvMRbInitBlockAtLayoutChange=false, NvMRbNoFallback=false, NvMRbResistantToLayoutRemoval=false, NvMRbSelectBlockForFirstInitAll=false, NvMNvramBlockIdentifier=17
      NV_ReserveForBoot_09: NvMBlockUseSyncMechanism=false, NvMNvBlockLength=1, NvMRamBlockDataAddress=Fbl_DataM_RamMirrorNV_Reserve09_Block, NvMRomBlockDataAddress=Fbl_DataM_RomDataNV_Reserve09_Block, NvMSingleBlockCallback=Fbl_DataM_NV_Reserve09_BlockCallbackFunction, NvMRbFirstReadDataMigration=false, NvMRbGenRteAdminPort=false, NvMRbGenRteServicePort=false, NvMRbInitBlockAtLayoutChange=false, NvMRbNoFallback=false, NvMRbResistantToLayoutRemoval=false, NvMRbSelectBlockForFirstInitAll=false, NvMNvramBlockIdentifier=18
