AUTOSAR XML (schema 00047)
package /INVT_Project/EcucModuleConfigurationValuess
  module config PduR: implementation-config-variant=VARIANT-PRE-COMPILE
    Dcm (PduRBswModules):
      PduRCancelTransmit = 1
      PduRTransportProtocol = 1
      PduRTxConfirmation = 1
      PduRUpperModule = 1
      PduRCancelReceive = 0
      PduRChangeParameterApi = 0
      PduRCommunicationInterface = 0
      PduRLowerModule = 0
      PduRRetransmission = 0
      PduRTriggertransmit = 0
      PduRUseTag = 0
      PduRBswModuleRef = Dcm
    CanTp (PduRBswModules):
      PduRCancelTransmit = 1
      PduRLowerModule = 1
      PduRTransportProtocol = 1
      PduRTxConfirmation = 1
      PduRCancelReceive = 0
      PduRChangeParameterApi = 0
      PduRCommunicationInterface = 0
      PduRRetransmission = 0
      PduRTriggertransmit = 0
      PduRUpperModule = 0
      PduRUseTag = 0
      PduRBswModuleRef = CanTp
      PduRInvalidHandlers: PduRIHCancelReceive=0, PduRIHCancelTransmit=0
    PduRRoutingTables: PduRConfigurationId=0
      PduRRoutingTable
        6 x PduRRoutingPath:
          CanTp2Dcm_Func_CAN03
            Dest_CanTp2Dcm_Func_CAN03 (PduRDestPdu): PduRDestPduRef=UDS_Rx_Func_CANNODE_03_PduR2Dcm
            Src_CanTp2Dcm_Func_CAN03 (PduRSrcPdu): PduRSrcPduUpTxConf=1, PduRSrcPduRef=UDS_Rx_Func_CANNODE_03_CanTp2PduR
          CanTp2Dcm_Phys_CAN03
            Dest_CanTp2Dcm_Phys_CAN03 (PduRDestPdu): PduRDestPduRef=UDS_Rx_Phys_CANNODE_03_PduR2Dcm
            Src_CanTp2Dcm_Phys_CAN03 (PduRSrcPdu): PduRSrcPduUpTxConf=1, PduRSrcPduRef=UDS_Rx_Phys_CANNODE_03_CanTp2PduR
          Dcm2CanTp_Phys_CAN03
            Dst_Dcm2CanTp_Phys_CAN03 (PduRDestPdu): PduRDestPduRef=UDS_Tx_Phys_CANNODE_03_PduR2CanTp
            Src_Dcm2CanTp_Phys_CAN03 (PduRSrcPdu): PduRSrcPduUpTxConf=1, PduRSrcPduRef=UDS_Tx_Phys_CANNODE_03_Dcm2PduR
          CanTp2Dcm_Func_CAN01
            Dest_CanTp2Dcm_Func_CAN01 (PduRDestPdu): PduRDestPduRef=UDS_Rx_Func_CANNODE_01_PduR2Dcm
            Src_CanTp2Dcm_Func_CAN01 (PduRSrcPdu): PduRSrcPduUpTxConf=1, PduRSrcPduRef=UDS_Rx_Func_CANNODE_01_CanTp2PduR
          CanTp2Dcm_Phys_CAN01
            Dest_CanTp2Dcm_Phys_CAN01 (PduRDestPdu): PduRDestPduRef=UDS_Rx_Phys_CANNODE_01_PduR2Dcm
            Src_CanTp2Dcm_Phys_CAN01 (PduRSrcPdu): PduRSrcPduUpTxConf=1, PduRSrcPduRef=UDS_Rx_Phys_CANNODE_01_CanTp2PduR
          Dcm2CanTp_Phys_CAN01
            Dst_Dcm2CanTp_Phys_CAN01 (PduRDestPdu): PduRDestPduRef=UDS_Tx_Phys_CANNODE_01_PduR2CanTp
            Src_Dcm2CanTp_Phys_CAN01 (PduRSrcPdu): PduRSrcPduUpTxConf=1, PduRSrcPduRef=UDS_Tx_Phys_CANNODE_01_Dcm2PduR
    PduRGeneral:
      PduRDevErrorDetect = 0
      PduRVersionInfoApi = 0
      PduRZeroCostOperation = 0
      PduRFifoTxBufferSupport = 0
      PduRCanTpChangeParameterRequestApi = 0
      PduRIFGatewayOperation = 0
      PduRFrTpChangeParameterRequestApi = 0
      PduRTPGatewayOperation = 0
      PduRMemorySize = 0
      PduRMinimumRoutingLoRxPduId = 0
      PduRQueueingSupport = 0
      PduRSbTxBufferSupport = 0
      PduRMulticastToTpSupport = 0
      PduRMulticastToIfSupport = 0
      PduRMulticastFromTpSupport = 0
      PduRMulticastFromIfSupport = 0
      PduRMinimumRoutingLoTxPduId = 0
      PduRMinimumRoutingUpRxPduId = 0
      PduRMinimumRoutingUpTxPduId = 0
      PduRGwTpWithLimitedBuffer = false
