AUTOSAR XML (schema 00047)
package /INVT_Project/EcucModuleConfigurationValuess
  module config NvM
    9 x NvMBlockDescriptor, all with NvMBlockWriteProt=false, NvMBlockJobPriority=1, NvMMaxNumOfWriteRetries=0, NvMNvramDeviceId=0, NvMStaticBlockIDCheck=false, NvMWriteVerification=false, NvMMaxNumOfReadRetries=0, NvMSelectBlockForReadAll=true, NvMRomBlockNum=1, NvMWriteBlockOnce=false, NvMInitBlockCallback=NULL_PTR, NvMBlockCrcType=NVM_CRC16, NvMBlockUseCrc=true, NvMWriteVerificationDataSize=0:
      NvM_NativeBlock_2: NvMRbSelectBlockForFirstInitAll=false, NvMNvBlockNum=2, NvMBlockManagementType=NVM_BLOCK_REDUNDANT, NvMResistantToChangedSw=false, NvMRbGenRteServicePort=true, NvMNvBlockLength=100, NvMRamBlockDataAddress=Rte_CPim_ASW_NVM_ASW_NVM_BlockNative_1024_1, NvMSelectBlockForWriteAll=true, NvMBlockUseSyncMechanism=false, NvMBlockUseAutoValidation=false, NvMCalcRamBlockCrc=false, NvMRbGenRteAdminPort=false, NvMNvramBlockIdentifier=23, NvMRomBlockDataAddress=Rte_CPim_ASW_NVM_ASW_NVM_BlockNative_1024_1_Rom_NVM
      NVM_BlockRunTime: NvMBlockUseSyncMechanism=false, NvMNvBlockNum=1, NvMCalcRamBlockCrc=false, NvMBlockManagementType=NVM_BLOCK_NATIVE, NvMResistantToChangedSw=false, NvMNvBlockLength=8, NvMRamBlockDataAddress=MAIN_u64RunTime_NVM, NvMSelectBlockForWriteAll=true, NvMNvramBlockIdentifier=24, NvMBlockHeaderInclude=MAIN_RunTime, NvMRomBlockDataAddress=MAIN_u64RunTimeRom_NVM
      NvM_UDS_au8WrDidTable: NvMBlockUseSyncMechanism=false, NvMNvBlockNum=1, NvMCalcRamBlockCrc=false, NvMBlockManagementType=NVM_BLOCK_NATIVE, NvMResistantToChangedSw=false, NvMNvBlockLength=128, NvMRamBlockDataAddress=UDS_au8WrDidTableNvM_Ram, NvMSelectBlockForWriteAll=true, NvMRomBlockDataAddress=UDS_au8WrDidTableNvM_Rom, NvMNvramBlockIdentifier=21, NvMBlockHeaderInclude=UDS_Nvm, NvMRbGenRteServicePort=true
      NvM_UDS_au8ESKData: NvMBlockUseSyncMechanism=0, NvMCalcRamBlockCrc=0, NvMRamBlockDataAddress=UDS_au8ESKDataNvM_Ram, NvMRomBlockDataAddress=UDS_au8ESKDataNvM_Rom, NvMSelectBlockForWriteAll=true, NvMBlockManagementType=NVM_BLOCK_NATIVE, NvMNvBlockLength=16, NvMNvramBlockIdentifier=22, NvMNvBlockNum=1, NvMResistantToChangedSw=false, NvMBlockHeaderInclude=UDS_Nvm
      NvMBlock_LogisticData: NvMBlockManagementType=NVM_BLOCK_NATIVE, NvMBlockUseSyncMechanism=false, NvMCalcRamBlockCrc=false, NvMNvBlockLength=128, NvMNvBlockNum=1, NvMNvramBlockIdentifier=19, NvMRbGenRteServicePort=false, NvMReadRamBlockFromNvCallback=NULL_PTR, NvMResistantToChangedSw=true, NvMSelectBlockForWriteAll=false, NvMSingleBlockCallback=NULL_PTR, NvMWriteRamBlockToNvCallback=NULL_PTR, NvMRamBlockDataAddress=NvBlock_ECU_LogisticData, NvMRomBlockDataAddress=NvBlock_ECU_LogisticDataRom_NVM
      NvMBlockDescriptor_ECUConfiguration: NvMBlockUseSyncMechanism=0, NvMCalcRamBlockCrc=0, NvMRbSelectBlockForFirstInitAll=true, NvMSelectBlockForWriteAll=true, NvMBlockManagementType=NVM_BLOCK_REDUNDANT, NvMNvBlockNum=2, NvMNvramBlockIdentifier=20, NvMRamBlockDataAddress=NvBlock_ECU_Configuration, NvMNvBlockLength=4, NvMReadRamBlockFromNvCallback=NULL_PTR, NvMResistantToChangedSw=false, NvMRomBlockDataAddress=NvBlock_ECU_ConfigurationRom_NVM, NvMSingleBlockCallback=NULL_PTR, NvMWriteRamBlockToNvCallback=NULL_PTR
      NvM_UDS_au8FailureAttemptCnt_L1: NvMBlockUseSyncMechanism=false, NvMNvBlockNum=1, NvMCalcRamBlockCrc=false, NvMBlockManagementType=NVM_BLOCK_NATIVE, NvMResistantToChangedSw=false, NvMNvBlockLength=1, NvMRamBlockDataAddress=UDS_au8FAC_L1_Ram, NvMSelectBlockForWriteAll=true, NvMNvramBlockIdentifier=25, NvMRomBlockDataAddress=UDS_au8FAC_L1_Rom
      NvM_RCVoltageGain: NvMBlockUseSyncMechanism=0, NvMCalcRamBlockCrc=0, NvMRamBlockDataAddress=RC_au16VoltageGain, NvMRomBlockDataAddress=RC_kau16VoltageGain, NvMSelectBlockForWriteAll=true, NvMBlockManagementType=NVM_BLOCK_NATIVE, NvMNvBlockLength=50, NvMNvBlockNum=1, NvMNvramBlockIdentifier=27, NvMResistantToChangedSw=false
      NvM_NTC_Voltage_Calibration: NvMBlockUseSyncMechanism=0, NvMCalcRamBlockCrc=0, NvMRamBlockDataAddress=NvM_u16NTC_Voltage_Calibration, NvMRomBlockDataAddress=NvM_u16NTC_Voltage_CalibrationDef, NvMSelectBlockForWriteAll=true, NvMBlockManagementType=NVM_BLOCK_NATIVE, NvMNvBlockLength=2, NvMNvBlockNum=1, NvMNvramBlockIdentifier=26, NvMResistantToChangedSw=false
