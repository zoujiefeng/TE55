AUTOSAR XML (schema 00047)
package /INVT_Project/EcucModuleConfigurationValuess
  module config NvM
    NvM_MultiBlock (NvMBlockDescriptor):
      NvMStaticBlockIDCheck = false
      NvMWriteVerification = false
      NvMMaxNumOfReadRetries = 0
      NvMBlockUseSyncMechanism = false
      NvMBlockWriteProt = false
      NvMNvBlockNum = 1
      NvMCalcRamBlockCrc = false
      NvMBlockManagementType = NVM_BLOCK_NATIVE
      NvMWriteBlockOnce = false
      NvMRomBlockNum = 0
      NvMBlockJobPriority = 1
      NvMResistantToChangedSw = false
      NvMInitBlockCallback = NULL_PTR
      NvMBlockUseCrc = true
      NvMBlockCrcType = NVM_CRC16
      NvMNvBlockLength = 1
      NvMMaxNumOfWriteRetries = 0
      NvMNvramDeviceId = 0
      NvMWriteVerificationDataSize = 0
    NvM_ConfigId (NvMBlockDescriptor):
      NvMStaticBlockIDCheck = false
      NvMWriteVerification = false
      NvMMaxNumOfReadRetries = 0
      NvMBlockUseSyncMechanism = false
      NvMBlockWriteProt = false
      NvMNvBlockNum = 1
      NvMSelectBlockForReadAll = true
      NvMCalcRamBlockCrc = false
      NvMBlockManagementType = NVM_BLOCK_NATIVE
      NvMWriteBlockOnce = false
      NvMRomBlockNum = 0
      NvMBlockJobPriority = 1
      NvMResistantToChangedSw = false
      NvMInitBlockCallback = NULL_PTR
      NvMBlockUseCrc = true
      NvMBlockCrcType = NVM_CRC16
      NvMNvBlockLength = 2
      NvMMaxNumOfWriteRetries = 0
      NvMRamBlockDataAddress = NvM_Prv_idConfigStored_u16
      NvMSelectBlockForWriteAll = true
      NvMNvramDeviceId = 0
      NvMWriteVerificationDataSize = 0
