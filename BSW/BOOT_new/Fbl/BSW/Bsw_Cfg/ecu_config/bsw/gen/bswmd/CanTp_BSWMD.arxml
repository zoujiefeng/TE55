AUTOSAR XML (schema 4-2-2)
package /AUTOSAR_CanTp/CompuMethods
  compu method CanTp_Switch: 0=CANTP_OFF, 1=CANTP_ON
package /AUTOSAR_CanTp/DataConstraints
  range CanTp_MainState: phys 0..1
package /AUTOSAR_CanTp/ImplementationDataTypes
  impl type CanTp_ConfigStructType: category=STRUCTURE, type-emitter=HEADER_FILE  # This is CanTp implementation specific internal type, i.e. it is declared in the CanTp Library and not in the XML. CanTpGen Action does not have any information about this type apart from its name.
    element CanTp_Dummy: implementation-data-type=uint8
  impl type CanTp_ConfigType: implementation-data-type=CanTp_ConfigStructType, type-emitter=HEADER_FILE  # This is CanTp implementation specific internal type, EcuM to pass pointer argument of this type for CanTp_Init Api call.
  impl type CanTp_TickType: implementation-data-type=uint32, type-emitter=HEADER_FILE  # This is CanTp implementation specific internal(uint16 or uint32) tick type.
package /AUTOSAR_CanTp/BswModuleEntrys
  14 x bsw module entry:
    CanTp_GetVersionInfo: service-id=0x07, is-reentrant=true, is-synchronous=true, call-type=REGULAR, execution-context=TASK, sw-service-impl-policy=STANDARD  # This function returns the version information of the CanTp module.
      sw service arg versioninfo: category=DATA_REFERENCE, direction=OUT, sw-pointer-target-props={target-category=STRUCTURE, implementation-data-type=Std_VersionInfoType}  # Indicator as to where to store the version information of this module.
    CanTp_Init: service-id=0x01, is-reentrant=false, is-synchronous=true, call-type=REGULAR, execution-context=TASK, sw-service-impl-policy=STANDARD  # This function initializes the CanTp module.
      sw service arg CfgPtr: category=DATA_REFERENCE, direction=IN, sw-pointer-target-props={target-category=STRUCTURE, implementation-data-type=CanTp_ConfigType, sw-impl-policy=CONST}  # (In)Pointer to post-build configuration data. This parameter is not relevant for Pre-compile configuration. "NULL_PTR" can be passed in case of Pre-compile configuration.
    CanTp_Shutdown: service-id=0x02, is-reentrant=false, is-synchronous=true, call-type=REGULAR, execution-context=TASK, sw-service-impl-policy=STANDARD  # This function is called to shutdown the CanTp module.
    CanTp_Transmit: service-id=0x03, is-reentrant=true, is-synchronous=false, call-type=REGULAR, execution-context=TASK, sw-service-impl-policy=STANDARD  # This service is used to request the transfer of segmented/unsegmented data via CAN Transport Protocol Layer.
      return type ReturnValue: implementation-data-type=Std_ReturnType  # E_OK: The request can be started successfully E_NOT_OK: The request cannot be started (e.g. a transmit request is in progress with the same N-SDU identifier)
      sw service arg CanTpTxSduId: direction=IN, implementation-data-type=PduIdType  # This parameter contains the unique CanTp module identifier of the CAN N-SDU to be transmitted. Range: 0..(maximum number of L-PDU IDs received ) - 1
      sw service arg CanTpTxInfoPtr: category=DATA_REFERENCE, direction=IN, sw-pointer-target-props={target-category=STRUCTURE, implementation-data-type=PduInfoType, sw-impl-policy=CONST}  # A pointer to a structure with CAN N-SDU related data: the length of the N-SDU that shall be transmitted, and a pointer to SDU data, which contains the addressing information for N-SDUs with MetaData (generic connections), and NULL otherwise.
    CanTp_CancelTransmit: service-id=0x08, is-reentrant=false, is-synchronous=true, call-type=REGULAR, execution-context=TASK, sw-service-impl-policy=STANDARD  # This service cancels the transmission of an N-SDU that has already requested for transmission by calling CanTp_Transmit service.
      return type ReturnValue: implementation-data-type=Std_ReturnType  # E_OK: Cancellation request of the specified N-SDU is accepted. E_NOT_OK: Cancellation request is rejected; the reason can be that request is issued for an N-SDU that is not segmented, request is issued after the last CF has been requested for transmission or cancellation is not possible for the related N-SDU due to configuration.
      sw service arg CanTpTxSduId: implementation-data-type=PduIdType  # This parameter contains the unique CanTp module identifier of the N-SDU to be cancelled for transmission. Range: 0..(maximum number of L-PDU IDs received ) - 1
    CanTp_CancelReceive: service-id=0x09, is-reentrant=false, is-synchronous=true, call-type=REGULAR, execution-context=TASK, sw-service-impl-policy=STANDARD  # This service is used to cancel the reception of an ongoing N-SDU.
      return type ReturnValue: implementation-data-type=Std_ReturnType  # E_OK: Cancellation request of the specified N-SDU is accepted. E_NOT_OK: Cancellation request is rejected; the reason can be that request is issued for an N-SDU that is not segmented or request is issued for an N-SDU that is not in the reception process.
      sw service arg CanTpRxSduId: implementation-data-type=PduIdType  # Identifier of the received N-SDU.
    CanTp_ChangeParameter: service-id=0x0a, is-reentrant=false, is-synchronous=true, call-type=REGULAR, execution-context=TASK, sw-service-impl-policy=STANDARD  # This service is used to request the change of reception parameters BS and STmin for a specified N-SDU.
      return type ReturnValue: implementation-data-type=Std_ReturnType  # E_OK: request is accepted. E_NOT_OK: request is not accepted.
      sw service arg id: implementation-data-type=PduIdType  # Identifier of the received N-SDU on which the reception parameter has to be changed.
      sw service arg parameter: implementation-data-type=TPParameterType  # Specify the parameter to which the value has to be changed (BS or STmin).
      sw service arg value: implementation-data-type=uint16  # The new value of the parameter.
    CanTp_ReadParameter: service-id=0x0b, is-reentrant=false, is-synchronous=true, call-type=REGULAR, execution-context=TASK, sw-service-impl-policy=STANDARD  # This service is used to read the current value of reception parameters BS and STmin for a specified N-SDU.
      return type ReturnValue: implementation-data-type=Std_ReturnType  # E_OK: request is accepted. E_NOT_OK: request is not accepted.
      sw service arg id: implementation-data-type=PduIdType  # Identifier of the received N-SDU on which the reception parameter are read.
      sw service arg parameter: implementation-data-type=TPParameterType  # Specify the parameter to which the value has to be read (BS or STmin).
      sw service arg value: category=DATA_REFERENCE, direction=OUT, sw-pointer-target-props={target-category=STRUCTURE, implementation-data-type=uint16}  # Pointer where the parameter value will be provided.
    CanTp_RxIndication: service-id=0x42, is-reentrant=true, is-synchronous=true, call-type=CALLBACK, execution-context=INTERRUPT-CAT-2, sw-service-impl-policy=STANDARD  # Indication of a received I-PDU from a lower layer communication interface module.
      sw service arg RxPduId: implementation-data-type=PduIdType  # ID of the received I-PDU.
      sw service arg PduInfoPtr: category=DATA_REFERENCE, direction=IN, sw-pointer-target-props={target-category=STRUCTURE, implementation-data-type=PduInfoType, sw-impl-policy=CONST}  # Contains the length (SduLength) of the received I-PDU and a pointer to a buffer (SduDataPtr) containing the I-PDU.
    CanTp_TxConfirmation: service-id=0x40, is-reentrant=true, is-synchronous=true, call-type=CALLBACK, execution-context=INTERRUPT-CAT-2, sw-service-impl-policy=STANDARD  # The lower layer communication interface module confirms the transmission of an I-PDU.
      sw service arg TxPduId: implementation-data-type=PduIdType  # ID of the I-PDU that has been transmitted.
    CanTp_TriggerTransmit: service-id=0x0c, is-reentrant=true, is-synchronous=true, call-type=CALLBACK, execution-context=INTERRUPT-CAT-2, sw-service-impl-policy=STANDARD  # Within this API, the upper layer module (called module) shall check whether the available data fits into the buffer size reported by PduInfoPtr->SduLength. If it fits, it shall copy its data into the buffer provided by PduInfoPtr->SduDataPtr and update the length of the actual copied data in PduInfoPtr->SduLength. If not, it returns E_NOT_OK without changing PduInfoPtr.
      return type ReturnValue: implementation-data-type=Std_ReturnType  # E_OK: SDU has been copied and SduLength indicates the number of copied bytes. E_NOT_OK: No SDU data has been copied. PduInfoPtr must not be used since it may contain a NULL pointer or point to invalid data.
      sw service arg TxPduId: implementation-data-type=PduIdType  # ID of the SDU that is requested to be transmitted.
      sw service arg PduInfoPtr: category=DATA_REFERENCE, direction=INOUT, sw-pointer-target-props={target-category=STRUCTURE, implementation-data-type=PduInfoType}  # Contains a pointer to a buffer (SduDataPtr) to where the SDU data shall be copied, and the available buffer size in SduLengh. On return, the service will indicate the length of the copied SDU data in SduLength.
    CanTp_MainFunction: service-id=0x06, is-reentrant=false, is-synchronous=true, call-type=SCHEDULED, execution-context=TASK, sw-service-impl-policy=STANDARD  # The main function for scheduling the CAN TP. CanTp_MainFunction is involved in handling of CAN TP timeouts N_As, N_Bs, N_Cs, N_Ar, N_Br, N_Cr and STMmin.
    CanTp_Cfg_DlcCheck: sw-service-impl-policy=MACRO  # Dlc check rule with condition ">=" or "==" depending on the configuration parameter CanTpRbStrictDlcCheck. It is for internal CanTp purpose only but can be used outside if dependent on CanTpRbStrictDlcCheck.
      return type ReturnValue: category=MACRO, direction=OUT, implementation-data-type=Std_ReturnType  # E_OK: SduLength is valid. E_NOT_OK: SduLength is invalid.
      sw service arg SduLength: category=MACRO, direction=IN, implementation-data-type=PduLengthType  # Recieved Length from CanIf in the callback
      sw service arg ExpectedLength: category=MACRO, direction=IN, implementation-data-type=PduLengthType  # Length required to continue with the data transfer.
    CanTp_Cfg_GetUsToTicks: sw-service-impl-policy=MACRO  # Micro Seconds to Tick converter w.r.t. External/Internal Timer selection. It is for CanTp internal use only but can be used if user wants to know the resolution of Ticks used internally.
      return type ReturnValue: category=MACRO, direction=OUT, implementation-data-type=CanTp_TickType  # Time in terms of ExternalTimer/CanTp_MainFunction Ticks.
      sw service arg Us: category=MACRO, direction=IN, implementation-data-type=uint32  # Time in terms of Micro Seconds.
package /AUTOSAR_CanTp/BswModuleDescriptions
  bsw module description CanTp: category=BSW_MODULE, module-id=35, outgoing-callbacks=[CanTp_RxIndication, CanTp_TxConfirmation, CanTp_TriggerTransmit]
    provided-entrys:
      CanTp_GetVersionInfo
      CanTp_Init
      CanTp_Shutdown
      CanTp_MainFunction
      CanTp_Transmit
      CanTp_CancelTransmit
      CanTp_CancelReceive
      CanTp_ChangeParameter
      CanTp_ReadParameter
      CanTp_Cfg_DlcCheck
      CanTp_Cfg_GetUsToTicks
    bsw module dependency CanIf: target-module-id=60, required-entrys=CanIf_Transmit
    bsw internal behavior BswInternalBehavior
      static-memorys:
        data CanTp_MainState: category=VALUE, sw-addr-method=VAR_CLEARED, sw-calibration-access=READ-ONLY, display-format=%5.1f, type=uint8  # MainState of CanTp indicating whether Tp Communication on CanStack is possible.
      bsw internal triggering point RxIndication: sw-impl-policy=QUEUED
      bsw internal triggering point TxConfirmation: sw-impl-policy=QUEUED
      11 x bsw called entity, all with sw-addr-method=CODE:
        CE_CanTp_GetVersionInfo: implemented-entry=CanTp_GetVersionInfo
        CE_CanTp_Init: implemented-entry=CanTp_Init
        CE_CanTp_Shutdown: implemented-entry=CanTp_Shutdown
        CE_CanTp_Transmit: implemented-entry=CanTp_Transmit
        CE_CanTp_CancelTransmit: implemented-entry=CanTp_CancelTransmit
        CE_CanTp_CancelReceive: implemented-entry=CanTp_CancelReceive
        CE_CanTp_ChangeParameter: implemented-entry=CanTp_ChangeParameter
        CE_CanTp_ReadParameter: implemented-entry=CanTp_ReadParameter
        CE_CanTp_RxIndication: activation-points=RxIndication, implemented-entry=CanTp_RxIndication
        CE_CanTp_TxConfirmation: activation-points=TxConfirmation, implemented-entry=CanTp_TxConfirmation
        CE_CanTp_TriggerTransmit: implemented-entry=CanTp_TriggerTransmit
      bsw schedulable entity CanTp_MainFunction: sw-addr-method=CODE, implemented-entry=CanTp_MainFunction
      bsw internal trigger occurred event ITOE_RxIndication: starts-on-event=CanTp_MainFunction, event-source=RxIndication
      bsw internal trigger occurred event ITOE_TxConfirmation: starts-on-event=CanTp_MainFunction, event-source=TxConfirmation
package /AUTOSAR_CanTp/BswImplementations
  bsw implementation CanTp: programming-language=C, sw-version=9.0.0, ar-release-version=4.2.2, behavior=BswInternalBehavior
    code-descriptors:
      code CodeDescriptor: artifact-descriptors=autosar-engineering-object={short-label=ArEngObj, category=SWSRC}
    resource consumption CanTp_ResourceConsumption
      10 x memory section, all with prefix=CANTP:
        CANTP_VAR_CLEARED_8: sw-addrmethod=VAR_CLEARED, symbol=VAR_CLEARED_8
        CANTP_VAR_CLEARED_UNSPECIFIED: sw-addrmethod=VAR_CLEARED, symbol=VAR_CLEARED_UNSPECIFIED
        CANTP_CONST_UNSPECIFIED: sw-addrmethod=CONST, symbol=CONST_UNSPECIFIED
        CANTP_CONST_8: sw-addrmethod=CONST, symbol=CONST_8
        CANTP_CODE: sw-addrmethod=CODE, symbol=CODE
        CANTP_FDCALLOUT_CODE: sw-addrmethod=CALLOUT_CODE, symbol=FDCALLOUT_CODE
        CANTP_CONFIG_DATA_UNSPECIFIED: sw-addrmethod=CONFIG_DATA, symbol=CONFIG_DATA_UNSPECIFIED
        CANTP_CONFIG_CODE: sw-addrmethod=CODE, symbol=CONFIG_CODE
        CANTP_CONFIG_CODE_POSTBUILD: sw-addrmethod=CODE, symbol=CONFIG_CODE_POSTBUILD
        CANTP_CONFIG_DATA_POSTBUILD_UNSPECIFIED: sw-addrmethod=CONFIG_DATA_POSTBUILD, symbol=CONFIG_DATA_POSTBUILD_UNSPECIFIED
      section name prefix CANTP
    bsw debug info BswDebugInfo_0: category=VALUE, variable-accessed-for-debug=CanTp_MainState
