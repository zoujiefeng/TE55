AUTOSAR XML (schema 4-0-3)
package /AUTOSAR_ComM/BswModuleEntrys
  bsw module entry ComM_Init: is-reentrant=false, is-synchronous=true, call-type=REGULAR, execution-context=UNSPECIFIED, sw-service-impl-policy=STANDARD
  bsw module entry ComM_MainFunction_ComMChannel_Can_Network_Channel_01: is-reentrant=false, is-synchronous=true, call-type=SCHEDULED, execution-context=TASK, sw-service-impl-policy=STANDARD
  bsw module entry ComM_MainFunction_ComMChannel_Can_Network_Channel_03: is-reentrant=false, is-synchronous=true, call-type=SCHEDULED, execution-context=TASK, sw-service-impl-policy=STANDARD
