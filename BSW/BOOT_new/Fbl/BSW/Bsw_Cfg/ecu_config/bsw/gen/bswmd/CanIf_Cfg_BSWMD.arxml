AUTOSAR XML (schema 4-2-2)
package /AUTOSAR_CanIf/ApplicationDataTypes
  application array data type CanIf_ControllerState_Astruct_app: category=ARRAY, sw-calibration-access=READ-WRITE  # Structure datatype in CanIf
    element CanIf_ControllerStateType: category=STRUCTURE, type=CanIf_ControllerStateType_struct_app, max-number-of-elements=2
  application array data type CanIf_NotifStatusType_Aenum_app: category=ARRAY, sw-calibration-access=READ-WRITE  # application data type for array of enum
    element CanIf_NotifStatusType: category=VALUE, type=CanIf_NotifStatusType_Enum_app, max-number-of-elements=2
  app type CanIf_boolean_app: category=VALUE, sw-calibration-access=READ-WRITE, compu-method=Identical, range phys 0..1, display-format=%5.0f  # boolean application datatype in CanIf
  application record data type CanIf_ControllerStateType_struct_app: category=STRUCTURE, sw-calibration-access=READ-WRITE  # structure in CanIf
    application record element Ctrl_Pdu_mode: category=VALUE, type=CanIf_u8_app
  application record data type CanIf_CanIdBuffer_struct_app: category=STRUCTURE, sw-calibration-access=READ-WRITE  # structure in CanIf
    4 x application record element, all with category=VALUE:
      CanId: type=CanIf_u32_app
      swPduHandle: type=CanIf_u16_app
      SduLength: type=CanIf_u8_app
      BufferIndex: type=CanIf_u8_app
  application record data type CanIf_Prv_TxBufferStatus_tst_struct_app: category=STRUCTURE, sw-calibration-access=READ-WRITE  # structure in CanIf
    application record element last_index: category=VALUE, type=CanIf_u8_app
    application record element bufferstatus: category=VALUE, type=CanIf_u8_app
  6 x app type, all with category=VALUE, sw-calibration-access=READ-WRITE, display-format=%5.0f:
    CanIf_NotifStatusType_Enum_app: compu {0=CANIF_NO_NOTIFICATION, 1=CANIF_TX_RX_NOTIFICATION} "Computation method for enum type CanIf_NotifStatusType", range phys 0..255  # enumeration data type
    CanIf_ControllerModeType_Enum_app: compu {0=CANIF_CS_UNINIT, 1=CANIF_CS_SLEEP, 2=CANIF_CS_STARTED, 3=CANIF_CS_STOPPED} "Computation method for enum type CanIf_ControllerModeType", range phys 0..255  # enumeration data type
    CanIf_PduModeType_Enum_app: compu {0=CANIF_OFFLINE, 1=CANIF_TX_OFFLINE, 2=CANIF_TX_OFFLINE_ACTIVE, 3=CANIF_ONLINE} "Computation method for enum type CanIf_PduModeType", range phys 0..255  # enumeration data type
    CanIf_u8_app: compu-method=Identical, range phys 0..255  # unsigned char application datatype in CanIf
    CanIf_u16_app: compu-method=Identical, range phys 0..65535  # unsigned short application datatype in CanIf
    CanIf_u32_app: compu-method=Identical, range phys 0..4294967295  # unsigned long application datatype in CanIf
package /AUTOSAR_CanIf/BswImplementations
  bsw implementation CanIf: programming-language=C, sw-version=8.0.0, ar-release-version=4.2.2, behavior=BswInternalBehavior
    code-descriptors:
      code CodeDescriptor: artifact-descriptors=autosar-engineering-object={short-label=ArEngObj, category=SWSRC}
    resource consumption CanIf_ResourceConsumption
      16 x memory section:
        CANIF_VAR_CLEARED_8: alignment=8, prefix=CANIF, sw-addrmethod=VAR_CLEARED, symbol=VAR_CLEARED_8
        CANIF_VAR_CLEARED_16: alignment=16, prefix=CANIF, sw-addrmethod=VAR_CLEARED, symbol=VAR_CLEARED_16
        CANIF_VAR_CLEARED_32: alignment=32, prefix=CANIF, sw-addrmethod=VAR_CLEARED, symbol=VAR_CLEARED_32
        CANIF_VAR_CLEARED_UNSPECIFIED: alignment=UNSPECIFIED, prefix=CANIF, sw-addrmethod=VAR_CLEARED, symbol=VAR_CLEARED_UNSPECIFIED
        CANIF_CONST_8: alignment=8, prefix=CANIF, sw-addrmethod=CONST, symbol=CONST_8
        CANIF_CONST_16: alignment=16, prefix=CANIF, sw-addrmethod=CONST, symbol=CONST_16
        CANIF_CONST_32: alignment=32, prefix=CANIF, sw-addrmethod=CONST, symbol=CONST_32
        CANIF_CONST_UNSPECIFIED: alignment=UNSPECIFIED, prefix=CANIF, sw-addrmethod=CONST, symbol=CONST_UNSPECIFIED
        CANIF_CONFIG_DATA_POSTBUILD_32: alignment=32, prefix=CANIF, sw-addrmethod=CONFIG_DATA_POSTBUILD, symbol=CONFIG_DATA_POSTBUILD_32
        CANIF_CONFIG_DATA_POSTBUILD_UNSPECIFIED: alignment=UNSPECIFIED, prefix=CANIF, sw-addrmethod=CONFIG_DATA_POSTBUILD, symbol=CONFIG_DATA_POSTBUILD_UNSPECIFIED
        CANIF_VAR_FAST_CLEARED_8: alignment=8, prefix=CANIF, sw-addrmethod=VAR_FAST_CLEARED, symbol=VAR_FAST_CLEARED_8
        CANIF_VAR_FAST_CLEARED_32: alignment=32, prefix=CANIF, sw-addrmethod=VAR_FAST_CLEARED, symbol=VAR_FAST_CLEARED_32
        CANIF_VAR_FAST_CLEARED_UNSPECIFIED: alignment=UNSPECIFIED, prefix=CANIF, sw-addrmethod=VAR_FAST_CLEARED, symbol=VAR_FAST_CLEARED_UNSPECIFIED
        CANIF_CODE_FAST: prefix=CANIF, sw-addrmethod=CODE_FAST, symbol=CODE_FAST
        CanIf_CODE: prefix=CanIf, sw-addrmethod=CODE, symbol=CODE
        CANIF_CODE: prefix=CANIF, sw-addrmethod=CODE, symbol=CODE
      section name prefix CanIf
      section name prefix CANIF
package /AUTOSAR_CanIf/BswModuleDescriptions
  bsw module description CanIf: category=BSW_MODULE, module-id=60  # CANInterface
    bsw internal behavior BswInternalBehavior: data-type-mapping=DataTypeMappingSet
      static-memorys:
        data CanIf_Prv_ControllerState_ast: category=ARRAY, sw-addr-method=INTERNAL_VAR_CLEARED, sw-calibration-access=READ-ONLY, display-format=%5.0f, type=CanIf_ControllerState_Astruct_app  # Can Interface controller State
        data CanIf_Prv_TxNotification_aen: category=ARRAY, sw-addr-method=INTERNAL_VAR_CLEARED, sw-calibration-access=READ-ONLY, display-format=%5.0f, type=CanIf_NotifStatusType_Aenum_app  # Can Interface Transmit Notification
        data CanIf_Prv_InitStatus_b: category=VALUE, sw-addr-method=INTERNAL_VAR_CLEARED, sw-calibration-access=READ-ONLY, display-format=%5.0f, type=CanIf_boolean_app  # Flag to check if CANIF is Initialized(TRUE) or Not Initialized (FALSE)
      bsw called entity CE_Init: implemented-entry=CanIf_Init
package /AUTOSAR_CanIf/DataTypeMappingSets
  data type mapping set DataTypeMappingSet
    data-type-maps:
      application-data-type=CanIf_ControllerState_Astruct_app, implementation-data-type=CanIf_ControllerState_Astruct_impl
      application-data-type=CanIf_NotifStatusType_Aenum_app, implementation-data-type=CanIf_NotifStatusType_Aenum_impl
      application-data-type=CanIf_boolean_app, implementation-data-type=CanIf_boolean_impl
      application-data-type=CanIf_ControllerStateType_struct_app, implementation-data-type=CanIf_ControllerStateType_struct_impl
      application-data-type=CanIf_CanIdBuffer_struct_app, implementation-data-type=CanIf_CanIdBuffer_struct_impl
      application-data-type=CanIf_Prv_TxBufferStatus_tst_struct_app, implementation-data-type=CanIf_Prv_TxBufferStatus_tst_struct_impl
      application-data-type=CanIf_NotifStatusType_Enum_app, implementation-data-type=uint8
      application-data-type=CanIf_ControllerModeType_Enum_app, implementation-data-type=uint8
      application-data-type=CanIf_PduModeType_Enum_app, implementation-data-type=uint8
      application-data-type=CanIf_u8_app, implementation-data-type=CanIf_u8_impl
      application-data-type=CanIf_u16_app, implementation-data-type=CanIf_u16_impl
      application-data-type=CanIf_u32_app, implementation-data-type=CanIf_u32_impl
package /AUTOSAR_CanIf/ImplementationDataTypes
  13 x impl type:
    CanIf_ControllerState_Astruct_impl: category=ARRAY  # Implementation datatype for array of struct
      element CanIf_struct_impl: array-size=2, array-size-semantics=FIXED-SIZE, implementation-data-type=CanIf_ControllerStateType_struct_impl
    CanIf_NotifStatusType_Aenum_impl: category=ARRAY  # implementation data type for array of enum
      element CanIf_Enum_impl: array-size=2, array-size-semantics=FIXED-SIZE, implementation-data-type=CanIf_NotifStatusType_Enum_impl
    CanIf_boolean_impl: implementation-data-type=uint8  # implementation data type for application data type boolean
    CanIf_u8_impl: implementation-data-type=uint8  # implementation data type for application data type uint8
    CanIf_u16_impl: implementation-data-type=uint16  # implementation data type for application data type uint16
    CanIf_u32_impl: implementation-data-type=uint32  # implementation data type for application data type uint32
    CanIf_NotifStatusType_Enum_impl: implementation-data-type=uint8  # implementation data type for application data type enum
    CanIf_ControllerModeType_Enum_impl: implementation-data-type=uint8  # implementation data type for application data type enum
    CanIf_PduModeType_Enum_impl: implementation-data-type=uint8  # implementation data type for application data type enum
    CanIf_Prv_BuffStatus_ten_Enum_impl: implementation-data-type=uint8  # implementation data type for application data type enum
    CanIf_ControllerStateType_struct_impl: category=STRUCTURE  # implementation data type for structure
      element Ctrl_Pdu_mode: implementation-data-type=CanIf_u8_impl
    CanIf_CanIdBuffer_struct_impl: category=STRUCTURE  # implementation data type for structure
      4 x element, all with category=TYPE_REFERENCE:
        CanId: implementation-data-type=CanIf_u32_impl
        swPduHandle: implementation-data-type=CanIf_u16_impl
        SduLength: implementation-data-type=CanIf_u8_impl
        BufferIndex: implementation-data-type=CanIf_u8_impl
    CanIf_Prv_TxBufferStatus_tst_struct_impl: category=STRUCTURE  # implementation data type for structure
      element last_index: implementation-data-type=CanIf_u8_impl
      element bufferstatus: implementation-data-type=CanIf_u8_impl
package /AUTOSAR_CanIf/Units
  unit NoUnit: display-name=noUnit, factor-si-to-unit=1.0, offset-si-to-unit=0.0, physical-dimension=NoUnit  # No Unit
package /AUTOSAR_CanIf/PhysicalDimensions
  physical dimension NoUnit: length-exp=0
