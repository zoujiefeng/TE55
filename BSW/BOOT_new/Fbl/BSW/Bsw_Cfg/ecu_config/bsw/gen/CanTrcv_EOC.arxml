AUTOSAR XML (schema 4-3-0)
package /CanTrcv_EOC
  bsw module timing CanTrcv: behavior=BswInternalBehavior
    timing-requirements:
      execution order constraint EOC_EcuM_Init: execution-order-constraint-type=ORDINARY-EOC, is-event=false, permit-multiple-references-to-ee=false
        ordered-elements:
          eoc executable entity ref EOCExecutableEntityRef_CanTrcv_Init: bsw-module-instance=CanTrcv, executable=CE_CanTrcv_Init
      execution order constraint EOC_T_10ms: execution-order-constraint-type=ORDINARY-EOC, is-event=true, permit-multiple-references-to-ee=false
        ordered-elements:
          eoc event ref EventRef_1: bsw-module-instance=CanTrcv, event=EV_SE_MainFunction_CanTrcv
