AUTOSAR XML (schema 4-2-2)
package /AUTOSAR_ComM/SwcImplementations
  swc implementation ComM_Imp: programming-language=C, sw-version=10.0.0, vendor-id=6, behavior=ComM_Int
    code-descriptors:
      code ComM_Imp_Code: artifact-descriptors=autosar-engineering-object={short-label=Code, category=SWSRC}
    resource consumption ResourceConsumption_ResourceConsumption
package /AUTOSAR_ComM/SwComponentTypes
  service sw component type ComM
    behavior ComM_Int
      6 x runnable:
        RequestComMode: arguments=[symbol=User, symbol=ComMode], can-be-invoked-concurrently=true, symbol=ComM_RequestComMode
        MainFunction_ComMChannel_Can_Network_Channel_01: symbol=ComM_MainFunction_ComMChannel_Can_Network_Channel_01
        MainFunction_ComMChannel_Can_Network_Channel_03: symbol=ComM_MainFunction_ComMChannel_Can_Network_Channel_03
        GetMaxComMode: arguments=[symbol=User, symbol=ComMode], can-be-invoked-concurrently=true, symbol=ComM_GetMaxComMode
        GetRequestedComMode: arguments=[symbol=User, symbol=ComMode], can-be-invoked-concurrently=true, symbol=ComM_GetRequestedComMode
        GetCurrentComMode: arguments=[symbol=User, symbol=ComMode], can-be-invoked-concurrently=true, symbol=ComM_GetCurrentComMode
package /AUTOSAR_ComM/SwcBswMappings/SwcBswmapping
  swc bsw mapping SwcBswMapping_ComM: bsw-behavior=BswInternalBehavior, swc-behavior=ComM_Int
    runnable-mappings:
      bsw-entity=SE_MainFunction_ComMChannel_Can_Network_Channel_01, swc-runnable=MainFunction_ComMChannel_Can_Network_Channel_01
      bsw-entity=SE_MainFunction_ComMChannel_Can_Network_Channel_03, swc-runnable=MainFunction_ComMChannel_Can_Network_Channel_03
