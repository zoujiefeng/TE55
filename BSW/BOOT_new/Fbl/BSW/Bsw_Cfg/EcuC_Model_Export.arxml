AUTOSAR XML (schema 00047)
package /INVT_Project/EcucModuleConfigurationValuess
  module config EcuC
    EcucConfigSet
      PduCollection (EcucPduCollection): PduIdTypeEnum=uint16, PduLengthTypeEnum=uint16
        18 x Pdu, all with PduLength=8:
          UDS_Rx_Phys_CANNODE_03_CanIf2CanTp
          UDS_Rx_Phys_CANNODE_03_CanTp2PduR
          UDS_Rx_Phys_CANNODE_03_PduR2Dcm
          UDS_Rx_Func_CANNODE_03_CanIf2CanTp
          UDS_Rx_Func_CANNODE_03_CanTp2PduR
          UDS_Rx_Func_CANNODE_03_PduR2Dcm
          UDS_Tx_Phys_CANNODE_03_Dcm2PduR
          UDS_Tx_Phys_CANNODE_03_PduR2CanTp
          UDS_Tx_Phys_CANNODE_03_CanTp2CanIf
          UDS_Rx_Phys_CANNODE_01_CanIf2CanTp
          UDS_Rx_Phys_CANNODE_01_CanTp2PduR
          UDS_Rx_Phys_CANNODE_01_PduR2Dcm
          UDS_Rx_Func_CANNODE_01_CanIf2CanTp
          UDS_Rx_Func_CANNODE_01_CanTp2PduR
          UDS_Rx_Func_CANNODE_01_PduR2Dcm
          UDS_Tx_Phys_CANNODE_01_Dcm2PduR
          UDS_Tx_Phys_CANNODE_01_PduR2CanTp
          UDS_Tx_Phys_CANNODE_01_CanTp2CanIf
