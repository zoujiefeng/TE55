AUTOSAR XML (schema 00047)
package /Can
  module config Can: implementation-config-variant=VARIANT-PRE-COMPILE
    CanGeneral:
      CanMainFunctionBusoffPeriod = 0.0010
      CanMainFunctionModePeriod = 0.0010
      CanMultiplexedTransmission = false
      CanVersionInfoApi = false
      CanIndex = 0
      CanPublicIcomSupport = false
      CanTimeoutDuration = 1
      CanDevErrorDetection = false
    CanConfigSet
      CANNODE_01 (CanController):
        CanBusoffProcessing = POLLING
        CanControllerActivation = true
        CanControllerBaseAddress = 0
        CanTxProcessing = POLLING
        CanWakeupFunctionalityAPI = false
        CanWakeupProcessing = POLLING
        CanWakeupSupport = false
        CanControllerId = 0
        CanRxProcessing = POLLING
        CanControllerDefaultBaudrate = CANNODE_01/CANNODE_01
        CANNODE_01 (CanControllerBaudrateConfig):
          CanControllerBaudRate = 500
          CanControllerBaudRateConfigID = 1
          CanControllerPropSeg = 0
          CanControllerSeg1 = 10
          CanControllerSeg2 = 0
          CanControllerSyncJumpWidth = 0
      4 x CanHardwareObject, all with CanHwObjectCount=1, CanHandleType=FULL, CanObjectType=RECEIVE, CanIdType=EXTENDED:
        CANNODE_01_Rx_Std_MailBox_1: CanObjectId=0, CanControllerRef=CanConfigSet/CANNODE_01
          CanHwFilter: CanHwFilterCode=417001457, CanHwFilterMask=536870911
        CANNODE_01_Rx_Std_MailBox_2: CanObjectId=1, CanControllerRef=CanConfigSet/CANNODE_01
          CanHwFilter: CanHwFilterCode=417066993, CanHwFilterMask=536870911
        CANNODE_03_Rx_Std_MailBox_1: CanObjectId=2, CanControllerRef=CanConfigSet/CANNODE_03
          CanHwFilter: CanHwFilterCode=417001457, CanHwFilterMask=536870911
        CANNODE_03_Rx_Std_MailBox_2: CanObjectId=3, CanControllerRef=CanConfigSet/CANNODE_03
          CanHwFilter: CanHwFilterCode=417066993, CanHwFilterMask=536870911
      CANNODE_03 (CanController):
        CanBusoffProcessing = POLLING
        CanControllerActivation = true
        CanControllerBaseAddress = 0
        CanTxProcessing = POLLING
        CanWakeupFunctionalityAPI = false
        CanWakeupProcessing = POLLING
        CanWakeupSupport = false
        CanControllerId = 0
        CanRxProcessing = POLLING
        CanControllerDefaultBaudrate = CANNODE_03/CANNODE_03
        CANNODE_03 (CanControllerBaudrateConfig):
          CanControllerBaudRate = 500
          CanControllerBaudRateConfigID = 1
          CanControllerPropSeg = 0
          CanControllerSeg1 = 10
          CanControllerSeg2 = 0
          CanControllerSyncJumpWidth = 0
      CANNODE_01_Tx_Std_MailBox_1 (CanHardwareObject): CanHwObjectCount=1, CanHandleType=FULL, CanObjectType=TRANSMIT, CanObjectId=4, CanIdType=EXTENDED, CanControllerRef=CanConfigSet/CANNODE_01
      CANNODE_03_Tx_Std_MailBox_1 (CanHardwareObject): CanHwObjectCount=1, CanHandleType=FULL, CanObjectType=TRANSMIT, CanObjectId=5, CanIdType=EXTENDED, CanControllerRef=CanConfigSet/CANNODE_03
