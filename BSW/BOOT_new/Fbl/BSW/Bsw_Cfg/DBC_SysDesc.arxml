AUTOSAR XML (schema 4-2-2)
package /DBC_SysDesc_Can_Network/Pkg_Cluster
  can cluster Can_Network: protocol-name=CAN
    can physical channel Can_Network_Channel: comm-connectors=Conn_CANNODE_0_VCU
      frame UDS_Rx_Phys_Id_0x737: id 0x7E3, to VCU, frame-length=8, can-addressing-mode=STANDARD, can-frame-rx-behavior=ANY
        carries pdu UDS_Rx_Phys_Id_0x737: start-position=7, update-indication-bit-position=-1
        dcm i pdu UDS_Rx_Phys_Id_0x737: length=8
      frame UDS_Rx_Func_Id_0x7DF: id 0x7DF, to VCU, frame-length=8, can-addressing-mode=STANDARD, can-frame-rx-behavior=ANY
        carries pdu UDS_Rx_Func_Id_0x7DF: start-position=7, update-indication-bit-position=-1
        dcm i pdu UDS_Rx_Func_Id_0x7DF: length=8
      frame UDS_Tx_Phys_Id_0x7B7: id 0x7EB, from VCU, frame-length=8, can-addressing-mode=STANDARD
        carries pdu UDS_Tx_Phys_Id_0x7B7: start-position=7, update-indication-bit-position=-1
        dcm i pdu UDS_Tx_Phys_Id_0x7B7: length=8
package /DBC_SysDesc_Can_Network/Pkg_Ecu
  ecu instance VCU: com-configuration-gw-time-base=0.005, com-configuration-rx-time-base=0.01, com-configuration-tx-time-base=0.01, sleep-mode-supported=false, wake-up-over-bus-supported=false
    can communication controller CANNODE_0: can-controller-attributes=can-controller-configuration={prop-seg=0, sync-jump-width=0, time-seg-1=10, time-seg-2=0}
    can communication connector Conn_CANNODE_0_VCU: comm-controller=CANNODE_0
