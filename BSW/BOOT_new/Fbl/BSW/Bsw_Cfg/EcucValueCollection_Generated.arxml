AUTOSAR XML (schema 00047)
package /INVT_Project/EcucModuleConfigurationValuess
  ecuc value collection EcucValueCollection_0: ecuc-values=[Rte, Os, ComStack, NvM, Fee, EcuC, ComM, Dcm, CanIf, CanTp, Can, PduR, Crc, EcuM, CanSM, MemIf, CanTrcv, Spi, rba_ArxmlGen]
