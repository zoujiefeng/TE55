AUTOSAR XML (schema 00047)
package /System
  composition sw component type TopLevelComposition
    5 x component:
      CPT_EcuM: type=EcuM
      CPT_Dcm: type=Dcm
      CPT_ComM: type=ComM
      CPT_NvM: type=NvM
      CPT_rba_DiagLib: type=rba_DiagLib
