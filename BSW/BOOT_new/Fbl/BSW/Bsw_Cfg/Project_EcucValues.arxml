AUTOSAR XML (schema 00047)
package /INVT_Project/EcucModuleConfigurationValuess
  module config ComM: implementation-config-variant=VARIANT-PRE-COMPILE
    ComMGeneral:
      ComMEcuGroupClassification = 0
      ComMModeLimitationEnabled = false
      ComMTMinFullComModeDuration = 0.01
      ComMVersionInfoApi = false
      ComMWakeupInhibitionEnabled = false
      ComMPncGatewayEnabled = false
      ComMPncSupport = false
      ComMResetAfterForcingNoComm = false
      ComMSynchronousWakeUp = false
      ComMRteEnabled = false
      ComMDevErrorDetect = false
    ComMConfigSet
      ComMUser_Can_Network_Channel_01 (ComMUser): ComMUserIdentifier=0
      ComMUser_Can_Network_Channel_03 (ComMUser): ComMUserIdentifier=1
      ComMChannel_Can_Network_Channel_01 (ComMChannel):
        ComMMainFunctionPeriod = 0.01
        ComMFullCommRequestNotificationEnabled = false
        ComMNoCom = true
        ComMNoWakeUpInhibitionNvmStorage = false
        ComMNoWakeup = true
        ComMChannelId = 0
        ComMBusType = COMM_BUS_TYPE_CAN
        ComMNetworkManagement: ComMNmLightTimeout=10, ComMNmVariant=NONE, ComMPncNmRequest=false
        ComMUserPerChannel_Can_Network_Channel (ComMUserPerChannel): ComMUserChannel=ComMUser_Can_Network_Channel_01
      ComMChannel_Can_Network_Channel_03 (ComMChannel):
        ComMMainFunctionPeriod = 0.01
        ComMFullCommRequestNotificationEnabled = false
        ComMNoCom = true
        ComMNoWakeUpInhibitionNvmStorage = false
        ComMNoWakeup = true
        ComMChannelId = 1
        ComMBusType = COMM_BUS_TYPE_CAN
        ComMNetworkManagement: ComMNmLightTimeout=10, ComMNmVariant=NONE, ComMPncNmRequest=false
        ComMUserPerChannel_Can_Network_Channel (ComMUserPerChannel): ComMUserChannel=ComMUser_Can_Network_Channel_03
  module config CanIf: implementation-config-variant=VARIANT-PRE-COMPILE
    CanIfInitCfg: CanIfInitCfgSet=0
      CanIfInitHohCfg
        4 x CanIfHrhCfg:
          CANNODE_01_Rx_Std_MailBox_1: CanIfHrhCanCtrlIdRef=CANNODE_01, CanIfHrhIdSymRef=CANNODE_01_Rx_Std_MailBox_1
          CANNODE_01_Rx_Std_MailBox_2: CanIfHrhCanCtrlIdRef=CANNODE_01, CanIfHrhIdSymRef=CANNODE_01_Rx_Std_MailBox_2
          CANNODE_03_Rx_Std_MailBox_1: CanIfHrhCanCtrlIdRef=CANNODE_03, CanIfHrhIdSymRef=CANNODE_03_Rx_Std_MailBox_1
          CANNODE_03_Rx_Std_MailBox_2: CanIfHrhCanCtrlIdRef=CANNODE_03, CanIfHrhIdSymRef=CANNODE_03_Rx_Std_MailBox_2
        CANNODE_01_Tx_Std_MailBox_1 (CanIfHthCfg): CanIfHthCanCtrlIdRef=CANNODE_01, CanIfHthIdSymRef=CANNODE_01_Tx_Std_MailBox_1
        CANNODE_03_Tx_Std_MailBox_1 (CanIfHthCfg): CanIfHthCanCtrlIdRef=CANNODE_03, CanIfHthIdSymRef=CANNODE_03_Tx_Std_MailBox_1
      4 x CanIfRxPduCfg, all with CanIfRxPduReadData=false, CanIfRxPduReadNotifyStatus=true, CanIfRxPduCanIdType=EXTENDED_CAN, CanIfRxPduDlc=1, CanIfRxPduUserRxIndicationUL=CAN_TP, CanIfRxPduControllerRef=CANNODE_01:
        UDS_Rx_Phys_CANNODE_01: CanIfRxPduCanId=417001457, CanIfRxPduId=0, CanIfRxPduHrhIdRef=CANNODE_01_Rx_Std_MailBox_1, CanIfRxPduRef=UDS_Rx_Phys_CANNODE_01_CanIf2CanTp
        UDS_Rx_Func_CANNODE_01: CanIfRxPduCanId=417066993, CanIfRxPduId=1, CanIfRxPduHrhIdRef=CANNODE_01_Rx_Std_MailBox_2, CanIfRxPduRef=UDS_Rx_Func_CANNODE_01_CanIf2CanTp
        UDS_Rx_Phys_CANNODE_03: CanIfRxPduCanId=417001457, CanIfRxPduId=2, CanIfRxPduHrhIdRef=CANNODE_03_Rx_Std_MailBox_1, CanIfRxPduRef=UDS_Rx_Phys_CANNODE_03_CanIf2CanTp
        UDS_Rx_Func_CANNODE_03: CanIfRxPduCanId=417066993, CanIfRxPduId=3, CanIfRxPduHrhIdRef=CANNODE_03_Rx_Std_MailBox_2, CanIfRxPduRef=UDS_Rx_Func_CANNODE_03_CanIf2CanTp
      Buffer_CANNODE_01_Tx_Std_MailBox_1 (CanIfBufferCfg): CanIfBufferSize=0, CanIfBufferHthRef=CANNODE_01_Tx_Std_MailBox_1
      Buffer_CANNODE_03_Tx_Std_MailBox_1 (CanIfBufferCfg): CanIfBufferSize=0, CanIfBufferHthRef=CANNODE_03_Tx_Std_MailBox_1
      UDS_Tx_Phys_CANNODE_01 (CanIfTxPduCfg):
        CanIfTxPduReadNotifyStatus = false
        CanIfTxPduType = STATIC
        CanIfTxPduCanIdType = EXTENDED_CAN
        CanIfTxPduCanId = 417001967
        CanIfTxPduDlc = 8
        CanIfTxPduUserTxConfirmationUL = CAN_TP
        CanIfTxPduTruncation = true
        CanIfTxPduControllerRef = CANNODE_01
        CanIfTxPduBufferRef = Buffer_CANNODE_01_Tx_Std_MailBox_1
        CanIfTxPduRef = UDS_Tx_Phys_CANNODE_01_CanTp2CanIf
      UDS_Tx_Phys_CANNODE_03 (CanIfTxPduCfg):
        CanIfTxPduReadNotifyStatus = false
        CanIfTxPduType = STATIC
        CanIfTxPduCanIdType = EXTENDED_CAN
        CanIfTxPduCanId = 417001967
        CanIfTxPduDlc = 8
        CanIfTxPduUserTxConfirmationUL = CAN_TP
        CanIfTxPduTruncation = true
        CanIfTxPduBufferRef = Buffer_CANNODE_03_Tx_Std_MailBox_1
        CanIfTxPduRef = UDS_Tx_Phys_CANNODE_03_CanTp2CanIf
    CanIfCtrlDrvCfg:
      CanIfCtrlDrvBusOffNotification = true
      CanIfCtrlDrvWakeUpNotification = false
      CanIfRbCtrlDrvPrefix = CanConf_CanHardwareObject
      CanIfCtrlDrvNameRef = CanGeneral
      CanIfCtrlDrvInitHohConfigRef = CanIfInitHohCfg
      CANNODE_01 (CanIfCtrlCfg): CanIfCtrlId=0, CanIfCtrlWakeupSupport=false, CanIfCtrlCanCtrlRef=CANNODE_01
      CANNODE_03 (CanIfCtrlCfg): CanIfCtrlId=1, CanIfCtrlWakeupSupport=false, CanIfCtrlCanCtrlRef=CANNODE_03
    CanIfDispatchCfg:
      CanIfDispatchUserCtrlBusOffUL = CAN_SM
      CanIfDispatchUserCtrlModeIndicationUL = CAN_SM
      CanIfDispatchUserTrcvModeIndicationName = CAN_SM
      CanIfDispatchUserTrcvModeIndicationUL = CAN_SM
    CanIfPrivateCfg: CanIfPrivateDlcCheck=false
    CanIfPublicCfg:
      CanIfHwObjectPrefix = Can_17_MCanPConf_CanHardwareObject
      CanIfPublicReadRxPduDataApi = false
      CanIfPublicReadRxPduNotifyStatusApi = true
      CanIfPublicReadTxPduNotifyStatusApi = true
      CanIfPublicSetDynamicTxIdApi = false
      CanIfPublicTxBuffering = false
      CanIfPublicTxConfirmPollingSupport = false
      CanIfPublicVersionInfoApi = false
      CanIfPublicChangeBaudrateSupport = false
      CanIfPublicCancelTransmitSupport = false
      CanIfPublicRxBuffering = false
      CanIfPublicErrorPassiveSupport = false
      CanIfPublicDynamicTxIdSupport = false
      CanIfPublicCanIfLiteConfiguration = false
      CanIfPublicUserTpTxInOfflineMode = false
      CanIfPublicWakeupCheckValidSupport = false
      CanIfPublicPnSupport = false
      CanIfPublicHandleTypeEnum = UINT16
      CanIfPublicBusoffRecoveryfromRxIndication = false
      CanIfPublicInstanceId = 1
      CanIfPublicDevErrorDetect = false
      CanIfTriggerTransmitSupport = true
      CanIfTxOfflineActiveSupport = false
      CanIfWakeupSupport = false
      CanIfReadMsgIdApi = true
      CanIfPublicMultipleDrvSupport = false
      CanIfCalibrationSupport: CanIfCalibration=false
  module config CanSM: implementation-config-variant=VARIANT-PRE-COMPILE
    CanSMConfiguration: CanSMModeRequestRepetitionMax=5, CanSMModeRequestRepetitionTime=0.07
      CanSMManagerNetwork_CAN01 (CanSMManagerNetwork):
        CanSMBorTxConfirmationPolling = false
        CanSMBorCounterL1ToL2 = 0
        CanSMBorTimeL1 = 0.04
        CanSMBorTimeL2 = 0.1
        CanSMBorTimeTxEnsured = 0.02
        CanSMNetworkIndex = 0
        CanSMComMNetworkHandleRef = ComMChannel_Can_Network_Channel_01
        CanSMDemEventParameterRefs: CanSMRbDynCreate_CANSM_E_BUS_OFF=Standard
        CanSMController_CANNODE_01 (CanSMController): CanSMControllerId=CANNODE_01
      CanSMManagerNetwork_CAN03 (CanSMManagerNetwork):
        CanSMBorTxConfirmationPolling = false
        CanSMBorCounterL1ToL2 = 0
        CanSMBorTimeL1 = 0.04
        CanSMBorTimeL2 = 0.1
        CanSMBorTimeTxEnsured = 0.02
        CanSMNetworkIndex = 1
        CanSMComMNetworkHandleRef = ComMChannel_Can_Network_Channel_03
        CanSMDemEventParameterRefs: CanSMRbDynCreate_CANSM_E_BUS_OFF=Standard
        CanSMController_CANNODE_03 (CanSMController): CanSMControllerId=CANNODE_03
    CanSMGeneral: CanSMMainFunctionTimePeriod=0.01, CanSMVersionInfoApi=false, CanSMChangeBaudrateApi=false, CanSMDevErrorDetect=false, CanSMPncSupport=false
  module config EcuC: implementation-config-variant=VARIANT-PRE-COMPILE
    EcucConfigSet
      PduCollection (EcucPduCollection): PduIdTypeEnum=uint16, PduLengthTypeEnum=uint16
        9 x Pdu, all with PduLength=8:
          UDS_Rx_Phys_CANNODE_03_CanIf2CanTp
          UDS_Rx_Phys_CANNODE_03_CanTp2PduR
          UDS_Rx_Phys_CANNODE_03_PduR2Dcm
          UDS_Rx_Func_CANNODE_03_CanIf2CanTp
          UDS_Rx_Func_CANNODE_03_CanTp2PduR
          UDS_Rx_Func_CANNODE_03_PduR2Dcm
          UDS_Tx_Phys_CANNODE_03_Dcm2PduR
          UDS_Tx_Phys_CANNODE_03_PduR2CanTp
          UDS_Tx_Phys_CANNODE_03_CanTp2CanIf
    EcuCRbSettings: EcuCRbArRelease=AR42_Rev2, EcuCRbRteInUse=false
