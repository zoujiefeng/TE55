AUTOSAR XML (schema 4-2-2)
package /Spi
  module config Spi: implementation-config-variant=VARIANT-POST-BUILD-SELECTABLE
    SpiDriver_0 (SpiDriver)
      CAN2_Trcv_TJA1145 (SpiChannel): SpiChannelType=EB, SpiDataWidth=16, SpiDefaultData=0, SpiEbMaxLength=511, SpiTransferStart=MSB
      SpiExternalDev_TJA1145_CAN2 (SpiExternalDevice):
        SpiAutoCalcBaudParams = 0
        SpiAutoCalcDelayParams = 0
        SpiCsPolarity = LOW
        SpiCsSelection = CS_VIA_PERIPHERAL_ENGINE
        SpiDataShiftEdge = LEADING
        SpiEnableCs = 1
        SpiParitySupport = Unused
        SpiQSpiParamA = 2
        SpiQSpiParamB = 1
        SpiQSpiParamC = 1
        SpiQSpiParamIPre = 1
        SpiQSpiParamIdle = 1
        SpiQSpiParamLPre = 0
        SpiQSpiParamLead = 1
        SpiQSpiParamQ = 1
        SpiQSpiParamTPre = 0
        SpiQSpiParamTq = 9
        SpiQSpiParamTrail = 1
        SpiShiftClockIdleLevel = LOW
      SpiJob_TJA1145_CAN2 (SpiJob): SpiChannelBasedCS=Enabled, SpiJobEndNotification=NULL_PTR, SpiJobPriority=0, SpiDeviceAssignment=SpiExternalDev_TJA1145_CAN2
        SpiChannelList_0 (SpiChannelList): SpiChannelIndex=0, SpiChannelAssignment=CAN2_Trcv_TJA1145
      SpiSequence_TjA1145_CAN2 (SpiSequence): SpiSeqEndNotification=NULL_PTR, SpiJobAssignment=SpiJob_TJA1145_CAN2
    SpiGeneral:
      SpiAsyncParallelTransmit = 0
      SpiBaudrateConfigAtRuntime = 0
      SpiCancelApi = 0
      SpiChannelBuffersAllowed = 1
      SpiDebugSupport = 0
      SpiDevErrorDetect = 0
      SpiHwStatusApi = 1
      SpiInterruptibleSeqAllowed = 0
      SpiLevelDelivered = 1
      SpiMainFunctionPeriod = 0.01
      SpiMaxJobTriggerQueueLength = 3
      SpiPBFixedAddress = 0
      SpiResetSfrAtInit = 0
      SpiRunningInUser0Mode = 0
      SpiSyncTransmitTimeoutDuration = 4294967295
      SpiUserModeDeInitApiEnable = 0
      SpiUserModeInitApiEnable = 0
      SpiUserModeRuntimeApiEnable = 0
      SpiVersionInfoApi = 0
