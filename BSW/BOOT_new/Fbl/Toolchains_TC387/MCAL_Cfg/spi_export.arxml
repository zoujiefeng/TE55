AUTOSAR XML (schema 4-2-2)
package /Spi
  module config Spi: implementation-config-variant=VARIANT-POST-BUILD-SELECTABLE
    SpiDriver
      CAN_Trcv_Tja1145 (SpiChannel): SpiChannelType=EB, SpiDataWidth=16, SpiEbMaxLength=511, SpiIbNBuffers=10, SpiTransferStart=MSB
      Can_Trv_Tja1145 (SpiExternalDevice):
        SpiAutoCalcBaudParams = 0
        SpiAutoCalcDelayParams = 0
        SpiCsPolarity = LOW
        SpiCsSelection = CS_VIA_PERIPHERAL_ENGINE
        SpiDataShiftEdge = LEADING
        SpiEnableCs = 1
        SpiParitySupport = UNUSED
        SpiTimeClk2Cs = 1.0E-7
        SpiTrailingTime = 1.0E-7
        SpiBaudrateParams_0 (SpiBaudrateParams): SpiBaudParamA=1, SpiBaudParamB=0, SpiBaudParamC=1, SpiBaudParamQ=10, SpiBaudParamTQ=2
        SpiDelayParams_0 (SpiDelayParams):
          SpiDelayParamIdleLength = 1
          SpiDelayParamIdlePre = 0
          SpiDelayParamLeadLength = 7
          SpiDelayParamLeadPre = 0
          SpiDelayParamTrailLength = 5
          SpiDelayParamTrailPre = 0
      TLF35584 (SpiExternalDevice):
        SpiAutoCalcBaudParams = 1
        SpiAutoCalcDelayParams = 1
        SpiBaudrate = 1000000.0
        SpiCsIdentifier = CHANNEL10
        SpiCsPolarity = LOW
        SpiCsSelection = CS_VIA_PERIPHERAL_ENGINE
        SpiDataShiftEdge = TRAILING
        SpiEnableCs = 1
        SpiHwUnit = QSPI1
        SpiIdleTime = 1.0E-7
        SpiParitySupport = EVEN
        SpiShiftClockIdleLevel = LOW
        SpiTimeClk2Cs = 1.6E-6
        SpiTrailingTime = 1.6E-6
      SpiJob_0 (SpiJob): SpiFrameBasedCS=1, SpiHwUnitSynchronous=SYNCHRONOUS, SpiJobId=0, SpiJobPriority=0, SpiDeviceAssignment=Can_Trv_Tja1145
        SpiChannelList_0 (SpiChannelList): SpiChannelIndex=0, SpiChannelAssignment=CAN_Trcv_Tja1145
      SpiSequence_0 (SpiSequence): SpiInterruptibleSequence=0, SpiSequenceId=0, SpiJobAssignment=SpiJob_0
      TLF35584_SEQ (SpiSequence): SpiInterruptibleSequence=0, SpiSeqEndNotification=TLF35584_vidSpiEndNotification, SpiSequenceId=1, SpiJobAssignment=TLF35584_JOB
    SpiGeneral:
      SpiCancelApi = 0
      SpiChannelBuffersAllowed = 1
      SpiDevErrorDetect = 0
      SpiEnableLoopBackApi = 0
      SpiHwStatusApi = 1
      SpiInitCheckApi = 0
      SpiInitDeInitApiMode = SPI_MCAL_SUPERVISOR
      SpiInterruptibleSeqAllowed = 0
      SpiLevelDelivered = 0
      SpiMultiCoreErrorDetect = 0
      SpiRuntimeApiMode = SPI_MCAL_SUPERVISOR
      SpiSafetyEnable = 0
      SpiSupportConcurrentSyncTransmit = 0
      SpiSyncTransmitTimeoutDuration = 4294967295
      SpiVersionInfoApi = 0
