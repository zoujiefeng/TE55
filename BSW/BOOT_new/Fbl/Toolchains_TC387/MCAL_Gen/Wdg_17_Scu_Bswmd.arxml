AUTOSAR XML (schema 4-2-2)
# Copyright (C) Infineon Technologies (2021)
# All rights reserved.
package /AUTOSAR_Wdg_17_Scu/BswModuleDescriptions
  bsw module description Wdg: category=BSW_MODULE, module-id=102, provided-entrys=[Wdg_Init, Wdg_SetMode, Wdg_SetTriggerCondition, Wdg_Isr]  # WDG Driver
    bsw module dependency DetDependency: target-module-id=15, required-entrys=Det_ReportError
    bsw module dependency McuDependency: target-module-id=101
      required-entrys:
        Mcu_17_Gtm_TomChannelInit
        Mcu_17_Gtm_TomChannelShadowTransfer
        Mcu_17_Gtm_TomChannelEnable
        Mcu_17_Gtm_TomChannelDisable
        Mcu_17_Gtm_AtomChannelInit
        Mcu_17_Gtm_AtomChannelShadowTransfer
        Mcu_17_Gtm_AtomChannelEnable
        Mcu_17_Gtm_AtomChannelDisable
        Mcu_17_Gtm_TomChInitCheck
        Mcu_17_Gtm_AtomChInitCheck
    bsw module dependency McalLibDependency: target-module-id=255, required-entrys=[Mcal_GetCpuIndex, Mcal_WriteCpuEndInitProtReg]
    bsw internal behavior WdgBehavior
      exclusive area TimerHandling
      exclusive area ChangeMode
      exclusive area CpuEndInit
      bsw called entity Wdg_Init: can-enter-exclusive-area=[TimerHandling, CpuEndInit, ChangeMode], reentrancy-level=MULTICORE-REENTRANT, implemented-entry=Wdg_Init
      bsw called entity Wdg_SetMode: can-enter-exclusive-area=[TimerHandling, CpuEndInit, ChangeMode], reentrancy-level=MULTICORE-REENTRANT, implemented-entry=Wdg_SetMode
      bsw called entity Wdg_SetTriggerCondition: can-enter-exclusive-area=[TimerHandling, CpuEndInit], reentrancy-level=MULTICORE-REENTRANT, implemented-entry=Wdg_SetTriggerCondition
      bsw interrupt entity Wdg_Isr: can-enter-exclusive-area=[TimerHandling, CpuEndInit], reentrancy-level=MULTICORE-REENTRANT, implemented-entry=Wdg_Isr
package /AUTOSAR_Wdg_17_Scu/BswModuleEntrys
  4 x bsw module entry, all with is-reentrant=true, is-synchronous=true, sw-service-impl-policy=STANDARD:
    Wdg_Init: service-id=0, call-type=REGULAR, execution-context=TASK
      sw service arg ConfigPtr: category=DATA_REFERENCE, sw-pointer-target-props={target-category=TYPE_REFERENCE, implementation-data-type=Wdg_17_Scu_ConfigType}
    Wdg_SetMode: service-id=1, call-type=REGULAR, execution-context=TASK
      return type Return: implementation-data-type=Std_ReturnType
      sw service arg Mode: implementation-data-type=WdgIf_ModeType
    Wdg_SetTriggerCondition: service-id=3, call-type=REGULAR, execution-context=TASK
      sw service arg timeout: implementation-data-type=uint16
    Wdg_Isr: service-id=5, call-type=INTERRUPT, execution-context=INTERRUPT-CAT-1
      sw service arg LogicalChId: implementation-data-type=uint8
      sw service arg IsrStatus: implementation-data-type=uint32
package /AUTOSAR_Wdg_17_Scu/Implementations
  bsw implementation Wdg: programming-language=C, sw-version=20.10.0, vendor-id=17, ar-release-version=4.2.2, behavior=WdgBehavior, vendor-api-infix=Scu, vendor-specific-module-def=Wdg
    code-descriptors:
      code Files
        artifact-descriptors:
          short-label=ssc::src::Wdg_17_Scu.c, category=SWSRC
          short-label=ssc::inc::Wdg_17_Scu.h, category=SWHDR
    generated-artifacts:
      5 x dependency on artifact:
        Wdg_17_Scu_PBcfg_c: artifact-descriptor={short-label=src::Wdg_17_Scu_PBCfg.c, category=SWTEMPLATE}, usages=EXECUTE
        Wdg_17_Scu_Cfg_h: artifact-descriptor={short-label=inc::Wdg_17_Scu_Cfg.h, category=SWTEMPLATE}, usages=COMPILE
        Wdg_17_Scu_PBcfg_h: artifact-descriptor={short-label=inc::Wdg_17_Scu_PBcfg.h, category=SWTEMPLATE}, usages=EXECUTE
        Wdg_17_Scu_xdm: artifact-descriptor={short-label=config::Wdg_17_Scu.xdm, category=SWTOOL}, usages=CODEGENERATION
        Wdg_bmd: artifact-descriptor={short-label=autosar::TC38x::TC387x::Wdg_17_Scu.bmd, category=SWTOOL}, usages=CODEGENERATION
    resource consumption ResourceConsumption
      6 x memory section:
        VAR_CLEARED_ASIL_B_GLOBAL_32: alignment=32, sw-addrmethod=VAR_CLEARED
        CONST_ASIL_B_GLOBAL_UNSPECIFIED: alignment=UNSPECIFIED, sw-addrmethod=CONST
        CONFIG_DATA_ASIL_B_CORE0_UNSPECIFIED: alignment=UNSPECIFIED, sw-addrmethod=CONFIG_DATA
        VAR_CLEARED_ASIL_B_CORE0_UNSPECIFIED: alignment=UNSPECIFIED, sw-addrmethod=VAR_CLEARED
        CODE_ASIL_B_GLOBAL: alignment=UNSPECIFIED, sw-addrmethod=CODE
        CODE_FAST_ASIL_B_GLOBAL: alignment=UNSPECIFIED, sw-addrmethod=CODE_FAST
      section name prefix WDG_17_SCU
package /AUTOSAR_Wdg_17_Scu/ImplementationDataTypes
  impl type Wdg_17_Scu_ConfigType: category=STRUCTURE, type-emitter=BSW
    11 x element:
      DefaultMode: implementation-data-type=WdgIf_ModeType
      FastModeRefreshTime: implementation-data-type=uint16
      FastModeReloadValue: implementation-data-type=uint16
      InitialRefreshTime: implementation-data-type=uint16
      MaxTimeOutTime: implementation-data-type=uint16
      SlowModeRefreshTime: implementation-data-type=uint16
      SlowModeRelodValue: implementation-data-type=uint16
      WdgCoreID: implementation-data-type=uint32
      WdgDisableAllowed: implementation-data-type=boolean
      WdgGtmTimerInfo: category=DATA_REFERENCE, sw-pointer-target-props={target-category=TYPE_REFERENCE, implementation-data-type=Mcu_17_Gtm_TomAtomChConfigType}
      WdgPassword: implementation-data-type=uint32
